[part 17 of 23: packages /BaseType to /PhysicalDimension]
AUTOSAR XML (schema 4-3-0)
package /BaseType
  3236 x base type, all with category=FIXED_LENGTH:
    BT_AAU_Geblaese: base-type-encoding=NONE
    BT_AB_Abschaltanf_SIH_BF: base-type-encoding=NONE
    BT_AB_Anforderung_eCall: base-type-encoding=NONE
    BT_AB_Anforderung_USM: base-type-encoding=NONE
    BT_AB_Anprall_FGS: base-type-encoding=NONE
    BT_AB_Anprall_Front_Beifahrer: base-type-encoding=NONE
    BT_AB_Anprall_Front_Fahrer: base-type-encoding=NONE
    BT_AB_Anprall_Heck: base-type-encoding=NONE
    BT_AB_Anprall_Seite_Beifahrer: base-type-encoding=NONE
    BT_AB_Anprall_Seite_Fahrer: base-type-encoding=NONE
    BT_AB_Anzeige_Fussg: base-type-encoding=NONE
    BT_AB_Belegung_VB: base-type-encoding=NONE
    BT_AB_Belegung_VF: base-type-encoding=NONE
    BT_AB_Belegung_VF_ext: base-type-encoding=NONE
    BT_AB_Belegung_VF_ext_aktiv: base-type-encoding=NONE
    BT_AB_Crash_Int: base-type-encoding=NONE
    BT_AB_Crashschwere: base-type-encoding=NONE
    BT_AB_Deaktiviert: base-type-encoding=NONE
    BT_AB_Deaktivierung_HV: base-type-encoding=NONE
    BT_AB_Diagnose: base-type-encoding=NONE
    BT_AB_eCS_Error: base-type-encoding=NONE
    BT_AB_EDR_Trigger: base-type-encoding=NONE
    BT_AB_Erh_Auf_VB: base-type-encoding=NONE
    BT_AB_Front_Crash: base-type-encoding=NONE
    BT_AB_Gurtschloss_BF: base-type-encoding=NONE
    BT_AB_Gurtschloss_FA: base-type-encoding=NONE
    BT_AB_Gurtschloss_FA_ext: base-type-encoding=NONE
    BT_AB_Gurtschloss_FA_ext_aktiv: base-type-encoding=NONE
    BT_AB_Gurtschloss_MI: base-type-encoding=NONE
    BT_AB_Gurtschloss_Reihe2_BF: base-type-encoding=NONE
    BT_AB_Gurtschloss_Reihe2_FA: base-type-encoding=NONE
    BT_AB_Gurtschloss_Reihe2_MI: base-type-encoding=NONE
    BT_AB_Gurtschloss_Reihe3_BF: base-type-encoding=NONE
    BT_AB_Gurtschloss_Reihe3_FA: base-type-encoding=NONE
    BT_AB_Gurtschloss_Reihe3_MI: base-type-encoding=NONE
    BT_AB_Gurtschloss_Reihe4_BF: base-type-encoding=NONE
    BT_AB_Gurtschloss_Reihe4_FA: base-type-encoding=NONE
    BT_AB_Gurtschloss_Reihe4_MI: base-type-encoding=NONE
    BT_AB_Gurtwarn_Reihe2_BF: base-type-encoding=NONE
    BT_AB_Gurtwarn_Reihe2_FA: base-type-encoding=NONE
    BT_AB_Gurtwarn_Reihe2_MI: base-type-encoding=NONE
    BT_AB_Gurtwarn_Reihe3_BF: base-type-encoding=NONE
    BT_AB_Gurtwarn_Reihe3_FA: base-type-encoding=NONE
    BT_AB_Gurtwarn_Reihe3_MI: base-type-encoding=NONE
    BT_AB_Gurtwarn_Reihe4_BF: base-type-encoding=NONE
    BT_AB_Gurtwarn_Reihe4_FA: base-type-encoding=NONE
    BT_AB_Gurtwarn_Reihe4_MI: base-type-encoding=NONE
    BT_AB_Gurtwarn_VB: base-type-encoding=NONE
    BT_AB_Gurtwarn_VF: base-type-encoding=NONE
    BT_AB_Gurtwarn_VM: base-type-encoding=NONE
    BT_AB_Heck_Crash: base-type-encoding=NONE
    BT_AB_Lampe: base-type-encoding=NONE
    BT_AB_MKB_Anforderung: base-type-encoding=NONE
    BT_AB_MKB_gueltig: base-type-encoding=NONE
    BT_AB_PAO_Leuchte_Anf: base-type-encoding=NONE
    BT_AB_PSS_SollZustand: base-type-encoding=NONE
    BT_AB_RGS_Anst: base-type-encoding=NONE
    BT_AB_Rollover_Crash: base-type-encoding=NONE
    BT_AB_SB_Crash: base-type-encoding=NONE
    BT_AB_SBR_hinten_verbau: base-type-encoding=NONE
    BT_AB_SF_Crash: base-type-encoding=NONE
    BT_AB_Sitzpos_Sens_BF: base-type-encoding=NONE
    BT_AB_Sitzpos_Sens_FA: base-type-encoding=NONE
    BT_AB_Stellgliedtest: base-type-encoding=NONE
    BT_AB_Systemfehler: base-type-encoding=NONE
    BT_AB_Texte_AKS: base-type-encoding=NONE
    BT_AB_VB_deaktiviert: base-type-encoding=NONE
    BT_AB_Versorgungsspannung: base-type-encoding=NONE
    BT_AB_Wickelklappung_Reihe2_BF: base-type-encoding=NONE
    BT_AB_Wickelklappung_Reihe2_FA: base-type-encoding=NONE
    BT_AB_Wickelklappung_Reihe2_MI: base-type-encoding=NONE
    BT_AB_wSBR_Batteriestatus: base-type-encoding=NONE
    BT_ABS_Bremsung: base-type-encoding=NONE
    BT_AbstWarn_MV_FAS_Fkt_Status: base-type-encoding=NONE
    BT_ACT401_Adresse_Aktuator: base-type-encoding=NONE
    BT_ACT401_Blockierung_aufgetreten: base-type-encoding=NONE
    BT_ACT401_Drehrichtung: base-type-encoding=NONE
    BT_ACT401_Elektr_Defekt: base-type-encoding=NONE
    BT_ACT401_Freigabe_Blockiererkennung: base-type-encoding=NONE
    BT_ACT401_Geschwindigkeitsstatus: base-type-encoding=NONE
    BT_ACT401_Ist_Position_Aktuator: base-type-encoding=NONE
    BT_ACT401_Notlauf_aufgetreten: base-type-encoding=NONE
    BT_ACT401_Notlauffreigabe: base-type-encoding=NONE
    BT_ACT401_Notlaufposition: base-type-encoding=NONE
    BT_ACT401_Positionsvorgabe_Status: base-type-encoding=NONE
    BT_ACT401_Reset: base-type-encoding=NONE
    BT_ACT401_ResponseError: base-type-encoding=NONE
    BT_ACT401_Selbsthaltemoment: base-type-encoding=NONE
    BT_ACT401_Sonderfunktionen: base-type-encoding=NONE
    BT_ACT401_Spulenbestromung: base-type-encoding=NONE
    BT_ACT401_Stopmodus: base-type-encoding=NONE
    BT_ACT401_Uebertemperatur: base-type-encoding=NONE
    BT_ACT401_Variante: base-type-encoding=NONE
    BT_ACT401_Verfahrrichtung: base-type-encoding=NONE
    BT_ACT401_Versorgungsspannung: base-type-encoding=NONE
    BT_ACT402_Adresse_Aktuator: base-type-encoding=NONE
    BT_ACT402_Blockierung_aufgetreten: base-type-encoding=NONE
    BT_ACT402_Drehrichtung: base-type-encoding=NONE
    BT_ACT402_Elektr_Defekt: base-type-encoding=NONE
    BT_ACT402_Freigabe_Blockiererkennung: base-type-encoding=NONE
    BT_ACT402_Geschwindigkeitsstatus: base-type-encoding=NONE
    BT_ACT402_Ist_Position_Aktuator: base-type-encoding=NONE
    BT_ACT402_Notlauf_aufgetreten: base-type-encoding=NONE
    BT_ACT402_Notlauffreigabe: base-type-encoding=NONE
    BT_ACT402_Notlaufposition: base-type-encoding=NONE
    BT_ACT402_Positionsvorgabe_Status: base-type-encoding=NONE
    BT_ACT402_Reset: base-type-encoding=NONE
    BT_ACT402_ResponseError: base-type-encoding=NONE
    BT_ACT402_Selbsthaltemoment: base-type-encoding=NONE
    BT_ACT402_Sonderfunktionen: base-type-encoding=NONE
    BT_ACT402_Spulenbestromung: base-type-encoding=NONE
    BT_ACT402_Stopmodus: base-type-encoding=NONE
    BT_ACT402_Uebertemperatur: base-type-encoding=NONE
    BT_ACT402_Variante: base-type-encoding=NONE
    BT_ACT402_Verfahrrichtung: base-type-encoding=NONE
    BT_ACT402_Versorgungsspannung: base-type-encoding=NONE
    BT_ACT403_Adresse_Aktuator: base-type-encoding=NONE
    BT_ACT403_Blockierung_aufgetreten: base-type-encoding=NONE
    BT_ACT403_Drehrichtung: base-type-encoding=NONE
    BT_ACT403_Elektr_Defekt: base-type-encoding=NONE
    BT_ACT403_Freigabe_Blockiererkennung: base-type-encoding=NONE
    BT_ACT403_Geschwindigkeitsstatus: base-type-encoding=NONE
    BT_ACT403_Ist_Position_Aktuator: base-type-encoding=NONE
    BT_ACT403_Notlauf_aufgetreten: base-type-encoding=NONE
    BT_ACT403_Notlauffreigabe: base-type-encoding=NONE
    BT_ACT403_Notlaufposition: base-type-encoding=NONE
    BT_ACT403_Positionsvorgabe_Status: base-type-encoding=NONE
    BT_ACT403_Reset: base-type-encoding=NONE
    BT_ACT403_ResponseError: base-type-encoding=NONE
    BT_ACT403_Selbsthaltemoment: base-type-encoding=NONE
    BT_ACT403_Sonderfunktionen: base-type-encoding=NONE
    BT_ACT403_Spulenbestromung: base-type-encoding=NONE
    BT_ACT403_Stopmodus: base-type-encoding=NONE
    BT_ACT403_Uebertemperatur: base-type-encoding=NONE
    BT_ACT403_Variante: base-type-encoding=NONE
    BT_ACT403_Verfahrrichtung: base-type-encoding=NONE
    BT_ACT403_Versorgungsspannung: base-type-encoding=NONE
    BT_ACT404_Adresse_Aktuator: base-type-encoding=NONE
    BT_ACT404_Blockierung_aufgetreten: base-type-encoding=NONE
    BT_ACT404_Drehrichtung: base-type-encoding=NONE
    BT_ACT404_Elektr_Defekt: base-type-encoding=NONE
    BT_ACT404_Freigabe_Blockiererkennung: base-type-encoding=NONE
    BT_ACT404_Geschwindigkeitsstatus: base-type-encoding=NONE
    BT_ACT404_Ist_Position_Aktuator: base-type-encoding=NONE
    BT_ACT404_Notlauf_aufgetreten: base-type-encoding=NONE
    BT_ACT404_Notlauffreigabe: base-type-encoding=NONE
    BT_ACT404_Notlaufposition: base-type-encoding=NONE
    BT_ACT404_Positionsvorgabe_Status: base-type-encoding=NONE
    BT_ACT404_Reset: base-type-encoding=NONE
    BT_ACT404_ResponseError: base-type-encoding=NONE
    BT_ACT404_Selbsthaltemoment: base-type-encoding=NONE
    BT_ACT404_Sonderfunktionen: base-type-encoding=NONE
    BT_ACT404_Spulenbestromung: base-type-encoding=NONE
    BT_ACT404_Stopmodus: base-type-encoding=NONE
    BT_ACT404_Uebertemperatur: base-type-encoding=NONE
    BT_ACT404_Variante: base-type-encoding=NONE
    BT_ACT404_Verfahrrichtung: base-type-encoding=NONE
    BT_ACT404_Versorgungsspannung: base-type-encoding=NONE
    BT_ACT405_Adresse_Aktuator: base-type-encoding=NONE
    BT_ACT405_Blockierung_aufgetreten: base-type-encoding=NONE
    BT_ACT405_Drehrichtung: base-type-encoding=NONE
    BT_ACT405_Elektr_Defekt: base-type-encoding=NONE
    BT_ACT405_Freigabe_Blockiererkennung: base-type-encoding=NONE
    BT_ACT405_Geschwindigkeitsstatus: base-type-encoding=NONE
    BT_ACT405_Ist_Position_Aktuator: base-type-encoding=NONE
    BT_ACT405_Notlauf_aufgetreten: base-type-encoding=NONE
    BT_ACT405_Notlauffreigabe: base-type-encoding=NONE
    BT_ACT405_Notlaufposition: base-type-encoding=NONE
    BT_ACT405_Positionsvorgabe_Status: base-type-encoding=NONE
    BT_ACT405_Reset: base-type-encoding=NONE
    BT_ACT405_ResponseError: base-type-encoding=NONE
    BT_ACT405_Selbsthaltemoment: base-type-encoding=NONE
    BT_ACT405_Sonderfunktionen: base-type-encoding=NONE
    BT_ACT405_Spulenbestromung: base-type-encoding=NONE
    BT_ACT405_Stopmodus: base-type-encoding=NONE
    BT_ACT405_Uebertemperatur: base-type-encoding=NONE
    BT_ACT405_Variante: base-type-encoding=NONE
    BT_ACT405_Verfahrrichtung: base-type-encoding=NONE
    BT_ACT405_Versorgungsspannung: base-type-encoding=NONE
    BT_ACT406_Adresse_Aktuator: base-type-encoding=NONE
    BT_ACT406_Blockierung_aufgetreten: base-type-encoding=NONE
    BT_ACT406_Drehrichtung: base-type-encoding=NONE
    BT_ACT406_Elektr_Defekt: base-type-encoding=NONE
    BT_ACT406_Freigabe_Blockiererkennung: base-type-encoding=NONE
    BT_ACT406_Geschwindigkeitsstatus: base-type-encoding=NONE
    BT_ACT406_Ist_Position_Aktuator: base-type-encoding=NONE
    BT_ACT406_Notlauf_aufgetreten: base-type-encoding=NONE
    BT_ACT406_Notlauffreigabe: base-type-encoding=NONE
    BT_ACT406_Notlaufposition: base-type-encoding=NONE
    BT_ACT406_Positionsvorgabe_Status: base-type-encoding=NONE
    BT_ACT406_Reset: base-type-encoding=NONE
    BT_ACT406_ResponseError: base-type-encoding=NONE
    BT_ACT406_Selbsthaltemoment: base-type-encoding=NONE
    BT_ACT406_Sonderfunktionen: base-type-encoding=NONE
    BT_ACT406_Spulenbestromung: base-type-encoding=NONE
    BT_ACT406_Stopmodus: base-type-encoding=NONE
    BT_ACT406_Uebertemperatur: base-type-encoding=NONE
    BT_ACT406_Variante: base-type-encoding=NONE
    BT_ACT406_Verfahrrichtung: base-type-encoding=NONE
    BT_ACT406_Versorgungsspannung: base-type-encoding=NONE
    BT_ACT407_Adresse_Aktuator: base-type-encoding=NONE
    BT_ACT407_Blockierung_aufgetreten: base-type-encoding=NONE
    BT_ACT407_Drehrichtung: base-type-encoding=NONE
    BT_ACT407_Elektr_Defekt: base-type-encoding=NONE
    BT_ACT407_Freigabe_Blockiererkennung: base-type-encoding=NONE
    BT_ACT407_Geschwindigkeitsstatus: base-type-encoding=NONE
    BT_ACT407_Ist_Position_Aktuator: base-type-encoding=NONE
    BT_ACT407_Notlauf_aufgetreten: base-type-encoding=NONE
    BT_ACT407_Notlauffreigabe: base-type-encoding=NONE
    BT_ACT407_Notlaufposition: base-type-encoding=NONE
    BT_ACT407_Positionsvorgabe_Status: base-type-encoding=NONE
    BT_ACT407_Reset: base-type-encoding=NONE
    BT_ACT407_ResponseError: base-type-encoding=NONE
    BT_ACT407_Selbsthaltemoment: base-type-encoding=NONE
    BT_ACT407_Sonderfunktionen: base-type-encoding=NONE
    BT_ACT407_Spulenbestromung: base-type-encoding=NONE
    BT_ACT407_Stopmodus: base-type-encoding=NONE
    BT_ACT407_Uebertemperatur: base-type-encoding=NONE
    BT_ACT407_Variante: base-type-encoding=NONE
    BT_ACT407_Verfahrrichtung: base-type-encoding=NONE
    BT_ACT407_Versorgungsspannung: base-type-encoding=NONE
    BT_ACT408_Adresse_Aktuator: base-type-encoding=NONE
    BT_ACT408_Blockierung_aufgetreten: base-type-encoding=NONE
    BT_ACT408_Drehrichtung: base-type-encoding=NONE
    BT_ACT408_Elektr_Defekt: base-type-encoding=NONE
    BT_ACT408_Freigabe_Blockiererkennung: base-type-encoding=NONE
    BT_ACT408_Geschwindigkeitsstatus: base-type-encoding=NONE
    BT_ACT408_Ist_Position_Aktuator: base-type-encoding=NONE
    BT_ACT408_Notlauf_aufgetreten: base-type-encoding=NONE
    BT_ACT408_Notlauffreigabe: base-type-encoding=NONE
    BT_ACT408_Notlaufposition: base-type-encoding=NONE
    BT_ACT408_Positionsvorgabe_Status: base-type-encoding=NONE
    BT_ACT408_Reset: base-type-encoding=NONE
    BT_ACT408_ResponseError: base-type-encoding=NONE
    BT_ACT408_Selbsthaltemoment: base-type-encoding=NONE
    BT_ACT408_Sonderfunktionen: base-type-encoding=NONE
    BT_ACT408_Spulenbestromung: base-type-encoding=NONE
    BT_ACT408_Stopmodus: base-type-encoding=NONE
    BT_ACT408_Uebertemperatur: base-type-encoding=NONE
    BT_ACT408_Variante: base-type-encoding=NONE
    BT_ACT408_Verfahrrichtung: base-type-encoding=NONE
    BT_ACT408_Versorgungsspannung: base-type-encoding=NONE
    BT_ACT409_Adresse_Aktuator: base-type-encoding=NONE
    BT_ACT409_Blockierung_aufgetreten: base-type-encoding=NONE
    BT_ACT409_Drehrichtung: base-type-encoding=NONE
    BT_ACT409_Elektr_Defekt: base-type-encoding=NONE
    BT_ACT409_Freigabe_Blockiererkennung: base-type-encoding=NONE
    BT_ACT409_Geschwindigkeitsstatus: base-type-encoding=NONE
    BT_ACT409_Ist_Position_Aktuator: base-type-encoding=NONE
    BT_ACT409_Notlauf_aufgetreten: base-type-encoding=NONE
    BT_ACT409_Notlauffreigabe: base-type-encoding=NONE
    BT_ACT409_Notlaufposition: base-type-encoding=NONE
    BT_ACT409_Positionsvorgabe_Status: base-type-encoding=NONE
    BT_ACT409_Reset: base-type-encoding=NONE
    BT_ACT409_ResponseError: base-type-encoding=NONE
    BT_ACT409_Selbsthaltemoment: base-type-encoding=NONE
    BT_ACT409_Sonderfunktionen: base-type-encoding=NONE
    BT_ACT409_Spulenbestromung: base-type-encoding=NONE
    BT_ACT409_Stopmodus: base-type-encoding=NONE
    BT_ACT409_Uebertemperatur: base-type-encoding=NONE
    BT_ACT409_Variante: base-type-encoding=NONE
    BT_ACT409_Verfahrrichtung: base-type-encoding=NONE
    BT_ACT409_Versorgungsspannung: base-type-encoding=NONE
    BT_ACT410_Adresse_Aktuator: base-type-encoding=NONE
    BT_ACT410_Blockierung_aufgetreten: base-type-encoding=NONE
    BT_ACT410_Drehrichtung: base-type-encoding=NONE
    BT_ACT410_Elektr_Defekt: base-type-encoding=NONE
    BT_ACT410_Freigabe_Blockiererkennung: base-type-encoding=NONE
    BT_ACT410_Geschwindigkeitsstatus: base-type-encoding=NONE
    BT_ACT410_Ist_Position_Aktuator: base-type-encoding=NONE
    BT_ACT410_Notlauf_aufgetreten: base-type-encoding=NONE
    BT_ACT410_Notlauffreigabe: base-type-encoding=NONE
    BT_ACT410_Notlaufposition: base-type-encoding=NONE
    BT_ACT410_Positionsvorgabe_Status: base-type-encoding=NONE
    BT_ACT410_Reset: base-type-encoding=NONE
    BT_ACT410_ResponseError: base-type-encoding=NONE
    BT_ACT410_Selbsthaltemoment: base-type-encoding=NONE
    BT_ACT410_Sonderfunktionen: base-type-encoding=NONE
    BT_ACT410_Spulenbestromung: base-type-encoding=NONE
    BT_ACT410_Stopmodus: base-type-encoding=NONE
    BT_ACT410_Uebertemperatur: base-type-encoding=NONE
    BT_ACT410_Variante: base-type-encoding=NONE
    BT_ACT410_Verfahrrichtung: base-type-encoding=NONE
    BT_ACT410_Versorgungsspannung: base-type-encoding=NONE
    BT_ACT411_Adresse_Aktuator: base-type-encoding=NONE
    BT_ACT411_Blockierung_aufgetreten: base-type-encoding=NONE
    BT_ACT411_Drehrichtung: base-type-encoding=NONE
    BT_ACT411_Elektr_Defekt: base-type-encoding=NONE
    BT_ACT411_Freigabe_Blockiererkennung: base-type-encoding=NONE
    BT_ACT411_Geschwindigkeitsstatus: base-type-encoding=NONE
    BT_ACT411_Ist_Position_Aktuator: base-type-encoding=NONE
    BT_ACT411_Notlauf_aufgetreten: base-type-encoding=NONE
    BT_ACT411_Notlauffreigabe: base-type-encoding=NONE
    BT_ACT411_Notlaufposition: base-type-encoding=NONE
    BT_ACT411_Positionsvorgabe_Status: base-type-encoding=NONE
    BT_ACT411_Reset: base-type-encoding=NONE
    BT_ACT411_ResponseError: base-type-encoding=NONE
    BT_ACT411_Selbsthaltemoment: base-type-encoding=NONE
    BT_ACT411_Sonderfunktionen: base-type-encoding=NONE
    BT_ACT411_Spulenbestromung: base-type-encoding=NONE
    BT_ACT411_Stopmodus: base-type-encoding=NONE
    BT_ACT411_Uebertemperatur: base-type-encoding=NONE
    BT_ACT411_Variante: base-type-encoding=NONE
    BT_ACT411_Verfahrrichtung: base-type-encoding=NONE
    BT_ACT411_Versorgungsspannung: base-type-encoding=NONE
    BT_ACT412_Adresse_Aktuator: base-type-encoding=NONE
    BT_ACT412_Blockierung_aufgetreten: base-type-encoding=NONE
    BT_ACT412_Drehrichtung: base-type-encoding=NONE
    BT_ACT412_Elektr_Defekt: base-type-encoding=NONE
    BT_ACT412_Freigabe_Blockiererkennung: base-type-encoding=NONE
    BT_ACT412_Geschwindigkeitsstatus: base-type-encoding=NONE
    BT_ACT412_Ist_Position_Aktuator: base-type-encoding=NONE
    BT_ACT412_Notlauf_aufgetreten: base-type-encoding=NONE
    BT_ACT412_Notlauffreigabe: base-type-encoding=NONE
    BT_ACT412_Notlaufposition: base-type-encoding=NONE
    BT_ACT412_Positionsvorgabe_Status: base-type-encoding=NONE
    BT_ACT412_Reset: base-type-encoding=NONE
    BT_ACT412_ResponseError: base-type-encoding=NONE
    BT_ACT412_Selbsthaltemoment: base-type-encoding=NONE
    BT_ACT412_Sonderfunktionen: base-type-encoding=NONE
    BT_ACT412_Spulenbestromung: base-type-encoding=NONE
    BT_ACT412_Stopmodus: base-type-encoding=NONE
    BT_ACT412_Uebertemperatur: base-type-encoding=NONE
    BT_ACT412_Variante: base-type-encoding=NONE
    BT_ACT412_Verfahrrichtung: base-type-encoding=NONE
    BT_ACT412_Versorgungsspannung: base-type-encoding=NONE
    BT_Adresse_ION: base-type-encoding=NONE
    BT_Adresse_PCU: base-type-encoding=NONE
    BT_Adressegment_ION: base-type-encoding=NONE
    BT_Airbag_01_BZ: base-type-encoding=NONE
    BT_Airbag_01_CRC: base-type-encoding=NONE
    BT_Airbag_02_BZ: base-type-encoding=NONE
    BT_Airbag_02_CRC: base-type-encoding=NONE
    BT_Airbag_04_BZ: base-type-encoding=NONE
    BT_Airbag_04_CRC: base-type-encoding=NONE
    BT_Anlernen_LLR_li: base-type-encoding=NONE
    BT_Anlernen_LLR_re: base-type-encoding=NONE
    BT_APS_Tongeber_defekt: base-type-encoding=NONE
    BT_AQS_COBereich: base-type-encoding=NONE
    BT_AQS_COStatus: base-type-encoding=NONE
    BT_AQS_COWert: base-type-encoding=NONE
    BT_AQS_HW: base-type-encoding=NONE
    BT_AQS_Luftguete: base-type-encoding=NONE
    BT_AQS_NoxBereich: base-type-encoding=NONE
    BT_AQS_NoxStatus: base-type-encoding=NONE
    BT_AQS_NoxWert: base-type-encoding=NONE
    BT_AQS_Parameter: base-type-encoding=NONE
    BT_AQS_ResponseError: base-type-encoding=NONE
    BT_AQS_Sensorheizung: base-type-encoding=NONE
    BT_AQS_Sensorheizung_Status: base-type-encoding=NONE
    BT_AQS_SW: base-type-encoding=NONE
    BT_AQS_Toggle: base-type-encoding=NONE
    BT_AQS_Traffic: base-type-encoding=NONE
    BT_ASM_Masterzeit_02: base-type-encoding=NONE
    BT_ASR_Anf: base-type-encoding=NONE
    BT_ASR_Schalteingriff: base-type-encoding=NONE
    BT_ASR_Tastung_passiv: base-type-encoding=NONE
    BT_ASW_HMI_defekt: base-type-encoding=NONE
    BT_ASW_wakeup: base-type-encoding=NONE
    BT_ASW_Warnung_aktiv_BFS: base-type-encoding=NONE
    BT_ASW_Warnung_aktiv_FS: base-type-encoding=NONE
    BT_ASW_Warnung_aktiv_HBFS: base-type-encoding=NONE
    BT_ASW_Warnung_aktiv_HFS: base-type-encoding=NONE
    BT_Aussentemp_ungef: base-type-encoding=NONE
    BT_AWV_Einstellung_System_ASG: base-type-encoding=NONE
    BT_AWV_Einstellung_Warnung_ASG: base-type-encoding=NONE
    BT_bCall_active: base-type-encoding=NONE
    BT_BCM1_AFS_Lampe: base-type-encoding=NONE
    BT_BCM1_Aussen_Temp_ungef: base-type-encoding=NONE
    BT_BCM1_EasyEntry_Status: base-type-encoding=NONE
    BT_BCM1_FStatus_Aussentemp_ungef: base-type-encoding=NONE
    BT_BCM1_Kl_15_HW_erkannt: base-type-encoding=NONE
    BT_BCM1_Kl_15_Sig_HW_erkannt: base-type-encoding=NONE
    BT_BCM1_Kompressorstrom_ist: base-type-encoding=NONE
    BT_BCM1_Lenksaeule_aktiv: base-type-encoding=NONE
    BT_BCM1_MH_Schalter: base-type-encoding=NONE
    BT_BCM1_MH_WIV_Schalter: base-type-encoding=NONE
    BT_BCM1_NV_Taster: base-type-encoding=NONE
    BT_BCM1_OBD_FStatus_ATemp: base-type-encoding=NONE
    BT_BCM1_PTC_stufig_Status: base-type-encoding=NONE
    BT_BCM1_Reisemodus_Texte: base-type-encoding=NONE
    BT_BCM1_Rueckfahrlicht_Schalter: base-type-encoding=NONE
    BT_BCM1_Spannungs_Anf: base-type-encoding=NONE
    BT_BCM1_SRA_aktiv: base-type-encoding=NONE
    BT_BCM1_Stellgroesse_Kl_58s: base-type-encoding=NONE
    BT_BCM1_Valet_Parking_Taster: base-type-encoding=NONE
    BT_BCM1_Warnblink_Taster: base-type-encoding=NONE
    BT_BCM_01_BZ: base-type-encoding=NONE
    BT_BCM_01_CRC: base-type-encoding=NONE
    BT_BCM_Anf_AAW_MoLaWa: base-type-encoding=NONE
    BT_BCM_Bremsbelag_Sensor: base-type-encoding=NONE
    BT_BCM_Bremsfluessigkeit_Sensor: base-type-encoding=NONE
    BT_BCM_Charisma_Taste2: base-type-encoding=NONE
    BT_BCM_Eco_Charisma_Taste: base-type-encoding=NONE
    BT_BCM_FH_Freigabe: base-type-encoding=NONE
    BT_BCM_Handbremse_Hinweis: base-type-encoding=NONE
    BT_BCM_HDF_betaetigt: base-type-encoding=NONE
    BT_BCM_Heizungsabsperrventil_Status: base-type-encoding=NONE
    BT_BCM_Heizungspumpe_Status: base-type-encoding=NONE
    BT_BCM_HSK_Freigabe: base-type-encoding=NONE
    BT_BCM_Hybrid_StartStopp_Taste: base-type-encoding=NONE
    BT_BCM_Hybrid_StSt_Taste_Fehler: base-type-encoding=NONE
    BT_BCM_Komfortfkt_Freigabe: base-type-encoding=NONE
    BT_BCM_Kompressorkupplung_Status: base-type-encoding=NONE
    BT_BCM_Kuehlmittel_Sensor: base-type-encoding=NONE
    BT_BCM_Kuehlmittel_Sensor_02: base-type-encoding=NONE
    BT_BCM_Offroad_Taste: base-type-encoding=NONE
    BT_BCM_Relais_2_Batterie: base-type-encoding=NONE
    BT_BCM_Remotestart_Betrieb: base-type-encoding=NONE
    BT_BCM_ValetTaster_Fkts_LED: base-type-encoding=NONE
    BT_BCM_Verdeck_Freigabe: base-type-encoding=NONE
    BT_BCM_Waschwasser_Sensor: base-type-encoding=NONE
    BT_BEM_06_BZ: base-type-encoding=NONE
    BT_BEM_06_CRC: base-type-encoding=NONE
    BT_BEM_Anf_KL15_schalten: base-type-encoding=NONE
    BT_BEM_Batt_Ab: base-type-encoding=NONE
    BT_BEM_Batteriediagnose: base-type-encoding=NONE
    BT_BEM_DFM: base-type-encoding=NONE
    BT_BEM_EMLIN_ungueltig: base-type-encoding=NONE
    BT_BEM_Generatordiagnose: base-type-encoding=NONE
    BT_BEM_HL_Kontingentierung: base-type-encoding=NONE
    BT_BEM_HL_Regelung_Status: base-type-encoding=NONE
    BT_BEM_Ladezustand: base-type-encoding=NONE
    BT_BEM_MMI_Vorwarnung: base-type-encoding=NONE
    BT_BEM_Red_Innengeblaese: base-type-encoding=NONE
    BT_BEM_REK_aktiv: base-type-encoding=NONE
    BT_BEM_STH_Einschaltverbot: base-type-encoding=NONE
    BT_BEM_STH_Zielzeit: base-type-encoding=NONE
    BT_BEM_UBDM: base-type-encoding=NONE
    BT_BEM_UGenSoll: base-type-encoding=NONE
    BT_BFS_Status_eTAG: base-type-encoding=NONE
    BT_BH_Blinker_Fehler: base-type-encoding=NONE
    BT_BH_Blinker_li: base-type-encoding=NONE
    BT_BH_Blinker_re: base-type-encoding=NONE
    BT_BH_Fernlicht: base-type-encoding=NONE
    BT_BH_Lichthupe: base-type-encoding=NONE
    BT_BLOWER1_HW: base-type-encoding=NONE
    BT_BLOWER1_IBATT: base-type-encoding=NONE
    BT_BLOWER1_IMAX_MAX: base-type-encoding=NONE
    BT_BLOWER1_IMAX_MIN: base-type-encoding=NONE
    BT_BLOWER1_RAMP: base-type-encoding=NONE
    BT_BLOWER1_ResponseError: base-type-encoding=NONE
    BT_BLOWER1_RX_FREQUENCY: base-type-encoding=NONE
    BT_BLOWER1_SAFETY_SPEED: base-type-encoding=NONE
    BT_BLOWER1_SAFETYRUN_THRESHOLD: base-type-encoding=NONE
    BT_BLOWER1_SELECT: base-type-encoding=NONE
    BT_BLOWER1_SPEED: base-type-encoding=NONE
    BT_BLOWER1_STATUS1: base-type-encoding=NONE
    BT_BLOWER1_STATUS2: base-type-encoding=NONE
    BT_BLOWER1_SUPPLIER: base-type-encoding=NONE
    BT_BLOWER1_SW: base-type-encoding=NONE
    BT_BLOWER1_TEMPERATURE: base-type-encoding=NONE
    BT_BLOWER1_U_KNEE: base-type-encoding=NONE
    BT_BLOWER1_UBATT: base-type-encoding=NONE
    BT_BLOWER1_UMOTOR: base-type-encoding=NONE
    BT_BLOWER1b_HW: base-type-encoding=NONE
    BT_BLOWER1b_IBATT: base-type-encoding=NONE
    BT_BLOWER1b_IMAX_MAX: base-type-encoding=NONE
    BT_BLOWER1b_IMAX_MIN: base-type-encoding=NONE
    BT_BLOWER1b_RAMP: base-type-encoding=NONE
    BT_BLOWER1b_ResponseError: base-type-encoding=NONE
    BT_BLOWER1b_RX_FREQUENCY: base-type-encoding=NONE
    BT_BLOWER1b_SAFETY_SPEED: base-type-encoding=NONE
    BT_BLOWER1b_SAFETYRUN_THRESHOLD: base-type-encoding=NONE
    BT_BLOWER1b_SELECT: base-type-encoding=NONE
    BT_BLOWER1b_SPEED: base-type-encoding=NONE
    BT_BLOWER1b_STATUS1: base-type-encoding=NONE
    BT_BLOWER1b_STATUS2: base-type-encoding=NONE
    BT_BLOWER1b_SUPPLIER: base-type-encoding=NONE
    BT_BLOWER1b_SW: base-type-encoding=NONE
    BT_BLOWER1b_TEMPERATURE: base-type-encoding=NONE
    BT_BLOWER1b_U_KNEE: base-type-encoding=NONE
    BT_BLOWER1b_UBATT: base-type-encoding=NONE
    BT_BLOWER1b_UMOTOR: base-type-encoding=NONE
    BT_BLOWER1c_HW: base-type-encoding=NONE
    BT_BLOWER1c_IBATT: base-type-encoding=NONE
    BT_BLOWER1c_IMAX_MAX: base-type-encoding=NONE
    BT_BLOWER1c_IMAX_MIN: base-type-encoding=NONE
    BT_BLOWER1c_RAMP: base-type-encoding=NONE
    BT_BLOWER1c_ResponseError: base-type-encoding=NONE
    BT_BLOWER1c_RX_FREQUENCY: base-type-encoding=NONE
    BT_BLOWER1c_SAFETY_SPEED: base-type-encoding=NONE
    BT_BLOWER1c_SAFETYRUN_THRESHOLD: base-type-encoding=NONE
    BT_BLOWER1c_SELECT: base-type-encoding=NONE
    BT_BLOWER1c_SPEED: base-type-encoding=NONE
    BT_BLOWER1c_STATUS1: base-type-encoding=NONE
    BT_BLOWER1c_STATUS2: base-type-encoding=NONE
    BT_BLOWER1c_SUPPLIER: base-type-encoding=NONE
    BT_BLOWER1c_SW: base-type-encoding=NONE
    BT_BLOWER1c_TEMPERATURE: base-type-encoding=NONE
    BT_BLOWER1c_U_KNEE: base-type-encoding=NONE
    BT_BLOWER1c_UBATT: base-type-encoding=NONE
    BT_BLOWER1c_UMOTOR: base-type-encoding=NONE
    BT_BLOWER2_HW: base-type-encoding=NONE
    BT_BLOWER2_IBATT: base-type-encoding=NONE
    BT_BLOWER2_ResponseError: base-type-encoding=NONE
    BT_BLOWER2_STATUS1: base-type-encoding=NONE
    BT_BLOWER2_STATUS1_INVALID: base-type-encoding=NONE
    BT_BLOWER2_STATUS2: base-type-encoding=NONE
    BT_BLOWER2_SUPPLIER: base-type-encoding=NONE
    BT_BLOWER2_SW: base-type-encoding=NONE
    BT_BLOWER2_TEMPERATURE: base-type-encoding=NONE
    BT_BLOWER2_UBATT: base-type-encoding=NONE
    BT_BLOWER2_UMOTOR: base-type-encoding=NONE
    BT_BLOWER2b_HW: base-type-encoding=NONE
    BT_BLOWER2b_IBATT: base-type-encoding=NONE
    BT_BLOWER2b_ResponseError: base-type-encoding=NONE
    BT_BLOWER2b_STATUS1: base-type-encoding=NONE
    BT_BLOWER2b_STATUS1_INVALID: base-type-encoding=NONE
    BT_BLOWER2b_STATUS2: base-type-encoding=NONE
    BT_BLOWER2b_SUPPLIER: base-type-encoding=NONE
    BT_BLOWER2b_SW: base-type-encoding=NONE
    BT_BLOWER2b_TEMPERATURE: base-type-encoding=NONE
    BT_BLOWER2b_UBATT: base-type-encoding=NONE
    BT_BLOWER2b_UMOTOR: base-type-encoding=NONE
    BT_BLOWER2be_IMAX_MAX: base-type-encoding=NONE
    BT_BLOWER2be_IMAX_MIN: base-type-encoding=NONE
    BT_BLOWER2be_RAMP: base-type-encoding=NONE
    BT_BLOWER2be_RX_FREQUENCY: base-type-encoding=NONE
    BT_BLOWER2be_SAFETY_SPEED: base-type-encoding=NONE
    BT_BLOWER2be_SAFETYRUN_THRESHOLD: base-type-encoding=NONE
    BT_BLOWER2be_SELECT: base-type-encoding=NONE
    BT_BLOWER2be_SPEED: base-type-encoding=NONE
    BT_BLOWER2be_U_KNEE: base-type-encoding=NONE
    BT_BLOWER2e_IMAX_MAX: base-type-encoding=NONE
    BT_BLOWER2e_IMAX_MIN: base-type-encoding=NONE
    BT_BLOWER2e_RAMP: base-type-encoding=NONE
    BT_BLOWER2e_RX_FREQUENCY: base-type-encoding=NONE
    BT_BLOWER2e_SAFETY_SPEED: base-type-encoding=NONE
    BT_BLOWER2e_SAFETYRUN_THRESHOLD: base-type-encoding=NONE
    BT_BLOWER2e_SELECT: base-type-encoding=NONE
    BT_BLOWER2e_SPEED: base-type-encoding=NONE
    BT_BLOWER2e_U_KNEE: base-type-encoding=NONE
    BT_BLOWER_DIAG_FLAG1: base-type-encoding=NONE
    BT_BLOWER_DIAG_FLAG2: base-type-encoding=NONE
    BT_BLOWER_IBATT: base-type-encoding=NONE
    BT_BLOWER_ResponseError: base-type-encoding=NONE
    BT_BLOWER_ROTATION_SPEED: base-type-encoding=NONE
    BT_BLOWER_STATUS_MOTOR: base-type-encoding=NONE
    BT_BLOWER_SUPPLIER: base-type-encoding=NONE
    BT_BLOWER_TEMPERATURE: base-type-encoding=NONE
    BT_BLOWER_TORQUE: base-type-encoding=NONE
    BT_BLOWER_UBATT: base-type-encoding=NONE
    BT_BLOWER_UMOTOR: base-type-encoding=NONE
    BT_BMS_07_BZ: base-type-encoding=NONE
    BT_BMS_07_CRC: base-type-encoding=NONE
    BT_BMS_20_BZ: base-type-encoding=NONE
    BT_BMS_20_CRC: base-type-encoding=NONE
    BT_BMS_Ausgleichsladung_Anf: base-type-encoding=NONE
    BT_BMS_Balancing_Aktiv: base-type-encoding=NONE
    BT_BMS_Batteriediagnose: base-type-encoding=NONE
    BT_BMS_BattHeizung_Aktiv: base-type-encoding=NONE
    BT_BMS_BattHeizung_Anf: base-type-encoding=NONE
    BT_BMS_BattHeizung_VerbautStatus: base-type-encoding=NONE
    BT_BMS_BattHeizung_Zieltemp: base-type-encoding=NONE
    BT_BMS_Crashfall_erkannt: base-type-encoding=NONE
    BT_BMS_Dauer_Entladeleistung: base-type-encoding=NONE
    BT_BMS_Dauer_Ladeleistung: base-type-encoding=NONE
    BT_BMS_DC_Ladeprofil: base-type-encoding=NONE
    BT_BMS_DC_Ladeprofil_Wechsel: base-type-encoding=NONE
    BT_BMS_DC_Ladeschuetze_Ist: base-type-encoding=NONE
    BT_BMS_Energieinhalt: base-type-encoding=NONE
    BT_BMS_EnergieVorhalt: base-type-encoding=NONE
    BT_BMS_ErwGrenzen_aktiv: base-type-encoding=NONE
    BT_BMS_eTM_KonditionierWunsch: base-type-encoding=NONE
    BT_BMS_Fehler_HVBattAbschaltung: base-type-encoding=NONE
    BT_BMS_Fehler_HVBattAbschaltung_Anf: base-type-encoding=NONE
    BT_BMS_Fehler_Leistungsred: base-type-encoding=NONE
    BT_BMS_Fehler_Notabschaltung_Crash: base-type-encoding=NONE
    BT_BMS_Fehler_NTKreis: base-type-encoding=NONE
    BT_BMS_Fehlerstatus_HV_Schuetze: base-type-encoding=NONE
    BT_BMS_Gesamtst_Spgfreiheit: base-type-encoding=NONE
    BT_BMS_Hauptschuetze_Ist: base-type-encoding=NONE
    BT_BMS_HVIL_Status: base-type-encoding=NONE
    BT_BMS_IstModus: base-type-encoding=NONE
    BT_BMS_Kuehlung_Anf: base-type-encoding=NONE
    BT_BMS_KundenWarnung: base-type-encoding=NONE
    BT_BMS_Ladevorgang_aktiv: base-type-encoding=NONE
    BT_BMS_Ladezustand: base-type-encoding=NONE
    BT_BMS_Leistung_BattHeizung: base-type-encoding=NONE
    BT_BMS_Leistung_BattHeizung_Anf: base-type-encoding=NONE
    BT_BMS_Max_DC_Ladeleistung: base-type-encoding=NONE
    BT_BMS_Max_Spannung: base-type-encoding=NONE
    BT_BMS_Max_UBE: base-type-encoding=NONE
    BT_BMS_MaxEnergieinhalt: base-type-encoding=NONE
    BT_BMS_Min_Spannung: base-type-encoding=NONE
    BT_BMS_Nennspannung: base-type-encoding=NONE
    BT_BMS_Nom_Ladeleistung: base-type-encoding=NONE
    BT_BMS_Nutzbare_EntladeEnergie: base-type-encoding=NONE
    BT_BMS_OCV_Dauer_Relaxation: base-type-encoding=NONE
    BT_BMS_PerfInd_Entladen: base-type-encoding=NONE
    BT_BMS_PerfInd_EntladenPeak_Temp: base-type-encoding=NONE
    BT_BMS_PerfInd_Laden: base-type-encoding=NONE
    BT_BMS_PerfInd_LadenPeak_Temp: base-type-encoding=NONE
    BT_BMS_Pumpe1_Ansteuerung: base-type-encoding=NONE
    BT_BMS_Pumpe2_Ansteuerung: base-type-encoding=NONE
    BT_BMS_Range_Indikator: base-type-encoding=NONE
    BT_BMS_Relaxation_Status: base-type-encoding=NONE
    BT_BMS_RIso_Ext: base-type-encoding=NONE
    BT_BMS_RuecklaufTemperatur: base-type-encoding=NONE
    BT_BMS_SoC_Genauigkeit: base-type-encoding=NONE
    BT_BMS_SollVolumenstrom: base-type-encoding=NONE
    BT_BMS_SollVorlauftemperatur: base-type-encoding=NONE
    BT_BMS_Spannung: base-type-encoding=NONE
    BT_BMS_Spannung_Zwischenkreis: base-type-encoding=NONE
    BT_BMS_Status_EoHVL_Heizer: base-type-encoding=NONE
    BT_BMS_Status_Ventil1: base-type-encoding=NONE
    BT_BMS_Status_Ventil2: base-type-encoding=NONE
    BT_BMS_Strom: base-type-encoding=NONE
    BT_BMS_Temperatur: base-type-encoding=NONE
    BT_BMS_Temperierung_Anf: base-type-encoding=NONE
    BT_BMS_TempStatus_Entladen: base-type-encoding=NONE
    BT_BMS_TempStatus_Laden: base-type-encoding=NONE
    BT_BMS_TMA_Betriebsart: base-type-encoding=NONE
    BT_BMS_TMA_Kuehlkreis_Status: base-type-encoding=NONE
    BT_BMS_UBE: base-type-encoding=NONE
    BT_BMS_UBE_Indik_last_update_km: base-type-encoding=NONE
    BT_BMS_UBE_Indikator: base-type-encoding=NONE
    BT_BMS_UBE_T: base-type-encoding=NONE
    BT_BMS_VoKo_HV_Anf: base-type-encoding=NONE
    BT_BMS_VorlaufTemperatur: base-type-encoding=NONE
    BT_BMS_VTD_DivideLifetimeCntReq: base-type-encoding=NONE
    BT_BMS_VTD_DivideLifetimeCntResp: base-type-encoding=NONE
    BT_BMS_VTD_FreezeReq: base-type-encoding=NONE
    BT_BMS_VTD_LifetimeResetReq: base-type-encoding=NONE
    BT_BMS_VTD_LifetimeResetResp: base-type-encoding=NONE
    BT_BMS_Warnung_Stuetzung_NV: base-type-encoding=NONE
    BT_BR_Eingriffsmoment: base-type-encoding=NONE
    BT_BT_ASW_HMI_defekt: base-type-encoding=NONE
    BT_BT_EC_Spiegel_Helligkeit: base-type-encoding=NONE
    BT_BT_FH_Bew_hoch: base-type-encoding=NONE
    BT_BT_FH_Bew_tief: base-type-encoding=NONE
    BT_BT_FH_Block: base-type-encoding=NONE
    BT_BT_FH_Fang: base-type-encoding=NONE
    BT_BT_FH_normiert: base-type-encoding=NONE
    BT_BT_FH_Oeffnung: base-type-encoding=NONE
    BT_BT_FH_Oeffnung_4Bit: base-type-encoding=NONE
    BT_BT_FH_Pos_oben: base-type-encoding=NONE
    BT_BT_FH_S_AutoHoch: base-type-encoding=NONE
    BT_BT_FH_S_AutoTief: base-type-encoding=NONE
    BT_BT_FH_S_ManHoch: base-type-encoding=NONE
    BT_BT_FH_S_ManTief: base-type-encoding=NONE
    BT_BT_FH_Thermo: base-type-encoding=NONE
    BT_BT_gesafet: base-type-encoding=NONE
    BT_BT_Kisi_Fehler: base-type-encoding=NONE
    BT_BT_Lock_Taster: base-type-encoding=NONE
    BT_BT_Lock_Taster_inv: base-type-encoding=NONE
    BT_BT_Lock_Unlock_Taster: base-type-encoding=NONE
    BT_BT_Oben_Block_erw: base-type-encoding=NONE
    BT_BT_Schliesstaster: base-type-encoding=NONE
    BT_BT_Schluesselschalter_auf: base-type-encoding=NONE
    BT_BT_Schluesselschalter_zu: base-type-encoding=NONE
    BT_BT_Schluesselschalter_zu_inv: base-type-encoding=NONE
    BT_BT_SP_ausgerastet: base-type-encoding=NONE
    BT_BT_Sp_Blk_def: base-type-encoding=NONE
    BT_BT_SP_Heizung_aktiv: base-type-encoding=NONE
    BT_BT_Sp_Heizung_Anf: base-type-encoding=NONE
    BT_BT_SP_Heizung_Status: base-type-encoding=NONE
    BT_BT_SP_ht_aktiv: base-type-encoding=NONE
    BT_BT_SP_lr_aktiv: base-type-encoding=NONE
    BT_BT_Sperrklinke: base-type-encoding=NONE
    BT_BT_SWA_HMI_defekt: base-type-encoding=NONE
    BT_BT_TAG_betaetigt: base-type-encoding=NONE
    BT_BT_TCR_Mode_aktiv: base-type-encoding=NONE
    BT_BT_TIG_betaetigt: base-type-encoding=NONE
    BT_BT_TSG_hinten_verbaut: base-type-encoding=NONE
    BT_BT_Tuer_geoeffnet: base-type-encoding=NONE
    BT_BT_Tuer_Status: base-type-encoding=NONE
    BT_BT_Tuer_Status_QBit: base-type-encoding=NONE
    BT_BT_Tueroeffnen_Warnung: base-type-encoding=NONE
    BT_BT_Tuerschloss_defekt: base-type-encoding=NONE
    BT_BT_UEKB_aktiviert: base-type-encoding=NONE
    BT_BT_Unlock_Taster: base-type-encoding=NONE
    BT_BT_Unten_Block_erw: base-type-encoding=NONE
    BT_BT_verriegelt: base-type-encoding=NONE
    BT_BT_Zuziehhilfe_aktiv: base-type-encoding=NONE
    BT_CHA_Charisma_Taste2_LED: base-type-encoding=NONE
    BT_CHA_Current_Mode: base-type-encoding=NONE
    BT_CHA_Current_Mode_FPA: base-type-encoding=NONE
    BT_CHA_Eco_Charisma_LED: base-type-encoding=NONE
    BT_CHA_EV_LED: base-type-encoding=NONE
    BT_CHA_Fahrer_Umschaltung: base-type-encoding=NONE
    BT_CHA_Kombi_Texte: base-type-encoding=NONE
    BT_CHA_Kombi_Texte_02: base-type-encoding=NONE
    BT_CHA_ReqPrgDispSetup: base-type-encoding=NONE
    BT_CHA_StCurProfDft: base-type-encoding=NONE
    BT_CHA_Ziel_FahrPr_03_01: base-type-encoding=NONE
    BT_CHA_Ziel_FahrPr_03_02: base-type-encoding=NONE
    BT_CHA_Ziel_FahrPr_AMB: base-type-encoding=NONE
    BT_CHA_Ziel_FahrPr_HSP: base-type-encoding=NONE
    BT_CHA_Ziel_FahrPr_HVBatt: base-type-encoding=NONE
    BT_CHA_Ziel_FahrPr_IVB: base-type-encoding=NONE
    BT_CHA_Ziel_FahrPr_KL: base-type-encoding=NONE
    BT_CHA_Ziel_FahrPr_RWB: base-type-encoding=NONE
    BT_DBK_Fahrerwarnung: base-type-encoding=NONE
    BT_DGN_Verlernzaehler: base-type-encoding=NONE
    BT_DI_Display_Nachtdesign: base-type-encoding=NONE
    BT_DI_Fotosensor: base-type-encoding=NONE
    BT_DI_KL_58xd: base-type-encoding=NONE
    BT_DI_KL_58xs: base-type-encoding=NONE
    BT_DI_KL_58xt: base-type-encoding=NONE
    BT_DiETa_Car: base-type-encoding=NONE
    BT_DiETa_Defrost_Taste: base-type-encoding=NONE
    BT_DiETa_FAS_Stufe: base-type-encoding=NONE
    BT_DiETa_FSH_Taste: base-type-encoding=NONE
    BT_DiETa_HSH_Taste: base-type-encoding=NONE
    BT_DiETa_Klima: base-type-encoding=NONE
    BT_DiETa_Lock_Unlock_Taste: base-type-encoding=NONE
    BT_DiETa_Mode: base-type-encoding=NONE
    BT_DiETa_Mode2: base-type-encoding=NONE
    BT_DiETa_Mode_roh: base-type-encoding=NONE
    BT_DiETa_PAO_OFF_Status: base-type-encoding=NONE
    BT_DiETa_PAO_ON_Status: base-type-encoding=NONE
    BT_DiETa_Parken: base-type-encoding=NONE
    BT_DiETa_Reserve_Byte2_4: base-type-encoding=NONE
    BT_DiETa_Reserve_Byte6_6: base-type-encoding=NONE
    BT_DiETa_Reserve_Byte7_4: base-type-encoding=NONE
    BT_DiETa_Reserve_Byte8: base-type-encoding=NONE
    BT_DiETa_ResponseError: base-type-encoding=NONE
    BT_DiETa_Status: base-type-encoding=NONE
    BT_DiETa_Touch_Event: base-type-encoding=NONE
    BT_DiETa_Warnblink_Taste: base-type-encoding=NONE
    BT_DiETas_01_BZ: base-type-encoding=NONE
    BT_DiETas_01_CRC: base-type-encoding=NONE
    BT_DS_BitError: base-type-encoding=NONE
    BT_DS_ChecksumError: base-type-encoding=NONE
    BT_DS_DruckError: base-type-encoding=NONE
    BT_DS_HW: base-type-encoding=NONE
    BT_DS_Kaeltemittel_P: base-type-encoding=NONE
    BT_DS_Kaeltemittel_P_WP: base-type-encoding=NONE
    BT_DS_Status: base-type-encoding=NONE
    BT_DS_SW: base-type-encoding=NONE
    BT_DS_TempError: base-type-encoding=NONE
    BT_DTS1_Fehler: base-type-encoding=NONE
    BT_DTS1_interne_Sensor_T: base-type-encoding=NONE
    BT_DTS1_Kaeltemittel_p: base-type-encoding=NONE
    BT_DTS1_Kaeltemittel_T: base-type-encoding=NONE
    BT_DTS1_Kommunikation: base-type-encoding=NONE
    BT_DTS1_R744_Fehler: base-type-encoding=NONE
    BT_DTS1_R744_interne_Sensor_T: base-type-encoding=NONE
    BT_DTS1_R744_Kaeltemittel_p: base-type-encoding=NONE
    BT_DTS1_R744_Kaeltemittel_t: base-type-encoding=NONE
    BT_DTS1_R744_Kommunikation: base-type-encoding=NONE
    BT_DTS1_R744_ResponseError: base-type-encoding=NONE
    BT_DTS1_R744_TNCTOC: base-type-encoding=NONE
    BT_DTS1_ResponseError: base-type-encoding=NONE
    BT_DTS1_TNCTOC: base-type-encoding=NONE
    BT_DTS2_Fehler: base-type-encoding=NONE
    BT_DTS2_interne_Sensor_T: base-type-encoding=NONE
    BT_DTS2_Kaeltemittel_p: base-type-encoding=NONE
    BT_DTS2_Kaeltemittel_T: base-type-encoding=NONE
    BT_DTS2_Kommunikation: base-type-encoding=NONE
    BT_DTS2_R744_Fehler: base-type-encoding=NONE
    BT_DTS2_R744_interne_Sensor_T: base-type-encoding=NONE
    BT_DTS2_R744_Kaeltemittel_p: base-type-encoding=NONE
    BT_DTS2_R744_Kaeltemittel_t: base-type-encoding=NONE
    BT_DTS2_R744_Kommunikation: base-type-encoding=NONE
    BT_DTS2_R744_ResponseError: base-type-encoding=NONE
    BT_DTS2_R744_TNCTOC: base-type-encoding=NONE
    BT_DTS2_ResponseError: base-type-encoding=NONE
    BT_DTS2_TNCTOC: base-type-encoding=NONE
    BT_DTS2b_R744_Fehler: base-type-encoding=NONE
    BT_DTS2b_R744_interne_Sensor_T: base-type-encoding=NONE
    BT_DTS2b_R744_Kaeltemittel_p: base-type-encoding=NONE
    BT_DTS2b_R744_Kaeltemittel_t: base-type-encoding=NONE
    BT_DTS2b_R744_Kommunikation: base-type-encoding=NONE
    BT_DTS2b_R744_ResponseError: base-type-encoding=NONE
    BT_DTS2b_R744_TNCTOC: base-type-encoding=NONE
    BT_DTS2c_R744_Fehler: base-type-encoding=NONE
    BT_DTS2c_R744_interne_Sensor_T: base-type-encoding=NONE
    BT_DTS2c_R744_Kaeltemittel_p: base-type-encoding=NONE
    BT_DTS2c_R744_Kaeltemittel_t: base-type-encoding=NONE
    BT_DTS2c_R744_Kommunikation: base-type-encoding=NONE
    BT_DTS2c_R744_ResponseError: base-type-encoding=NONE
    BT_DTS2c_R744_TNCTOC: base-type-encoding=NONE
    BT_DTS3_Fehler: base-type-encoding=NONE
    BT_DTS3_interne_Sensor_T: base-type-encoding=NONE
    BT_DTS3_Kaeltemittel_p: base-type-encoding=NONE
    BT_DTS3_Kaeltemittel_T: base-type-encoding=NONE
    BT_DTS3_Kommunikation: base-type-encoding=NONE
    BT_DTS3_R744_Fehler: base-type-encoding=NONE
    BT_DTS3_R744_interne_Sensor_T: base-type-encoding=NONE
    BT_DTS3_R744_Kaeltemittel_p: base-type-encoding=NONE
    BT_DTS3_R744_Kaeltemittel_t: base-type-encoding=NONE
    BT_DTS3_R744_Kommunikation: base-type-encoding=NONE
    BT_DTS3_R744_ResponseError: base-type-encoding=NONE
    BT_DTS3_R744_TNCTOC: base-type-encoding=NONE
    BT_DTS3_ResponseError: base-type-encoding=NONE
    BT_DTS3_TNCTOC: base-type-encoding=NONE
    BT_DTS3b_R744_Fehler: base-type-encoding=NONE
    BT_DTS3b_R744_interne_Sensor_T: base-type-encoding=NONE
    BT_DTS3b_R744_Kaeltemittel_p: base-type-encoding=NONE
    BT_DTS3b_R744_Kaeltemittel_t: base-type-encoding=NONE
    BT_DTS3b_R744_Kommunikation: base-type-encoding=NONE
    BT_DTS3b_R744_ResponseError: base-type-encoding=NONE
    BT_DTS3b_R744_TNCTOC: base-type-encoding=NONE
    BT_DWA_aktiv: base-type-encoding=NONE
    BT_EASV1_Err_Blockierung_TF: base-type-encoding=NONE
    BT_EASV1_Err_Blockierung_TNCTOC: base-type-encoding=NONE
    BT_EASV1_Err_EDefekt_MoKomp_TF: base-type-encoding=NONE
    BT_EASV1_Err_EDefekt_MoKomp_TNCTOC: base-type-encoding=NONE
    BT_EASV1_Err_EDefekt_TSens_TF: base-type-encoding=NONE
    BT_EASV1_Err_EDefekt_TSens_TNCTOC: base-type-encoding=NONE
    BT_EASV1_Err_Notlaufpos_TF: base-type-encoding=NONE
    BT_EASV1_Err_Notlaufpos_TNCTOC: base-type-encoding=NONE
    BT_EASV1_Err_RAMROMNADChange_TF: base-type-encoding=NONE
    BT_EASV1_Err_RAMROMNADChange_TNCTOC: base-type-encoding=NONE
    BT_EASV1_Err_Ueberspannung_TF: base-type-encoding=NONE
    BT_EASV1_Err_Ueberspannung_TNCTOC: base-type-encoding=NONE
    BT_EASV1_Err_Uebertemperatur_TF: base-type-encoding=NONE
    BT_EASV1_Err_Uebertemperatur_TNCTOC: base-type-encoding=NONE
    BT_EASV1_Err_Unterspannung_TF: base-type-encoding=NONE
    BT_EASV1_Err_Unterspannung_TNCTOC: base-type-encoding=NONE
    BT_EASV1_ErrMem_State: base-type-encoding=NONE
    BT_EASV1_Geschwindigkeitsstatus: base-type-encoding=NONE
    BT_EASV1_Ist_Position_Aktuator: base-type-encoding=NONE
    BT_EASV1_ResponseError: base-type-encoding=NONE
    BT_EASV1_ResponseError_TNCTOC: base-type-encoding=NONE
    BT_EASV1_Spulenbestromung: base-type-encoding=NONE
    BT_EASV1_Temp: base-type-encoding=NONE
    BT_EASV1_Temp_Warning: base-type-encoding=NONE
    BT_EASV2_Err_Blockierung_TF: base-type-encoding=NONE
    BT_EASV2_Err_Blockierung_TNCTOC: base-type-encoding=NONE
    BT_EASV2_Err_EDefekt_MoKomp_TF: base-type-encoding=NONE
    BT_EASV2_Err_EDefekt_MoKomp_TNCTOC: base-type-encoding=NONE
    BT_EASV2_Err_EDefekt_TSens_TF: base-type-encoding=NONE
    BT_EASV2_Err_EDefekt_TSens_TNCTOC: base-type-encoding=NONE
    BT_EASV2_Err_Notlaufpos_TF: base-type-encoding=NONE
    BT_EASV2_Err_Notlaufpos_TNCTOC: base-type-encoding=NONE
    BT_EASV2_Err_RAMROMNADChange_TF: base-type-encoding=NONE
    BT_EASV2_Err_RAMROMNADChange_TNCTOC: base-type-encoding=NONE
    BT_EASV2_Err_Ueberspannung_TF: base-type-encoding=NONE
    BT_EASV2_Err_Ueberspannung_TNCTOC: base-type-encoding=NONE
    BT_EASV2_Err_Uebertemperatur_TF: base-type-encoding=NONE
    BT_EASV2_Err_Uebertemperatur_TNCTOC: base-type-encoding=NONE
    BT_EASV2_Err_Unterspannung_TF: base-type-encoding=NONE
    BT_EASV2_Err_Unterspannung_TNCTOC: base-type-encoding=NONE
    BT_EASV2_ErrMem_State: base-type-encoding=NONE
    BT_EASV2_Geschwindigkeitsstatus: base-type-encoding=NONE
    BT_EASV2_Ist_Position_Aktuator: base-type-encoding=NONE
    BT_EASV2_ResponseError: base-type-encoding=NONE
    BT_EASV2_ResponseError_TNCTOC: base-type-encoding=NONE
    BT_EASV2_Spulenbestromung: base-type-encoding=NONE
    BT_EASV2_Temp: base-type-encoding=NONE
    BT_EASV2_Temp_Warning: base-type-encoding=NONE
    BT_EASV3_Err_Blockierung_TF: base-type-encoding=NONE
    BT_EASV3_Err_Blockierung_TNCTOC: base-type-encoding=NONE
    BT_EASV3_Err_EDefekt_MoKomp_TF: base-type-encoding=NONE
    BT_EASV3_Err_EDefekt_MoKomp_TNCTOC: base-type-encoding=NONE
    BT_EASV3_Err_EDefekt_TSens_TF: base-type-encoding=NONE
    BT_EASV3_Err_EDefekt_TSens_TNCTOC: base-type-encoding=NONE
    BT_EASV3_Err_Notlaufpos_TF: base-type-encoding=NONE
    BT_EASV3_Err_Notlaufpos_TNCTOC: base-type-encoding=NONE
    BT_EASV3_Err_RAMROMNADChange_TF: base-type-encoding=NONE
    BT_EASV3_Err_RAMROMNADChange_TNCTOC: base-type-encoding=NONE
    BT_EASV3_Err_Ueberspannung_TF: base-type-encoding=NONE
    BT_EASV3_Err_Ueberspannung_TNCTOC: base-type-encoding=NONE
    BT_EASV3_Err_Uebertemperatur_TF: base-type-encoding=NONE
    BT_EASV3_Err_Uebertemperatur_TNCTOC: base-type-encoding=NONE
    BT_EASV3_Err_Unterspannung_TF: base-type-encoding=NONE
    BT_EASV3_Err_Unterspannung_TNCTOC: base-type-encoding=NONE
    BT_EASV3_ErrMem_State: base-type-encoding=NONE
    BT_EASV3_Geschwindigkeitsstatus: base-type-encoding=NONE
    BT_EASV3_Ist_Position_Aktuator: base-type-encoding=NONE
    BT_EASV3_ResponseError: base-type-encoding=NONE
    BT_EASV3_ResponseError_TNCTOC: base-type-encoding=NONE
    BT_EASV3_Spulenbestromung: base-type-encoding=NONE
    BT_EASV3_Temp: base-type-encoding=NONE
    BT_EASV3_Temp_Warning: base-type-encoding=NONE
    BT_EASV4_Err_Blockierung_TF: base-type-encoding=NONE
    BT_EASV4_Err_Blockierung_TNCTOC: base-type-encoding=NONE
    BT_EASV4_Err_EDefekt_MoKomp_TF: base-type-encoding=NONE
    BT_EASV4_Err_EDefekt_MoKomp_TNCTOC: base-type-encoding=NONE
    BT_EASV4_Err_EDefekt_TSens_TF: base-type-encoding=NONE
    BT_EASV4_Err_EDefekt_TSens_TNCTOC: base-type-encoding=NONE
    BT_EASV4_Err_Notlaufpos_TF: base-type-encoding=NONE
    BT_EASV4_Err_Notlaufpos_TNCTOC: base-type-encoding=NONE
    BT_EASV4_Err_RAMROMNADChange_TF: base-type-encoding=NONE
    BT_EASV4_Err_RAMROMNADChange_TNCTOC: base-type-encoding=NONE
    BT_EASV4_Err_Ueberspannung_TF: base-type-encoding=NONE
    BT_EASV4_Err_Ueberspannung_TNCTOC: base-type-encoding=NONE
    BT_EASV4_Err_Uebertemperatur_TF: base-type-encoding=NONE
    BT_EASV4_Err_Uebertemperatur_TNCTOC: base-type-encoding=NONE
    BT_EASV4_Err_Unterspannung_TF: base-type-encoding=NONE
    BT_EASV4_Err_Unterspannung_TNCTOC: base-type-encoding=NONE
    BT_EASV4_ErrMem_State: base-type-encoding=NONE
    BT_EASV4_Geschwindigkeitsstatus: base-type-encoding=NONE
    BT_EASV4_Ist_Position_Aktuator: base-type-encoding=NONE
    BT_EASV4_ResponseError: base-type-encoding=NONE
    BT_EASV4_ResponseError_TNCTOC: base-type-encoding=NONE
    BT_EASV4_Spulenbestromung: base-type-encoding=NONE
    BT_EASV4_Temp: base-type-encoding=NONE
    BT_EASV4_Temp_Warning: base-type-encoding=NONE
    BT_EASV5_Err_Blockierung_TF: base-type-encoding=NONE
    BT_EASV5_Err_Blockierung_TNCTOC: base-type-encoding=NONE
    BT_EASV5_Err_EDefekt_MoKomp_TF: base-type-encoding=NONE
    BT_EASV5_Err_EDefekt_MoKomp_TNCTOC: base-type-encoding=NONE
    BT_EASV5_Err_EDefekt_TSens_TF: base-type-encoding=NONE
    BT_EASV5_Err_EDefekt_TSens_TNCTOC: base-type-encoding=NONE
    BT_EASV5_Err_Notlaufpos_TF: base-type-encoding=NONE
    BT_EASV5_Err_Notlaufpos_TNCTOC: base-type-encoding=NONE
    BT_EASV5_Err_RAMROMNADChange_TF: base-type-encoding=NONE
    BT_EASV5_Err_RAMROMNADChange_TNCTOC: base-type-encoding=NONE
    BT_EASV5_Err_Ueberspannung_TF: base-type-encoding=NONE
    BT_EASV5_Err_Ueberspannung_TNCTOC: base-type-encoding=NONE
    BT_EASV5_Err_Uebertemperatur_TF: base-type-encoding=NONE
    BT_EASV5_Err_Uebertemperatur_TNCTOC: base-type-encoding=NONE
    BT_EASV5_Err_Unterspannung_TF: base-type-encoding=NONE
    BT_EASV5_Err_Unterspannung_TNCTOC: base-type-encoding=NONE
    BT_EASV5_ErrMem_State: base-type-encoding=NONE
    BT_EASV5_Geschwindigkeitsstatus: base-type-encoding=NONE
    BT_EASV5_Ist_Position_Aktuator: base-type-encoding=NONE
    BT_EASV5_ResponseError: base-type-encoding=NONE
    BT_EASV5_ResponseError_TNCTOC: base-type-encoding=NONE
    BT_EASV5_Spulenbestromung: base-type-encoding=NONE
    BT_EASV5_temp: base-type-encoding=NONE
    BT_EASV5_Temp_Warning: base-type-encoding=NONE
    BT_EBV_Eingriff: base-type-encoding=NONE
    BT_eCall_Funktionsstatus: base-type-encoding=NONE
    BT_eCall_Funktionsstatus_02: base-type-encoding=NONE
    BT_eCall_Mute_Anf: base-type-encoding=NONE
    BT_EDS_Charisma_FahrPr: base-type-encoding=NONE
    BT_EDS_Charisma_Status: base-type-encoding=NONE
    BT_EDS_Eingriff: base-type-encoding=NONE
    BT_EKK4_Comp_Error_Mask_Nr: base-type-encoding=NONE
    BT_EKK4_COMP_SPEED: base-type-encoding=NONE
    BT_EKK4_COMP_ST: base-type-encoding=NONE
    BT_EKK4_Err_Ind_Nr_1_8_15_22: base-type-encoding=NONE
    BT_EKK4_Err_Ind_Nr_2_9_16_23: base-type-encoding=NONE
    BT_EKK4_Err_Ind_Nr_3_10_17_24: base-type-encoding=NONE
    BT_EKK4_Err_Ind_Nr_4_11_18_25: base-type-encoding=NONE
    BT_EKK4_Err_Ind_Nr_5_12_19_26: base-type-encoding=NONE
    BT_EKK4_Err_Ind_Nr_6_13_20_27: base-type-encoding=NONE
    BT_EKK4_Err_Ind_Nr_7_14_21_28: base-type-encoding=NONE
    BT_EKK4_Err_Ind_TF_1_7: base-type-encoding=NONE
    BT_EKK4_Err_Ind_TF_2_8: base-type-encoding=NONE
    BT_EKK4_Err_Ind_TF_3_9: base-type-encoding=NONE
    BT_EKK4_Err_Ind_TF_4_10: base-type-encoding=NONE
    BT_EKK4_Err_Ind_TF_5_11: base-type-encoding=NONE
    BT_EKK4_Err_Ind_TF_6_12: base-type-encoding=NONE
    BT_EKK4_ErrMem_State: base-type-encoding=NONE
    BT_EKK4_Fehler_AE: base-type-encoding=NONE
    BT_EKK4_HIGH_VOLTAGE: base-type-encoding=NONE
    BT_EKK4_INPUT_CURRENT: base-type-encoding=NONE
    BT_EKK4_INV_TEMP: base-type-encoding=NONE
    BT_EKK4_Level_Rsp: base-type-encoding=NONE
    BT_EKK4_Match: base-type-encoding=NONE
    BT_EKK4_MUX_Err_Ind: base-type-encoding=NONE
    BT_EKK4_Number_of_Err_Ind_TF: base-type-encoding=NONE
    BT_EKK4_ParameterChange: base-type-encoding=NONE
    BT_EKK4_Q_High_Voltage: base-type-encoding=NONE
    BT_EKK4_Reason_Err_Ind_TF_1_7: base-type-encoding=NONE
    BT_EKK4_Reason_Err_Ind_TF_2_8: base-type-encoding=NONE
    BT_EKK4_Reason_Err_Ind_TF_3_9: base-type-encoding=NONE
    BT_EKK4_Reason_Err_Ind_TF_4_10: base-type-encoding=NONE
    BT_EKK4_Reason_Err_Ind_TF_5_11: base-type-encoding=NONE
    BT_EKK4_Reason_Err_Ind_TF_6_12: base-type-encoding=NONE
    BT_EKK4_ResponseError: base-type-encoding=NONE
    BT_EKK4_TF_Change: base-type-encoding=NONE
    BT_EKK_Active_Discharge: base-type-encoding=NONE
    BT_EKK_ENB_COMP: base-type-encoding=NONE
    BT_EKK_HV_ST: base-type-encoding=NONE
    BT_EKK_KL_15_Status: base-type-encoding=NONE
    BT_EKK_REQ_COMP_SPEED: base-type-encoding=NONE
    BT_EKK_REQ_COMP_SPEED_HiRes: base-type-encoding=NONE
    BT_EKKe_Error_Mask_Nr: base-type-encoding=NONE
    BT_EKKe_Level_REQ: base-type-encoding=NONE
    BT_EKKe_Q_Mask: base-type-encoding=NONE
    BT_ELM1_FacPwrPred: base-type-encoding=NONE
    BT_ELM1_PwrLosDrvTq0: base-type-encoding=NONE
    BT_EM1_01_BZ: base-type-encoding=NONE
    BT_EM1_01_CRC: base-type-encoding=NONE
    BT_EM1_AR_aktiv: base-type-encoding=NONE
    BT_EM1_ErwGrenzen_aktiv: base-type-encoding=NONE
    BT_EM1_Fehler_ElAntriebAbschaltung: base-type-encoding=NONE
    BT_EM1_Fehler_Notabschaltung: base-type-encoding=NONE
    BT_EM1_IstDrehzahl: base-type-encoding=NONE
    BT_EM1_Istmodus: base-type-encoding=NONE
    BT_EM1_IstMoment: base-type-encoding=NONE
    BT_EM1_IstSpannung: base-type-encoding=NONE
    BT_EM1_Max_Moment: base-type-encoding=NONE
    BT_EM1_Max_Moment_Gesamt: base-type-encoding=NONE
    BT_EM1_Max_Moment_Lim: base-type-encoding=NONE
    BT_EM1_Min_Moment: base-type-encoding=NONE
    BT_EM1_Min_Moment_Gesamt: base-type-encoding=NONE
    BT_EM1_Min_Moment_Lim: base-type-encoding=NONE
    BT_EM1_MinVorlauftemperatur: base-type-encoding=NONE
    BT_EM1_Mom_DrzEingriff: base-type-encoding=NONE
    BT_EM1_Moment_AR_Eingriff: base-type-encoding=NONE
    BT_EM1_Raddrehzahl_links: base-type-encoding=NONE
    BT_EM1_Raddrehzahl_rechts: base-type-encoding=NONE
    BT_EM1_Status_DrzEingriff: base-type-encoding=NONE
    BT_EM1_Strom_HV: base-type-encoding=NONE
    BT_Empfindlichkeit_AQS: base-type-encoding=NONE
    BT_ESC_51_BZ: base-type-encoding=NONE
    BT_ESC_51_CRC: base-type-encoding=NONE
    BT_ESC_Achsdrehzahl_Max: base-type-encoding=NONE
    BT_ESC_Achsdrehzahl_Max_sek: base-type-encoding=NONE
    BT_ESC_Achsdrehzahl_Min: base-type-encoding=NONE
    BT_ESC_Achsdrehzahl_Min_sek: base-type-encoding=NONE
    BT_ESC_aktBR_Modus_02: base-type-encoding=NONE
    BT_ESC_aktBr_Volumenstrom: base-type-encoding=NONE
    BT_ESC_Allrad_Anteil_max_sek: base-type-encoding=NONE
    BT_ESC_Allrad_Anteil_min_sek: base-type-encoding=NONE
    BT_ESC_Allradverteilung_aktiv: base-type-encoding=NONE
    BT_ESC_Anf_KL: base-type-encoding=NONE
    BT_ESC_Anf_KV: base-type-encoding=NONE
    BT_ESC_Anf_Mindestreku: base-type-encoding=NONE
    BT_ESC_Blending_Solldruck: base-type-encoding=NONE
    BT_ESC_Bremsdruck_02: base-type-encoding=NONE
    BT_ESC_Bremsdruck_Modell: base-type-encoding=NONE
    BT_ESC_EBKV_Kraftblending_Modus: base-type-encoding=NONE
    BT_ESC_FBA_Meldungen: base-type-encoding=NONE
    BT_ESC_GMV_aktiv: base-type-encoding=NONE
    BT_ESC_GMV_nicht_verfuegbar: base-type-encoding=NONE
    BT_ESC_Lernfreigabe_Abrollumfang: base-type-encoding=NONE
    BT_ESC_MBK_Meldungen: base-type-encoding=NONE
    BT_ESC_MomRad_Eingriff: base-type-encoding=NONE
    BT_ESC_MomRad_Eingriff_sek: base-type-encoding=NONE
    BT_ESC_QBit_Bremsdruck_02: base-type-encoding=NONE
    BT_ESC_Reku_Freigabe: base-type-encoding=NONE
    BT_ESC_Status_Eingriff: base-type-encoding=NONE
    BT_ESC_Status_Eingriff_sek: base-type-encoding=NONE
    BT_ESC_Status_vRef_Stuetzeingriff: base-type-encoding=NONE
    BT_ESC_Texte_eBKV_Betaetigung: base-type-encoding=NONE
    BT_ESC_v_Signal_Qualifier_High_Low: base-type-encoding=NONE
    BT_ESP_21_BZ: base-type-encoding=NONE
    BT_ESP_21_CRC: base-type-encoding=NONE
    BT_ESP_30_BZ: base-type-encoding=NONE
    BT_ESP_30_CRC: base-type-encoding=NONE
    BT_ESP_Anhaltevorgang_ACC_aktiv: base-type-encoding=NONE
    BT_ESP_ASP: base-type-encoding=NONE
    BT_ESP_AWV3_Brems_aktiv: base-type-encoding=NONE
    BT_ESP_Diagnose: base-type-encoding=NONE
    BT_ESP_Eingriff: base-type-encoding=NONE
    BT_ESP_FDR_uebersteuern: base-type-encoding=NONE
    BT_ESP_FDR_untersteuern: base-type-encoding=NONE
    BT_ESP_FZR_uebersteuern: base-type-encoding=NONE
    BT_ESP_FZR_untersteuern: base-type-encoding=NONE
    BT_ESP_Haltebestaetigung: base-type-encoding=NONE
    BT_ESP_HL_Bremsmoment: base-type-encoding=NONE
    BT_ESP_HL_Radgeschw_02: base-type-encoding=NONE
    BT_ESP_HR_Bremsmoment: base-type-encoding=NONE
    BT_ESP_HR_Radgeschw_02: base-type-encoding=NONE
    BT_ESP_MKB_Abbruch_Geschw: base-type-encoding=NONE
    BT_ESP_Off_Taster: base-type-encoding=NONE
    BT_ESP_PLA_Bremseingriff: base-type-encoding=NONE
    BT_ESP_QBit_v_Signal: base-type-encoding=NONE
    BT_ESP_Systemstatus: base-type-encoding=NONE
    BT_ESP_Tastung_passiv: base-type-encoding=NONE
    BT_ESP_v_Signal: base-type-encoding=NONE
    BT_ESP_v_Signal_8Bit: base-type-encoding=NONE
    BT_ESP_VL_Bremsmoment: base-type-encoding=NONE
    BT_ESP_VL_Radgeschw_02: base-type-encoding=NONE
    BT_ESP_Vorsteuerung: base-type-encoding=NONE
    BT_ESP_VR_Bremsmoment: base-type-encoding=NONE
    BT_ESP_VR_Radgeschw_02: base-type-encoding=NONE
    BT_eTM_Batterieheizen_Anf: base-type-encoding=NONE
    BT_eTM_BMS_Konditionierung_moeglich: base-type-encoding=NONE
    BT_eTM_BMS_Pumpe1_Befuellung: base-type-encoding=NONE
    BT_eTM_BMS_Pumpe1_SollAnsteuerung: base-type-encoding=NONE
    BT_eTM_BMS_ThermischeIstLeistung: base-type-encoding=NONE
    BT_eTM_BMS_Ventil1_Befuellung: base-type-encoding=NONE
    BT_eTM_BMS_Ventil2_Befuellung: base-type-encoding=NONE
    BT_eTM_HVBatt_IstVolumenstrom: base-type-encoding=NONE
    BT_eTM_HWT_IstVolumenstrom: base-type-encoding=NONE
    BT_eTM_Ist_rLM: base-type-encoding=NONE
    BT_eTM_Kuehlung_Status: base-type-encoding=NONE
    BT_eTM_Pumpe1_Status: base-type-encoding=NONE
    BT_eTM_Pumpe1_Volumenstrom: base-type-encoding=NONE
    BT_eTM_Pumpe1_Volumenstromteilung: base-type-encoding=NONE
    BT_eTM_Pumpe2_Status: base-type-encoding=NONE
    BT_eTM_Pumpe2_Volumenstrom: base-type-encoding=NONE
    BT_eTM_Pumpe3_Status: base-type-encoding=NONE
    BT_eTM_PumpeAntrieb_Ansteuerung: base-type-encoding=NONE
    BT_eTM_PumpeBat_Ansteuerung: base-type-encoding=NONE
    BT_eTM_PumpeHWT_Ansteuerung: base-type-encoding=NONE
    BT_eTM_PV1_Ansteuerung: base-type-encoding=NONE
    BT_eTM_PV2_Ansteuerung: base-type-encoding=NONE
    BT_eTM_PWR_MinVorlaufTemp: base-type-encoding=NONE
    BT_eTM_Temperatur_1: base-type-encoding=NONE
    BT_eTM_Temperatur_2: base-type-encoding=NONE
    BT_eTM_Ventil{1..3}_Status: base-type-encoding=NONE
    BT_eTM_Wasserheizer_IstVolumenstrom: base-type-encoding=NONE
    BT_eTM_Wasserheizer_SollTemp_Ausgng: base-type-encoding=NONE
    BT_EXV1_Err_Blockierung_TF: base-type-encoding=NONE
    BT_EXV1_Err_Blockierung_TNCTOC: base-type-encoding=NONE
    BT_EXV1_Err_EDefekt_MoKomp_TF: base-type-encoding=NONE
    BT_EXV1_Err_EDefekt_MoKomp_TNCTOC: base-type-encoding=NONE
    BT_EXV1_Err_EDefekt_TSens_TF: base-type-encoding=NONE
    BT_EXV1_Err_EDefekt_TSens_TNCTOC: base-type-encoding=NONE
    BT_EXV1_Err_Notlaufpos_TF: base-type-encoding=NONE
    BT_EXV1_Err_Notlaufpos_TNCTOC: base-type-encoding=NONE
    BT_EXV1_Err_RAMROMNADChange_TF: base-type-encoding=NONE
    BT_EXV1_Err_RAMROMNADChange_TNCTOC: base-type-encoding=NONE
    BT_EXV1_Err_Ueberspannung_TF: base-type-encoding=NONE
    BT_EXV1_Err_Ueberspannung_TNCTOC: base-type-encoding=NONE
    BT_EXV1_Err_Uebertemperatur_TF: base-type-encoding=NONE
    BT_EXV1_Err_Uebertemperatur_TNCTOC: base-type-encoding=NONE
    BT_EXV1_Err_Unterspannung_TF: base-type-encoding=NONE
    BT_EXV1_Err_Unterspannung_TNCTOC: base-type-encoding=NONE
    BT_EXV1_ErrMem_State: base-type-encoding=NONE
    BT_EXV1_Geschwindigkeitsstatus: base-type-encoding=NONE
    BT_EXV1_Ist_Position_Aktuator: base-type-encoding=NONE
    BT_EXV1_ResponseError: base-type-encoding=NONE
    BT_EXV1_ResponseError_TNCTOC: base-type-encoding=NONE
    BT_EXV1_Spulenbestromung: base-type-encoding=NONE
    BT_EXV1_Temp: base-type-encoding=NONE
    BT_EXV1_Temp_Warning: base-type-encoding=NONE
    BT_EXV2_Err_Blockierung_TF: base-type-encoding=NONE
    BT_EXV2_Err_Blockierung_TNCTOC: base-type-encoding=NONE
    BT_EXV2_Err_EDefekt_MoKomp_TF: base-type-encoding=NONE
    BT_EXV2_Err_EDefekt_MoKomp_TNCTOC: base-type-encoding=NONE
    BT_EXV2_Err_EDefekt_TSens_TF: base-type-encoding=NONE
    BT_EXV2_Err_EDefekt_TSens_TNCTOC: base-type-encoding=NONE
    BT_EXV2_Err_Notlaufpos_TF: base-type-encoding=NONE
    BT_EXV2_Err_Notlaufpos_TNCTOC: base-type-encoding=NONE
    BT_EXV2_Err_RAMROMNADChange_TF: base-type-encoding=NONE
    BT_EXV2_Err_RAMROMNADChange_TNCTOC: base-type-encoding=NONE
    BT_EXV2_Err_Ueberspannung_TF: base-type-encoding=NONE
    BT_EXV2_Err_Ueberspannung_TNCTOC: base-type-encoding=NONE
    BT_EXV2_Err_Uebertemperatur_TF: base-type-encoding=NONE
    BT_EXV2_Err_Uebertemperatur_TNCTOC: base-type-encoding=NONE
    BT_EXV2_Err_Unterspannung_TF: base-type-encoding=NONE
    BT_EXV2_Err_Unterspannung_TNCTOC: base-type-encoding=NONE
    BT_EXV2_ErrMem_State: base-type-encoding=NONE
    BT_EXV2_Geschwindigkeitsstatus: base-type-encoding=NONE
    BT_EXV2_Ist_Position_Aktuator: base-type-encoding=NONE
    BT_EXV2_ResponseError: base-type-encoding=NONE
    BT_EXV2_ResponseError_TNCTOC: base-type-encoding=NONE
    BT_EXV2_Spulenbestromung: base-type-encoding=NONE
    BT_EXV2_Temp: base-type-encoding=NONE
    BT_EXV2_Temp_Warning: base-type-encoding=NONE
    BT_EXV3_Err_Blockierung_TF: base-type-encoding=NONE
    BT_EXV3_Err_Blockierung_TNCTOC: base-type-encoding=NONE
    BT_EXV3_Err_EDefekt_MoKomp_TF: base-type-encoding=NONE
    BT_EXV3_Err_EDefekt_MoKomp_TNCTOC: base-type-encoding=NONE
    BT_EXV3_Err_EDefekt_TSens_TF: base-type-encoding=NONE
    BT_EXV3_Err_EDefekt_TSens_TNCTOC: base-type-encoding=NONE
    BT_EXV3_Err_Notlaufpos_TF: base-type-encoding=NONE
    BT_EXV3_Err_Notlaufpos_TNCTOC: base-type-encoding=NONE
    BT_EXV3_Err_RAMROMNADChange_TF: base-type-encoding=NONE
    BT_EXV3_Err_RAMROMNADChange_TNCTOC: base-type-encoding=NONE
    BT_EXV3_Err_Ueberspannung_TF: base-type-encoding=NONE
    BT_EXV3_Err_Ueberspannung_TNCTOC: base-type-encoding=NONE
    BT_EXV3_Err_Uebertemperatur_TF: base-type-encoding=NONE
    BT_EXV3_Err_Uebertemperatur_TNCTOC: base-type-encoding=NONE
    BT_EXV3_Err_Unterspannung_TF: base-type-encoding=NONE
    BT_EXV3_Err_Unterspannung_TNCTOC: base-type-encoding=NONE
    BT_EXV3_ErrMem_State: base-type-encoding=NONE
    BT_EXV3_Geschwindigkeitsstatus: base-type-encoding=NONE
    BT_EXV3_Ist_Position_Aktuator: base-type-encoding=NONE
    BT_EXV3_ResponseError: base-type-encoding=NONE
    BT_EXV3_ResponseError_TNCTOC: base-type-encoding=NONE
    BT_EXV3_Spulenbestromung: base-type-encoding=NONE
    BT_EXV3_Temp: base-type-encoding=NONE
    BT_EXV3_Temp_Warning: base-type-encoding=NONE
    BT_EXV4_Err_Blockierung_TF: base-type-encoding=NONE
    BT_EXV4_Err_Blockierung_TNCTOC: base-type-encoding=NONE
    BT_EXV4_Err_EDefekt_MoKomp_TF: base-type-encoding=NONE
    BT_EXV4_Err_EDefekt_MoKomp_TNCTOC: base-type-encoding=NONE
    BT_EXV4_Err_EDefekt_TSens_TF: base-type-encoding=NONE
    BT_EXV4_Err_EDefekt_TSens_TNCTOC: base-type-encoding=NONE
    BT_EXV4_Err_Notlaufpos_TF: base-type-encoding=NONE
    BT_EXV4_Err_Notlaufpos_TNCTOC: base-type-encoding=NONE
    BT_EXV4_Err_RAMROMNADChange_TF: base-type-encoding=NONE
    BT_EXV4_Err_RAMROMNADChange_TNCTOC: base-type-encoding=NONE
    BT_EXV4_Err_Ueberspannung_TF: base-type-encoding=NONE
    BT_EXV4_Err_Ueberspannung_TNCTOC: base-type-encoding=NONE
    BT_EXV4_Err_Uebertemperatur_TF: base-type-encoding=NONE
    BT_EXV4_Err_Uebertemperatur_TNCTOC: base-type-encoding=NONE
    BT_EXV4_Err_Unterspannung_TF: base-type-encoding=NONE
    BT_EXV4_Err_Unterspannung_TNCTOC: base-type-encoding=NONE
    BT_EXV4_ErrMem_State: base-type-encoding=NONE
    BT_EXV4_Geschwindigkeitsstatus: base-type-encoding=NONE
    BT_EXV4_Ist_Position_Aktuator: base-type-encoding=NONE
    BT_EXV4_ResponseError: base-type-encoding=NONE
    BT_EXV4_ResponseError_TNCTOC: base-type-encoding=NONE
    BT_EXV4_Spulenbestromung: base-type-encoding=NONE
    BT_EXV4_Temp: base-type-encoding=NONE
    BT_EXV4_Temp_Warning: base-type-encoding=NONE
    BT_FA_Hoehenwert_HL_01: base-type-encoding=NONE
    BT_FA_Hoehenwert_VL_01: base-type-encoding=NONE
    BT_FaceRec_Auth_Challenge_Request: base-type-encoding=NONE
    BT_FaceRec_Enroll_Challenge_Request: base-type-encoding=NONE
    BT_FAS_Taster: base-type-encoding=NONE
    BT_FAS_Taster_Fehler: base-type-encoding=NONE
    BT_FBS_IDG_in_Reichweite: base-type-encoding=NONE
    BT_FBS_Warn_Schluessel_Batt: base-type-encoding=NONE
    BT_FCM_01_alt: base-type-encoding=NONE
    BT_FDR_Allradverteilung_aktiv: base-type-encoding=NONE
    BT_FDR_Anf_Allradbetrieb: base-type-encoding=NONE
    BT_FFB_Auf_Taste: base-type-encoding=NONE
    BT_FFB_CarFinder: base-type-encoding=NONE
    BT_FFB_HDF_Taste: base-type-encoding=NONE
    BT_FFB_Komfortoeffnen: base-type-encoding=NONE
    BT_FFB_Komfortschliessen: base-type-encoding=NONE
    BT_FFB_Panik_Taste: base-type-encoding=NONE
    BT_FFB_Zu_Taste: base-type-encoding=NONE
    BT_FoD_Anz_Funktionsabschaltung: base-type-encoding=NONE
    BT_FoD_DTC_TSK_ACC: base-type-encoding=NONE
    BT_FoD_DTC_TSK_GRA: base-type-encoding=NONE
    BT_FoD_State_IPA_RPA: base-type-encoding=NONE
    BT_FoD_State_TopView_SideView_RVC: base-type-encoding=NONE
    BT_FoD_State_TPA_rTPA: base-type-encoding=NONE
    BT_FoD_Transmission_Info: base-type-encoding=NONE
    BT_FRS_active_container: base-type-encoding=NONE
    BT_FRS_ChannelSelect: base-type-encoding=NONE
    BT_FRS_CurrentIntensity: base-type-encoding=NONE
    BT_FRS_Expiry_Container_{1..3}: base-type-encoding=NONE
    BT_FRS_Fan_status: base-type-encoding=NONE
    BT_FRS_FragranceID_Container_{1..3}: base-type-encoding=NONE
    BT_FRS_IntensityReq: base-type-encoding=NONE
    BT_FRS_Level_Container_{1..3}: base-type-encoding=NONE
    BT_FRS_ResponseError: base-type-encoding=NONE
    BT_FRS_Status: base-type-encoding=NONE
    BT_FRS_Status_Car: base-type-encoding=NONE
    BT_FRS_Status_UBatt: base-type-encoding=NONE
    BT_FRS_Stepper_Status: base-type-encoding=NONE
    BT_FS_Luftfeuchte_rel: base-type-encoding=NONE
    BT_FS_ResponseError: base-type-encoding=NONE
    BT_FS_Status_eTAG: base-type-encoding=NONE
    BT_FS_Taupunkt: base-type-encoding=NONE
    BT_FS_Temp_Scheibe: base-type-encoding=NONE
    BT_FS_Temp_Sensor: base-type-encoding=NONE
    BT_FSA_Err_Defekt_HumSens_TNCTOC: base-type-encoding=NONE
    BT_FSA_Err_Defekt_HumSense_TF: base-type-encoding=NONE
    BT_FSA_Err_Defekt_Tsens_TF: base-type-encoding=NONE
    BT_FSA_Err_RAMROM_Check_TF: base-type-encoding=NONE
    BT_FSA_Err_RAMROM_Check_TNCTOC: base-type-encoding=NONE
    BT_FSA_Err_Ueberspannung_TF: base-type-encoding=NONE
    BT_FSA_Err_Unterspannung_TF: base-type-encoding=NONE
    BT_FSA_ErrMemState: base-type-encoding=NONE
    BT_FSA_HW: base-type-encoding=NONE
    BT_FSA_Luftfeuchte_rel: base-type-encoding=NONE
    BT_FSA_Luftfeuchte_TF: base-type-encoding=NONE
    BT_FSA_Luftfeuchte_TNCTOC: base-type-encoding=NONE
    BT_FSA_ResponseError: base-type-encoding=NONE
    BT_FSA_Sensorheizung_Status: base-type-encoding=NONE
    BT_FSA_SW: base-type-encoding=NONE
    BT_FSA_Taupunkt: base-type-encoding=NONE
    BT_FSA_Taupunkt_PMS: base-type-encoding=NONE
    BT_FSA_Temp_Luft: base-type-encoding=NONE
    BT_FSA_Temp_Sensor: base-type-encoding=NONE
    BT_FSH_Status: base-type-encoding=NONE
    BT_FSH_Taster: base-type-encoding=NONE
    BT_FT_BFS_Fond_Freigabe: base-type-encoding=NONE
    BT_FT_Daemmglas: base-type-encoding=NONE
    BT_FT_FH_Bew_hoch: base-type-encoding=NONE
    BT_FT_FH_Bew_tief: base-type-encoding=NONE
    BT_FT_FH_Block: base-type-encoding=NONE
    BT_FT_FH_Fang: base-type-encoding=NONE
    BT_FT_FH_normiert: base-type-encoding=NONE
    BT_FT_FH_Oeffnung: base-type-encoding=NONE
    BT_FT_FH_Oeffnung_4Bit: base-type-encoding=NONE
    BT_FT_FH_Pos_oben: base-type-encoding=NONE
    BT_FT_FH_S_AutoHoch: base-type-encoding=NONE
    BT_FT_FH_S_AutoTief: base-type-encoding=NONE
    BT_FT_FH_S_ManHoch: base-type-encoding=NONE
    BT_FT_FH_S_ManTief: base-type-encoding=NONE
    BT_FT_FH_Thermo: base-type-encoding=NONE
    BT_FT_gesafet: base-type-encoding=NONE
    BT_FT_HD_Taste: base-type-encoding=NONE
    BT_FT_HD_Taste_2: base-type-encoding=NONE
    BT_FT_IRUE_Taste: base-type-encoding=NONE
    BT_FT_Kisi_Fehler: base-type-encoding=NONE
    BT_FT_Kisi_li_aktiv: base-type-encoding=NONE
    BT_FT_Kisi_re_aktiv: base-type-encoding=NONE
    BT_FT_Kisi_Taster_li: base-type-encoding=NONE
    BT_FT_Kisi_Taster_re: base-type-encoding=NONE
    BT_FT_Lock_Taster: base-type-encoding=NONE
    BT_FT_Lock_Unlock_Taster: base-type-encoding=NONE
    BT_FT_Oben_Block_erw: base-type-encoding=NONE
    BT_FT_Schliesstaster: base-type-encoding=NONE
    BT_FT_Schluesselschalter_auf: base-type-encoding=NONE
    BT_FT_Schluesselschalter_zu: base-type-encoding=NONE
    BT_FT_SP_ausgerastet: base-type-encoding=NONE
    BT_FT_Sp_Blk_def: base-type-encoding=NONE
    BT_FT_Sp_Heizung_Anf: base-type-encoding=NONE
    BT_FT_SP_Heizung_Status: base-type-encoding=NONE
    BT_FT_SP_ht_aktiv: base-type-encoding=NONE
    BT_FT_SP_lr_aktiv: base-type-encoding=NONE
    BT_FT_Sperrklinke: base-type-encoding=NONE
    BT_FT_SWA_Taster: base-type-encoding=NONE
    BT_FT_TAG_betaetigt: base-type-encoding=NONE
    BT_FT_TD_Taste: base-type-encoding=NONE
    BT_FT_TD_Taste_Fehler: base-type-encoding=NONE
    BT_FT_TIG_betaetigt: base-type-encoding=NONE
    BT_FT_TSG_hinten_verbaut: base-type-encoding=NONE
    BT_FT_Tuer_geoeffnet: base-type-encoding=NONE
    BT_FT_Tuerschloss_defekt: base-type-encoding=NONE
    BT_FT_UEKB_aktiviert: base-type-encoding=NONE
    BT_FT_Unlock_Taster: base-type-encoding=NONE
    BT_FT_Unten_Block_erw: base-type-encoding=NONE
    BT_FT_verriegelt: base-type-encoding=NONE
    BT_FT_Zuziehhilfe_aktiv: base-type-encoding=NONE
    BT_Geblaesestufe: base-type-encoding=NONE
    BT_GNSS_Breite_Ortung: base-type-encoding=NONE
    BT_GNSS_DR_Breite_Ortung: base-type-encoding=NONE
    BT_GNSS_DR_Laenge_Ortung: base-type-encoding=NONE
    BT_GNSS_DR_Nachrichtenpaket_ID1: base-type-encoding=NONE
    BT_GNSS_DR_Nachrichtenpaket_ID2: base-type-encoding=NONE
    BT_GNSS_DR_Nachrichtenpaket_ID5: base-type-encoding=NONE
    BT_GNSS_DR_Ortung_2D_Geschw_u_Grund: base-type-encoding=NONE
    BT_GNSS_DR_Ortung_Ausrichtung: base-type-encoding=NONE
    BT_GNSS_DR_Ortung_Hoehe: base-type-encoding=NONE
    BT_GNSS_DR_Richtung_Breite_Ortung: base-type-encoding=NONE
    BT_GNSS_DR_Richtung_Laenge_Ortung: base-type-encoding=NONE
    BT_GNSS_DR_UTC_Zeit: base-type-encoding=NONE
    BT_GNSS_Empfaenger_Status: base-type-encoding=NONE
    BT_GNSS_Empfangbare_Satelliten: base-type-encoding=NONE
    BT_GNSS_Fehlerzustand: base-type-encoding=NONE
    BT_GNSS_Genutzte_Satelliten: base-type-encoding=NONE
    BT_GNSS_GLONASS_in_Nutzung: base-type-encoding=NONE
    BT_GNSS_GPS_in_Nutzung: base-type-encoding=NONE
    BT_GNSS_Laenge_Ortung: base-type-encoding=NONE
    BT_GNSS_Nachrichtenpaket_ID1: base-type-encoding=NONE
    BT_GNSS_Nachrichtenpaket_ID2: base-type-encoding=NONE
    BT_GNSS_Nachrichtenpaket_ID4: base-type-encoding=NONE
    BT_GNSS_Nachrichtenpaket_ID5: base-type-encoding=NONE
    BT_GNSS_Ortung_2D_Geschw_ue_Grund: base-type-encoding=NONE
    BT_GNSS_Ortung_Ausrichtung: base-type-encoding=NONE
    BT_GNSS_Ortung_FIX_Typ: base-type-encoding=NONE
    BT_GNSS_Ortung_Hoehe: base-type-encoding=NONE
    BT_GNSS_Ortung_Latenz: base-type-encoding=NONE
    BT_GNSS_Ortung_Noerdliche_Geschw: base-type-encoding=NONE
    BT_GNSS_Ortung_Oestliche_Geschw: base-type-encoding=NONE
    BT_GNSS_Ortung_Vertikale_Geschw: base-type-encoding=NONE
    BT_GNSS_Ortung_Zeit_in_GPSWoche: base-type-encoding=NONE
    BT_GNSS_Richtung_Breite_Ortung: base-type-encoding=NONE
    BT_GNSS_Richtung_Laenge_Ortung: base-type-encoding=NONE
    BT_GNSS_Sichtbare_Satelliten: base-type-encoding=NONE
    BT_GNSS_UTC_Zeit: base-type-encoding=NONE
    BT_Gong_TFL_Umschaltung: base-type-encoding=NONE
    BT_GRA_FoD_Status: base-type-encoding=NONE
    BT_GW_KD_Fehler: base-type-encoding=NONE
    BT_HBFS_FH_Bew_hoch: base-type-encoding=NONE
    BT_HBFS_FH_Bew_tief: base-type-encoding=NONE
    BT_HBFS_FH_Block: base-type-encoding=NONE
    BT_HBFS_FH_Fang: base-type-encoding=NONE
    BT_HBFS_FH_normiert: base-type-encoding=NONE
    BT_HBFS_FH_Oeffnung: base-type-encoding=NONE
    BT_HBFS_FH_Oeffnung_4Bit: base-type-encoding=NONE
    BT_HBFS_FH_S_AutoHoch: base-type-encoding=NONE
    BT_HBFS_FH_S_AutoTief: base-type-encoding=NONE
    BT_HBFS_FH_S_HFS_AutoHoch: base-type-encoding=NONE
    BT_HBFS_FH_S_HFS_AutoTief: base-type-encoding=NONE
    BT_HBFS_FH_S_HFS_ManHoch: base-type-encoding=NONE
    BT_HBFS_FH_S_HFS_ManTief: base-type-encoding=NONE
    BT_HBFS_FH_S_ManHoch: base-type-encoding=NONE
    BT_HBFS_FH_S_ManTief: base-type-encoding=NONE
    BT_HBFS_FH_Thermo: base-type-encoding=NONE
    BT_HBFS_gesafet: base-type-encoding=NONE
    BT_HBFS_Heckrollotaster_betaetigt: base-type-encoding=NONE
    BT_HBFS_Lock_Taster: base-type-encoding=NONE
    BT_HBFS_Lock_Taster_inv: base-type-encoding=NONE
    BT_HBFS_MRollo_Schalter: base-type-encoding=NONE
    BT_HBFS_Oben_Block_erw: base-type-encoding=NONE
    BT_HBFS_SAD_Schalter: base-type-encoding=NONE
    BT_HBFS_Seitenrollo_hoch: base-type-encoding=NONE
    BT_HBFS_Seitenrollo_tief: base-type-encoding=NONE
    BT_HBFS_SK_betaetigt: base-type-encoding=NONE
    BT_HBFS_Sperrklinke: base-type-encoding=NONE
    BT_HBFS_Status_eTAG: base-type-encoding=NONE
    BT_HBFS_Status_KiSi: base-type-encoding=NONE
    BT_HBFS_Status_KiSi_inv: base-type-encoding=NONE
    BT_HBFS_TAG_betaetigt: base-type-encoding=NONE
    BT_HBFS_TIG_betaetigt: base-type-encoding=NONE
    BT_HBFS_TIG_betaetigt_oeffnen: base-type-encoding=NONE
    BT_HBFS_TIG_betaetigt_schliessen: base-type-encoding=NONE
    BT_HBFS_Tuer_geoeffnet: base-type-encoding=NONE
    BT_HBFS_Tuer_Status: base-type-encoding=NONE
    BT_HBFS_Tuer_Status_QBit: base-type-encoding=NONE
    BT_HBFS_Tueroeffnen_Warnung: base-type-encoding=NONE
    BT_HBFS_Tuerschloss_defekt: base-type-encoding=NONE
    BT_HBFS_UEKB_aktiviert: base-type-encoding=NONE
    BT_HBFS_Unlock_Taster: base-type-encoding=NONE
    BT_HBFS_Unten_Block_erw: base-type-encoding=NONE
    BT_HBFS_verriegelt: base-type-encoding=NONE
    BT_HBFS_Vorraste_betaetigt: base-type-encoding=NONE
    BT_HBFS_Zuziehhilfe_aktiv: base-type-encoding=NONE
    BT_HD_Bewegung_auf: base-type-encoding=NONE
    BT_HD_Bewegung_zu: base-type-encoding=NONE
    BT_HD_Endstellung_oben: base-type-encoding=NONE
    BT_HD_Endstellung_unten: base-type-encoding=NONE
    BT_HD_Innentaster_betaetigt: base-type-encoding=NONE
    BT_HD_Position: base-type-encoding=NONE
    BT_HD_Rueckmeld_prog: base-type-encoding=NONE
    BT_HD_Taster_defekt: base-type-encoding=NONE
    BT_HD_UeKB_erkannt: base-type-encoding=NONE
    BT_HD_Verr_Taster_betaetigt_inv: base-type-encoding=NONE
    BT_HD_Verriegelungstaster_betaetigt: base-type-encoding=NONE
    BT_HD_ZV_Verr_Taster_betaetigt: base-type-encoding=NONE
    BT_HD_ZZH_Schalter_S3: base-type-encoding=NONE
    BT_HDSG_Anf_Umluftklappe: base-type-encoding=NONE
    BT_HFS_FH_Bew_hoch: base-type-encoding=NONE
    BT_HFS_FH_Bew_tief: base-type-encoding=NONE
    BT_HFS_FH_Block: base-type-encoding=NONE
    BT_HFS_FH_Fang: base-type-encoding=NONE
    BT_HFS_FH_normiert: base-type-encoding=NONE
    BT_HFS_FH_Oeffnung: base-type-encoding=NONE
    BT_HFS_FH_Oeffnung_4Bit: base-type-encoding=NONE
    BT_HFS_FH_S_AutoHoch: base-type-encoding=NONE
    BT_HFS_FH_S_AutoTief: base-type-encoding=NONE
    BT_HFS_FH_S_HBFS_AutoHoch: base-type-encoding=NONE
    BT_HFS_FH_S_HBFS_AutoTief: base-type-encoding=NONE
    BT_HFS_FH_S_HBFS_ManHoch: base-type-encoding=NONE
    BT_HFS_FH_S_HBFS_ManTief: base-type-encoding=NONE
    BT_HFS_FH_S_ManHoch: base-type-encoding=NONE
    BT_HFS_FH_S_ManTief: base-type-encoding=NONE
    BT_HFS_FH_Thermo: base-type-encoding=NONE
    BT_HFS_gesafet: base-type-encoding=NONE
    BT_HFS_Heckrollotaster_betaetigt: base-type-encoding=NONE
    BT_HFS_Lock_Taster: base-type-encoding=NONE
    BT_HFS_Lock_Taster_inv: base-type-encoding=NONE
    BT_HFS_MRollo_Schalter: base-type-encoding=NONE
    BT_HFS_Oben_Block_erw: base-type-encoding=NONE
    BT_HFS_SAD_Schalter: base-type-encoding=NONE
    BT_HFS_Seitenrollo_hoch: base-type-encoding=NONE
    BT_HFS_Seitenrollo_tief: base-type-encoding=NONE
    BT_HFS_SK_betaetigt: base-type-encoding=NONE
    BT_HFS_Sperrklinke: base-type-encoding=NONE
    BT_HFS_Status_eTAG: base-type-encoding=NONE
    BT_HFS_Status_KiSi: base-type-encoding=NONE
    BT_HFS_TAG_betaetigt: base-type-encoding=NONE
    BT_HFS_TCR_Mode_aktiv: base-type-encoding=NONE
    BT_HFS_TIG_betaetigt: base-type-encoding=NONE
    BT_HFS_TIG_betaetigt_oeffnen: base-type-encoding=NONE
    BT_HFS_TIG_betaetigt_schliessen: base-type-encoding=NONE
    BT_HFS_Tuer_geoeffnet: base-type-encoding=NONE
    BT_HFS_Tuer_Status: base-type-encoding=NONE
    BT_HFS_Tuer_Status_QBit: base-type-encoding=NONE
    BT_HFS_Tueroeffnen_Warnung: base-type-encoding=NONE
    BT_HFS_Tuerschloss_defekt: base-type-encoding=NONE
    BT_HFS_UEKB_aktiviert: base-type-encoding=NONE
    BT_HFS_Unlock_Taster: base-type-encoding=NONE
    BT_HFS_Unten_Block_erw: base-type-encoding=NONE
    BT_HFS_verriegelt: base-type-encoding=NONE
    BT_HFS_Vorraste_betaetigt: base-type-encoding=NONE
    BT_HFS_Zuziehhilfe_aktiv: base-type-encoding=NONE
    BT_HHC_Charisma_FahrPr: base-type-encoding=NONE
    BT_HHC_Charisma_Status: base-type-encoding=NONE
    BT_HLR_FlHz_Freigabe_HL: base-type-encoding=NONE
    BT_HLR_FlHz_Freigabe_HR: base-type-encoding=NONE
    BT_HLR_FlHz_Freigabe_Ruhesitz: base-type-encoding=NONE
    BT_HLR_FlHz_Freigabe_VL: base-type-encoding=NONE
    BT_HLR_FlHz_Freigabe_VR: base-type-encoding=NONE
    BT_HLR_FSH_Freigabe: base-type-encoding=NONE
    BT_HLR_HSH_Freigabe: base-type-encoding=NONE
    BT_HLR_KRH_Freigabe_VL: base-type-encoding=NONE
    BT_HLR_KRH_Freigabe_VR: base-type-encoding=NONE
    BT_HLR_LRH_Freigabe: base-type-encoding=NONE
    BT_HLR_PTC_Freigabe: base-type-encoding=NONE
    BT_HLR_PTC_linear_Freigabe: base-type-encoding=NONE
    BT_HLR_SIH_Freigabe_Fond: base-type-encoding=NONE
    BT_HLR_SIH_Freigabe_HL: base-type-encoding=NONE
    BT_HLR_SIH_Freigabe_HR: base-type-encoding=NONE
    BT_HLR_SIH_Freigabe_VL: base-type-encoding=NONE
    BT_HLR_SIH_Freigabe_VR: base-type-encoding=NONE
    BT_HLR_SIL_Freigabe_HL: base-type-encoding=NONE
    BT_HLR_SIL_Freigabe_HR: base-type-encoding=NONE
    BT_HLR_SIL_Freigabe_VL: base-type-encoding=NONE
    BT_HLR_SIL_Freigabe_VR: base-type-encoding=NONE
    BT_HLR_Sp_Heizung_Freigabe_BT: base-type-encoding=NONE
    BT_HLR_Sp_Heizung_Freigabe_FT: base-type-encoding=NONE
    BT_HLR_TCH_Freigabe: base-type-encoding=NONE
    BT_HMS_EML_Steig_Exkl: base-type-encoding=NONE
    BT_HSH_LED: base-type-encoding=NONE
    BT_HSH_Relais_Anf: base-type-encoding=NONE
    BT_HSH_Status: base-type-encoding=NONE
    BT_HSH_Taster: base-type-encoding=NONE
    BT_HV_Bordnetz_aktiv: base-type-encoding=NONE
    BT_HV_Bordnetz_Fehler: base-type-encoding=NONE
    BT_HV_H3_Err_intern: base-type-encoding=NONE
    BT_HV_H3_Err_Leckagestrom: base-type-encoding=NONE
    BT_HV_H3_Err_Temperaturschutz: base-type-encoding=NONE
    BT_HV_H3_Err_Ueberstromabschaltung: base-type-encoding=NONE
    BT_HV_H3_HIGH_VOLTAGE: base-type-encoding=NONE
    BT_HV_H3_HIGH_VOLTAGE_ERR: base-type-encoding=NONE
    BT_HV_H3_I_ist: base-type-encoding=NONE
    BT_HV_H3_ResponseError: base-type-encoding=NONE
    BT_HV_H3_Status_Heizer: base-type-encoding=NONE
    BT_HV_H3_Status_Heizkreis_{1..4}: base-type-encoding=NONE
    BT_HV_H3_Status_UBatt_NV: base-type-encoding=NONE
    BT_HV_H3_Temp_PCB: base-type-encoding=NONE
    BT_HV_H3_TimeOut_Fehler: base-type-encoding=NONE
    BT_HV_H3_UBatt_NV: base-type-encoding=NONE
    BT_HV_H3b_Err_intern: base-type-encoding=NONE
    BT_HV_H3b_Err_Leckagestrom: base-type-encoding=NONE
    BT_HV_H3b_Err_Temperaturschutz: base-type-encoding=NONE
    BT_HV_H3b_Err_Ueberstromabschaltung: base-type-encoding=NONE
    BT_HV_H3b_HIGH_VOLTAGE: base-type-encoding=NONE
    BT_HV_H3b_HIGH_VOLTAGE_ERR: base-type-encoding=NONE
    BT_HV_H3b_I_ist: base-type-encoding=NONE
    BT_HV_H3b_ResponseError: base-type-encoding=NONE
    BT_HV_H3b_Status_Heizer: base-type-encoding=NONE
    BT_HV_H3b_Status_Heizkreis_{1..4}: base-type-encoding=NONE
    BT_HV_H3b_Status_UBatt_NV: base-type-encoding=NONE
    BT_HV_H3b_Temp_PCB: base-type-encoding=NONE
    BT_HV_H3b_TimeOut_Fehler: base-type-encoding=NONE
    BT_HV_H3b_UBatt_NV: base-type-encoding=NONE
    BT_HV_H3be_Geblaesedrehzahl: base-type-encoding=NONE
    BT_HV_H3be_Heizer_ein: base-type-encoding=NONE
    BT_HV_H3be_Heizer_links_soll: base-type-encoding=NONE
    BT_HV_H3be_Heizer_Mitte_soll: base-type-encoding=NONE
    BT_HV_H3be_Heizer_rechts_soll: base-type-encoding=NONE
    BT_HV_H3be_Heizgaskuehler: base-type-encoding=NONE
    BT_HV_H3be_Heizsystem: base-type-encoding=NONE
    BT_HV_H3be_PTC_Zonenanzahl: base-type-encoding=NONE
    BT_HV_H3be_Tempklappenwinkel_li: base-type-encoding=NONE
    BT_HV_H3be_Tempklappenwinkel_mi: base-type-encoding=NONE
    BT_HV_H3be_Tempklappenwinkel_re: base-type-encoding=NONE
    BT_HV_H3be_Verdampfertemp_Delta: base-type-encoding=NONE
    BT_HV_H3be_Verdampfertemp_min: base-type-encoding=NONE
    BT_HV_H3e_Geblaesedrehzahl: base-type-encoding=NONE
    BT_HV_H3e_Heizer_ein: base-type-encoding=NONE
    BT_HV_H3e_Heizer_links_soll: base-type-encoding=NONE
    BT_HV_H3e_Heizer_Mitte_soll: base-type-encoding=NONE
    BT_HV_H3e_Heizer_rechts_soll: base-type-encoding=NONE
    BT_HV_H3e_Heizgaskuehler: base-type-encoding=NONE
    BT_HV_H3e_Heizsystem: base-type-encoding=NONE
    BT_HV_H3e_PTC_Zonenanzahl: base-type-encoding=NONE
    BT_HV_H3e_Tempklappenwinkel_li: base-type-encoding=NONE
    BT_HV_H3e_Tempklappenwinkel_mi: base-type-encoding=NONE
    BT_HV_H3e_Tempklappenwinkel_re: base-type-encoding=NONE
    BT_HV_H3e_Verdampfertemp_Delta: base-type-encoding=NONE
    BT_HV_H3e_Verdampfertemp_min: base-type-encoding=NONE
    BT_HV_H6_aktive_Entladung_Status: base-type-encoding=NONE
    BT_HV_H6_Err_Leckagestrom: base-type-encoding=NONE
    BT_HV_H6_Error_HVH: base-type-encoding=NONE
    BT_HV_H6_Heizmedium_Sensor_1: base-type-encoding=NONE
    BT_HV_H6_Heizmedium_Sensor_2: base-type-encoding=NONE
    BT_HV_H6_High_Voltage: base-type-encoding=NONE
    BT_HV_H6_HV_ERR: base-type-encoding=NONE
    BT_HV_H6_I_ist: base-type-encoding=NONE
    BT_HV_H6_PTC_ResponseError: base-type-encoding=NONE
    BT_HV_H6_Status_HVH: base-type-encoding=NONE
    BT_HV_H6_Status_UBatt: base-type-encoding=NONE
    BT_HV_H6_Temp_PCB: base-type-encoding=NONE
    BT_HV_H6_UBatt: base-type-encoding=NONE
    BT_HVEM_Abschaltstatus: base-type-encoding=NONE
    BT_HVEM_Anf_ReichweiteNV: base-type-encoding=NONE
    BT_HVEM_Betriebsart: base-type-encoding=NONE
    BT_HVEM_DCDC_Freigabe: base-type-encoding=NONE
    BT_HVEM_Energie_Klima_Vorgabe: base-type-encoding=NONE
    BT_HVEM_Energie_Klima_Vorgabe_HighR: base-type-encoding=NONE
    BT_HVEM_FreigabeBattHeizung: base-type-encoding=NONE
    BT_HVEM_FreigabeKlimatisierung: base-type-encoding=NONE
    BT_HVEM_HV_Anf: base-type-encoding=NONE
    BT_HVEM_HVK_Aktivitaet: base-type-encoding=NONE
    BT_HVEM_IstLeistungNA: base-type-encoding=NONE
    BT_HVEM_IstStrom_HVVerbraucher: base-type-encoding=NONE
    BT_HVEM_KlimaMaxHVStrom: base-type-encoding=NONE
    BT_HVEM_Ladesteckerentr_Anf: base-type-encoding=NONE
    BT_HVEM_Leistung_Bat_Kond_Vorgabe: base-type-encoding=NONE
    BT_HVEM_Leistung_Klima_Vorgabe: base-type-encoding=NONE
    BT_HVEM_LeistungsAnf: base-type-encoding=NONE
    BT_HVEM_MinLeistungNA_Anf: base-type-encoding=NONE
    BT_HVEM_MO_MaxLeistungIgnoriert: base-type-encoding=NONE
    BT_HVEM_Nachlad_Status: base-type-encoding=NONE
    BT_HVEM_Nachladen_Anf: base-type-encoding=NONE
    BT_HVEM_Nutzbare_Energie: base-type-encoding=NONE
    BT_HVEM_NVEM_Leistungsvorgabe: base-type-encoding=NONE
    BT_HVEM_NVLeistungEmpf: base-type-encoding=NONE
    BT_HVEM_Pruefpuls_Anf: base-type-encoding=NONE
    BT_HVEM_Text_1: base-type-encoding=NONE
    BT_HVEM_WunschLeistungNA_Anf: base-type-encoding=NONE
    BT_HVEM_ZusatzMinLeistungNA_Anf: base-type-encoding=NONE
    BT_HVH2_Err_Heizkreis_{1..3}: base-type-encoding=NONE
    BT_HVH2_Err_intern: base-type-encoding=NONE
    BT_HVH2_Err_Leckagestrom: base-type-encoding=NONE
    BT_HVH2_Err_Temperaturschutz: base-type-encoding=NONE
    BT_HVH2_Err_Ueberstromabschaltung: base-type-encoding=NONE
    BT_HVH2_Heizmedium_Sensor_1: base-type-encoding=NONE
    BT_HVH2_Heizmedium_Sensor_2: base-type-encoding=NONE
    BT_HVH2_High_Voltage: base-type-encoding=NONE
    BT_HVH2_HV_ERR: base-type-encoding=NONE
    BT_HVH2_I_ist: base-type-encoding=NONE
    BT_HVH2_ResponseError: base-type-encoding=NONE
    BT_HVH2_Status_HVH: base-type-encoding=NONE
    BT_HVH2_Status_UBatt: base-type-encoding=NONE
    BT_HVH2_Temp_PCB: base-type-encoding=NONE
    BT_HVH2_Timeout_Fehler: base-type-encoding=NONE
    BT_HVH2_UBatt: base-type-encoding=NONE
    BT_HVH_ErrMem_State: base-type-encoding=NONE
    BT_HVH_HV_Ilock_Status: base-type-encoding=NONE
    BT_HVH_HV_Voltage: base-type-encoding=NONE
    BT_HVH_HV_Voltage_Offset: base-type-encoding=NONE
    BT_HVH_HVb_Ilock_Status: base-type-encoding=NONE
    BT_HVH_HVb_Voltage: base-type-encoding=NONE
    BT_HVH_HVb_Voltage_Offset: base-type-encoding=NONE
    BT_HVH_ParameterChange: base-type-encoding=NONE
    BT_HVHb_ErrMem_State: base-type-encoding=NONE
    BT_HVHb_ParameterChange: base-type-encoding=NONE
    BT_HVK_01_BZ: base-type-encoding=NONE
    BT_HVK_01_CRC: base-type-encoding=NONE
    BT_HVK_AktiveEntladung_Anf: base-type-encoding=NONE
    BT_HVK_BMS_Sollmodus: base-type-encoding=NONE
    BT_HVK_DCDC_Sollmodus: base-type-encoding=NONE
    BT_HVK_EKK_Sollmodus: base-type-encoding=NONE
    BT_HVK_Gesamtst_Spgfreiheit: base-type-encoding=NONE
    BT_HVK_HV_Netz_Warnungen: base-type-encoding=NONE
    BT_HVK_HVEM_Freigabe: base-type-encoding=NONE
    BT_HVK_HVLM_Sollmodus: base-type-encoding=NONE
    BT_HVK_HVPTC_Sollmodus: base-type-encoding=NONE
    BT_HVK_Iso_Messung_Start: base-type-encoding=NONE
    BT_HVK_Istmodus_Anf: base-type-encoding=NONE
    BT_HVK_Ladebereit: base-type-encoding=NONE
    BT_HVK_Notabschaltung_Anf: base-type-encoding=NONE
    BT_HVK_PPulsFreigabe: base-type-encoding=NONE
    BT_HVK_TN1_Sollmodus: base-type-encoding=NONE
    BT_HVK_Vorladung_aktiv: base-type-encoding=NONE
    BT_HVLM_17_BZ: base-type-encoding=NONE
    BT_HVLM_17_CRC: base-type-encoding=NONE
    BT_HVLM_Blindleistung: base-type-encoding=NONE
    BT_HVLM_Blindleistung_2: base-type-encoding=NONE
    BT_HVLM_Blindleistung_3: base-type-encoding=NONE
    BT_HVLM_DCBoostLaden_Anf: base-type-encoding=NONE
    BT_HVLM_IstSpannungFzgPlc: base-type-encoding=NONE
    BT_HVLM_Ladeenergie: base-type-encoding=NONE
    BT_HVLM_MaxLadeleistungDcFzg: base-type-encoding=NONE
    BT_HVLM_MeterInfoRequestFzgPlc: base-type-encoding=NONE
    BT_HVLM_OeffnenSchliessenAnf_Lk{1..3}: base-type-encoding=NONE
    BT_HVLM_RQCP_Anf: base-type-encoding=NONE
    BT_HVLM_ServiceIDFzgPlc: base-type-encoding=NONE
    BT_HVLM_SOC_Kalib_Conf: base-type-encoding=NONE
    BT_HVLM_TLS_Version: base-type-encoding=NONE
    BT_HVLM_TriggerScheduleRenegFzgPlc: base-type-encoding=NONE
    BT_HVLM_V2L_EV_CAN_Wakeup_zulassen: base-type-encoding=NONE
    BT_HVLM_V2X_SollModus: base-type-encoding=NONE
    BT_HVLM_VasAnzeige_ZielSoc: base-type-encoding=NONE
    BT_HVLM_Wirkleistung: base-type-encoding=NONE
    BT_HVLM_Wirkleistung_2: base-type-encoding=NONE
    BT_HVLM_Wirkleistung_3: base-type-encoding=NONE
    BT_IAA_Active_User_ID: base-type-encoding=NONE
    BT_IAA_Identified_User_ID: base-type-encoding=NONE
    BT_IAA_PSO_wake_up: base-type-encoding=NONE
    BT_iCall_active: base-type-encoding=NONE
    BT_ICO2_Alarm: base-type-encoding=NONE
    BT_ICO2_BZ: base-type-encoding=NONE
    BT_ICO2_CO2_Wert: base-type-encoding=NONE
    BT_ICO2_defekt: base-type-encoding=NONE
    BT_ICO2_Gradient: base-type-encoding=NONE
    BT_ICO2_Laufzeit: base-type-encoding=NONE
    BT_ICO2_Luftdruck: base-type-encoding=NONE
    BT_ICO2_Luftdruck_2: base-type-encoding=NONE
    BT_ICO2_Messvorgabe: base-type-encoding=NONE
    BT_ICO2_Messzyklus1: base-type-encoding=NONE
    BT_ICO2_Messzyklus2: base-type-encoding=NONE
    BT_ICO2_ResponseError: base-type-encoding=NONE
    BT_ICO2_Status_Kabine: base-type-encoding=NONE
    BT_ICO2b_Alarm: base-type-encoding=NONE
    BT_ICO2b_BZ: base-type-encoding=NONE
    BT_ICO2b_CO2_Wert: base-type-encoding=NONE
    BT_ICO2b_defekt: base-type-encoding=NONE
    BT_ICO2b_Gradient: base-type-encoding=NONE
    BT_ICO2b_Laufzeit: base-type-encoding=NONE
    BT_ICO2b_Luftdruck: base-type-encoding=NONE
    BT_ICO2b_Luftdruck_2: base-type-encoding=NONE
    BT_ICO2b_Messvorgabe: base-type-encoding=NONE
    BT_ICO2b_Messzyklus1: base-type-encoding=NONE
    BT_ICO2b_Messzyklus2: base-type-encoding=NONE
    BT_ICO2b_ResponseError: base-type-encoding=NONE
    BT_ICO2b_Status_Kabine: base-type-encoding=NONE
    BT_ION_0e_Dummy: base-type-encoding=NONE
    BT_ION_0s_Dummy: base-type-encoding=NONE
    BT_ION_Adressegment: base-type-encoding=NONE
    BT_ION_Adressinhalt: base-type-encoding=NONE
    BT_ION_BZ: base-type-encoding=NONE
    BT_ION_Fehler_Emitter: base-type-encoding=NONE
    BT_ION_Fehler_Emitter_2: base-type-encoding=NONE
    BT_ION_Fehler_Intern: base-type-encoding=NONE
    BT_ION_Fehler_LED: base-type-encoding=NONE
    BT_ION_Fehler_Taster: base-type-encoding=NONE
    BT_ION_FehlerGueltigkeit: base-type-encoding=NONE
    BT_ION_HW: base-type-encoding=NONE
    BT_ION_ResponseError: base-type-encoding=NONE
    BT_ION_Status: base-type-encoding=NONE
    BT_ION_Status_LED: base-type-encoding=NONE
    BT_ION_Status_Taster: base-type-encoding=NONE
    BT_ION_SW: base-type-encoding=NONE
    BT_IRUE_aktiv: base-type-encoding=NONE
    BT_IRUE_Taster_Fkts_LED: base-type-encoding=NONE
    BT_ISA_Regelung_aktiv: base-type-encoding=NONE
    BT_ISA_Status: base-type-encoding=NONE
    BT_ISOALLReqB{0..7}: base-type-encoding=NONE
    BT_KBF_defekt: base-type-encoding=NONE
    BT_KBF_Einheiten: base-type-encoding=NONE
    BT_KBF_ResponseError: base-type-encoding=NONE
    BT_KBF_SIH_Diag: base-type-encoding=NONE
    BT_KBF_SIH_hl_Status: base-type-encoding=NONE
    BT_KBF_SIH_hr_Status: base-type-encoding=NONE
    BT_KBF_Strom_SIH_hl: base-type-encoding=NONE
    BT_KBF_Strom_SIH_hr: base-type-encoding=NONE
    BT_KBF_Tasten_Fehler: base-type-encoding=NONE
    BT_KBF_Temp_Fuss_Fond: base-type-encoding=NONE
    BT_KBF_Temp_MA_Fond: base-type-encoding=NONE
    BT_KBF_Temp_SIH_hl: base-type-encoding=NONE
    BT_KBF_Temp_SIH_hr: base-type-encoding=NONE
    BT_KBI_Aussen_Temp_gef: base-type-encoding=NONE
    BT_KBI_Einheit_Datum: base-type-encoding=NONE
    BT_KBI_Einheit_Druck: base-type-encoding=NONE
    BT_KBI_Einheit_Masse: base-type-encoding=NONE
    BT_KBI_Einheit_Sprache: base-type-encoding=NONE
    BT_KBI_Einheit_Streckenanz: base-type-encoding=NONE
    BT_KBI_Einheit_Tacho: base-type-encoding=NONE
    BT_KBI_Einheit_Temp: base-type-encoding=NONE
    BT_KBI_Einheit_Uhrzeit: base-type-encoding=NONE
    BT_KBI_Einheit_Verbrauch: base-type-encoding=NONE
    BT_KBI_Einheit_Verbrauch_elektr: base-type-encoding=NONE
    BT_KBI_Einheit_Verbrauch_Gas: base-type-encoding=NONE
    BT_KBI_Einheit_Volumen: base-type-encoding=NONE
    BT_KBI_Kilometerstand: base-type-encoding=NONE
    BT_KBI_MFA_v_Einheit_02: base-type-encoding=NONE
    BT_KBI_QBit_Aussen_Temp_gef: base-type-encoding=NONE
    BT_KBT_CODE_VEHICLE: base-type-encoding=NONE
    BT_KBT_Defrost_aktiv: base-type-encoding=NONE
    BT_KBT_RAMP: base-type-encoding=NONE
    BT_KBT_RX_FREQUENCY: base-type-encoding=NONE
    BT_KBT_SAFETY_SPEED: base-type-encoding=NONE
    BT_KBT_SPEED: base-type-encoding=NONE
    BT_KL_AC_Schalter: base-type-encoding=NONE
    BT_KL_ActiveDischarge: base-type-encoding=NONE
    BT_KL_AirCleaner_aktiv: base-type-encoding=NONE
    BT_KL_Ak_Verd_hi_li: base-type-encoding=NONE
    BT_KL_Ak_Verd_hi_re: base-type-encoding=NONE
    BT_KL_Ak_Verd_hinten: base-type-encoding=NONE
    BT_KL_Ak_Verd_links: base-type-encoding=NONE
    BT_KL_Ak_Verd_rechts: base-type-encoding=NONE
    BT_KL_Ak_Verd_vo_li: base-type-encoding=NONE
    BT_KL_Ak_Verd_vo_re: base-type-encoding=NONE
    BT_KL_Ak_Verd_vorne: base-type-encoding=NONE
    BT_KL_AL_HL_Anf: base-type-encoding=NONE
    BT_KL_AL_HR_Anf: base-type-encoding=NONE
    BT_KL_AL_VL_Anf: base-type-encoding=NONE
    BT_KL_AL_VR_Anf: base-type-encoding=NONE
    BT_KL_Anf_AussenspiegelHzg: base-type-encoding=NONE
    BT_KL_Anf_KL: base-type-encoding=NONE
    BT_KL_Anf_KV: base-type-encoding=NONE
    BT_KL_Anf_rLM: base-type-encoding=NONE
    BT_KL_Anz_auto_hl: base-type-encoding=NONE
    BT_KL_Anz_Geblaese_hl: base-type-encoding=NONE
    BT_KL_Anz_mitte_hl: base-type-encoding=NONE
    BT_KL_Anz_oben_hl: base-type-encoding=NONE
    BT_KL_Anz_seite_defog_hl: base-type-encoding=NONE
    BT_KL_Anz_seite_hl: base-type-encoding=NONE
    BT_KL_Anz_Temp_Einheit: base-type-encoding=NONE
    BT_KL_Anz_Temp_hl: base-type-encoding=NONE
    BT_KL_Anz_Temp_hr: base-type-encoding=NONE
    BT_KL_Anz_unten_hl: base-type-encoding=NONE
    BT_KL_AQI_Innenraum: base-type-encoding=NONE
    BT_KL_Ausstattung_Klima: base-type-encoding=NONE
    BT_KL_Batterieheizen_Freigabe: base-type-encoding=NONE
    BT_KL_BattKond_WaPu_DZMax: base-type-encoding=NONE
    BT_KL_BCmE_Livetip_Freigabe: base-type-encoding=NONE
    BT_KL_Beschlagsgefahr: base-type-encoding=NONE
    BT_KL_Betriebsmodus_FH: base-type-encoding=NONE
    BT_KL_Charisma_FahrPr: base-type-encoding=NONE
    BT_KL_Charisma_Status: base-type-encoding=NONE
    BT_KL_Defrost_LED: base-type-encoding=NONE
    BT_KL_Drehz_Anh: base-type-encoding=NONE
    BT_KL_Einheiten: base-type-encoding=NONE
    BT_KL_EKK_2_Status_Spgfreiheit: base-type-encoding=NONE
    BT_KL_EKK_Status_Spgfreiheit: base-type-encoding=NONE
    BT_KL_EKK_Strom: base-type-encoding=NONE
    BT_KL_el_Zuheizer_Stufe: base-type-encoding=NONE
    BT_KL_Enteisung_Anf: base-type-encoding=NONE
    BT_KL_ErwVK_Anf: base-type-encoding=NONE
    BT_KL_ErwVK_Beifahrerzone: base-type-encoding=NONE
    BT_KL_ErwVK_Fahrerzone: base-type-encoding=NONE
    BT_KL_ErwVK_Heckzone_links: base-type-encoding=NONE
    BT_Kl_ErwVK_Heckzone_rechts: base-type-encoding=NONE
    BT_KL_ErwVK_Scheibenheizung: base-type-encoding=NONE
    BT_KL_ErwVK_Status: base-type-encoding=NONE
    BT_KL_eTM_SollVolumenstrom: base-type-encoding=NONE
    BT_KL_Fehler_HV_EKK: base-type-encoding=NONE
    BT_KL_Fehler_HV_Heizer: base-type-encoding=NONE
    BT_KL_Fehler_NTKreis: base-type-encoding=NONE
    BT_KL_Fond_Status: base-type-encoding=NONE
    BT_KL_Fondbedienung_aktiv: base-type-encoding=NONE
    BT_KL_Freilauf_Info: base-type-encoding=NONE
    BT_KL_FSH_Automatikbetrieb: base-type-encoding=NONE
    BT_KL_FSH_LED: base-type-encoding=NONE
    BT_KL_FSH_Soll: base-type-encoding=NONE
    BT_KL_Geblaese_Fond_Status: base-type-encoding=NONE
    BT_KL_Geblaese_Status: base-type-encoding=NONE
    BT_KL_Geblspng_Fond_Soll: base-type-encoding=NONE
    BT_KL_Geblspng_Soll: base-type-encoding=NONE
    BT_KL_HBT_Geblaesestufe_anzeigen: base-type-encoding=NONE
    BT_KL_HBT_Verbausituation: base-type-encoding=NONE
    BT_KL_Heizbedarf: base-type-encoding=NONE
    BT_KL_Heizbedarf_Anf: base-type-encoding=NONE
    BT_KL_Heizen_Status: base-type-encoding=NONE
    BT_KL_Heizkreisventilstellung: base-type-encoding=NONE
    BT_KL_Heizstufe_LSH: base-type-encoding=NONE
    BT_KL_Hinweis_Kuehlmodus: base-type-encoding=NONE
    BT_KL_HSH_LED: base-type-encoding=NONE
    BT_KL_HSH_Soll: base-type-encoding=NONE
    BT_KL_HUP_aktiv: base-type-encoding=NONE
    BT_KL_HV_Energie_Anf: base-type-encoding=NONE
    BT_KL_HV_H6_aktive_Entladung: base-type-encoding=NONE
    BT_KL_HV_H6_Durchflussrichtung: base-type-encoding=NONE
    BT_KL_HV_H6_ein: base-type-encoding=NONE
    BT_KL_HV_H6_soll: base-type-encoding=NONE
    BT_KL_HV_Hb_ein: base-type-encoding=NONE
    BT_KL_HV_Hb_soll: base-type-encoding=NONE
    BT_KL_HV_Heizer_Strom: base-type-encoding=NONE
    BT_KL_HV_PTC_ein: base-type-encoding=NONE
    BT_KL_HV_PTC_soll: base-type-encoding=NONE
    BT_KL_HVH_1_VerbautStatus: base-type-encoding=NONE
    BT_KL_HVH_2_Status_Spgfreiheit: base-type-encoding=NONE
    BT_KL_HVH_2_VerbautStatus: base-type-encoding=NONE
    BT_KL_HVH_3_VerbautStatus: base-type-encoding=NONE
    BT_KL_HVHeizer2_ein: base-type-encoding=NONE
    BT_KL_HVHeizer2_soll: base-type-encoding=NONE
    BT_KL_HWT_Sollvolumenstrom: base-type-encoding=NONE
    BT_KL_I_Geblaese: base-type-encoding=NONE
    BT_KL_I_Geblaese_Fond: base-type-encoding=NONE
    BT_KL_Innen_Temp: base-type-encoding=NONE
    BT_KL_Innentemp_KBT_Sensor: base-type-encoding=NONE
    BT_KL_Ionisator: base-type-encoding=NONE
    BT_KL_IstLeistung: base-type-encoding=NONE
    BT_KL_K_Status: base-type-encoding=NONE
    BT_KL_KBF_Sync: base-type-encoding=NONE
    BT_KL_KD_Fehler: base-type-encoding=NONE
    BT_KL_Kennlinie: base-type-encoding=NONE
    BT_KL_Klappe_Status: base-type-encoding=NONE
    BT_KL_KLE_Fehler_Anf: base-type-encoding=NONE
    BT_KL_KLh_aus: base-type-encoding=NONE
    BT_KL_KLh_LastMode: base-type-encoding=NONE
    BT_KL_KLh_lock: base-type-encoding=NONE
    BT_Kl_Klima_Aktiv: base-type-encoding=NONE
    BT_KL_Klimastandzeit: base-type-encoding=NONE
    BT_KL_KM_ASV_01_Status: base-type-encoding=NONE
    BT_KL_KM_ASV_02_Status: base-type-encoding=NONE
    BT_KL_Komp_Moment_alt: base-type-encoding=NONE
    BT_KL_Kompressorkupplung: base-type-encoding=NONE
    BT_KL_Kompressorkupplung_linear: base-type-encoding=NONE
    BT_KL_Kompressorstrom_soll: base-type-encoding=NONE
    BT_KL_Kuehlungs_Status: base-type-encoding=NONE
    BT_KL_Kundenwunsch_Kuehlen: base-type-encoding=NONE
    BT_KL_Last_Kompr: base-type-encoding=NONE
    BT_KL_Leistung_BattHeizung: base-type-encoding=NONE
    BT_KL_Leistung_Klima_Anf: base-type-encoding=NONE
    BT_KL_LRH_FoD_Status: base-type-encoding=NONE
    BT_KL_LRH_PWM: base-type-encoding=NONE
    BT_KL_LRH_Soll: base-type-encoding=NONE
    BT_KL_LRH_Stufe: base-type-encoding=NONE
    BT_KL_LRH_Taster: base-type-encoding=NONE
    BT_KL_LSH_Ansteuerung: base-type-encoding=NONE
    BT_KL_LSH_Betriebsdauer: base-type-encoding=NONE
    BT_KL_LSH_DBetr_Bestaet: base-type-encoding=NONE
    BT_KL_LSH_DBetr_Ein: base-type-encoding=NONE
    BT_KL_Magnetventil: base-type-encoding=NONE
    BT_KL_Meldung_Status: base-type-encoding=NONE
    BT_Kl_Meldung_Status2: base-type-encoding=NONE
    BT_KL_Mot_Tk_Soll_li: base-type-encoding=NONE
    BT_KL_Mot_Tk_Soll_re: base-type-encoding=NONE
    BT_KL_nachtr_Stopp_Anf: base-type-encoding=NONE
    BT_KL_OBD_Status: base-type-encoding=NONE
    BT_KL_OBD_Status_Auth: base-type-encoding=NONE
    BT_KL_PTC_ein: base-type-encoding=NONE
    BT_KL_PTC_Rampe: base-type-encoding=NONE
    BT_KL_PTC_soll: base-type-encoding=NONE
    BT_KL_PTC_Verbauinfo: base-type-encoding=NONE
    BT_KL_Pumpe_02_Soll: base-type-encoding=NONE
    BT_KL_Reheat_Innenraum: base-type-encoding=NONE
    BT_KL_Restwaerme_aktiv: base-type-encoding=NONE
    BT_KL_Scheibe_Typ: base-type-encoding=NONE
    BT_KL_SDA_AQS_COBereich: base-type-encoding=NONE
    BT_KL_SDA_AQS_COStatus: base-type-encoding=NONE
    BT_KL_SDA_AQS_NoxBereich: base-type-encoding=NONE
    BT_KL_SDA_AQS_NoxStatus: base-type-encoding=NONE
    BT_KL_SDA_AQS_Traffic: base-type-encoding=NONE
    BT_KL_SDA_AQS_VOZBereich: base-type-encoding=NONE
    BT_KL_SDA_AQS_VOZStatus: base-type-encoding=NONE
    BT_KL_SDA_Klima_Automatik: base-type-encoding=NONE
    BT_KL_SDA_Luft_Feinstaub: base-type-encoding=NONE
    BT_KL_SDA_Luft_Qualitaet: base-type-encoding=NONE
    BT_KL_SDA_Luftverteilung_Person: base-type-encoding=NONE
    BT_KL_SDA_Luftverteilung_Scheibe: base-type-encoding=NONE
    BT_KL_SDA_Luftverteilung_Unten: base-type-encoding=NONE
    BT_KL_SDA_Menutaste: base-type-encoding=NONE
    BT_KL_SDA_Sitzheizung_VL: base-type-encoding=NONE
    BT_KL_SDA_Sitzheizung_VR: base-type-encoding=NONE
    BT_KL_SDA_Sitzlueftung_VL: base-type-encoding=NONE
    BT_KL_SDA_Sitzlueftung_VR: base-type-encoding=NONE
    BT_KL_SDA_Sonderfkt_AirCare: base-type-encoding=NONE
    BT_KL_SDA_Sonderfkt_HSH: base-type-encoding=NONE
    BT_KL_SDA_Sonderfkt_MaxAC: base-type-encoding=NONE
    BT_KL_SDA_Sonderfkt_MaxDefrost: base-type-encoding=NONE
    BT_KL_SDA_Sonderfunktionen_Sprache: base-type-encoding=NONE
    BT_KL_SDA_Temp_Kundenwunsch_2: base-type-encoding=NONE
    BT_KL_SDA_Temp_Kundenwunsch_3: base-type-encoding=NONE
    BT_KL_Senderkennung: base-type-encoding=NONE
    BT_KL_SH_Soll_hl: base-type-encoding=NONE
    BT_KL_SH_Soll_hr: base-type-encoding=NONE
    BT_KL_SIH_Anforderung_hl: base-type-encoding=NONE
    BT_KL_SIH_Anforderung_hr: base-type-encoding=NONE
    BT_KL_SIH_hl_Leistung: base-type-encoding=NONE
    BT_KL_SIH_hl_Temp_aus: base-type-encoding=NONE
    BT_KL_SIH_hl_Temp_ein: base-type-encoding=NONE
    BT_KL_SIH_hl_Vorgabe: base-type-encoding=NONE
    BT_KL_SIH_hr_Leistung: base-type-encoding=NONE
    BT_KL_SIH_hr_Temp_aus: base-type-encoding=NONE
    BT_KL_SIH_hr_Temp_ein: base-type-encoding=NONE
    BT_KL_SIH_hr_Vorgabe: base-type-encoding=NONE
    BT_KL_SIH_LEH_Verteilung_VL: base-type-encoding=NONE
    BT_KL_SIH_LEH_Verteilung_VR: base-type-encoding=NONE
    BT_KL_SIH_LEL_Verteilung_VL: base-type-encoding=NONE
    BT_KL_SIH_LEL_Verteilung_VR: base-type-encoding=NONE
    BT_KL_SIH_Soll_li: base-type-encoding=NONE
    BT_KL_SIH_Soll_re: base-type-encoding=NONE
    BT_KL_SIL_Soll_li: base-type-encoding=NONE
    BT_KL_SIL_Soll_re: base-type-encoding=NONE
    BT_KL_Sitzkennlinie_Heck: base-type-encoding=NONE
    BT_KL_SL_Soll_hl: base-type-encoding=NONE
    BT_KL_SL_Soll_hr: base-type-encoding=NONE
    BT_KL_SMod_SIH_Stufe_LED_hl: base-type-encoding=NONE
    BT_KL_SMod_SIH_Stufe_LED_hr: base-type-encoding=NONE
    BT_KL_SMod_SIL_Stufe_LED_hl: base-type-encoding=NONE
    BT_KL_SMod_SIL_Stufe_LED_hr: base-type-encoding=NONE
    BT_KL_Solarluefter_aktiv: base-type-encoding=NONE
    BT_KL_SoSe_Intensitaet_BFS: base-type-encoding=NONE
    BT_KL_SoSe_Intensitaet_FS: base-type-encoding=NONE
    BT_KL_Spannungs_Anf: base-type-encoding=NONE
    BT_KL_Standklima_RemoteModus: base-type-encoding=NONE
    BT_KL_Standklima_Status_02: base-type-encoding=NONE
    BT_KL_Standklima_Status_03: base-type-encoding=NONE
    BT_KL_StartStopp_Info: base-type-encoding=NONE
    BT_KL_Status_Battkuehlung: base-type-encoding=NONE
    BT_KL_Status_EoHVL_EKK: base-type-encoding=NONE
    BT_KL_Status_EoHVL_Heizer: base-type-encoding=NONE
    BT_KL_Status_EoHVL_Heizer_2: base-type-encoding=NONE
    BT_KL_Status_EoHVL_Heizer_3: base-type-encoding=NONE
    BT_KL_Status_Soll: base-type-encoding=NONE
    BT_KL_StellgliedtestINV_Heck: base-type-encoding=NONE
    BT_KL_STH_aktiv: base-type-encoding=NONE
    BT_KL_STH_Ansteuerung: base-type-encoding=NONE
    BT_KL_STH_Betriebsdauer: base-type-encoding=NONE
    BT_KL_STH_Betriebsdauer_lang: base-type-encoding=NONE
    BT_KL_STL_aktiv: base-type-encoding=NONE
    BT_KL_Stopp_Wiederstart_Anz_{01..09}: base-type-encoding=NONE
    BT_KL_Stopp_Wiederstart_Anz_Std1: base-type-encoding=NONE
    BT_KL_Stopp_Wiederstart_Anz_Std2: base-type-encoding=NONE
    BT_KL_T_Charge: base-type-encoding=NONE
    BT_KL_Temp_hl: base-type-encoding=NONE
    BT_KL_Temp_HL_Soll: base-type-encoding=NONE
    BT_KL_Temp_Kundenwunsch: base-type-encoding=NONE
    BT_KL_Temp_Status_hl: base-type-encoding=NONE
    BT_KL_Temp_vor_NTK: base-type-encoding=NONE
    BT_KL_Temp_ZH_Soll: base-type-encoding=NONE
    BT_KL_Texte: base-type-encoding=NONE
    BT_KL_Thermomanagement: base-type-encoding=NONE
    BT_KL_UIF_Parametersatz: base-type-encoding=NONE
    BT_KL_Umluft_Taste: base-type-encoding=NONE
    BT_KL_Umluftklappe_Status: base-type-encoding=NONE
    BT_KL_Variante_Standheizung: base-type-encoding=NONE
    BT_KL_Ventil_03_Soll: base-type-encoding=NONE
    BT_KL_Ventil_10_Status: base-type-encoding=NONE
    BT_KL_Verdeckstatus: base-type-encoding=NONE
    BT_KL_VK_Anf: base-type-encoding=NONE
    BT_KL_VK_Betriebsdauer: base-type-encoding=NONE
    BT_KL_VoKo_LED: base-type-encoding=NONE
    BT_KL_Voko_Status: base-type-encoding=NONE
    BT_KL_Vorkond_Strategie: base-type-encoding=NONE
    BT_KL_Vorwarn_HVHeizer_Leistung: base-type-encoding=NONE
    BT_KL_Vorwarn_Komp_ein: base-type-encoding=NONE
    BT_KL_Vorwarn_Zuheizer_ein: base-type-encoding=NONE
    BT_KL_WaPu: base-type-encoding=NONE
    BT_KL_Wasserheizer_Ansteuerung: base-type-encoding=NONE
    BT_KL_Wasserheizer_IstTemp_Ausgang: base-type-encoding=NONE
    BT_KL_Wasserheizer_IstTemp_Eingang: base-type-encoding=NONE
    BT_KL_Wasserheizer_SollTemp_Ausgang: base-type-encoding=NONE
    BT_KL_Wasserheizer_Status: base-type-encoding=NONE
    BT_KL_ZR_Anforderung: base-type-encoding=NONE
    BT_KL_Zuheizer_Freigabe: base-type-encoding=NONE
    BT_KL_Zustand: base-type-encoding=NONE
    BT_KL_ZZ_Betriebsmodus: base-type-encoding=NONE
    BT_KL_ZZ_Minute: base-type-encoding=NONE
    BT_KL_ZZ_Monat: base-type-encoding=NONE
    BT_KL_ZZ_Status_Timer: base-type-encoding=NONE
    BT_KL_ZZ_Stunde: base-type-encoding=NONE
    BT_KL_ZZ_Tag: base-type-encoding=NONE
    BT_Klemme_15: base-type-encoding=NONE
    BT_Klemmen_Status_01_BZ: base-type-encoding=NONE
    BT_Klemmen_Status_01_CRC: base-type-encoding=NONE
    BT_Klemmen_Status_02_BZ: base-type-encoding=NONE
    BT_Klemmen_Status_02_CRC: base-type-encoding=NONE
    BT_KLh_aus: base-type-encoding=NONE
    BT_KLh_Ausstattung_KlimaHeck: base-type-encoding=NONE
    BT_KLh_Fehler{1..8}: base-type-encoding=NONE
    BT_KLh_Seite_defog_hl: base-type-encoding=NONE
    BT_KLh_SIH_Last_defekt_hl: base-type-encoding=NONE
    BT_KLh_SIH_Last_defekt_hr: base-type-encoding=NONE
    BT_KLh_SIH_NTC_defekt_hl: base-type-encoding=NONE
    BT_KLh_SIH_NTC_defekt_hr: base-type-encoding=NONE
    BT_KLh_SIH_Stufe_hl: base-type-encoding=NONE
    BT_KLh_SIH_Stufe_hr: base-type-encoding=NONE
    BT_KLh_toggle_LVT: base-type-encoding=NONE
    BT_KLhl_GeblaeseSoll: base-type-encoding=NONE
    BT_KLhl_Luft_auto: base-type-encoding=NONE
    BT_KLhl_Luft_mitte: base-type-encoding=NONE
    BT_KLhl_Luft_oben: base-type-encoding=NONE
    BT_KLhl_Luft_seite: base-type-encoding=NONE
    BT_KLhl_Luft_unten: base-type-encoding=NONE
    BT_KLhl_ResponseError: base-type-encoding=NONE
    BT_KLhl_TempSoll: base-type-encoding=NONE
    BT_KLhr_TempSoll: base-type-encoding=NONE
    BT_KLhs_02_alt: base-type-encoding=NONE
    BT_Klima_Abschaltstufe: base-type-encoding=NONE
    BT_Klima_KompSchutz: base-type-encoding=NONE
    BT_Klima_Nachlauftyp: base-type-encoding=NONE
    BT_Klima_Transport_Mode: base-type-encoding=NONE
    BT_KN_KL_DiagPfad: base-type-encoding=NONE
    BT_KN_Klima_BusKnockOut: base-type-encoding=NONE
    BT_KN_Klima_BusKnockOutTimer: base-type-encoding=NONE
    BT_KN_Klima_ECUKnockOutTimer: base-type-encoding=NONE
    BT_Kombi_02_alt: base-type-encoding=NONE
    BT_KompressorModus: base-type-encoding=NONE
    BT_KPV_AC: base-type-encoding=NONE
    BT_KPV_AC_max: base-type-encoding=NONE
    BT_KPV_AC_Taste: base-type-encoding=NONE
    BT_KPV_Auto_li: base-type-encoding=NONE
    BT_KPV_Auto_Taste: base-type-encoding=NONE
    BT_KPV_AutoSiKli_li: base-type-encoding=NONE
    BT_KPV_AutoSiKli_re: base-type-encoding=NONE
    BT_KPV_AutoUmluft: base-type-encoding=NONE
    BT_KPV_Beduftung: base-type-encoding=NONE
    BT_KPV_Defrost: base-type-encoding=NONE
    BT_KPV_DefrostMAX_Taste: base-type-encoding=NONE
    BT_KPV_ECO: base-type-encoding=NONE
    BT_KPV_FSH: base-type-encoding=NONE
    BT_KPV_Geblaese_Auto_li: base-type-encoding=NONE
    BT_KPV_Geblaese_Stufe_li: base-type-encoding=NONE
    BT_KPV_HSH: base-type-encoding=NONE
    BT_KPV_HSH_Taste: base-type-encoding=NONE
    BT_KPV_Init: base-type-encoding=NONE
    BT_KPV_Init_2: base-type-encoding=NONE
    BT_KPV_Ionisator: base-type-encoding=NONE
    BT_KPV_Joker_Taste: base-type-encoding=NONE
    BT_KPV_Klima_Menue_MMI: base-type-encoding=NONE
    BT_KPV_Konditionierung_Taste: base-type-encoding=NONE
    BT_KPV_Kopfraumheizung_li: base-type-encoding=NONE
    BT_KPV_Kopfraumheizung_re: base-type-encoding=NONE
    BT_KPV_Lokalaktiv: base-type-encoding=NONE
    BT_KPV_Luftverteilung_Auto_li: base-type-encoding=NONE
    BT_KPV_Luftverteilung_Mitte_li: base-type-encoding=NONE
    BT_KPV_Luftverteilung_Oben_li: base-type-encoding=NONE
    BT_KPV_Luftverteilung_Unten_li: base-type-encoding=NONE
    BT_KPV_OBD: base-type-encoding=NONE
    BT_KPV_OBD_Gruppe: base-type-encoding=NONE
    BT_KPV_Off: base-type-encoding=NONE
    BT_KPV_Panel_Error: base-type-encoding=NONE
    BT_KPV_Popup_Content_ZL1R: base-type-encoding=NONE
    BT_KPV_Popup_Content_ZR1R: base-type-encoding=NONE
    BT_KPV_PureAir: base-type-encoding=NONE
    BT_KPV_Rear: base-type-encoding=NONE
    BT_KPV_ResponseError: base-type-encoding=NONE
    BT_KPV_Restwaerme: base-type-encoding=NONE
    BT_KPV_Sitzheizung_li: base-type-encoding=NONE
    BT_KPV_Sitzheizung_re: base-type-encoding=NONE
    BT_KPV_Sitzlueftung_li: base-type-encoding=NONE
    BT_KPV_Sitzlueftung_re: base-type-encoding=NONE
    BT_KPV_Status_Spannung: base-type-encoding=NONE
    BT_KPV_Sync: base-type-encoding=NONE
    BT_KPV_Tasten_Fehler: base-type-encoding=NONE
    BT_KPV_Temp_li: base-type-encoding=NONE
    BT_KPV_Temp_Platine: base-type-encoding=NONE
    BT_KPV_Temp_re: base-type-encoding=NONE
    BT_KPV_Umluft: base-type-encoding=NONE
    BT_KPV_Zustand_Off: base-type-encoding=NONE
    BT_KPVe_Auto_Toggle: base-type-encoding=NONE
    BT_KPVe_Einheit: base-type-encoding=NONE
    BT_KPVe_Funktion_AC: base-type-encoding=NONE
    BT_KPVe_Funktion_AC_max: base-type-encoding=NONE
    BT_KPVe_Funktion_Auto_li: base-type-encoding=NONE
    BT_KPVe_Funktion_AutoSiKli_li: base-type-encoding=NONE
    BT_KPVe_Funktion_AutoSiKli_re: base-type-encoding=NONE
    BT_KPVe_Funktion_AutoUmluft: base-type-encoding=NONE
    BT_KPVe_Funktion_Beduftung: base-type-encoding=NONE
    BT_KPVe_Funktion_Defrost: base-type-encoding=NONE
    BT_KPVe_Funktion_ECO: base-type-encoding=NONE
    BT_KPVe_Funktion_ECO_Zone: base-type-encoding=NONE
    BT_KPVe_Funktion_FSH: base-type-encoding=NONE
    BT_KPVe_Funktion_HSH: base-type-encoding=NONE
    BT_KPVe_Funktion_Ionisator: base-type-encoding=NONE
    BT_KPVe_Funktion_Joker_Taste: base-type-encoding=NONE
    BT_KPVe_Funktion_Klima_Menue_MMI: base-type-encoding=NONE
    BT_KPVe_Funktion_Konditionierung: base-type-encoding=NONE
    BT_KPVe_Funktion_Locked: base-type-encoding=NONE
    BT_KPVe_Funktion_OBD: base-type-encoding=NONE
    BT_KPVe_Funktion_Off: base-type-encoding=NONE
    BT_KPVe_Funktion_PureAir: base-type-encoding=NONE
    BT_KPVe_Funktion_Rear: base-type-encoding=NONE
    BT_KPVe_Funktion_Restwaerme: base-type-encoding=NONE
    BT_KPVe_Funktion_Sync: base-type-encoding=NONE
    BT_KPVe_Funktion_Umluft: base-type-encoding=NONE
    BT_KPVe_Funktionsbeleuchtung: base-type-encoding=NONE
    BT_KPVe_Geblaese_Auto_li: base-type-encoding=NONE
    BT_KPVe_Geblaese_Begrenzung: base-type-encoding=NONE
    BT_KPVe_Geblaese_Stufe_li: base-type-encoding=NONE
    BT_KPVe_Kopfraumheizung_li: base-type-encoding=NONE
    BT_KPVe_Kopfraumheizung_re: base-type-encoding=NONE
    BT_KPVe_LCD: base-type-encoding=NONE
    BT_KPVe_Lenker_Position: base-type-encoding=NONE
    BT_KPVe_Luftverteilung_Auto_li: base-type-encoding=NONE
    BT_KPVe_Luftverteilung_Mitte_li: base-type-encoding=NONE
    BT_KPVe_Luftverteilung_Oben_li: base-type-encoding=NONE
    BT_KPVe_Luftverteilung_Unten_li: base-type-encoding=NONE
    BT_KPVe_OBD_Gruppe: base-type-encoding=NONE
    BT_KPVe_Sitzheizung_li: base-type-encoding=NONE
    BT_KPVe_Sitzheizung_re: base-type-encoding=NONE
    BT_KPVe_Sitzlueftung_li: base-type-encoding=NONE
    BT_KPVe_Sitzlueftung_re: base-type-encoding=NONE
    BT_KPVe_Suchbeleuchtung: base-type-encoding=NONE
    BT_KPVe_Symbol_Luftmenge_li: base-type-encoding=NONE
    BT_KPVe_Symbol_Luftverteilung_li: base-type-encoding=NONE
    BT_KPVe_Temp_li: base-type-encoding=NONE
    BT_KPVe_Temp_re: base-type-encoding=NONE
    BT_KPVe_Verbau_AutoSikli: base-type-encoding=NONE
    BT_KRH_Soll_li: base-type-encoding=NONE
    BT_KRH_Soll_re: base-type-encoding=NONE
    BT_KRH_Stufe_LED_li: base-type-encoding=NONE
    BT_KRH_Stufe_LED_re: base-type-encoding=NONE
    BT_KS_Geheimnis_{1..4}: base-type-encoding=NONE
    BT_KST_ComfortReadyStatus: base-type-encoding=NONE
    BT_KST_Fahrerhinweis_4: base-type-encoding=NONE
    BT_KST_Sonderzustand_Anforderung: base-type-encoding=NONE
    BT_KST_Sonderzustand_Status: base-type-encoding=NONE
    BT_KST_Warn_P1_ZST_def: base-type-encoding=NONE
    BT_KST_Warn_P2_ZST_def: base-type-encoding=NONE
    BT_KST_WFS_Fahrfreigabe_Anforderung: base-type-encoding=NONE
    BT_KVA_Ist_Pos: base-type-encoding=NONE
    BT_Ladezustand_02: base-type-encoding=NONE
    BT_Ladezustand_gering: base-type-encoding=NONE
    BT_LGI_FAS_Fkt_Status: base-type-encoding=NONE
    BT_LHR_01_FnAbbruch_Heizkreis_A: base-type-encoding=NONE
    BT_LHR_01_FnAbbruch_Heizkreis_B: base-type-encoding=NONE
    BT_LHR_01_NTC_Temperatur_A: base-type-encoding=NONE
    BT_LHR_01_NTC_Temperatur_B: base-type-encoding=NONE
    BT_LHR_01_ResponseError: base-type-encoding=NONE
    BT_LHR_01_SG_defekt: base-type-encoding=NONE
    BT_LHR_01_Status_Ausgang_A_02: base-type-encoding=NONE
    BT_LHR_01_Status_Ausgang_B_02: base-type-encoding=NONE
    BT_LHR_01_Status_CodierPins: base-type-encoding=NONE
    BT_LHR_01_Status_PCB_Uebertemp: base-type-encoding=NONE
    BT_LHR_01_Status_Taster_A: base-type-encoding=NONE
    BT_LHR_01_Status_Taster_B: base-type-encoding=NONE
    BT_LHRe_01_AnsteuerVorgabe_A: base-type-encoding=NONE
    BT_LHRe_01_AnsteuerVorgabe_B: base-type-encoding=NONE
    BT_LHRe_01_Config_NTC_A: base-type-encoding=NONE
    BT_LHRe_01_Config_NTC_B: base-type-encoding=NONE
    BT_LHRe_Global_Unterbrechen_Inv: base-type-encoding=NONE
    BT_LiSi_Defrost_Taste: base-type-encoding=NONE
    BT_LiSi_FSH_Taste: base-type-encoding=NONE
    BT_LiSi_HSH_Taste: base-type-encoding=NONE
    BT_LiSi_Touch_Event: base-type-encoding=NONE
    BT_LLR_LL1_Blockierung: base-type-encoding=NONE
    BT_LLR_LL1_CodierPinError: base-type-encoding=NONE
    BT_LLR_LL1_Feuchte01: base-type-encoding=NONE
    BT_LLR_LL1_Feuchte02: base-type-encoding=NONE
    BT_LLR_LL1_Feuchtesensor_01_defekt: base-type-encoding=NONE
    BT_LLR_LL1_Feuchtesensor_02_defekt: base-type-encoding=NONE
    BT_LLR_LL1_Ist_Drehzahl: base-type-encoding=NONE
    BT_LLR_LL1_Lokalaktiv: base-type-encoding=NONE
    BT_LLR_LL1_Luefter_defekt: base-type-encoding=NONE
    BT_LLR_LL1_ResponseError: base-type-encoding=NONE
    BT_LLR_LL1_Temperatur_01: base-type-encoding=NONE
    BT_LLR_LL1_Temperatur_02: base-type-encoding=NONE
    BT_LLR_LL1_Ueberspannung: base-type-encoding=NONE
    BT_LLR_LL1_Uebertemperatur: base-type-encoding=NONE
    BT_LLR_LL1_Unterspannung: base-type-encoding=NONE
    BT_LLR_LS1_Blockierung: base-type-encoding=NONE
    BT_LLR_LS1_CodierPinError: base-type-encoding=NONE
    BT_LLR_LS1_Feuchte01: base-type-encoding=NONE
    BT_LLR_LS1_Feuchte02: base-type-encoding=NONE
    BT_LLR_LS1_Feuchtesensor_01_defekt: base-type-encoding=NONE
    BT_LLR_LS1_Feuchtesensor_02_defekt: base-type-encoding=NONE
    BT_LLR_LS1_Ist_Drehzahl: base-type-encoding=NONE
    BT_LLR_LS1_Lokalaktiv: base-type-encoding=NONE
    BT_LLR_LS1_Luefter_defekt: base-type-encoding=NONE
    BT_LLR_LS1_ResponseError: base-type-encoding=NONE
    BT_LLR_LS1_Temperatur_01: base-type-encoding=NONE
    BT_LLR_LS1_Temperatur_02: base-type-encoding=NONE
    BT_LLR_LS1_Ueberspannung: base-type-encoding=NONE
    BT_LLR_LS1_Uebertemperatur: base-type-encoding=NONE
    BT_LLR_LS1_Unterspannung: base-type-encoding=NONE
    BT_LLR_LS2_Blockierung: base-type-encoding=NONE
    BT_LLR_LS2_CodierPinError: base-type-encoding=NONE
    BT_LLR_LS2_Ist_Drehzahl: base-type-encoding=NONE
    BT_LLR_LS2_Lokalaktiv: base-type-encoding=NONE
    BT_LLR_LS2_Luefter_defekt: base-type-encoding=NONE
    BT_LLR_LS2_ResponseError: base-type-encoding=NONE
    BT_LLR_LS2_Ueberspannung: base-type-encoding=NONE
    BT_LLR_LS2_Uebertemperatur: base-type-encoding=NONE
    BT_LLR_LS2_Unterspannung: base-type-encoding=NONE
    BT_LLR_RL1_Blockierung: base-type-encoding=NONE
    BT_LLR_RL1_CodierPinError: base-type-encoding=NONE
    BT_LLR_RL1_Feuchte01: base-type-encoding=NONE
    BT_LLR_RL1_Feuchte02: base-type-encoding=NONE
    BT_LLR_RL1_Feuchtesensor_01_defekt: base-type-encoding=NONE
    BT_LLR_RL1_Feuchtesensor_02_defekt: base-type-encoding=NONE
    BT_LLR_RL1_Ist_Drehzahl: base-type-encoding=NONE
    BT_LLR_RL1_Lokalaktiv: base-type-encoding=NONE
    BT_LLR_RL1_Luefter_defekt: base-type-encoding=NONE
    BT_LLR_RL1_ResponseError: base-type-encoding=NONE
    BT_LLR_RL1_Temperatur_01: base-type-encoding=NONE
    BT_LLR_RL1_Temperatur_02: base-type-encoding=NONE
    BT_LLR_RL1_Ueberspannung: base-type-encoding=NONE
    BT_LLR_RL1_Uebertemperatur: base-type-encoding=NONE
    BT_LLR_RL1_Unterspannung: base-type-encoding=NONE
    BT_LLR_RS1_Blockierung: base-type-encoding=NONE
    BT_LLR_RS1_CodierPinError: base-type-encoding=NONE
    BT_LLR_RS1_Feuchte01: base-type-encoding=NONE
    BT_LLR_RS1_Feuchte02: base-type-encoding=NONE
    BT_LLR_RS1_Feuchtesensor_01_defekt: base-type-encoding=NONE
    BT_LLR_RS1_Feuchtesensor_02_defekt: base-type-encoding=NONE
    BT_LLR_RS1_Ist_Drehzahl: base-type-encoding=NONE
    BT_LLR_RS1_Lokalaktiv: base-type-encoding=NONE
    BT_LLR_RS1_Luefter_defekt: base-type-encoding=NONE
    BT_LLR_RS1_ResponseError: base-type-encoding=NONE
    BT_LLR_RS1_Temperatur_01: base-type-encoding=NONE
    BT_LLR_RS1_Temperatur_02: base-type-encoding=NONE
    BT_LLR_RS1_Ueberspannung: base-type-encoding=NONE
    BT_LLR_RS1_Uebertemperatur: base-type-encoding=NONE
    BT_LLR_RS1_Unterspannung: base-type-encoding=NONE
    BT_LLR_RS2_Blockierung: base-type-encoding=NONE
    BT_LLR_RS2_CodierPinError: base-type-encoding=NONE
    BT_LLR_RS2_Ist_Drehzahl: base-type-encoding=NONE
    BT_LLR_RS2_Lokalaktiv: base-type-encoding=NONE
    BT_LLR_RS2_Luefter_defekt: base-type-encoding=NONE
    BT_LLR_RS2_ResponseError: base-type-encoding=NONE
    BT_LLR_RS2_Ueberspannung: base-type-encoding=NONE
    BT_LLR_RS2_Uebertemperatur: base-type-encoding=NONE
    BT_LLR_RS2_Unterspannung: base-type-encoding=NONE
    BT_LoGeWa_Event_Kombiwarnung: base-type-encoding=NONE
    BT_LR_HZG_Konfiguration: base-type-encoding=NONE
    BT_LR_HZG_Taster_on_off: base-type-encoding=NONE
    BT_LR_HZG_Temp_Sensor: base-type-encoding=NONE
    BT_LRH_aktiv: base-type-encoding=NONE
    BT_LRH_On_Off: base-type-encoding=NONE
    BT_LRH_Taster: base-type-encoding=NONE
    BT_LS_defekt: base-type-encoding=NONE
    BT_LS_Helligkeit_FW: base-type-encoding=NONE
    BT_LS_Helligkeit_IR: base-type-encoding=NONE
    BT_LS_Verbau: base-type-encoding=NONE
    BT_LSS_Tastencode: base-type-encoding=NONE
    BT_LTM_01_BZ: base-type-encoding=NONE
    BT_LTM_01_CRC: base-type-encoding=NONE
    BT_LTM_Autolicht: base-type-encoding=NONE
    BT_LTM_Beruehrung: base-type-encoding=NONE
    BT_LTM_Lokalaktiv: base-type-encoding=NONE
    BT_LTM_Nebellicht: base-type-encoding=NONE
    BT_LTM_Nebelschlusslicht: base-type-encoding=NONE
    BT_LTM_ResponseError: base-type-encoding=NONE
    BT_LTM_StatusLichttastenmodul: base-type-encoding=NONE
    BT_LTM_Variante: base-type-encoding=NONE
    BT_Luftmenge_Innenraum_PMS: base-type-encoding=NONE
    BT_MD1_Lage: base-type-encoding=NONE
    BT_MD1_Position: base-type-encoding=NONE
    BT_MD1_Position_4Bit: base-type-encoding=NONE
    BT_MD3_Lage: base-type-encoding=NONE
    BT_MD3_Position: base-type-encoding=NONE
    BT_Messung_Enable_PMS: base-type-encoding=NONE
    BT_MFL_Eventcode_1: base-type-encoding=NONE
    BT_MFL_Eventcode_2: base-type-encoding=NONE
    BT_MFL_Marke: base-type-encoding=NONE
    BT_MFL_Tastencode_1: base-type-encoding=NONE
    BT_MFL_Tastencode_2: base-type-encoding=NONE
    BT_MFL_Variante: base-type-encoding=NONE
    BT_MIB_Stromsparmodus: base-type-encoding=NONE
    BT_MIK_01_BZ: base-type-encoding=NONE
    BT_MIK_01_CRC: base-type-encoding=NONE
    BT_MIK_BlinkRate: base-type-encoding=NONE
    BT_MIK_CabinCare_Active: base-type-encoding=NONE
    BT_MIK_CabinCare_state: base-type-encoding=NONE
    BT_MIK_ChildPresence: base-type-encoding=NONE
    BT_MIK_ChildStatus: base-type-encoding=NONE
    BT_MIK_DetectionMode: base-type-encoding=NONE
    BT_MIK_DriverChange: base-type-encoding=NONE
    BT_MIK_DriverPresence: base-type-encoding=NONE
    BT_MIK_DriverSmoking: base-type-encoding=NONE
    BT_MIK_DriverSmokingQual: base-type-encoding=NONE
    BT_MIK_DriverSpeaking: base-type-encoding=NONE
    BT_MIK_DriverTelephoneUsage: base-type-encoding=NONE
    BT_MIK_DriverTelephoneUsageQual: base-type-encoding=NONE
    BT_MIK_DriverYawning: base-type-encoding=NONE
    BT_MIK_DriverYawningQual: base-type-encoding=NONE
    BT_MIK_DrowsinessLevel: base-type-encoding=NONE
    BT_MIK_DrowsinessLevelQual: base-type-encoding=NONE
    BT_MIK_DurEyesCl: base-type-encoding=NONE
    BT_MIK_DurEyesNotOnTfc: base-type-encoding=NONE
    BT_MIK_Fahrer_erkannt: base-type-encoding=NONE
    BT_MIK_FakeDetected: base-type-encoding=NONE
    BT_MIK_ICV_AspectRatio: base-type-encoding=NONE
    BT_MIK_ICV_Brightness: base-type-encoding=NONE
    BT_MIK_ICV_ColorMode: base-type-encoding=NONE
    BT_MIK_ICV_Contrast: base-type-encoding=NONE
    BT_MIK_ICV_FieldOfView: base-type-encoding=NONE
    BT_MIK_ICV_FrameRate: base-type-encoding=NONE
    BT_MIK_ICV_FunctionState: base-type-encoding=NONE
    BT_MIK_ICV_HDR: base-type-encoding=NONE
    BT_MIK_ICV_Resolution: base-type-encoding=NONE
    BT_MIK_ICV_VideoLength: base-type-encoding=NONE
    BT_MIK_ICV_Videostream_State: base-type-encoding=NONE
    BT_MIK_ICV_VideostreamResult: base-type-encoding=NONE
    BT_MIK_LeftEyeClosed: base-type-encoding=NONE
    BT_MIK_LeftEyeDetected: base-type-encoding=NONE
    BT_MIK_LeftEyeDetectionQual: base-type-encoding=NONE
    BT_MIK_LeftHandPos: base-type-encoding=NONE
    BT_MIK_LeftHandPosQual: base-type-encoding=NONE
    BT_MIK_Microsleep: base-type-encoding=NONE
    BT_MIK_MicrosleepQual: base-type-encoding=NONE
    BT_MIK_PassengerPresence: base-type-encoding=NONE
    BT_MIK_PercentageEyesOnTraffic: base-type-encoding=NONE
    BT_MIK_PetPresence: base-type-encoding=NONE
    BT_MIK_PetsMode_Active: base-type-encoding=NONE
    BT_MIK_PetsMode_state: base-type-encoding=NONE
    BT_MIK_RightEyeClosed: base-type-encoding=NONE
    BT_MIK_RightEyeDetected: base-type-encoding=NONE
    BT_MIK_RightEyeDetectionQual: base-type-encoding=NONE
    BT_MIK_RightHandPos: base-type-encoding=NONE
    BT_MIK_RightHandPosQual: base-type-encoding=NONE
    BT_MIK_Selfie_FunctionState: base-type-encoding=NONE
    BT_MIK_Selfie_Resolution: base-type-encoding=NONE
    BT_MIK_SpaAttDstrAr_01: base-type-encoding=NONE
    BT_MIK_SpaAttDstrProb_01: base-type-encoding=NONE
    BT_MIK_Status: base-type-encoding=NONE
    BT_MIK_TotDurEyesNotOnTfc: base-type-encoding=NONE
    BT_MIK_UnusualHeadPose: base-type-encoding=NONE
    BT_MIK_UnusualHeadPoseQual: base-type-encoding=NONE
    BT_MIK_VisualDistractionLevel: base-type-encoding=NONE
    BT_MIK_VisualDistractionLevelQual: base-type-encoding=NONE
    BT_MIK_ZR_ActivationState: base-type-encoding=NONE
    BT_MO_Anforderung_Anzeige_Halten: base-type-encoding=NONE
    BT_MO_Anforderung_HMS: base-type-encoding=NONE
    BT_MO_Ansaugsystem: base-type-encoding=NONE
    BT_MO_Anzahl_Zyl: base-type-encoding=NONE
    BT_MO_Anzeige_Drehmoment: base-type-encoding=NONE
    BT_MO_Anzeige_Leistung: base-type-encoding=NONE
    BT_MO_Anzeige_StSt_gueltig: base-type-encoding=NONE
    BT_MO_Anzeige_Verbr_Einheit: base-type-encoding=NONE
    BT_MO_Anzeigedrehz: base-type-encoding=NONE
    BT_MO_Aussp_Anlass: base-type-encoding=NONE
    BT_MO_BKV_Unterdruckwarnung: base-type-encoding=NONE
    BT_MO_BLS: base-type-encoding=NONE
    BT_MO_BMS_NV_Anf_stuetzen: base-type-encoding=NONE
    BT_MO_Code: base-type-encoding=NONE
    BT_MO_DPF_reg: base-type-encoding=NONE
    BT_MO_DPF_verbaut: base-type-encoding=NONE
    BT_MO_E_Mode: base-type-encoding=NONE
    BT_MO_E_Texte: base-type-encoding=NONE
    BT_MO_E_Warnungen: base-type-encoding=NONE
    BT_MO_EBoost_verf_praed: base-type-encoding=NONE
    BT_MO_Effizienzmodus: base-type-encoding=NONE
    BT_MO_EFLEX_Lampe: base-type-encoding=NONE
    BT_MO_EKlKomLeiRed: base-type-encoding=NONE
    BT_MO_eLaunch_verf: base-type-encoding=NONE
    BT_MO_EMG_Sollmodus: base-type-encoding=NONE
    BT_MO_Energieinhalt_BMS: base-type-encoding=NONE
    BT_MO_ePerformance: base-type-encoding=NONE
    BT_MO_ePowermeter: base-type-encoding=NONE
    BT_MO_ErwGrenzen_Anf: base-type-encoding=NONE
    BT_MO_Ext_E_Fahrt_aktiv: base-type-encoding=NONE
    BT_MO_Fahrbereitschaft: base-type-encoding=NONE
    BT_MO_Fahrer_bremst: base-type-encoding=NONE
    BT_MO_Faktor_Momente_02: base-type-encoding=NONE
    BT_MO_Fehler_Notentladung_Anf: base-type-encoding=NONE
    BT_MO_Fehler_Oeldrucksensor: base-type-encoding=NONE
    BT_MO_FMAus_aktiv: base-type-encoding=NONE
    BT_MO_FMAus_Startvariante: base-type-encoding=NONE
    BT_MO_FoD_Performance_Status: base-type-encoding=NONE
    BT_MO_FoD_Performance_Switch_Status: base-type-encoding=NONE
    BT_MO_Freig_Anlass: base-type-encoding=NONE
    BT_MO_Freig_Reku: base-type-encoding=NONE
    BT_MO_Freigabe_Segeln: base-type-encoding=NONE
    BT_MO_Freilauf_Info: base-type-encoding=NONE
    BT_MO_Freilauf_Status: base-type-encoding=NONE
    BT_MO_FSA_Sensorheizung: base-type-encoding=NONE
    BT_MO_Gangposition: base-type-encoding=NONE
    BT_MO_Getriebe_Code: base-type-encoding=NONE
    BT_MO_Handshake_STH: base-type-encoding=NONE
    BT_MO_Heckspoiler_Anf: base-type-encoding=NONE
    BT_MO_Heissleuchte: base-type-encoding=NONE
    BT_MO_Heizstrom_EKAT: base-type-encoding=NONE
    BT_MO_Heizstrom_SCR: base-type-encoding=NONE
    BT_MO_Hochschaltdrehz: base-type-encoding=NONE
    BT_MO_Hubraum: base-type-encoding=NONE
    BT_MO_HVEM_Eskalation: base-type-encoding=NONE
    BT_MO_HVEM_MaxLeistung: base-type-encoding=NONE
    BT_MO_HVK_AntriebFehlerstatus: base-type-encoding=NONE
    BT_MO_HVK_AntriebZustand: base-type-encoding=NONE
    BT_MO_HVK_EmFehlerstatus: base-type-encoding=NONE
    BT_MO_HVK_EmIstzustand: base-type-encoding=NONE
    BT_MO_HYB_Fahrbereitschaft: base-type-encoding=NONE
    BT_MO_HYB_VM_aktiv: base-type-encoding=NONE
    BT_MO_Hybridfahrzeug: base-type-encoding=NONE
    BT_MO_Interlock: base-type-encoding=NONE
    BT_MO_Istgang: base-type-encoding=NONE
    BT_MO_ITM_Warnung_Pumpe: base-type-encoding=NONE
    BT_MO_Kickdown: base-type-encoding=NONE
    BT_MO_KJS_nicht_bereit: base-type-encoding=NONE
    BT_MO_Kl_50: base-type-encoding=NONE
    BT_MO_Kl_75: base-type-encoding=NONE
    BT_MO_Klima_Eingr: base-type-encoding=NONE
    BT_MO_Klima_Regelmodus: base-type-encoding=NONE
    BT_MO_Konsistenz_Bremsped: base-type-encoding=NONE
    BT_MO_Kraftstoffart: base-type-encoding=NONE
    BT_MO_Krit_Heckobjekt: base-type-encoding=NONE
    BT_MO_Kuehlerluefter_1: base-type-encoding=NONE
    BT_MO_Kuehlerluefter_2: base-type-encoding=NONE
    BT_MO_Kuehlerluefter_MUX: base-type-encoding=NONE
    BT_MO_Kuppl_schalter: base-type-encoding=NONE
    BT_MO_KVS: base-type-encoding=NONE
    BT_MO_KVS_Ueberlauf: base-type-encoding=NONE
    BT_MO_Ladedruck: base-type-encoding=NONE
    BT_MO_Leistung: base-type-encoding=NONE
    BT_MO_Motor_laeuft: base-type-encoding=NONE
    BT_MO_MVK_AntriebFehlerstatus: base-type-encoding=NONE
    BT_MO_MVK_AntriebZustand: base-type-encoding=NONE
    BT_MO_MVK_Bordnetz_Anf: base-type-encoding=NONE
    BT_MO_MVK_EmFehlerstatus: base-type-encoding=NONE
    BT_MO_MVK_EmIstzustand: base-type-encoding=NONE
    BT_MO_NGS_Gangpos: base-type-encoding=NONE
    BT_MO_OBD2_Lampe: base-type-encoding=NONE
    BT_MO_OBD_Typ: base-type-encoding=NONE
    BT_MO_Oeldruck: base-type-encoding=NONE
    BT_MO_Oelwarnung_max: base-type-encoding=NONE
    BT_MO_OnePedalDriving_integriert: base-type-encoding=NONE
    BT_MO_OnePedalDriving_Warnung: base-type-encoding=NONE
    BT_MO_P_Generator_ungefiltert_Anf: base-type-encoding=NONE
    BT_MO_Partikel_Lampe: base-type-encoding=NONE
    BT_MO_Positionierung_aktiv: base-type-encoding=NONE
    BT_MO_Powermeter: base-type-encoding=NONE
    BT_MO_Powermeter_Elm_02: base-type-encoding=NONE
    BT_MO_PTC_Status: base-type-encoding=NONE
    BT_MO_QBit_Aussen_Temp: base-type-encoding=NONE
    BT_MO_QBit_Fahrer_bremst: base-type-encoding=NONE
    BT_MO_QBit_Gangposition: base-type-encoding=NONE
    BT_MO_QBit_KL_75: base-type-encoding=NONE
    BT_MO_Red_El_Fahrleistung: base-type-encoding=NONE
    BT_MO_RedFahrleistung_Lampe: base-type-encoding=NONE
    BT_MO_rel_Ladedruck: base-type-encoding=NONE
    BT_MO_Remotestart_Betrieb: base-type-encoding=NONE
    BT_MO_Remotestart_moeglich: base-type-encoding=NONE
    BT_MO_Schaltblitz_Anz: base-type-encoding=NONE
    BT_MO_Schaltempf_verfbar: base-type-encoding=NONE
    BT_MO_Servicemodus: base-type-encoding=NONE
    BT_MO_Signalquelle_Gangposition: base-type-encoding=NONE
    BT_MO_Sollgang: base-type-encoding=NONE
    BT_MO_SpannungsAnf_02: base-type-encoding=NONE
    BT_MO_StartStopp_Codiert: base-type-encoding=NONE
    BT_MO_StartStopp_Fahrerwunsch: base-type-encoding=NONE
    BT_MO_StartStopp_Motorstopp: base-type-encoding=NONE
    BT_MO_StartStopp_Status: base-type-encoding=NONE
    BT_MO_StartStopp_Wiederstart: base-type-encoding=NONE
    BT_MO_StartVorauss_erfuellt: base-type-encoding=NONE
    BT_MO_Startwunsch: base-type-encoding=NONE
    BT_MO_Systemlampe: base-type-encoding=NONE
    BT_MO_Tankdeckel_Lampe: base-type-encoding=NONE
    BT_MO_Text_Motorstart: base-type-encoding=NONE
    BT_MO_Text_Partikelfil_Reg: base-type-encoding=NONE
    BT_MO_Text_Tankdeckelwarn: base-type-encoding=NONE
    BT_MO_Timeout_ESP: base-type-encoding=NONE
    BT_MO_UBE_Reserve: base-type-encoding=NONE
    BT_MO_VKMVirt_Drehzahl: base-type-encoding=NONE
    BT_MO_Vorglueh_Lampe: base-type-encoding=NONE
    BT_MO_Zust_Antrieb: base-type-encoding=NONE
    BT_MO_Zust_Betriebsstrategie: base-type-encoding=NONE
    BT_MO_Zustand_HWP: base-type-encoding=NONE
    BT_MO_Zylinderabschaltung: base-type-encoding=NONE
    BT_MOD_Energie_Anf: base-type-encoding=NONE
    BT_Motor_14_BZ: base-type-encoding=NONE
    BT_Motor_14_CRC: base-type-encoding=NONE
    BT_Motor_52_BZ: base-type-encoding=NONE
    BT_Motor_52_CRC: base-type-encoding=NONE
    BT_Motor_54_BZ: base-type-encoding=NONE
    BT_Motor_54_CRC: base-type-encoding=NONE
    BT_Motor_Code_01_BZ: base-type-encoding=NONE
    BT_Motor_Code_01_CRC: base-type-encoding=NONE
    BT_MRollo_Lage: base-type-encoding=NONE
    BT_MRollo_Position: base-type-encoding=NONE
    BT_MRollo_Position_4Bit: base-type-encoding=NONE
    BT_MSG_HYB_30_BZ: base-type-encoding=NONE
    BT_MSG_HYB_30_CRC: base-type-encoding=NONE
    BT_MSR_Anf: base-type-encoding=NONE
    BT_MTHBFS_M_Taste: base-type-encoding=NONE
    BT_MTHBFS_Pos{1..3}: base-type-encoding=NONE
    BT_MTHFS_M_Taste: base-type-encoding=NONE
    BT_MTHFS_Pos{1..3}: base-type-encoding=NONE
    BT_Navigationsattribute: base-type-encoding=NONE
    BT_ND_Avrg_Speed_RangeData: base-type-encoding=NONE
    BT_ND_PSD_Street_Category: base-type-encoding=NONE
    BT_ND_PSD_Tunnel_Status: base-type-encoding=NONE
    BT_Niveausensor_HL_verbaut: base-type-encoding=NONE
    BT_Niveausensor_VL_verbaut: base-type-encoding=NONE
    BT_NM_DCDC_NV_aktiv_Tmin_NO: base-type-encoding=NONE
    BT_NM_DCDC_NV_CAB_V15: base-type-encoding=ISO-8859-1
    BT_NM_DCDC_NV_Car_Wakeup: base-type-encoding=NONE
    BT_NM_DCDC_NV_CBV_AWB: base-type-encoding=NONE
    BT_NM_DCDC_NV_CBV_CRI: base-type-encoding=NONE
    BT_NM_DCDC_NV_DCDC_aktiv: base-type-encoding=NONE
    BT_NM_DCDC_NV_NM_aktiv_Diagnose: base-type-encoding=NONE
    BT_NM_DCDC_NV_NM_aktiv_KL15: base-type-encoding=NONE
    BT_NM_DCDC_NV_NM_aktiv_Tmin: base-type-encoding=NONE
    BT_NM_DCDC_NV_NM_State: base-type-encoding=NONE
    BT_NM_DCDC_NV_UDS_CC: base-type-encoding=NONE
    BT_NM_Gateway_CAB_V15: base-type-encoding=ISO-8859-1
    BT_NM_Gateway_Car_Wakeup: base-type-encoding=NONE
    BT_NM_Gateway_CBV_AWB: base-type-encoding=NONE
    BT_NM_Gateway_CBV_CRI: base-type-encoding=NONE
    BT_NM_Gateway_NM_aktiv_CAB: base-type-encoding=NONE
    BT_NM_Gateway_NM_aktiv_Diagnose: base-type-encoding=NONE
    BT_NM_Gateway_NM_aktiv_Energie: base-type-encoding=NONE
    BT_NM_Gateway_NM_aktiv_FoD: base-type-encoding=NONE
    BT_NM_Gateway_NM_aktiv_IAA_PSO: base-type-encoding=NONE
    BT_NM_Gateway_NM_aktiv_Kessy: base-type-encoding=NONE
    BT_NM_Gateway_NM_aktiv_KL15: base-type-encoding=NONE
    BT_NM_Gateway_NM_aktiv_KS: base-type-encoding=NONE
    BT_NM_Gateway_NM_aktiv_Licht: base-type-encoding=NONE
    BT_NM_Gateway_NM_aktiv_PaCo: base-type-encoding=NONE
    BT_NM_Gateway_NM_aktiv_RTM: base-type-encoding=NONE
    BT_NM_Gateway_NM_aktiv_Standklima: base-type-encoding=NONE
    BT_NM_Gateway_NM_aktiv_Tmin: base-type-encoding=NONE
    BT_NM_Gateway_NM_aktiv_USS: base-type-encoding=NONE
    BT_NM_Gateway_NM_aktiv_ZM: base-type-encoding=NONE
    BT_NM_Gateway_NM_aktiv_ZV: base-type-encoding=NONE
    BT_NM_Gateway_NM_State: base-type-encoding=NONE
    BT_NM_Gateway_UDS_CC: base-type-encoding=NONE
    BT_NM_Hybrid_01_aktiv_TPA: base-type-encoding=NONE
    BT_NM_Hybrid_01_CAB_V15: base-type-encoding=ISO-8859-1
    BT_NM_Hybrid_01_Car_Wakeup: base-type-encoding=NONE
    BT_NM_Hybrid_01_CBV_AWB: base-type-encoding=NONE
    BT_NM_Hybrid_01_CBV_CRI: base-type-encoding=NONE
    BT_NM_Hybrid_01_NM_aktiv_Diagnose: base-type-encoding=NONE
    BT_NM_Hybrid_01_NM_aktiv_Hochvolt: base-type-encoding=NONE
    BT_NM_Hybrid_01_NM_aktiv_KL15: base-type-encoding=NONE
    BT_NM_Hybrid_01_NM_aktiv_Tmin: base-type-encoding=NONE
    BT_NM_Hybrid_01_NM_aktiv_Vorkond: base-type-encoding=NONE
    BT_NM_Hybrid_01_NM_State: base-type-encoding=NONE
    BT_NM_Hybrid_01_UDS_CC: base-type-encoding=NONE
    BT_NM_Klima_CAB_V15: base-type-encoding=ISO-8859-1
    BT_NM_Klima_Car_Wakeup: base-type-encoding=NONE
    BT_NM_Klima_CBV_AWB: base-type-encoding=NONE
    BT_NM_Klima_CBV_CRI: base-type-encoding=NONE
    BT_NM_Klima_Lokalaktiv: base-type-encoding=NONE
    BT_NM_Klima_NM_aktiv_Diagnose: base-type-encoding=NONE
    BT_NM_Klima_NM_aktiv_KL15: base-type-encoding=NONE
    BT_NM_Klima_NM_aktiv_Tmin: base-type-encoding=NONE
    BT_NM_Klima_NM_State: base-type-encoding=NONE
    BT_NM_Klima_Subsystemaktiv: base-type-encoding=NONE
    BT_NM_Klima_UDS_CC: base-type-encoding=NONE
    BT_NM_Klima_Wakeup: base-type-encoding=NONE
    BT_NM_Ladegeraet_CAB_V15: base-type-encoding=ISO-8859-1
    BT_NM_Ladegeraet_Car_Wakeup: base-type-encoding=NONE
    BT_NM_Ladegeraet_CBV_AWB: base-type-encoding=NONE
    BT_NM_Ladegeraet_CBV_CRI: base-type-encoding=NONE
    BT_NM_Ladegeraet_NM_aktiv_Bere_CVN: base-type-encoding=NONE
    BT_NM_Ladegeraet_NM_aktiv_CP_change: base-type-encoding=NONE
    BT_NM_Ladegeraet_NM_aktiv_CVN_Berec: base-type-encoding=NONE
    BT_NM_Ladegeraet_NM_aktiv_Diagnose: base-type-encoding=NONE
    BT_NM_Ladegeraet_NM_aktiv_GBTChadem: base-type-encoding=NONE
    BT_NM_Ladegeraet_NM_aktiv_KL15: base-type-encoding=NONE
    BT_NM_Ladegeraet_NM_aktiv_PP_change: base-type-encoding=NONE
    BT_NM_Ladegeraet_NM_aktiv_Tmin: base-type-encoding=NONE
    BT_NM_Ladegeraet_NM_aktiv_V2L: base-type-encoding=NONE
    BT_NM_Ladegeraet_NM_aktiv_Vorkondit: base-type-encoding=NONE
    BT_NM_Ladegeraet_NM_State: base-type-encoding=NONE
    BT_NM_Ladegeraet_UDS_CC: base-type-encoding=NONE
    BT_NVEM2_Status_FuSiFahrt: base-type-encoding=NONE
    BT_NVEM2_Typ_EnergieNetz: base-type-encoding=NONE
    BT_NVEM_Abschaltstufe: base-type-encoding=NONE
    BT_NVEM_Anf_SD_schalten: base-type-encoding=NONE
    BT_NVEM_Batterie_Service: base-type-encoding=NONE
    BT_NVEM_Betriebsart: base-type-encoding=NONE
    BT_NVEM_Bordnetzdiagnose: base-type-encoding=NONE
    BT_NVEM_Energie_Klima_Vorgabe: base-type-encoding=NONE
    BT_NVEM_Energienetz_Status: base-type-encoding=NONE
    BT_NVEM_Freigabe_OnlineUpdate: base-type-encoding=NONE
    BT_NVEM_Freigabe_ORU4: base-type-encoding=NONE
    BT_NVEM_Freigabe_ZusBatt_Laden: base-type-encoding=NONE
    BT_NVEM_HV_Stuetzung_aktiv: base-type-encoding=NONE
    BT_NVEM_Ladezustand: base-type-encoding=NONE
    BT_NVEM_Last_Anf: base-type-encoding=NONE
    BT_NVEM_PTC_Sollstufe: base-type-encoding=NONE
    BT_NVEM_Red_KomfortVerbrauch: base-type-encoding=NONE
    BT_NVEM_STH_ZielzeitLang: base-type-encoding=NONE
    BT_NVEM_Verbraucherabsch_Anz: base-type-encoding=NONE
    BT_NVEM_Vorgabe_Leistungsstufe: base-type-encoding=NONE
    BT_OBD_Abs_Load_Val: base-type-encoding=NONE
    BT_OBD_Abs_Pedal_Pos: base-type-encoding=NONE
    BT_OBD_Abs_Throttle_Pos: base-type-encoding=NONE
    BT_OBD_Aussen_Temp_gef: base-type-encoding=NONE
    BT_OBD_Calc_Load_Val: base-type-encoding=NONE
    BT_OBD_ClearMem_Inhibit: base-type-encoding=NONE
    BT_OBD_Driving_Cycle: base-type-encoding=NONE
    BT_OBD_Eng_Cool_Temp: base-type-encoding=NONE
    BT_OBD_Kaltstart_Denominator: base-type-encoding=NONE
    BT_OBD_Minimum_Trip: base-type-encoding=NONE
    BT_OBD_Normed_Trip: base-type-encoding=NONE
    BT_OBD_QBit_Schlechtweg: base-type-encoding=NONE
    BT_OBD_Schlechtweg: base-type-encoding=NONE
    BT_OBD_Sperrung_IUMPR: base-type-encoding=NONE
    BT_OBD_Sperrung_Kaltstart_Denom: base-type-encoding=NONE
    BT_OBD_Warm_Up_Cycle: base-type-encoding=NONE
    BT_OBDProtocol_Klima: base-type-encoding=NONE
    BT_OBDProtocol_req: base-type-encoding=NONE
    BT_OCU_Privacymode_Locationdata: base-type-encoding=NONE
    BT_OCU_Privacymode_Status: base-type-encoding=NONE
    BT_OLEV_Oelstand_nicht_vorhanden: base-type-encoding=NONE
    BT_OLEV_Systemstoerung: base-type-encoding=NONE
    BT_OPS_ComfortReadyStatus: base-type-encoding=NONE
    BT_OPS_DriverPresenceStatus: base-type-encoding=NONE
    BT_OPS_OccupantPresenceStatus: base-type-encoding=NONE
    BT_OPS_QBit_DriverPresence: base-type-encoding=NONE
    BT_OPS_SafeDriverPresence_available: base-type-encoding=NONE
    BT_OPS_SafeDriverPresenceStatus: base-type-encoding=NONE
    BT_ORU_01_BZ: base-type-encoding=NONE
    BT_ORU_01_CRC: base-type-encoding=NONE
    BT_ORU_AP_Mode: base-type-encoding=NONE
    BT_ORU_DiagAddress: base-type-encoding=NONE
    BT_ORU_EM_Anfrage_Flashdauer: base-type-encoding=NONE
    BT_ORU_EM_Anfrage_freigegebeneNetze: base-type-encoding=NONE
    BT_ORU_EM_Anfrage_Stromaufnahme: base-type-encoding=NONE
    BT_ORU_Inventory: base-type-encoding=NONE
    BT_ORU_Status: base-type-encoding=NONE
    BT_ORU_Warnung: base-type-encoding=NONE
    BT_PCU_Adressinhalt: base-type-encoding=NONE
    BT_PCU_Aussentemp_gef: base-type-encoding=NONE
    BT_PCU_Betriebsstunden: base-type-encoding=NONE
    BT_PCU_Defekt: base-type-encoding=NONE
    BT_PCU_Ein: base-type-encoding=NONE
    BT_PCU_Fehler_Emitter: base-type-encoding=NONE
    BT_PCU_Fehler_Intern: base-type-encoding=NONE
    BT_PCU_FS_Luftfeuchte_rel: base-type-encoding=NONE
    BT_PCU_FSA_Luftfeuchte_rel: base-type-encoding=NONE
    BT_PCU_Funktionstest: base-type-encoding=NONE
    BT_PCU_Geblaese_Status: base-type-encoding=NONE
    BT_PCU_I_Sec: base-type-encoding=NONE
    BT_PCU_Innen_Temp: base-type-encoding=NONE
    BT_PCU_Kennlinie: base-type-encoding=NONE
    BT_PCU_Polarisation: base-type-encoding=NONE
    BT_PCU_ResponseError: base-type-encoding=NONE
    BT_PCU_State_Polarisation: base-type-encoding=NONE
    BT_PCU_Status: base-type-encoding=NONE
    BT_PCU_Status_LED: base-type-encoding=NONE
    BT_PCU_Temp_PCB: base-type-encoding=NONE
    BT_PCU_U_Sec: base-type-encoding=NONE
    BT_PCU_Umluftklappe_Status: base-type-encoding=NONE
    BT_Perso_Aktiv: base-type-encoding=NONE
    BT_Perso_Bedienstelle: base-type-encoding=NONE
    BT_Perso_Fahrernummer: base-type-encoding=NONE
    BT_Perso_Freigabe_Verstellung: base-type-encoding=NONE
    BT_Perso_Kontonummer: base-type-encoding=NONE
    BT_Perso_Schreibschutz: base-type-encoding=NONE
    BT_Perso_Status: base-type-encoding=NONE
    BT_Perso_Steuerung: base-type-encoding=NONE
    BT_Perso_Steuerungsparameter: base-type-encoding=NONE
    BT_PMS1_Partikel: base-type-encoding=NONE
    BT_PMS1_ResponseError: base-type-encoding=NONE
    BT_PMS1_Status: base-type-encoding=NONE
    BT_POS_GNSS_DR_Ausrichtung_Geschw: base-type-encoding=NONE
    BT_POS_GNSS_DR_Breite_Ortung: base-type-encoding=NONE
    BT_POS_GNSS_DR_Fahrtrichtung: base-type-encoding=NONE
    BT_POS_GNSS_DR_FahrzeugZeit_NanoSek: base-type-encoding=NONE
    BT_POS_GNSS_DR_FahrzeugZeit_Sek: base-type-encoding=NONE
    BT_POS_GNSS_DR_Geschw_3D: base-type-encoding=NONE
    BT_POS_GNSS_DR_Gierwinkel: base-type-encoding=NONE
    BT_POS_GNSS_DR_Guete_Ausricht_Gesch: base-type-encoding=NONE
    BT_POS_GNSS_DR_Guete_E_GrH_Ausr: base-type-encoding=NONE
    BT_POS_GNSS_DR_Guete_E_GrHalbachse: base-type-encoding=NONE
    BT_POS_GNSS_DR_Guete_E_KlHalbachse: base-type-encoding=NONE
    BT_POS_GNSS_DR_Guete_Geschw_3D: base-type-encoding=NONE
    BT_POS_GNSS_DR_Guete_Gierwinkel: base-type-encoding=NONE
    BT_POS_GNSS_DR_Guete_horizontal: base-type-encoding=NONE
    BT_POS_GNSS_DR_Guete_vertikal: base-type-encoding=NONE
    BT_POS_GNSS_DR_Laenge_Ortung: base-type-encoding=NONE
    BT_POS_GNSS_DR_Nachrichtenp_ID01: base-type-encoding=NONE
    BT_POS_GNSS_DR_Ortung_Hoehe_MSL: base-type-encoding=NONE
    BT_PreCrash_FAS_Fkt_Status: base-type-encoding=NONE
    BT_PSD_06_Mux: base-type-encoding=NONE
    BT_PSD_Abzweigerichtung: base-type-encoding=NONE
    BT_PSD_Abzweigewinkel: base-type-encoding=NONE
    BT_PSD_ADAS_Qualitaet: base-type-encoding=NONE
    BT_PSD_Anfangskruemmung: base-type-encoding=NONE
    BT_PSD_Anfangskruemmung_Vorz: base-type-encoding=NONE
    BT_PSD_Attribut_1_ID: base-type-encoding=NONE
    BT_PSD_Attribut_1_Offset: base-type-encoding=NONE
    BT_PSD_Attribut_1_Wert: base-type-encoding=NONE
    BT_PSD_Attribut_2_ID: base-type-encoding=NONE
    BT_PSD_Attribut_2_Offset: base-type-encoding=NONE
    BT_PSD_Attribut_2_Wert: base-type-encoding=NONE
    BT_PSD_Attribut_3_ID: base-type-encoding=NONE
    BT_PSD_Attribut_3_Offset: base-type-encoding=NONE
    BT_PSD_Attribut_3_Wert: base-type-encoding=NONE
    BT_PSD_Attribut_4_ID: base-type-encoding=NONE
    BT_PSD_Attribut_4_Offset: base-type-encoding=NONE
    BT_PSD_Attribut_4_Wert: base-type-encoding=NONE
    BT_PSD_Attribut_5_ID: base-type-encoding=NONE
    BT_PSD_Attribut_5_Offset: base-type-encoding=NONE
    BT_PSD_Attribut_5_Wert: base-type-encoding=NONE
    BT_PSD_Attribut_Segment_ID: base-type-encoding=NONE
    BT_PSD_Attribut_Segment_ID_05: base-type-encoding=NONE
    BT_PSD_Attribute_Komplett_05: base-type-encoding=NONE
    BT_PSD_Attribute_Komplett_06: base-type-encoding=NONE
    BT_PSD_Baum_Ausrichtung: base-type-encoding=NONE
    BT_PSD_Baum_Breite: base-type-encoding=NONE
    BT_PSD_Baum_Breite_VZ: base-type-encoding=NONE
    BT_PSD_Baum_Laenge: base-type-encoding=NONE
    BT_PSD_Baum_Laenge_VZ: base-type-encoding=NONE
    BT_PSD_Bebauung: base-type-encoding=NONE
    BT_PSD_Endkruemmung: base-type-encoding=NONE
    BT_PSD_Endkruemmung_Vorz: base-type-encoding=NONE
    BT_PSD_Fahrspuren_Anzahl: base-type-encoding=NONE
    BT_PSD_Geradester_Pfad: base-type-encoding=NONE
    BT_PSD_Ges_Attribute_Komplett: base-type-encoding=NONE
    BT_PSD_Ges_Geschwindigkeit: base-type-encoding=NONE
    BT_PSD_Ges_Geschwindigkeit_Gespann: base-type-encoding=NONE
    BT_PSD_Ges_Geschwindigkeit_Std_Anf: base-type-encoding=NONE
    BT_PSD_Ges_Geschwindigkeit_Std_Ende: base-type-encoding=NONE
    BT_PSD_Ges_Geschwindigkeit_Tag_Anf: base-type-encoding=NONE
    BT_PSD_Ges_Geschwindigkeit_Tag_Ende: base-type-encoding=NONE
    BT_PSD_Ges_Geschwindigkeit_Witter: base-type-encoding=NONE
    BT_PSD_Ges_Gesetzlich_Kategorie: base-type-encoding=NONE
    BT_PSD_Ges_Gesetzlich_Zusatz: base-type-encoding=NONE
    BT_PSD_Ges_Offset: base-type-encoding=NONE
    BT_PSD_Ges_Segment_ID: base-type-encoding=NONE
    BT_PSD_Ges_Spur_Geschw_Begrenzung: base-type-encoding=NONE
    BT_PSD_Ges_Typ: base-type-encoding=NONE
    BT_PSD_Ges_Ueberholverbot: base-type-encoding=NONE
    BT_PSD_Ges_Verkehrszeichen_Quelle: base-type-encoding=NONE
    BT_PSD_Ges_Wechselverkehrszeichen: base-type-encoding=NONE
    BT_PSD_Idenditaets_ID: base-type-encoding=NONE
    BT_PSD_LR_01_MUX: base-type-encoding=NONE
    BT_PSD_LR_Attribut_1_Offset: base-type-encoding=NONE
    BT_PSD_LR_Attribut_1_Wert: base-type-encoding=NONE
    BT_PSD_LR_Attribut_2_Offset: base-type-encoding=NONE
    BT_PSD_LR_Attribut_2_Wert: base-type-encoding=NONE
    BT_PSD_LR_Attribut_3_Offset: base-type-encoding=NONE
    BT_PSD_LR_Attribut_3_Wert: base-type-encoding=NONE
    BT_PSD_LR_Fahrzeug_Pos: base-type-encoding=NONE
    BT_PSD_LR_Globale_Steigung: base-type-encoding=NONE
    BT_PSD_LR_Globale_Steigung_Vorz: base-type-encoding=NONE
    BT_PSD_LR_Koeff_1_Amp: base-type-encoding=NONE
    BT_PSD_LR_Koeff_1_Phase: base-type-encoding=NONE
    BT_PSD_LR_Koeff_2_Amp: base-type-encoding=NONE
    BT_PSD_LR_Koeff_2_Phase: base-type-encoding=NONE
    BT_PSD_LR_Koeff_3_Amp: base-type-encoding=NONE
    BT_PSD_LR_Koeff_3_Phase: base-type-encoding=NONE
    BT_PSD_LR_Koeffizientensatz_Nr: base-type-encoding=NONE
    BT_PSD_LR_Max_Koeff_Amp: base-type-encoding=NONE
    BT_PSD_LR_Profil_Laenge: base-type-encoding=NONE
    BT_PSD_LR_Profil_Nummer: base-type-encoding=NONE
    BT_PSD_LR_Reset: base-type-encoding=NONE
    BT_PSD_LR_Steigung_1_Offset: base-type-encoding=NONE
    BT_PSD_LR_Steigung_1_Vorz: base-type-encoding=NONE
    BT_PSD_LR_Steigung_1_Wert: base-type-encoding=NONE
    BT_PSD_LR_Steigung_2_Offset: base-type-encoding=NONE
    BT_PSD_LR_Steigung_2_Vorz: base-type-encoding=NONE
    BT_PSD_LR_Steigung_2_Wert: base-type-encoding=NONE
    BT_PSD_LR_Steigung_3_Offset: base-type-encoding=NONE
    BT_PSD_LR_Steigung_3_Vorz: base-type-encoding=NONE
    BT_PSD_LR_Steigung_3_Wert: base-type-encoding=NONE
    BT_PSD_Pos_Fahrspur: base-type-encoding=NONE
    BT_PSD_Pos_Fehler_Laengsrichtung: base-type-encoding=NONE
    BT_PSD_Pos_Inhibitzeit: base-type-encoding=NONE
    BT_PSD_Pos_Segment_ID: base-type-encoding=NONE
    BT_PSD_Pos_Segmentlaenge: base-type-encoding=NONE
    BT_PSD_Pos_Standort_Eindeutig: base-type-encoding=NONE
    BT_PSD_Rampe: base-type-encoding=NONE
    BT_PSD_Segment_ID: base-type-encoding=NONE
    BT_PSD_Segment_Komplett: base-type-encoding=NONE
    BT_PSD_Segmentlaenge: base-type-encoding=NONE
    BT_PSD_Steigung_1_A_Offset: base-type-encoding=NONE
    BT_PSD_Steigung_1_A_Steigung: base-type-encoding=NONE
    BT_PSD_Steigung_1_A_Vorz: base-type-encoding=NONE
    BT_PSD_Steigung_1_Attribute_kompl: base-type-encoding=NONE
    BT_PSD_Steigung_1_B_Offset: base-type-encoding=NONE
    BT_PSD_Steigung_1_B_Steigung: base-type-encoding=NONE
    BT_PSD_Steigung_1_B_Vorz: base-type-encoding=NONE
    BT_PSD_Steigung_1_Segment_ID: base-type-encoding=NONE
    BT_PSD_Steigung_2_Attribute_kompl: base-type-encoding=NONE
    BT_PSD_Steigung_2_Offset: base-type-encoding=NONE
    BT_PSD_Steigung_2_Segment_ID: base-type-encoding=NONE
    BT_PSD_Steigung_2_Steigung: base-type-encoding=NONE
    BT_PSD_Steigung_2_Vorz: base-type-encoding=NONE
    BT_PSD_Strassenkategorie: base-type-encoding=NONE
    BT_PSD_Sys_Alter_Karte: base-type-encoding=NONE
    BT_PSD_Sys_Geometrieguete: base-type-encoding=NONE
    BT_PSD_Sys_Geometrieguete_erweitert: base-type-encoding=NONE
    BT_PSD_Sys_Geschwindigkeit_Einheit: base-type-encoding=NONE
    BT_PSD_Sys_Laendercode: base-type-encoding=NONE
    BT_PSD_Sys_Mapmatchingguete: base-type-encoding=NONE
    BT_PSD_Sys_Quali_Geometrien: base-type-encoding=NONE
    BT_PSD_Sys_Quali_Ortsinfo: base-type-encoding=NONE
    BT_PSD_Sys_Quali_sonstige_Attribute: base-type-encoding=NONE
    BT_PSD_Sys_Quali_Steigungen: base-type-encoding=NONE
    BT_PSD_Sys_Quali_Strassenkennz: base-type-encoding=NONE
    BT_PSD_Sys_Quali_Tempolimits: base-type-encoding=NONE
    BT_PSD_Sys_Quali_verfuegbar: base-type-encoding=NONE
    BT_PSD_Sys_Quali_Vorfahrtsregelung: base-type-encoding=NONE
    BT_PSD_Sys_Segment_ID: base-type-encoding=NONE
    BT_PSD_Sys_US_State: base-type-encoding=NONE
    BT_PSD_Sys_Verkehrsrichtung: base-type-encoding=NONE
    BT_PSD_Sys_Zielfuehrung: base-type-encoding=NONE
    BT_PSD_Sys_Zielfuehrung_geaendert: base-type-encoding=NONE
    BT_PSD_Vorgaenger_Segment_ID: base-type-encoding=NONE
    BT_PSD_wahrscheinlichster_Pfad: base-type-encoding=NONE
    BT_PSD_Wechselverkehrszeichen_Typ: base-type-encoding=NONE
    BT_PTC_Aktiv: base-type-encoding=NONE
    BT_PTC_Fehlerstatus: base-type-encoding=NONE
    BT_PTC_HV_ERR: base-type-encoding=NONE
    BT_PTC_HV_Err_Heizkreis_1: base-type-encoding=NONE
    BT_PTC_HV_Err_Heizkreis_1_TNCTOC: base-type-encoding=NONE
    BT_PTC_HV_Err_Heizkreis_2: base-type-encoding=NONE
    BT_PTC_HV_Err_Heizkreis_2_TNCTOC: base-type-encoding=NONE
    BT_PTC_HV_Err_Heizkreis_3: base-type-encoding=NONE
    BT_PTC_HV_Err_Heizkreis_3_TNCTOC: base-type-encoding=NONE
    BT_PTC_HV_Err_intern: base-type-encoding=NONE
    BT_PTC_HV_Err_Intern_TNCTOC: base-type-encoding=NONE
    BT_PTC_HV_Err_Leckagestrom: base-type-encoding=NONE
    BT_PTC_HV_Err_Leckagestrom_TNCTOC: base-type-encoding=NONE
    BT_PTC_HV_Err_Temperaturschutz: base-type-encoding=NONE
    BT_PTC_HV_Err_TempSchutz_TNCTOC: base-type-encoding=NONE
    BT_PTC_HV_ERR_TNCTOC: base-type-encoding=NONE
    BT_PTC_HV_Err_Ueberstromabs_TNCTOC: base-type-encoding=NONE
    BT_PTC_HV_Err_Ueberstromabschaltung: base-type-encoding=NONE
    BT_PTC_HV_Heizmedium_Sensor_1: base-type-encoding=NONE
    BT_PTC_HV_Heizmedium_Sensor_2: base-type-encoding=NONE
    BT_PTC_HV_I_ist: base-type-encoding=NONE
    BT_PTC_HV_ResponseError: base-type-encoding=NONE
    BT_PTC_HV_Status_PTC: base-type-encoding=NONE
    BT_PTC_HV_Status_UBatt: base-type-encoding=NONE
    BT_PTC_HV_Temp_PCB: base-type-encoding=NONE
    BT_PTC_HV_TimeOut_Fehler: base-type-encoding=NONE
    BT_PTC_HV_UBatt: base-type-encoding=NONE
    BT_PTC_HVb_ERR: base-type-encoding=NONE
    BT_PTC_HVb_Err_Heizkreis_1: base-type-encoding=NONE
    BT_PTC_HVb_Err_Heizkreis_1_TNCTOC: base-type-encoding=NONE
    BT_PTC_HVb_Err_Heizkreis_2: base-type-encoding=NONE
    BT_PTC_HVb_Err_Heizkreis_2_TNCTOC: base-type-encoding=NONE
    BT_PTC_HVb_Err_Heizkreis_3: base-type-encoding=NONE
    BT_PTC_HVb_Err_Heizkreis_3_TNCTOC: base-type-encoding=NONE
    BT_PTC_HVb_Err_intern: base-type-encoding=NONE
    BT_PTC_HVb_Err_Intern_TNCTOC: base-type-encoding=NONE
    BT_PTC_HVb_Err_Leckagestrom: base-type-encoding=NONE
    BT_PTC_HVb_Err_Leckagestrom_TNCTOC: base-type-encoding=NONE
    BT_PTC_HVb_Err_Temperaturschutz: base-type-encoding=NONE
    BT_PTC_HVb_Err_TempSchutz_TNCTOC: base-type-encoding=NONE
    BT_PTC_HVb_ERR_TNCTOC: base-type-encoding=NONE
    BT_PTC_HVb_Err_Ueberstromabs_TNCTOC: base-type-encoding=NONE
    BT_PTC_HVb_Err_Ueberstromabschaltung: base-type-encoding=NONE
    BT_PTC_HVb_Heizmedium_Sensor_1: base-type-encoding=NONE
    BT_PTC_HVb_Heizmedium_Sensor_2: base-type-encoding=NONE
    BT_PTC_HVb_I_ist: base-type-encoding=NONE
    BT_PTC_HVb_ResponseError: base-type-encoding=NONE
    BT_PTC_HVb_Status_PTC: base-type-encoding=NONE
    BT_PTC_HVb_Status_UBatt: base-type-encoding=NONE
    BT_PTC_HVb_Temp_PCB: base-type-encoding=NONE
    BT_PTC_HVb_TimeOut_Fehler: base-type-encoding=NONE
    BT_PTC_HVb_UBatt: base-type-encoding=NONE
    BT_PTC_HW: base-type-encoding=NONE
    BT_PTC_I_ist: base-type-encoding=NONE
    BT_PTC_Nenn_Strom: base-type-encoding=NONE
    BT_PTC_P_ist: base-type-encoding=NONE
    BT_PTC_ResponseError: base-type-encoding=NONE
    BT_PTC_Status: base-type-encoding=NONE
    BT_PTC_Status_PTC: base-type-encoding=NONE
    BT_PTC_Status_UBatt: base-type-encoding=NONE
    BT_PTC_SW: base-type-encoding=NONE
    BT_PTC_Temp_PCB: base-type-encoding=NONE
    BT_PTC_TimeOut_Fehler: base-type-encoding=NONE
    BT_PTC_UBatt: base-type-encoding=NONE
    BT_PTCs_01_alt: base-type-encoding=NONE
    BT_RLE_Anzeigen: base-type-encoding=NONE
    BT_RLS_Vorfeldhelligkeit_Boost: base-type-encoding=NONE
    BT_Rollo_normiert: base-type-encoding=NONE
    BT_Rollo_Thermoschutz: base-type-encoding=NONE
    BT_Rollo_UEKB_aktiv: base-type-encoding=NONE
    BT_RS_defekt: base-type-encoding=NONE
    BT_RS_Regenmenge: base-type-encoding=NONE
    BT_RS_Schwall: base-type-encoding=NONE
    BT_RS_Verbau: base-type-encoding=NONE
    BT_RS_Verglasung_schliessen: base-type-encoding=NONE
    BT_RS_Wischergeschwindigkeit: base-type-encoding=NONE
    BT_RSt_Fahrerhinweise: base-type-encoding=NONE
    BT_SAD_Anf_ESC_Zuschaltung: base-type-encoding=NONE
    BT_SAD_normiert: base-type-encoding=NONE
    BT_SAD_ParityBit: base-type-encoding=NONE
    BT_SAD_Taster_Deckel_hi: base-type-encoding=NONE
    BT_SAD_Taster_Deckel_vo: base-type-encoding=NONE
    BT_SAD_Taster_Rollo_hi: base-type-encoding=NONE
    BT_SAD_Taster_Rollo_vo: base-type-encoding=NONE
    BT_SAD_Text: base-type-encoding=NONE
    BT_SAD_Thermoschutz: base-type-encoding=NONE
    BT_SAD_ToggleBit: base-type-encoding=NONE
    BT_SAD_UEKB_aktiv: base-type-encoding=NONE
    BT_SC_PAO_OFF_Anf: base-type-encoding=NONE
    BT_SC_PAO_ON_Anf: base-type-encoding=NONE
    BT_SC_PAO_Schriftzug_Anf: base-type-encoding=NONE
    BT_SC_PreSense_Modus_System_KAS: base-type-encoding=NONE
    BT_SC_PreSense_Modus_System_MV: base-type-encoding=NONE
    BT_SC_PreSense_Modus_System_NV: base-type-encoding=NONE
    BT_SC_PreSense_Modus_Warnung_MV: base-type-encoding=NONE
    BT_SC_PreSense_Modus_Warnung_NV: base-type-encoding=NONE
    BT_Scheibenreinigung: base-type-encoding=NONE
    BT_SI_BUS_{01..15}: base-type-encoding=NONE
    BT_SI_Bus_Identifikation: base-type-encoding=NONE
    BT_SI_CAB_V15: base-type-encoding=ISO-8859-1
    BT_SI_Diagnose_Aktiv: base-type-encoding=NONE
    BT_SI_NWDF: base-type-encoding=NONE
    BT_SI_NWDF_30: base-type-encoding=NONE
    BT_SI_NWDF_gueltig: base-type-encoding=NONE
    BT_SI_P_Mode: base-type-encoding=NONE
    BT_SI_P_Mode_gueltig: base-type-encoding=NONE
    BT_SI_QRS_Mode: base-type-encoding=NONE
    BT_SI_Sammel_SG_Fehler: base-type-encoding=NONE
    BT_SI_Sammelfehler: base-type-encoding=NONE
    BT_SI_T_Mode: base-type-encoding=NONE
    BT_SI_T_Schutz: base-type-encoding=NONE
    BT_SignalVoid: base-type-encoding=NONE
    BT_SIH_Stufe_LED_li: base-type-encoding=NONE
    BT_SIH_Stufe_LED_re: base-type-encoding=NONE
    BT_SIL_Stufe_LED_HL: base-type-encoding=NONE
    BT_SIL_Stufe_LED_HR: base-type-encoding=NONE
    BT_SIL_Stufe_LED_li: base-type-encoding=NONE
    BT_SIL_Stufe_LED_re: base-type-encoding=NONE
    BT_SMLS_01_BZ: base-type-encoding=NONE
    BT_SMLS_01_CRC: base-type-encoding=NONE
    BT_SMLS_Hupe: base-type-encoding=NONE
    BT_SMLS_P_verriegelt: base-type-encoding=NONE
    BT_SMLS_P_verriegelt_plausibel: base-type-encoding=NONE
    BT_SMLS_PTT: base-type-encoding=NONE
    BT_SMod_SIH_Stufe_hl: base-type-encoding=NONE
    BT_SMod_SIH_Stufe_hr: base-type-encoding=NONE
    BT_SMod_SIL_Stufe_hl: base-type-encoding=NONE
    BT_SMod_SIL_Stufe_hr: base-type-encoding=NONE
    BT_SMod_SRH_Fehler: base-type-encoding=NONE
    BT_SMod_SRH_ResponseError: base-type-encoding=NONE
    BT_SOK_FoD_Klima_Req_Challenge: base-type-size=8, base-type-encoding=ISO-8859-1
    BT_SOK_FoD_Klima_Resp_Challenge: base-type-size=8, base-type-encoding=ISO-8859-1
    BT_Soll_Lehne_LLR_li_1: base-type-encoding=NONE
    BT_Soll_Lehne_LLR_li_2: base-type-encoding=NONE
    BT_Soll_Lehne_LLR_re_1: base-type-encoding=NONE
    BT_Soll_Lehne_LLR_re_2: base-type-encoding=NONE
    BT_Soll_Sitz_LLR_li_1: base-type-encoding=NONE
    BT_Soll_Sitz_LLR_li_2: base-type-encoding=NONE
    BT_Soll_Sitz_LLR_re_1: base-type-encoding=NONE
    BT_Soll_Sitz_LLR_re_2: base-type-encoding=NONE
    BT_SoSe_SunInt_2D_Li: base-type-encoding=NONE
    BT_SoSe_SunInt_2D_Re: base-type-encoding=NONE
    BT_SSR_HBFS_Pos_Unten: base-type-encoding=NONE
    BT_SSR_HFS_Pos_Unten: base-type-encoding=NONE
    BT_SSR_Temp_Freigabe: base-type-encoding=NONE
    BT_ST_VLD_BLW_CTRL_1_LIN: base-type-encoding=NONE
    BT_ST_VLD_BLWb_CTRL_1_LIN: base-type-encoding=NONE
    BT_ST_VLD_BLWc_CTRL_1_LIN: base-type-encoding=NONE
    BT_STK_AirCLeaner_Anf: base-type-encoding=NONE
    BT_STK_Anf_AussenspiegelHZ: base-type-encoding=NONE
    BT_STK_Berechnungsphase: base-type-encoding=NONE
    BT_STK_Betriebsdauer: base-type-encoding=NONE
    BT_STK_ErwVK_Anf: base-type-encoding=NONE
    BT_STK_ErwVK_Beifahrerzone: base-type-encoding=NONE
    BT_STK_ErwVK_Fahrerzone: base-type-encoding=NONE
    BT_STK_ErwVK_Heckzone2_links: base-type-encoding=NONE
    BT_STK_ErwVK_Heckzone2_rechts: base-type-encoding=NONE
    BT_STK_ErwVK_Heckzone_links: base-type-encoding=NONE
    BT_STK_ErwVK_Heckzone_rechts: base-type-encoding=NONE
    BT_STK_ErwVK_Modus: base-type-encoding=NONE
    BT_STK_ErwVK_Scheibenheizung: base-type-encoding=NONE
    BT_STK_FSH_Anf: base-type-encoding=NONE
    BT_STK_GesamtEnergiebedarf: base-type-encoding=NONE
    BT_STK_HSH_Anf: base-type-encoding=NONE
    BT_STK_Klima_Temp: base-type-encoding=NONE
    BT_STK_KurzVK_Anf: base-type-encoding=NONE
    BT_STK_MaxLeistung: base-type-encoding=NONE
    BT_STK_Sofortstart_Sperre_FFB: base-type-encoding=NONE
    BT_STK_Standklima_Anf: base-type-encoding=NONE
    BT_STK_Standklima_Timer_Status: base-type-encoding=NONE
    BT_STK_Stecker_Status: base-type-encoding=NONE
    BT_STK_VK_Modus: base-type-encoding=NONE
    BT_STK_VK_STH_Einsatz: base-type-encoding=NONE
    BT_STK_VK_Timer_Status: base-type-encoding=NONE
    BT_STK_Voko_LED: base-type-encoding=NONE
    BT_STRG1_Adresse_Aktuator: base-type-encoding=NONE
    BT_STRG1_Geschwindigkeitsvorgabe: base-type-encoding=NONE
    BT_STRG1_Notlauffreigabe: base-type-encoding=NONE
    BT_STRG1_Select_Positionsvorgabe: base-type-encoding=NONE
    BT_STRG1_Soll_Position_Aktuator: base-type-encoding=NONE
    BT_STRG1_Spulenbestromung: base-type-encoding=NONE
    BT_STRG4_Adresse_Aktuator: base-type-encoding=NONE
    BT_STRG4_Clear_Event_Flags: base-type-encoding=NONE
    BT_STRG4_Drehrichtung: base-type-encoding=NONE
    BT_STRG4_Freigabe_Blockiererkennung: base-type-encoding=NONE
    BT_STRG4_Geschwindigkeitsvorgabe: base-type-encoding=NONE
    BT_STRG4_Notlauffreigabe: base-type-encoding=NONE
    BT_STRG4_Notlaufposition: base-type-encoding=NONE
    BT_STRG4_Programmierdaten_speichern: base-type-encoding=NONE
    BT_STRG4_Select_Positionsvorgabe: base-type-encoding=NONE
    BT_STRG4_Soll_Position_Aktuator: base-type-encoding=NONE
    BT_STRG4_Spulenbestromung: base-type-encoding=NONE
    BT_STRG4_Start_Position_Aktuator: base-type-encoding=NONE
    BT_STRG4_Stopmodus: base-type-encoding=NONE
    BT_SWA_HMI_Diagnose: base-type-encoding=NONE
    BT_Thermo_Pred_Innen_Kunde_Anf: base-type-encoding=NONE
    BT_Thermo_Pred_Innen_System_Anf: base-type-encoding=NONE
    BT_Thermo_Pred_P_dyn_In_Efficien1: base-type-encoding=NONE
    BT_Thermo_Pred_P_dyn_In_Efficien2: base-type-encoding=NONE
    BT_Thermo_Pred_P_dyn_In_Standard: base-type-encoding=NONE
    BT_Thermo_Pred_P_dyn_Innen: base-type-encoding=NONE
    BT_Thermo_Pred_P_stat_In_Efficien1: base-type-encoding=NONE
    BT_Thermo_Pred_P_stat_In_Efficien2: base-type-encoding=NONE
    BT_Thermo_Pred_P_stat_In_Standard: base-type-encoding=NONE
    BT_Thermo_Pred_P_stat_Innen: base-type-encoding=NONE
    BT_Thermo_Pred_T_dyn_In_Efficien1: base-type-encoding=NONE
    BT_Thermo_Pred_T_dyn_In_Efficien2: base-type-encoding=NONE
    BT_Thermo_Pred_T_dyn_In_Standard: base-type-encoding=NONE
    BT_Thermo_Pred_T_dyn_Innen: base-type-encoding=NONE
    BT_Thermo_Verbrauch_BTL: base-type-encoding=NONE
    BT_Thermo_Verbrauch_BTL_Ueberlauf: base-type-encoding=NONE
    BT_Thermo_Verbrauch_Innen: base-type-encoding=NONE
    BT_Thermo_Verbrauch_Innen_Ueberlauf: base-type-encoding=NONE
    BT_TM_01_BZ: base-type-encoding=NONE
    BT_TM_Door_Lock: base-type-encoding=NONE
    BT_TM_Door_Unlock: base-type-encoding=NONE
    BT_TM_Nur_Hupen: base-type-encoding=NONE
    BT_TM_Panik_Alarm: base-type-encoding=NONE
    BT_TM_Spiegel_Anklappen: base-type-encoding=NONE
    BT_TM_Warnblinken: base-type-encoding=NONE
    BT_TM_ZV_Signatur: base-type-encoding=NONE
    BT_TME_HVEM_HV_Anf: base-type-encoding=NONE
    BT_TSK_ACC_FoD_Status: base-type-encoding=NONE
    BT_TSK_aktives_System: base-type-encoding=NONE
    BT_TSK_aktives_System_02: base-type-encoding=NONE
    BT_TSK_Anf_Antriebsmoment: base-type-encoding=NONE
    BT_TSK_Codierung: base-type-encoding=NONE
    BT_TSK_Einheit_vMax_Fahrerassistenz: base-type-encoding=NONE
    BT_TSK_erhoehter_Fahrwiderstand: base-type-encoding=NONE
    BT_TSK_Fahrzeugmasse_02: base-type-encoding=NONE
    BT_TSK_GRA_FoD_Status: base-type-encoding=NONE
    BT_TSK_Grundmasse: base-type-encoding=NONE
    BT_TSK_QBit_Fahrzeugmasse: base-type-encoding=NONE
    BT_TSK_QBit_Steigung: base-type-encoding=NONE
    BT_TSK_Status_ARA: base-type-encoding=NONE
    BT_TSK_Status_EA: base-type-encoding=NONE
    BT_TSK_Status_IPA: base-type-encoding=NONE
    BT_TSK_Status_PLA: base-type-encoding=NONE
    BT_TSK_Status_RHP: base-type-encoding=NONE
    BT_TSK_Steigung_02: base-type-encoding=NONE
    BT_TSK_vMax_aktuell: base-type-encoding=NONE
    BT_TSK_vMax_Fahrerassistenz: base-type-encoding=NONE
    BT_TSMomBegrenzung: base-type-encoding=NONE
    BT_UH_Jahr: base-type-encoding=NONE
    BT_UH_Minute: base-type-encoding=NONE
    BT_UH_Monat: base-type-encoding=NONE
    BT_UH_Sekunde: base-type-encoding=NONE
    BT_UH_Stunde: base-type-encoding=NONE
    BT_UH_Tag: base-type-encoding=NONE
    BT_Uhrzeit_01_alt: base-type-encoding=NONE
    BT_UIF_Itos_roh: base-type-encoding=NONE
    BT_UIF_Ref_roh: base-type-encoding=NONE
    BT_UIF_ResponseError: base-type-encoding=NONE
    BT_UIF_Status: base-type-encoding=NONE
    BT_UIF_Sun_roh: base-type-encoding=NONE
    BT_UIF_SunInt: base-type-encoding=NONE
    BT_UIF_Temp_OutOfRange: base-type-encoding=NONE
    BT_UIF_Temperatur: base-type-encoding=NONE
    BT_Umluft: base-type-encoding=NONE
    BT_UserStateServer_01_BZ: base-type-encoding=NONE
    BT_UserStateServer_01_CRC: base-type-encoding=NONE
    BT_Vehicle_Driving_Cycle: base-type-encoding=NONE
    BT_Verbauposition_LLR_li: base-type-encoding=NONE
    BT_Verbauposition_LLR_re: base-type-encoding=NONE
    BT_VIN_01_MUX: base-type-encoding=NONE
    BT_VIN_1: base-type-encoding=NONE
    BT_VIN_{10..17}: base-type-encoding=NONE
    BT_VIN_{2..9}: base-type-encoding=NONE
    BT_VIP_Sensor_STSG_HBFS_betaetigt: base-type-encoding=NONE
    BT_VIP_Sensor_STSG_HFS_betaetigt: base-type-encoding=NONE
    BT_WarnBrems_Charisma_FahrPr: base-type-encoding=NONE
    BT_WarnBrems_Charisma_Status: base-type-encoding=NONE
    BT_Waschen_vorne_aktiv: base-type-encoding=NONE
    BT_WH_Frontwaschen: base-type-encoding=NONE
    BT_WH_Heckintervall: base-type-encoding=NONE
    BT_WH_Heckwaschen: base-type-encoding=NONE
    BT_WH_Intervall: base-type-encoding=NONE
    BT_WH_Intervallstufen: base-type-encoding=NONE
    BT_WH_SRA: base-type-encoding=NONE
    BT_WH_Tipwischen: base-type-encoding=NONE
    BT_WH_Tipwischen_lang: base-type-encoding=NONE
    BT_WH_Wischer_Fehler: base-type-encoding=NONE
    BT_WH_WischerStufe1: base-type-encoding=NONE
    BT_WH_WischerStufe2: base-type-encoding=NONE
    BT_Wischer1_Wischgeschwindigkeit: base-type-encoding=NONE
    BT_Wischer_vorne_aktiv: base-type-encoding=NONE
    BT_Wischer_vorne_blockiert: base-type-encoding=NONE
    BT_Wischer_vorne_defekt: base-type-encoding=NONE
    BT_Wischer_vorne_Normal: base-type-encoding=NONE
    BT_Wischer_vorne_Parklage: base-type-encoding=NONE
    BT_Wischer_vorne_Schnell: base-type-encoding=NONE
    BT_Wischer_WH_PopUp_Anf: base-type-encoding=NONE
    BT_Wischer_WH_Typ: base-type-encoding=NONE
    BT_WIV_Anzeige_aktiv: base-type-encoding=NONE
    BT_WIV_laufender_Motor: base-type-encoding=NONE
    BT_WIV_nachfuellanzeige_ein: base-type-encoding=NONE
    BT_WIV_nicht_betriebswarm: base-type-encoding=NONE
    BT_WIV_Oeldr_Warn_Motor: base-type-encoding=NONE
    BT_WIV_Oeldyn_avl: base-type-encoding=NONE
    BT_WIV_Oelmenge: base-type-encoding=NONE
    BT_WIV_Oelmin_Warn: base-type-encoding=NONE
    BT_WIV_Oelstand: base-type-encoding=NONE
    BT_WIV_Oelstand_nicht_vorhanden: base-type-encoding=NONE
    BT_WIV_Oelsystem_aktiv: base-type-encoding=NONE
    BT_WIV_Schieflage: base-type-encoding=NONE
    BT_WIV_Sensorfehler: base-type-encoding=NONE
    BT_WIV_Ueberfuell_deaktiv: base-type-encoding=NONE
    BT_WIV_Ueberfuell_Warn: base-type-encoding=NONE
    BT_WIV_Unterfuell_Warn: base-type-encoding=NONE
    BT_WP_KJ_Soll: base-type-encoding=NONE
    BT_WP_Kuehlerluefter_Anf: base-type-encoding=NONE
    BT_WWSs_01_alt: base-type-encoding=NONE
    BT_ZAS_Kl_15: base-type-encoding=NONE
    BT_ZAS_Kl_50_Startanforderung: base-type-encoding=NONE
    BT_ZAS_Kl_Infotainment: base-type-encoding=NONE
    BT_ZAS_Kl_S: base-type-encoding=NONE
    BT_ZAS_Kl_X: base-type-encoding=NONE
    BT_ZM_Fahrzeugabstellzeit: base-type-encoding=NONE
    BT_ZM_Fahrzeugabstellzeit_Status: base-type-encoding=NONE
    BT_ZM_HV_Auszeit: base-type-encoding=NONE
    BT_ZM_HV_Auszeit_Status: base-type-encoding=NONE
    BT_ZM_Standzeit: base-type-encoding=NONE
    BT_ZV_Anf_Challenge_Auth: base-type-encoding=NONE
    BT_ZV_BT_offen: base-type-encoding=NONE
    BT_ZV_Einzeltuerentriegelung: base-type-encoding=NONE
    BT_ZV_eRWK_Umfeld_Pruefung: base-type-encoding=NONE
    BT_ZV_FT_offen: base-type-encoding=NONE
    BT_ZV_gesafet_extern_ist: base-type-encoding=NONE
    BT_ZV_gesafet_extern_soll: base-type-encoding=NONE
    BT_ZV_HBFS_offen: base-type-encoding=NONE
    BT_ZV_HD_offen: base-type-encoding=NONE
    BT_ZV_Heckeinzelentriegelung: base-type-encoding=NONE
    BT_ZV_HFS_offen: base-type-encoding=NONE
    BT_ZV_HS_offen: base-type-encoding=NONE
    BT_ZV_ist_Zustand_verfuegbar: base-type-encoding=NONE
    BT_ZV_Oeffnungsmodus: base-type-encoding=NONE
    BT_ZV_Rollo_auf: base-type-encoding=NONE
    BT_ZV_Rollo_zu: base-type-encoding=NONE
    BT_ZV_SAD_auf: base-type-encoding=NONE
    BT_ZV_SAD_zu: base-type-encoding=NONE
    BT_ZV_SafeFunktion_aktiv: base-type-encoding=NONE
    BT_ZV_Schluessel_Zugang: base-type-encoding=NONE
    BT_ZV_STSG_HBFS_Anf: base-type-encoding=NONE
    BT_ZV_STSG_HFS_Anf: base-type-encoding=NONE
    BT_ZV_Tankklappe_offen: base-type-encoding=NONE
    BT_ZV_verriegeln_Anf: base-type-encoding=NONE
    BT_ZV_verriegelt_extern_ist: base-type-encoding=NONE
    BT_ZV_verriegelt_extern_soll: base-type-encoding=NONE
    BT_ZV_verriegelt_intern_ist: base-type-encoding=NONE
    BT_ZV_verriegelt_intern_soll: base-type-encoding=NONE
    BT_ZV_verriegelt_soll: base-type-encoding=NONE
package /Signal
  21 x system signal:
    SignalVoid_ESC_51_Auth_0
    SignalVoid_ESC_51_Auth_1
    SignalVoid_ESC_51_Auth_{10..19}
    SignalVoid_ESC_51_Auth_2
    SignalVoid_ESC_51_Auth_20
    SignalVoid_ESC_51_Auth_{3..9}
package /Unit
  44 x unit:
    Unit_Unit_Amper: display-name=Unit_Amper, factor-si-to-unit=1.0, physical-dimension=PD_siAmpere
    Unit_Unit_Bar: display-name=Unit_Bar, factor-si-to-unit=1.0E-5, physical-dimension=PD_siPascal
    Unit_Unit_Bit: display-name=Unit_Bit, factor-si-to-unit=1.0, physical-dimension=PD_siNone
    Unit_Unit_Day: display-name=Unit_Day, factor-si-to-unit=1.157E-5, physical-dimension=PD_siSecond
    Unit_Unit_DegreCelsi: display-name=Unit_DegreCelsi, factor-si-to-unit=1.0, offset-si-to-unit=-273.2, physical-dimension=PD_siKelvin
    Unit_Unit_DegreOfArc: display-name=Unit_DegreOfArc, factor-si-to-unit=57.3, physical-dimension=PD_siRadiant
    Unit_Unit_DeziBel: display-name=Unit_DeziBel, factor-si-to-unit=1.0, physical-dimension=PD_siNone
    Unit_Unit_Hours: display-name=Unit_Hours, factor-si-to-unit=2.778E-4, physical-dimension=PD_siSecond
    Unit_Unit_KiloGram: display-name=Unit_KiloGram, factor-si-to-unit=1.0, physical-dimension=PD_siKiloGramm
    Unit_Unit_KiloHertz: display-name=Unit_KiloHertz, factor-si-to-unit=0.001, physical-dimension=PD_siPerSecond
    Unit_Unit_KiloMeter: display-name=Unit_KiloMeter, factor-si-to-unit=0.001, physical-dimension=PD_siMeter
    Unit_Unit_KiloMeterPerHour: display-name=Unit_KiloMeterPerHour, factor-si-to-unit=3.6, physical-dimension=PD_siMeterPerSecond
    Unit_Unit_KiloOhm: display-name=Unit_KiloOhm, factor-si-to-unit=0.001, physical-dimension=PD_siOhm
    Unit_Unit_KiloPascal: display-name=Unit_KiloPascal, factor-si-to-unit=0.001, physical-dimension=PD_siPascal
    Unit_Unit_KiloWatt: display-name=Unit_KiloWatt, factor-si-to-unit=0.001, physical-dimension=PD_siWatt
    Unit_Unit_KiloWattHour: display-name=Unit_KiloWattHour, factor-si-to-unit=2.7777778E-7, physical-dimension=PD_siWattSecond
    Unit_Unit_Liter: display-name=Unit_Liter, factor-si-to-unit=1000.0, physical-dimension=PD_siCubicMeter
    Unit_Unit_LiterPerMinut: display-name=Unit_LiterPerMinut, factor-si-to-unit=60000.0, physical-dimension=PD_siCubicMeterPerSecond
    Unit_Unit_Lux: display-name=Unit_Lux, factor-si-to-unit=1.0, physical-dimension=PD_siLux
    Unit_Unit_Meter: display-name=Unit_Meter, factor-si-to-unit=1.0, physical-dimension=PD_siMeter
    Unit_Unit_MeterPerSecon: display-name=Unit_MeterPerSecon, factor-si-to-unit=1.0, physical-dimension=PD_siMeterPerSecond
    Unit_Unit_MicroLiter: display-name=Unit_MicroLiter, factor-si-to-unit=1.0E9, physical-dimension=PD_siCubicMeter
    Unit_Unit_MilliAmper: display-name=Unit_MilliAmper, factor-si-to-unit=0.001, physical-dimension=PD_siAmpere
    Unit_Unit_MilliBar: display-name=Unit_MilliBar, factor-si-to-unit=0.01, physical-dimension=PD_siPascal
    Unit_Unit_MilliLiter: display-name=Unit_MilliLiter, factor-si-to-unit=1000000.0, physical-dimension=PD_siCubicMeter
    Unit_Unit_MilliLiterPerSec: display-name=Unit_MilliLiterPerSec, factor-si-to-unit=1000000.0, physical-dimension=PD_siCubicMeterPerSecond
    Unit_Unit_MilliSecon: display-name=Unit_MilliSecon, factor-si-to-unit=1000.0, physical-dimension=PD_siSecond
    Unit_Unit_Minut: display-name=Unit_Minut, factor-si-to-unit=60.0, physical-dimension=PD_siSecond
    Unit_Unit_MinutInver: display-name=Unit_MinutInver, factor-si-to-unit=60.0, physical-dimension=PD_siPerSecond
    Unit_Unit_Month: display-name=Unit_Month, factor-si-to-unit=3.805E-7, physical-dimension=PD_siSecond
    Unit_Unit_NanoSecon: display-name=Unit_NanoSecon, factor-si-to-unit=1.0E-9, offset-si-to-unit=0.0, physical-dimension=PD_siSecond
    Unit_Unit_NewtoMeter: display-name=Unit_NewtoMeter, factor-si-to-unit=1.0, physical-dimension=PD_siNewtonMeter
    Unit_Unit_None: display-name=Unit_None, factor-si-to-unit=1.0, physical-dimension=PD_siNone
    Unit_Unit_PerCent: display-name=Unit_PerCent, factor-si-to-unit=1.0, physical-dimension=PD_siNone
    Unit_Unit_Secon: display-name=Unit_Secon, factor-si-to-unit=1.0, physical-dimension=PD_siSecond
    Unit_Unit_SeconInver: display-name=Unit_SeconInver, factor-si-to-unit=1.0, physical-dimension=PD_siPerSecond
    Unit_Unit_Volt: display-name=Unit_Volt, factor-si-to-unit=1.0, physical-dimension=PD_siVolt
    Unit_Unit_VoltPerSecon: display-name=Unit_VoltPerSecon, factor-si-to-unit=1.0, physical-dimension=PD_siVoltPerSecond
    Unit_Unit_Watt: display-name=Unit_Watt, factor-si-to-unit=1.0, physical-dimension=PD_siWatt
    Unit_Unit_WattHour: display-name=Unit_WattHour, factor-si-to-unit=2.7778E-4, physical-dimension=PD_siWattSecond
    Unit_Unit_WattPerMeterSquar: display-name=Unit_WattPerMeterSquar, factor-si-to-unit=1.0, physical-dimension=PD_siWattPerMeterSquare
    Unit_Unit_WattPerSecon: display-name=Unit_WattPerSecon, factor-si-to-unit=1.0, physical-dimension=PD_siWattSecond
    Unit_Unit_WattSecond: display-name=Unit_WattSecond, factor-si-to-unit=1.0, physical-dimension=PD_siWattSecond
    Unit_Unit_Year: display-name=Unit_Year, factor-si-to-unit=3.16887646E-8, physical-dimension=PD_siSecond
package /PhysicalDimension
  20 x physical dimension:
    PD_siAmpere: current-exp=1
    PD_siCubicMeter: mass-exp=3
    PD_siCubicMeterPerSecond: length-exp=3, time-exp=-1
    PD_siKelvin: temperature-exp=1
    PD_siKiloGramm: mass-exp=1
    PD_siLux: length-exp=-2, luminous-intensity-exp=1
    PD_siMeter: length-exp=1
    PD_siMeterPerSecond: length-exp=1, time-exp=-1
    PD_siNewtonMeter: length-exp=2, mass-exp=1, time-exp=-2
    PD_siNone
    PD_siOhm: length-exp=2, mass-exp=1, time-exp=-3, current-exp=-2
    PD_siPascal: length-exp=-1, mass-exp=1, time-exp=-2
    PD_siPerSecond: time-exp=-1
    PD_siRadiant: length-exp=0
    PD_siSecond: time-exp=1
    PD_siVolt: length-exp=2, mass-exp=1, time-exp=-1, current-exp=-1
    PD_siVoltPerSecond: length-exp=2, mass-exp=1, time-exp=-2, current-exp=-1
    PD_siWatt: length-exp=2, mass-exp=1, time-exp=-3
    PD_siWattPerMeterSquare: mass-exp=1, time-exp=-3
    PD_siWattSecond: length-exp=2, mass-exp=1, time-exp=-2
