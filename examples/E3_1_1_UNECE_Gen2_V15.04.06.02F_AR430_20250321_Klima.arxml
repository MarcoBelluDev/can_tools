[part 2 of 23: package /E3_1_1_UNECE_Gen2]
AUTOSAR XML (schema 4-3-0)
package /E3_1_1_UNECE_Gen2  (continued)
  system System  (continued)
    system mapping System_Mappings  (continued)
      data-mappings:  (continued)
        communication-direction=IN, data-element=Grundumfang_XIX_Klima.Geltungsbereich_E3_1_1_UNECE_Gen2.RP_IF_HV_H3_Err_Leckagestrom_XIX_Grundumfang_XIX_Klima.DE_HV_H3_Err_Leckagestrom, system-signal=HV_H3_Err_Leckagestrom
        communication-direction=IN, data-element=Grundumfang_XIX_Klima.Geltungsbereich_E3_1_1_UNECE_Gen2.RP_IF_HV_H3_Err_Temperaturschutz_XIX_Grundumfang_XIX_Klima.DE_HV_H3_Err_Temperaturschutz, system-signal=HV_H3_Err_Temperaturschutz
        communication-direction=IN, data-element=Grundumfang_XIX_Klima.Geltungsbereich_E3_1_1_UNECE_Gen2.RP_IF_HV_H3_Err_Ueberstromabschaltung_XIX_Grundumfang_XIX_Klima.DE_HV_H3_Err_Ueberstromabschaltung, system-signal=HV_H3_Err_Ueberstromabschaltung
        communication-direction=IN, data-element=Grundumfang_XIX_Klima.Geltungsbereich_E3_1_1_UNECE_Gen2.RP_IF_HV_H3_HIGH_VOLTAGE_XIX_Grundumfang_XIX_Klima.DE_HV_H3_HIGH_VOLTAGE, system-signal=HV_H3_HIGH_VOLTAGE
        communication-direction=IN, data-element=Grundumfang_XIX_Klima.Geltungsbereich_E3_1_1_UNECE_Gen2.RP_IF_HV_H3_HIGH_VOLTAGE_ERR_XIX_Grundumfang_XIX_Klima.DE_HV_H3_HIGH_VOLTAGE_ERR, system-signal=HV_H3_HIGH_VOLTAGE_ERR
        communication-direction=IN, data-element=Grundumfang_XIX_Klima.Geltungsbereich_E3_1_1_UNECE_Gen2.RP_IF_HV_H3_I_ist_XIX_Grundumfang_XIX_Klima.DE_HV_H3_I_ist, system-signal=HV_H3_I_ist
        communication-direction=IN, data-element=Grundumfang_XIX_Klima.Geltungsbereich_E3_1_1_UNECE_Gen2.RP_IF_HV_H3_ResponseError_XIX_Grundumfang_XIX_Klima.DE_HV_H3_ResponseError, system-signal=HV_H3_ResponseError
        communication-direction=IN, data-element=Grundumfang_XIX_Klima.Geltungsbereich_E3_1_1_UNECE_Gen2.RP_IF_HV_H3_Status_Heizer_XIX_Grundumfang_XIX_Klima.DE_HV_H3_Status_Heizer, system-signal=HV_H3_Status_Heizer
        communication-direction=IN, data-element=Grundumfang_XIX_Klima.Geltungsbereich_E3_1_1_UNECE_Gen2.RP_IF_HV_H3_Status_Heizkreis_{1..4}_XIX_Grundumfang_XIX_Klima.DE_HV_H3_Status_Heizkreis_{1..4}, system-signal=HV_H3_Status_Heizkreis_{1..4}
        communication-direction=IN, data-element=Grundumfang_XIX_Klima.Geltungsbereich_E3_1_1_UNECE_Gen2.RP_IF_HV_H3_Status_UBatt_NV_XIX_Grundumfang_XIX_Klima.DE_HV_H3_Status_UBatt_NV, system-signal=HV_H3_Status_UBatt_NV
        communication-direction=IN, data-element=Grundumfang_XIX_Klima.Geltungsbereich_E3_1_1_UNECE_Gen2.RP_IF_HV_H3_Temp_PCB_XIX_Grundumfang_XIX_Klima.DE_HV_H3_Temp_PCB, system-signal=HV_H3_Temp_PCB
        communication-direction=IN, data-element=Grundumfang_XIX_Klima.Geltungsbereich_E3_1_1_UNECE_Gen2.RP_IF_HV_H3_TimeOut_Fehler_XIX_Grundumfang_XIX_Klima.DE_HV_H3_TimeOut_Fehler, system-signal=HV_H3_TimeOut_Fehler
        communication-direction=IN, data-element=Grundumfang_XIX_Klima.Geltungsbereich_E3_1_1_UNECE_Gen2.RP_IF_HV_H3_UBatt_NV_XIX_Grundumfang_XIX_Klima.DE_HV_H3_UBatt_NV, system-signal=HV_H3_UBatt_NV
        communication-direction=IN, data-element=Grundumfang_XIX_Klima.Geltungsbereich_E3_1_1_UNECE_Gen2.RP_IF_HV_H3b_Err_intern_XIX_Grundumfang_XIX_Klima.DE_HV_H3b_Err_intern, system-signal=HV_H3b_Err_intern
        communication-direction=IN, data-element=Grundumfang_XIX_Klima.Geltungsbereich_E3_1_1_UNECE_Gen2.RP_IF_HV_H3b_Err_Leckagestrom_XIX_Grundumfang_XIX_Klima.DE_HV_H3b_Err_Leckagestrom, system-signal=HV_H3b_Err_Leckagestrom
        communication-direction=IN, data-element=Grundumfang_XIX_Klima.Geltungsbereich_E3_1_1_UNECE_Gen2.RP_IF_HV_H3b_Err_Temperaturschutz_XIX_Grundumfang_XIX_Klima.DE_HV_H3b_Err_Temperaturschutz, system-signal=HV_H3b_Err_Temperaturschutz
        communication-direction=IN, data-element=Grundumfang_XIX_Klima.Geltungsbereich_E3_1_1_UNECE_Gen2.RP_IF_HV_H3b_Err_Ueberstromabschaltung_XIX_Grundumfang_XIX_Klima.DE_HV_H3b_Err_Ueberstromabschaltung, system-signal=HV_H3b_Err_Ueberstromabschaltung
        communication-direction=IN, data-element=Grundumfang_XIX_Klima.Geltungsbereich_E3_1_1_UNECE_Gen2.RP_IF_HV_H3b_HIGH_VOLTAGE_XIX_Grundumfang_XIX_Klima.DE_HV_H3b_HIGH_VOLTAGE, system-signal=HV_H3b_HIGH_VOLTAGE
        communication-direction=IN, data-element=Grundumfang_XIX_Klima.Geltungsbereich_E3_1_1_UNECE_Gen2.RP_IF_HV_H3b_HIGH_VOLTAGE_ERR_XIX_Grundumfang_XIX_Klima.DE_HV_H3b_HIGH_VOLTAGE_ERR, system-signal=HV_H3b_HIGH_VOLTAGE_ERR
        communication-direction=IN, data-element=Grundumfang_XIX_Klima.Geltungsbereich_E3_1_1_UNECE_Gen2.RP_IF_HV_H3b_I_ist_XIX_Grundumfang_XIX_Klima.DE_HV_H3b_I_ist, system-signal=HV_H3b_I_ist
        communication-direction=IN, data-element=Grundumfang_XIX_Klima.Geltungsbereich_E3_1_1_UNECE_Gen2.RP_IF_HV_H3b_ResponseError_XIX_Grundumfang_XIX_Klima.DE_HV_H3b_ResponseError, system-signal=HV_H3b_ResponseError
        communication-direction=IN, data-element=Grundumfang_XIX_Klima.Geltungsbereich_E3_1_1_UNECE_Gen2.RP_IF_HV_H3b_Status_Heizer_XIX_Grundumfang_XIX_Klima.DE_HV_H3b_Status_Heizer, system-signal=HV_H3b_Status_Heizer
        communication-direction=IN, data-element=Grundumfang_XIX_Klima.Geltungsbereich_E3_1_1_UNECE_Gen2.RP_IF_HV_H3b_Status_Heizkreis_{1..4}_XIX_Grundumfang_XIX_Klima.DE_HV_H3b_Status_Heizkreis_{1..4}, system-signal=HV_H3b_Status_Heizkreis_{1..4}
        communication-direction=IN, data-element=Grundumfang_XIX_Klima.Geltungsbereich_E3_1_1_UNECE_Gen2.RP_IF_HV_H3b_Status_UBatt_NV_XIX_Grundumfang_XIX_Klima.DE_HV_H3b_Status_UBatt_NV, system-signal=HV_H3b_Status_UBatt_NV
        communication-direction=IN, data-element=Grundumfang_XIX_Klima.Geltungsbereich_E3_1_1_UNECE_Gen2.RP_IF_HV_H3b_Temp_PCB_XIX_Grundumfang_XIX_Klima.DE_HV_H3b_Temp_PCB, system-signal=HV_H3b_Temp_PCB
        communication-direction=IN, data-element=Grundumfang_XIX_Klima.Geltungsbereich_E3_1_1_UNECE_Gen2.RP_IF_HV_H3b_TimeOut_Fehler_XIX_Grundumfang_XIX_Klima.DE_HV_H3b_TimeOut_Fehler, system-signal=HV_H3b_TimeOut_Fehler
        communication-direction=IN, data-element=Grundumfang_XIX_Klima.Geltungsbereich_E3_1_1_UNECE_Gen2.RP_IF_HV_H3b_UBatt_NV_XIX_Grundumfang_XIX_Klima.DE_HV_H3b_UBatt_NV, system-signal=HV_H3b_UBatt_NV
        communication-direction=OUT, data-element=Grundumfang_XIX_Klima.Geltungsbereich_E3_1_1_UNECE_Gen2.SP_IF_HV_H3be_Geblaesedrehzahl_XIX_Grundumfang_XIX_Klima.DE_HV_H3be_Geblaesedrehzahl, system-signal=HV_H3be_Geblaesedrehzahl
        communication-direction=OUT, data-element=Grundumfang_XIX_Klima.Geltungsbereich_E3_1_1_UNECE_Gen2.SP_IF_HV_H3be_Heizer_ein_XIX_Grundumfang_XIX_Klima.DE_HV_H3be_Heizer_ein, system-signal=HV_H3be_Heizer_ein
        communication-direction=OUT, data-element=Grundumfang_XIX_Klima.Geltungsbereich_E3_1_1_UNECE_Gen2.SP_IF_HV_H3be_Heizer_links_soll_XIX_Grundumfang_XIX_Klima.DE_HV_H3be_Heizer_links_soll, system-signal=HV_H3be_Heizer_links_soll
        communication-direction=OUT, data-element=Grundumfang_XIX_Klima.Geltungsbereich_E3_1_1_UNECE_Gen2.SP_IF_HV_H3be_Heizer_Mitte_soll_XIX_Grundumfang_XIX_Klima.DE_HV_H3be_Heizer_Mitte_soll, system-signal=HV_H3be_Heizer_Mitte_soll
        communication-direction=OUT, data-element=Grundumfang_XIX_Klima.Geltungsbereich_E3_1_1_UNECE_Gen2.SP_IF_HV_H3be_Heizer_rechts_soll_XIX_Grundumfang_XIX_Klima.DE_HV_H3be_Heizer_rechts_soll, system-signal=HV_H3be_Heizer_rechts_soll
        communication-direction=OUT, data-element=Grundumfang_XIX_Klima.Geltungsbereich_E3_1_1_UNECE_Gen2.SP_IF_HV_H3be_Heizgaskuehler_XIX_Grundumfang_XIX_Klima.DE_HV_H3be_Heizgaskuehler, system-signal=HV_H3be_Heizgaskuehler
        communication-direction=OUT, data-element=Grundumfang_XIX_Klima.Geltungsbereich_E3_1_1_UNECE_Gen2.SP_IF_HV_H3be_Heizsystem_XIX_Grundumfang_XIX_Klima.DE_HV_H3be_Heizsystem, system-signal=HV_H3be_Heizsystem
        communication-direction=OUT, data-element=Grundumfang_XIX_Klima.Geltungsbereich_E3_1_1_UNECE_Gen2.SP_IF_HV_H3be_PTC_Zonenanzahl_XIX_Grundumfang_XIX_Klima.DE_HV_H3be_PTC_Zonenanzahl, system-signal=HV_H3be_PTC_Zonenanzahl
        communication-direction=OUT, data-element=Grundumfang_XIX_Klima.Geltungsbereich_E3_1_1_UNECE_Gen2.SP_IF_HV_H3be_Tempklappenwinkel_li_XIX_Grundumfang_XIX_Klima.DE_HV_H3be_Tempklappenwinkel_li, system-signal=HV_H3be_Tempklappenwinkel_li
        communication-direction=OUT, data-element=Grundumfang_XIX_Klima.Geltungsbereich_E3_1_1_UNECE_Gen2.SP_IF_HV_H3be_Tempklappenwinkel_mi_XIX_Grundumfang_XIX_Klima.DE_HV_H3be_Tempklappenwinkel_mi, system-signal=HV_H3be_Tempklappenwinkel_mi
        communication-direction=OUT, data-element=Grundumfang_XIX_Klima.Geltungsbereich_E3_1_1_UNECE_Gen2.SP_IF_HV_H3be_Tempklappenwinkel_re_XIX_Grundumfang_XIX_Klima.DE_HV_H3be_Tempklappenwinkel_re, system-signal=HV_H3be_Tempklappenwinkel_re
        communication-direction=OUT, data-element=Grundumfang_XIX_Klima.Geltungsbereich_E3_1_1_UNECE_Gen2.SP_IF_HV_H3be_Verdampfertemp_Delta_XIX_Grundumfang_XIX_Klima.DE_HV_H3be_Verdampfertemp_Delta, system-signal=HV_H3be_Verdampfertemp_Delta
        communication-direction=OUT, data-element=Grundumfang_XIX_Klima.Geltungsbereich_E3_1_1_UNECE_Gen2.SP_IF_HV_H3be_Verdampfertemp_min_XIX_Grundumfang_XIX_Klima.DE_HV_H3be_Verdampfertemp_min, system-signal=HV_H3be_Verdampfertemp_min
        communication-direction=OUT, data-element=Grundumfang_XIX_Klima.Geltungsbereich_E3_1_1_UNECE_Gen2.SP_IF_HV_H3e_Geblaesedrehzahl_XIX_Grundumfang_XIX_Klima.DE_HV_H3e_Geblaesedrehzahl, system-signal=HV_H3e_Geblaesedrehzahl
        communication-direction=OUT, data-element=Grundumfang_XIX_Klima.Geltungsbereich_E3_1_1_UNECE_Gen2.SP_IF_HV_H3e_Heizer_ein_XIX_Grundumfang_XIX_Klima.DE_HV_H3e_Heizer_ein, system-signal=HV_H3e_Heizer_ein
        communication-direction=OUT, data-element=Grundumfang_XIX_Klima.Geltungsbereich_E3_1_1_UNECE_Gen2.SP_IF_HV_H3e_Heizer_links_soll_XIX_Grundumfang_XIX_Klima.DE_HV_H3e_Heizer_links_soll, system-signal=HV_H3e_Heizer_links_soll
        communication-direction=OUT, data-element=Grundumfang_XIX_Klima.Geltungsbereich_E3_1_1_UNECE_Gen2.SP_IF_HV_H3e_Heizer_Mitte_soll_XIX_Grundumfang_XIX_Klima.DE_HV_H3e_Heizer_Mitte_soll, system-signal=HV_H3e_Heizer_Mitte_soll
        communication-direction=OUT, data-element=Grundumfang_XIX_Klima.Geltungsbereich_E3_1_1_UNECE_Gen2.SP_IF_HV_H3e_Heizer_rechts_soll_XIX_Grundumfang_XIX_Klima.DE_HV_H3e_Heizer_rechts_soll, system-signal=HV_H3e_Heizer_rechts_soll
        communication-direction=OUT, data-element=Grundumfang_XIX_Klima.Geltungsbereich_E3_1_1_UNECE_Gen2.SP_IF_HV_H3e_Heizgaskuehler_XIX_Grundumfang_XIX_Klima.DE_HV_H3e_Heizgaskuehler, system-signal=HV_H3e_Heizgaskuehler
        communication-direction=OUT, data-element=Grundumfang_XIX_Klima.Geltungsbereich_E3_1_1_UNECE_Gen2.SP_IF_HV_H3e_Heizsystem_XIX_Grundumfang_XIX_Klima.DE_HV_H3e_Heizsystem, system-signal=HV_H3e_Heizsystem
        communication-direction=OUT, data-element=Grundumfang_XIX_Klima.Geltungsbereich_E3_1_1_UNECE_Gen2.SP_IF_HV_H3e_PTC_Zonenanzahl_XIX_Grundumfang_XIX_Klima.DE_HV_H3e_PTC_Zonenanzahl, system-signal=HV_H3e_PTC_Zonenanzahl
        communication-direction=OUT, data-element=Grundumfang_XIX_Klima.Geltungsbereich_E3_1_1_UNECE_Gen2.SP_IF_HV_H3e_Tempklappenwinkel_li_XIX_Grundumfang_XIX_Klima.DE_HV_H3e_Tempklappenwinkel_li, system-signal=HV_H3e_Tempklappenwinkel_li
        communication-direction=OUT, data-element=Grundumfang_XIX_Klima.Geltungsbereich_E3_1_1_UNECE_Gen2.SP_IF_HV_H3e_Tempklappenwinkel_mi_XIX_Grundumfang_XIX_Klima.DE_HV_H3e_Tempklappenwinkel_mi, system-signal=HV_H3e_Tempklappenwinkel_mi
        communication-direction=OUT, data-element=Grundumfang_XIX_Klima.Geltungsbereich_E3_1_1_UNECE_Gen2.SP_IF_HV_H3e_Tempklappenwinkel_re_XIX_Grundumfang_XIX_Klima.DE_HV_H3e_Tempklappenwinkel_re, system-signal=HV_H3e_Tempklappenwinkel_re
        communication-direction=OUT, data-element=Grundumfang_XIX_Klima.Geltungsbereich_E3_1_1_UNECE_Gen2.SP_IF_HV_H3e_Verdampfertemp_Delta_XIX_Grundumfang_XIX_Klima.DE_HV_H3e_Verdampfertemp_Delta, system-signal=HV_H3e_Verdampfertemp_Delta
        communication-direction=OUT, data-element=Grundumfang_XIX_Klima.Geltungsbereich_E3_1_1_UNECE_Gen2.SP_IF_HV_H3e_Verdampfertemp_min_XIX_Grundumfang_XIX_Klima.DE_HV_H3e_Verdampfertemp_min, system-signal=HV_H3e_Verdampfertemp_min
        communication-direction=IN, data-element=Grundumfang_XIX_Klima.Geltungsbereich_E3_1_1_UNECE_Gen2.RP_IF_HV_H6_aktive_Entladung_Status_XIX_Grundumfang_XIX_Klima.DE_HV_H6_aktive_Entladung_Status, system-signal=HV_H6_aktive_Entladung_Status
        communication-direction=IN, data-element=Grundumfang_XIX_Klima.Geltungsbereich_E3_1_1_UNECE_Gen2.RP_IF_HV_H6_Err_Leckagestrom_XIX_Grundumfang_XIX_Klima.DE_HV_H6_Err_Leckagestrom, system-signal=HV_H6_Err_Leckagestrom
        communication-direction=IN, data-element=Grundumfang_XIX_Klima.Geltungsbereich_E3_1_1_UNECE_Gen2.RP_IF_HV_H6_Error_HVH_XIX_Grundumfang_XIX_Klima.DE_HV_H6_Error_HVH, system-signal=HV_H6_Error_HVH
        communication-direction=IN, data-element=Grundumfang_XIX_Klima.Geltungsbereich_E3_1_1_UNECE_Gen2.RP_IF_HV_H6_Heizmedium_Sensor_1_XIX_Grundumfang_XIX_Klima.DE_HV_H6_Heizmedium_Sensor_1, system-signal=HV_H6_Heizmedium_Sensor_1
        communication-direction=IN, data-element=Grundumfang_XIX_Klima.Geltungsbereich_E3_1_1_UNECE_Gen2.RP_IF_HV_H6_Heizmedium_Sensor_2_XIX_Grundumfang_XIX_Klima.DE_HV_H6_Heizmedium_Sensor_2, system-signal=HV_H6_Heizmedium_Sensor_2
        communication-direction=IN, data-element=Grundumfang_XIX_Klima.Geltungsbereich_E3_1_1_UNECE_Gen2.RP_IF_HV_H6_High_Voltage_XIX_Grundumfang_XIX_Klima.DE_HV_H6_High_Voltage, system-signal=HV_H6_High_Voltage
        communication-direction=IN, data-element=Grundumfang_XIX_Klima.Geltungsbereich_E3_1_1_UNECE_Gen2.RP_IF_HV_H6_HV_ERR_XIX_Grundumfang_XIX_Klima.DE_HV_H6_HV_ERR, system-signal=HV_H6_HV_ERR
        communication-direction=IN, data-element=Grundumfang_XIX_Klima.Geltungsbereich_E3_1_1_UNECE_Gen2.RP_IF_HV_H6_I_ist_XIX_Grundumfang_XIX_Klima.DE_HV_H6_I_ist, system-signal=HV_H6_I_ist
        communication-direction=IN, data-element=Grundumfang_XIX_Klima.Geltungsbereich_E3_1_1_UNECE_Gen2.RP_IF_HV_H6_PTC_ResponseError_XIX_Grundumfang_XIX_Klima.DE_HV_H6_PTC_ResponseError, system-signal=HV_H6_PTC_ResponseError
        communication-direction=IN, data-element=Grundumfang_XIX_Klima.Geltungsbereich_E3_1_1_UNECE_Gen2.RP_IF_HV_H6_Status_HVH_XIX_Grundumfang_XIX_Klima.DE_HV_H6_Status_HVH, system-signal=HV_H6_Status_HVH
        communication-direction=IN, data-element=Grundumfang_XIX_Klima.Geltungsbereich_E3_1_1_UNECE_Gen2.RP_IF_HV_H6_Status_UBatt_XIX_Grundumfang_XIX_Klima.DE_HV_H6_Status_UBatt, system-signal=HV_H6_Status_UBatt
        communication-direction=IN, data-element=Grundumfang_XIX_Klima.Geltungsbereich_E3_1_1_UNECE_Gen2.RP_IF_HV_H6_Temp_PCB_XIX_Grundumfang_XIX_Klima.DE_HV_H6_Temp_PCB, system-signal=HV_H6_Temp_PCB
        communication-direction=IN, data-element=Grundumfang_XIX_Klima.Geltungsbereich_E3_1_1_UNECE_Gen2.RP_IF_HV_H6_UBatt_XIX_Grundumfang_XIX_Klima.DE_HV_H6_UBatt, system-signal=HV_H6_UBatt
        communication-direction=IN, data-element=Grundumfang_XIX_Klima.Geltungsbereich_E3_1_1_UNECE_Gen2.RP_IF_HVEM_Energie_Klima_Vorgabe_XIX_Grundumfang_XIX_Klima.DE_HVEM_Energie_Klima_Vorgabe, system-signal=HVEM_Energie_Klima_Vorgabe
        communication-direction=IN, data-element=Grundumfang_XIX_Klima.Geltungsbereich_E3_1_1_UNECE_Gen2.RP_IF_HVEM_Energie_Klima_Vorgabe_HighR_XIX_Grundumfang_XIX_Klima.DE_HVEM_Energie_Klima_Vorgabe_HighR, system-signal=HVEM_Energie_Klima_Vorgabe_HighR
        communication-direction=IN, data-element=Grundumfang_XIX_Klima.Geltungsbereich_E3_1_1_UNECE_Gen2.RP_IF_HVEM_FreigabeBattHeizung_XIX_Grundumfang_XIX_Klima.DE_HVEM_FreigabeBattHeizung, system-signal=HVEM_FreigabeBattHeizung
        communication-direction=IN, data-element=Grundumfang_XIX_Klima.Geltungsbereich_E3_1_1_UNECE_Gen2.RP_IF_HVEM_FreigabeKlimatisierung_XIX_Grundumfang_XIX_Klima.DE_HVEM_FreigabeKlimatisierung, system-signal=HVEM_FreigabeKlimatisierung
        communication-direction=IN, data-element=Grundumfang_XIX_Klima.Geltungsbereich_E3_1_1_UNECE_Gen2.RP_IF_HVEM_HV_Anf_XIX_Grundumfang_XIX_Klima.DE_HVEM_HV_Anf, system-signal=HVEM_HV_Anf
        communication-direction=IN, data-element=Grundumfang_XIX_Klima.Geltungsbereich_E3_1_1_UNECE_Gen2.RP_IF_HVEM_Leistung_Bat_Kond_Vorgabe_XIX_Grundumfang_XIX_Klima.DE_HVEM_Leistung_Bat_Kond_Vorgabe, system-signal=HVEM_Leistung_Bat_Kond_Vorgabe
        communication-direction=IN, data-element=Grundumfang_XIX_Klima.Geltungsbereich_E3_1_1_UNECE_Gen2.RP_IF_HVEM_Leistung_Klima_Vorgabe_XIX_Grundumfang_XIX_Klima.DE_HVEM_Leistung_Klima_Vorgabe, system-signal=HVEM_Leistung_Klima_Vorgabe
        communication-direction=IN, data-element=Grundumfang_XIX_Klima.Geltungsbereich_E3_1_1_UNECE_Gen2.RP_IF_HVEM_Nutzbare_Energie_XIX_Grundumfang_XIX_Klima.DE_HVEM_Nutzbare_Energie, system-signal=HVEM_Nutzbare_Energie
        communication-direction=IN, data-element=Grundumfang_XIX_Klima.Geltungsbereich_E3_1_1_UNECE_Gen2.RP_IF_HVH2_Err_Heizkreis_{1..3}_XIX_Grundumfang_XIX_Klima.DE_HVH2_Err_Heizkreis_{1..3}, system-signal=HVH2_Err_Heizkreis_{1..3}
        communication-direction=IN, data-element=Grundumfang_XIX_Klima.Geltungsbereich_E3_1_1_UNECE_Gen2.RP_IF_HVH2_Err_intern_XIX_Grundumfang_XIX_Klima.DE_HVH2_Err_intern, system-signal=HVH2_Err_intern
        communication-direction=IN, data-element=Grundumfang_XIX_Klima.Geltungsbereich_E3_1_1_UNECE_Gen2.RP_IF_HVH2_Err_Leckagestrom_XIX_Grundumfang_XIX_Klima.DE_HVH2_Err_Leckagestrom, system-signal=HVH2_Err_Leckagestrom
        communication-direction=IN, data-element=Grundumfang_XIX_Klima.Geltungsbereich_E3_1_1_UNECE_Gen2.RP_IF_HVH2_Err_Temperaturschutz_XIX_Grundumfang_XIX_Klima.DE_HVH2_Err_Temperaturschutz, system-signal=HVH2_Err_Temperaturschutz
        communication-direction=IN, data-element=Grundumfang_XIX_Klima.Geltungsbereich_E3_1_1_UNECE_Gen2.RP_IF_HVH2_Err_Ueberstromabschaltung_XIX_Grundumfang_XIX_Klima.DE_HVH2_Err_Ueberstromabschaltung, system-signal=HVH2_Err_Ueberstromabschaltung
        communication-direction=IN, data-element=Grundumfang_XIX_Klima.Geltungsbereich_E3_1_1_UNECE_Gen2.RP_IF_HVH2_Heizmedium_Sensor_1_XIX_Grundumfang_XIX_Klima.DE_HVH2_Heizmedium_Sensor_1, system-signal=HVH2_Heizmedium_Sensor_1
        communication-direction=IN, data-element=Grundumfang_XIX_Klima.Geltungsbereich_E3_1_1_UNECE_Gen2.RP_IF_HVH2_Heizmedium_Sensor_2_XIX_Grundumfang_XIX_Klima.DE_HVH2_Heizmedium_Sensor_2, system-signal=HVH2_Heizmedium_Sensor_2
        communication-direction=IN, data-element=Grundumfang_XIX_Klima.Geltungsbereich_E3_1_1_UNECE_Gen2.RP_IF_HVH2_High_Voltage_XIX_Grundumfang_XIX_Klima.DE_HVH2_High_Voltage, system-signal=HVH2_High_Voltage
        communication-direction=IN, data-element=Grundumfang_XIX_Klima.Geltungsbereich_E3_1_1_UNECE_Gen2.RP_IF_HVH2_HV_ERR_XIX_Grundumfang_XIX_Klima.DE_HVH2_HV_ERR, system-signal=HVH2_HV_ERR
        communication-direction=IN, data-element=Grundumfang_XIX_Klima.Geltungsbereich_E3_1_1_UNECE_Gen2.RP_IF_HVH2_I_ist_XIX_Grundumfang_XIX_Klima.DE_HVH2_I_ist, system-signal=HVH2_I_ist
        communication-direction=IN, data-element=Grundumfang_XIX_Klima.Geltungsbereich_E3_1_1_UNECE_Gen2.RP_IF_HVH2_ResponseError_XIX_Grundumfang_XIX_Klima.DE_HVH2_ResponseError, system-signal=HVH2_ResponseError
        communication-direction=IN, data-element=Grundumfang_XIX_Klima.Geltungsbereich_E3_1_1_UNECE_Gen2.RP_IF_HVH2_Status_HVH_XIX_Grundumfang_XIX_Klima.DE_HVH2_Status_HVH, system-signal=HVH2_Status_HVH
        communication-direction=IN, data-element=Grundumfang_XIX_Klima.Geltungsbereich_E3_1_1_UNECE_Gen2.RP_IF_HVH2_Status_UBatt_XIX_Grundumfang_XIX_Klima.DE_HVH2_Status_UBatt, system-signal=HVH2_Status_UBatt
        communication-direction=IN, data-element=Grundumfang_XIX_Klima.Geltungsbereich_E3_1_1_UNECE_Gen2.RP_IF_HVH2_Temp_PCB_XIX_Grundumfang_XIX_Klima.DE_HVH2_Temp_PCB, system-signal=HVH2_Temp_PCB
        communication-direction=IN, data-element=Grundumfang_XIX_Klima.Geltungsbereich_E3_1_1_UNECE_Gen2.RP_IF_HVH2_Timeout_Fehler_XIX_Grundumfang_XIX_Klima.DE_HVH2_Timeout_Fehler, system-signal=HVH2_Timeout_Fehler
        communication-direction=IN, data-element=Grundumfang_XIX_Klima.Geltungsbereich_E3_1_1_UNECE_Gen2.RP_IF_HVH2_UBatt_XIX_Grundumfang_XIX_Klima.DE_HVH2_UBatt, system-signal=HVH2_UBatt
        communication-direction=IN, data-element=Grundumfang_XIX_Klima.Geltungsbereich_E3_1_1_UNECE_Gen2.RP_IF_HVH_ErrMem_State_XIX_Grundumfang_XIX_Klima.DE_HVH_ErrMem_State, system-signal=HVH_ErrMem_State
        communication-direction=IN, data-element=Grundumfang_XIX_Klima.Geltungsbereich_E3_1_1_UNECE_Gen2.RP_IF_HVH_HV_Ilock_Status_XIX_Grundumfang_XIX_Klima.DE_HVH_HV_Ilock_Status, system-signal=HVH_HV_Ilock_Status
        communication-direction=IN, data-element=Grundumfang_XIX_Klima.Geltungsbereich_E3_1_1_UNECE_Gen2.RP_IF_HVH_HV_Voltage_XIX_Grundumfang_XIX_Klima.DE_HVH_HV_Voltage, system-signal=HVH_HV_Voltage
        communication-direction=IN, data-element=Grundumfang_XIX_Klima.Geltungsbereich_E3_1_1_UNECE_Gen2.RP_IF_HVH_HV_Voltage_Offset_XIX_Grundumfang_XIX_Klima.DE_HVH_HV_Voltage_Offset, system-signal=HVH_HV_Voltage_Offset
        communication-direction=IN, data-element=Grundumfang_XIX_Klima.Geltungsbereich_E3_1_1_UNECE_Gen2.RP_IF_HVH_HVb_Ilock_Status_XIX_Grundumfang_XIX_Klima.DE_HVH_HVb_Ilock_Status, system-signal=HVH_HVb_Ilock_Status
        communication-direction=IN, data-element=Grundumfang_XIX_Klima.Geltungsbereich_E3_1_1_UNECE_Gen2.RP_IF_HVH_HVb_Voltage_XIX_Grundumfang_XIX_Klima.DE_HVH_HVb_Voltage, system-signal=HVH_HVb_Voltage
        communication-direction=IN, data-element=Grundumfang_XIX_Klima.Geltungsbereich_E3_1_1_UNECE_Gen2.RP_IF_HVH_HVb_Voltage_Offset_XIX_Grundumfang_XIX_Klima.DE_HVH_HVb_Voltage_Offset, system-signal=HVH_HVb_Voltage_Offset
        communication-direction=IN, data-element=Grundumfang_XIX_Klima.Geltungsbereich_E3_1_1_UNECE_Gen2.RP_IF_HVH_ParameterChange_XIX_Grundumfang_XIX_Klima.DE_HVH_ParameterChange, system-signal=HVH_ParameterChange
        communication-direction=IN, data-element=Grundumfang_XIX_Klima.Geltungsbereich_E3_1_1_UNECE_Gen2.RP_IF_HVHb_ErrMem_State_XIX_Grundumfang_XIX_Klima.DE_HVHb_ErrMem_State, system-signal=HVHb_ErrMem_State
        communication-direction=IN, data-element=Grundumfang_XIX_Klima.Geltungsbereich_E3_1_1_UNECE_Gen2.RP_IF_HVHb_ParameterChange_XIX_Grundumfang_XIX_Klima.DE_HVHb_ParameterChange, system-signal=HVHb_ParameterChange
        communication-direction=IN, data-element=Grundumfang_XIX_Klima.Geltungsbereich_E3_1_1_UNECE_Gen2.RP_IF_HVK_AktiveEntladung_Anf_XIX_Grundumfang_XIX_Klima.DE_HVK_AktiveEntladung_Anf, system-signal=HVK_AktiveEntladung_Anf
        communication-direction=IN, data-element=Grundumfang_XIX_Klima.Geltungsbereich_E3_1_1_UNECE_Gen2.RP_IF_HVK_HV_Netz_Warnungen_XIX_Grundumfang_XIX_Klima.DE_HVK_HV_Netz_Warnungen, system-signal=HVK_HV_Netz_Warnungen
        communication-direction=IN, data-element=Grundumfang_XIX_Klima.Geltungsbereich_E3_1_1_UNECE_Gen2.RP_IF_HVK_Iso_Messung_Start_XIX_Grundumfang_XIX_Klima.DE_HVK_Iso_Messung_Start, system-signal=HVK_Iso_Messung_Start
        communication-direction=IN, data-element=Grundumfang_XIX_Klima.Geltungsbereich_E3_1_1_UNECE_Gen2.RP_IF_HVK_Notabschaltung_Anf_XIX_Grundumfang_XIX_Klima.DE_HVK_Notabschaltung_Anf, system-signal=HVK_Notabschaltung_Anf
        communication-direction=IN, data-element=Grundumfang_XIX_Klima.Geltungsbereich_E3_1_1_UNECE_Gen2.RP_IF_HVK_Vorladung_aktiv_XIX_Grundumfang_XIX_Klima.DE_HVK_Vorladung_aktiv, system-signal=HVK_Vorladung_aktiv
        communication-direction=IN, data-element=Grundumfang_XIX_Klima.Geltungsbereich_E3_1_1_UNECE_Gen2.RP_IF_HVLM_DCBoostLaden_Anf_XIX_Grundumfang_XIX_Klima.DE_HVLM_DCBoostLaden_Anf, system-signal=HVLM_DCBoostLaden_Anf
        communication-direction=IN, data-element=Grundumfang_XIX_Klima.Geltungsbereich_E3_1_1_UNECE_Gen2.RP_IF_IAA_Active_User_ID_XIX_Grundumfang_XIX_Klima.DE_IAA_Active_User_ID, system-signal=IAA_Active_User_ID
        communication-direction=IN, data-element=Grundumfang_XIX_Klima.Geltungsbereich_E3_1_1_UNECE_Gen2.RP_IF_IAA_Identified_User_ID_XIX_Grundumfang_XIX_Klima.DE_IAA_Identified_User_ID, system-signal=IAA_Identified_User_ID
        communication-direction=IN, data-element=Grundumfang_XIX_Klima.Geltungsbereich_E3_1_1_UNECE_Gen2.RP_IF_IAA_PSO_wake_up_XIX_Grundumfang_XIX_Klima.DE_IAA_PSO_wake_up, system-signal=IAA_PSO_wake_up
        communication-direction=IN, data-element=Grundumfang_XIX_Klima.Geltungsbereich_E3_1_1_UNECE_Gen2.RP_IF_ICO2_Alarm_XIX_Grundumfang_XIX_Klima.DE_ICO2_Alarm, system-signal=ICO2_Alarm
        communication-direction=IN, data-element=Grundumfang_XIX_Klima.Geltungsbereich_E3_1_1_UNECE_Gen2.RP_IF_ICO2_BZ_XIX_Grundumfang_XIX_Klima.DE_ICO2_BZ, system-signal=ICO2_BZ
        communication-direction=IN, data-element=Grundumfang_XIX_Klima.Geltungsbereich_E3_1_1_UNECE_Gen2.RP_IF_ICO2_CO2_Wert_XIX_Grundumfang_XIX_Klima.DE_ICO2_CO2_Wert, system-signal=ICO2_CO2_Wert
        communication-direction=IN, data-element=Grundumfang_XIX_Klima.Geltungsbereich_E3_1_1_UNECE_Gen2.RP_IF_ICO2_defekt_XIX_Grundumfang_XIX_Klima.DE_ICO2_defekt, system-signal=ICO2_defekt
        communication-direction=IN, data-element=Grundumfang_XIX_Klima.Geltungsbereich_E3_1_1_UNECE_Gen2.RP_IF_ICO2_Gradient_XIX_Grundumfang_XIX_Klima.DE_ICO2_Gradient, system-signal=ICO2_Gradient
        communication-direction=IN, data-element=Grundumfang_XIX_Klima.Geltungsbereich_E3_1_1_UNECE_Gen2.RP_IF_ICO2_Laufzeit_XIX_Grundumfang_XIX_Klima.DE_ICO2_Laufzeit, system-signal=ICO2_Laufzeit
        communication-direction=IN, data-element=Grundumfang_XIX_Klima.Geltungsbereich_E3_1_1_UNECE_Gen2.RP_IF_ICO2_Luftdruck_XIX_Grundumfang_XIX_Klima.DE_ICO2_Luftdruck, system-signal=ICO2_Luftdruck
        communication-direction=OUT, data-element=Grundumfang_XIX_Klima.Geltungsbereich_E3_1_1_UNECE_Gen2.SP_IF_ICO2_Luftdruck_2_XIX_Grundumfang_XIX_Klima.DE_ICO2_Luftdruck_2, system-signal=ICO2_Luftdruck_2
        communication-direction=OUT, data-element=Grundumfang_XIX_Klima.Geltungsbereich_E3_1_1_UNECE_Gen2.SP_IF_ICO2_Messvorgabe_XIX_Grundumfang_XIX_Klima.DE_ICO2_Messvorgabe, system-signal=ICO2_Messvorgabe
        communication-direction=OUT, data-element=Grundumfang_XIX_Klima.Geltungsbereich_E3_1_1_UNECE_Gen2.SP_IF_ICO2_Messzyklus1_XIX_Grundumfang_XIX_Klima.DE_ICO2_Messzyklus1, system-signal=ICO2_Messzyklus1
        communication-direction=OUT, data-element=Grundumfang_XIX_Klima.Geltungsbereich_E3_1_1_UNECE_Gen2.SP_IF_ICO2_Messzyklus2_XIX_Grundumfang_XIX_Klima.DE_ICO2_Messzyklus2, system-signal=ICO2_Messzyklus2
        communication-direction=IN, data-element=Grundumfang_XIX_Klima.Geltungsbereich_E3_1_1_UNECE_Gen2.RP_IF_ICO2_ResponseError_XIX_Grundumfang_XIX_Klima.DE_ICO2_ResponseError, system-signal=ICO2_ResponseError
        communication-direction=OUT, data-element=Grundumfang_XIX_Klima.Geltungsbereich_E3_1_1_UNECE_Gen2.SP_IF_ICO2_Status_Kabine_XIX_Grundumfang_XIX_Klima.DE_ICO2_Status_Kabine, system-signal=ICO2_Status_Kabine
        communication-direction=IN, data-element=Grundumfang_XIX_Klima.Geltungsbereich_E3_1_1_UNECE_Gen2.RP_IF_ICO2b_Alarm_XIX_Grundumfang_XIX_Klima.DE_ICO2b_Alarm, system-signal=ICO2b_Alarm
        communication-direction=IN, data-element=Grundumfang_XIX_Klima.Geltungsbereich_E3_1_1_UNECE_Gen2.RP_IF_ICO2b_BZ_XIX_Grundumfang_XIX_Klima.DE_ICO2b_BZ, system-signal=ICO2b_BZ
        communication-direction=IN, data-element=Grundumfang_XIX_Klima.Geltungsbereich_E3_1_1_UNECE_Gen2.RP_IF_ICO2b_CO2_Wert_XIX_Grundumfang_XIX_Klima.DE_ICO2b_CO2_Wert, system-signal=ICO2b_CO2_Wert
        communication-direction=IN, data-element=Grundumfang_XIX_Klima.Geltungsbereich_E3_1_1_UNECE_Gen2.RP_IF_ICO2b_defekt_XIX_Grundumfang_XIX_Klima.DE_ICO2b_defekt, system-signal=ICO2b_defekt
        communication-direction=IN, data-element=Grundumfang_XIX_Klima.Geltungsbereich_E3_1_1_UNECE_Gen2.RP_IF_ICO2b_Gradient_XIX_Grundumfang_XIX_Klima.DE_ICO2b_Gradient, system-signal=ICO2b_Gradient
        communication-direction=IN, data-element=Grundumfang_XIX_Klima.Geltungsbereich_E3_1_1_UNECE_Gen2.RP_IF_ICO2b_Laufzeit_XIX_Grundumfang_XIX_Klima.DE_ICO2b_Laufzeit, system-signal=ICO2b_Laufzeit
        communication-direction=IN, data-element=Grundumfang_XIX_Klima.Geltungsbereich_E3_1_1_UNECE_Gen2.RP_IF_ICO2b_Luftdruck_XIX_Grundumfang_XIX_Klima.DE_ICO2b_Luftdruck, system-signal=ICO2b_Luftdruck
        communication-direction=OUT, data-element=Grundumfang_XIX_Klima.Geltungsbereich_E3_1_1_UNECE_Gen2.SP_IF_ICO2b_Luftdruck_2_XIX_Grundumfang_XIX_Klima.DE_ICO2b_Luftdruck_2, system-signal=ICO2b_Luftdruck_2
        communication-direction=OUT, data-element=Grundumfang_XIX_Klima.Geltungsbereich_E3_1_1_UNECE_Gen2.SP_IF_ICO2b_Messvorgabe_XIX_Grundumfang_XIX_Klima.DE_ICO2b_Messvorgabe, system-signal=ICO2b_Messvorgabe
        communication-direction=OUT, data-element=Grundumfang_XIX_Klima.Geltungsbereich_E3_1_1_UNECE_Gen2.SP_IF_ICO2b_Messzyklus1_XIX_Grundumfang_XIX_Klima.DE_ICO2b_Messzyklus1, system-signal=ICO2b_Messzyklus1
        communication-direction=OUT, data-element=Grundumfang_XIX_Klima.Geltungsbereich_E3_1_1_UNECE_Gen2.SP_IF_ICO2b_Messzyklus2_XIX_Grundumfang_XIX_Klima.DE_ICO2b_Messzyklus2, system-signal=ICO2b_Messzyklus2
        communication-direction=IN, data-element=Grundumfang_XIX_Klima.Geltungsbereich_E3_1_1_UNECE_Gen2.RP_IF_ICO2b_ResponseError_XIX_Grundumfang_XIX_Klima.DE_ICO2b_ResponseError, system-signal=ICO2b_ResponseError
        communication-direction=OUT, data-element=Grundumfang_XIX_Klima.Geltungsbereich_E3_1_1_UNECE_Gen2.SP_IF_ICO2b_Status_Kabine_XIX_Grundumfang_XIX_Klima.DE_ICO2b_Status_Kabine, system-signal=ICO2b_Status_Kabine
        communication-direction=OUT, data-element=Grundumfang_XIX_Klima.Geltungsbereich_E3_1_1_UNECE_Gen2.SP_IF_ION_0e_Dummy_XIX_Grundumfang_XIX_Klima.DE_ION_0e_Dummy, system-signal=ION_0e_Dummy
        communication-direction=IN, data-element=Grundumfang_XIX_Klima.Geltungsbereich_E3_1_1_UNECE_Gen2.RP_IF_ION_0s_Dummy_XIX_Grundumfang_XIX_Klima.DE_ION_0s_Dummy, system-signal=ION_0s_Dummy
        communication-direction=IN, data-element=Grundumfang_XIX_Klima.Geltungsbereich_E3_1_1_UNECE_Gen2.RP_IF_ION_Adressegment_XIX_Grundumfang_XIX_Klima.DE_ION_Adressegment, system-signal=ION_Adressegment
        communication-direction=IN, data-element=Grundumfang_XIX_Klima.Geltungsbereich_E3_1_1_UNECE_Gen2.RP_IF_ION_Adressinhalt_XIX_Grundumfang_XIX_Klima.DE_ION_Adressinhalt, system-signal=ION_Adressinhalt
        communication-direction=IN, data-element=Grundumfang_XIX_Klima.Geltungsbereich_E3_1_1_UNECE_Gen2.RP_IF_ION_BZ_XIX_Grundumfang_XIX_Klima.DE_ION_BZ, system-signal=ION_BZ
        communication-direction=IN, data-element=Grundumfang_XIX_Klima.Geltungsbereich_E3_1_1_UNECE_Gen2.RP_IF_ION_Fehler_Emitter_XIX_Grundumfang_XIX_Klima.DE_ION_Fehler_Emitter, system-signal=ION_Fehler_Emitter
        communication-direction=IN, data-element=Grundumfang_XIX_Klima.Geltungsbereich_E3_1_1_UNECE_Gen2.RP_IF_ION_Fehler_Emitter_2_XIX_Grundumfang_XIX_Klima.DE_ION_Fehler_Emitter_2, system-signal=ION_Fehler_Emitter_2
        communication-direction=IN, data-element=Grundumfang_XIX_Klima.Geltungsbereich_E3_1_1_UNECE_Gen2.RP_IF_ION_Fehler_Intern_XIX_Grundumfang_XIX_Klima.DE_ION_Fehler_Intern, system-signal=ION_Fehler_Intern
        communication-direction=IN, data-element=Grundumfang_XIX_Klima.Geltungsbereich_E3_1_1_UNECE_Gen2.RP_IF_ION_Fehler_LED_XIX_Grundumfang_XIX_Klima.DE_ION_Fehler_LED, system-signal=ION_Fehler_LED
        communication-direction=IN, data-element=Grundumfang_XIX_Klima.Geltungsbereich_E3_1_1_UNECE_Gen2.RP_IF_ION_Fehler_Taster_XIX_Grundumfang_XIX_Klima.DE_ION_Fehler_Taster, system-signal=ION_Fehler_Taster
        communication-direction=IN, data-element=Grundumfang_XIX_Klima.Geltungsbereich_E3_1_1_UNECE_Gen2.RP_IF_ION_FehlerGueltigkeit_XIX_Grundumfang_XIX_Klima.DE_ION_FehlerGueltigkeit, system-signal=ION_FehlerGueltigkeit
        communication-direction=IN, data-element=Grundumfang_XIX_Klima.Geltungsbereich_E3_1_1_UNECE_Gen2.RP_IF_ION_HW_XIX_Grundumfang_XIX_Klima.DE_ION_HW, system-signal=ION_HW
        communication-direction=IN, data-element=Grundumfang_XIX_Klima.Geltungsbereich_E3_1_1_UNECE_Gen2.RP_IF_ION_ResponseError_XIX_Grundumfang_XIX_Klima.DE_ION_ResponseError, system-signal=ION_ResponseError
        communication-direction=IN, data-element=Grundumfang_XIX_Klima.Geltungsbereich_E3_1_1_UNECE_Gen2.RP_IF_ION_Status_XIX_Grundumfang_XIX_Klima.DE_ION_Status, system-signal=ION_Status
        communication-direction=IN, data-element=Grundumfang_XIX_Klima.Geltungsbereich_E3_1_1_UNECE_Gen2.RP_IF_ION_Status_LED_XIX_Grundumfang_XIX_Klima.DE_ION_Status_LED, system-signal=ION_Status_LED
        communication-direction=IN, data-element=Grundumfang_XIX_Klima.Geltungsbereich_E3_1_1_UNECE_Gen2.RP_IF_ION_Status_Taster_XIX_Grundumfang_XIX_Klima.DE_ION_Status_Taster, system-signal=ION_Status_Taster
        communication-direction=IN, data-element=Grundumfang_XIX_Klima.Geltungsbereich_E3_1_1_UNECE_Gen2.RP_IF_ION_SW_XIX_Grundumfang_XIX_Klima.DE_ION_SW, system-signal=ION_SW
        communication-direction=OUT, data-element=Grundumfang_XIX_Klima.Geltungsbereich_E3_1_1_UNECE_Gen2.SP_IF_ISOALLReqB{0..7}_XIX_Grundumfang_XIX_Klima.DE_ISOALLReqB{0..7}, system-signal=ISOALLReqB{0..7}
        communication-direction=IN, data-element=Grundumfang_XIX_Klima.Geltungsbereich_E3_1_1_UNECE_Gen2.RP_IF_KBF_defekt_XIX_Grundumfang_XIX_Klima.DE_KBF_defekt, system-signal=KBF_defekt
        communication-direction=IN, data-element=Grundumfang_XIX_Klima.Geltungsbereich_E3_1_1_UNECE_Gen2.RP_IF_KBF_Einheiten_XIX_Grundumfang_XIX_Klima.DE_KBF_Einheiten, system-signal=KBF_Einheiten
        communication-direction=IN, data-element=Grundumfang_XIX_Klima.Geltungsbereich_E3_1_1_UNECE_Gen2.RP_IF_KBF_ResponseError_XIX_Grundumfang_XIX_Klima.DE_KBF_ResponseError, system-signal=KBF_ResponseError
        communication-direction=IN, data-element=Grundumfang_XIX_Klima.Geltungsbereich_E3_1_1_UNECE_Gen2.RP_IF_KBF_SIH_Diag_XIX_Grundumfang_XIX_Klima.DE_KBF_SIH_Diag, system-signal=KBF_SIH_Diag
        communication-direction=IN, data-element=Grundumfang_XIX_Klima.Geltungsbereich_E3_1_1_UNECE_Gen2.RP_IF_KBF_SIH_hl_Status_XIX_Grundumfang_XIX_Klima.DE_KBF_SIH_hl_Status, system-signal=KBF_SIH_hl_Status
        communication-direction=IN, data-element=Grundumfang_XIX_Klima.Geltungsbereich_E3_1_1_UNECE_Gen2.RP_IF_KBF_SIH_hr_Status_XIX_Grundumfang_XIX_Klima.DE_KBF_SIH_hr_Status, system-signal=KBF_SIH_hr_Status
        communication-direction=IN, data-element=Grundumfang_XIX_Klima.Geltungsbereich_E3_1_1_UNECE_Gen2.RP_IF_KBF_Strom_SIH_hl_XIX_Grundumfang_XIX_Klima.DE_KBF_Strom_SIH_hl, system-signal=KBF_Strom_SIH_hl
        communication-direction=IN, data-element=Grundumfang_XIX_Klima.Geltungsbereich_E3_1_1_UNECE_Gen2.RP_IF_KBF_Strom_SIH_hr_XIX_Grundumfang_XIX_Klima.DE_KBF_Strom_SIH_hr, system-signal=KBF_Strom_SIH_hr
        communication-direction=IN, data-element=Grundumfang_XIX_Klima.Geltungsbereich_E3_1_1_UNECE_Gen2.RP_IF_KBF_Tasten_Fehler_XIX_Grundumfang_XIX_Klima.DE_KBF_Tasten_Fehler, system-signal=KBF_Tasten_Fehler
        communication-direction=IN, data-element=Grundumfang_XIX_Klima.Geltungsbereich_E3_1_1_UNECE_Gen2.RP_IF_KBF_Temp_Fuss_Fond_XIX_Grundumfang_XIX_Klima.DE_KBF_Temp_Fuss_Fond, system-signal=KBF_Temp_Fuss_Fond
        communication-direction=IN, data-element=Grundumfang_XIX_Klima.Geltungsbereich_E3_1_1_UNECE_Gen2.RP_IF_KBF_Temp_MA_Fond_XIX_Grundumfang_XIX_Klima.DE_KBF_Temp_MA_Fond, system-signal=KBF_Temp_MA_Fond
        communication-direction=IN, data-element=Grundumfang_XIX_Klima.Geltungsbereich_E3_1_1_UNECE_Gen2.RP_IF_KBF_Temp_SIH_hl_XIX_Grundumfang_XIX_Klima.DE_KBF_Temp_SIH_hl, system-signal=KBF_Temp_SIH_hl
        communication-direction=IN, data-element=Grundumfang_XIX_Klima.Geltungsbereich_E3_1_1_UNECE_Gen2.RP_IF_KBF_Temp_SIH_hr_XIX_Grundumfang_XIX_Klima.DE_KBF_Temp_SIH_hr, system-signal=KBF_Temp_SIH_hr
        communication-direction=IN, data-element=Grundumfang_XIX_Klima.Geltungsbereich_E3_1_1_UNECE_Gen2.RP_IF_KBI_Aussen_Temp_gef_XIX_Grundumfang_XIX_Klima.DE_KBI_Aussen_Temp_gef, system-signal=KBI_Aussen_Temp_gef
        communication-direction=IN, data-element=Grundumfang_XIX_Klima.Geltungsbereich_E3_1_1_UNECE_Gen2.RP_IF_KBI_Einheit_Temp_XIX_Grundumfang_XIX_Klima.DE_KBI_Einheit_Temp, system-signal=KBI_Einheit_Temp
        communication-direction=IN, data-element=Grundumfang_XIX_Klima.Geltungsbereich_E3_1_1_UNECE_Gen2.RP_IF_KBI_Kilometerstand_XIX_Grundumfang_XIX_Klima.DE_KBI_Kilometerstand, system-signal=KBI_Kilometerstand
        communication-direction=IN, data-element=Grundumfang_XIX_Klima.Geltungsbereich_E3_1_1_UNECE_Gen2.RP_IF_KBI_QBit_Aussen_Temp_gef_XIX_Grundumfang_XIX_Klima.DE_KBI_QBit_Aussen_Temp_gef, system-signal=KBI_QBit_Aussen_Temp_gef
        communication-direction=OUT, data-element=Grundumfang_XIX_Klima.Geltungsbereich_E3_1_1_UNECE_Gen2.SP_IF_KBT_CODE_VEHICLE_XIX_Grundumfang_XIX_Klima.DE_KBT_CODE_VEHICLE, system-signal=KBT_CODE_VEHICLE
        communication-direction=OUT, data-element=Grundumfang_XIX_Klima.Geltungsbereich_E3_1_1_UNECE_Gen2.SP_IF_KBT_Defrost_aktiv_XIX_Grundumfang_XIX_Klima.DE_KBT_Defrost_aktiv, system-signal=KBT_Defrost_aktiv
        communication-direction=OUT, data-element=Grundumfang_XIX_Klima.Geltungsbereich_E3_1_1_UNECE_Gen2.SP_IF_KBT_RAMP_XIX_Grundumfang_XIX_Klima.DE_KBT_RAMP, system-signal=KBT_RAMP
        communication-direction=OUT, data-element=Grundumfang_XIX_Klima.Geltungsbereich_E3_1_1_UNECE_Gen2.SP_IF_KBT_RX_FREQUENCY_XIX_Grundumfang_XIX_Klima.DE_KBT_RX_FREQUENCY, system-signal=KBT_RX_FREQUENCY
        communication-direction=OUT, data-element=Grundumfang_XIX_Klima.Geltungsbereich_E3_1_1_UNECE_Gen2.SP_IF_KBT_SAFETY_SPEED_XIX_Grundumfang_XIX_Klima.DE_KBT_SAFETY_SPEED, system-signal=KBT_SAFETY_SPEED
        communication-direction=OUT, data-element=Grundumfang_XIX_Klima.Geltungsbereich_E3_1_1_UNECE_Gen2.SP_IF_KBT_SPEED_XIX_Grundumfang_XIX_Klima.DE_KBT_SPEED, system-signal=KBT_SPEED
        communication-direction=OUT, data-element=Grundumfang_XIX_Klima.Geltungsbereich_E3_1_1_UNECE_Gen2.SP_IF_KL_AC_Schalter_XIX_Grundumfang_XIX_Klima.DE_KL_AC_Schalter, system-signal=KL_AC_Schalter
        communication-direction=OUT, data-element=Grundumfang_XIX_Klima.Geltungsbereich_E3_1_1_UNECE_Gen2.SP_IF_KL_ActiveDischarge_XIX_Grundumfang_XIX_Klima.DE_KL_ActiveDischarge, system-signal=KL_ActiveDischarge
        communication-direction=OUT, data-element=Grundumfang_XIX_Klima.Geltungsbereich_E3_1_1_UNECE_Gen2.SP_IF_KL_AirCleaner_aktiv_XIX_Grundumfang_XIX_Klima.DE_KL_AirCleaner_aktiv, system-signal=KL_AirCleaner_aktiv
        communication-direction=OUT, data-element=Grundumfang_XIX_Klima.Geltungsbereich_E3_1_1_UNECE_Gen2.SP_IF_KL_Ak_Verd_hi_li_XIX_Grundumfang_XIX_Klima.DE_KL_Ak_Verd_hi_li, system-signal=KL_Ak_Verd_hi_li
        communication-direction=OUT, data-element=Grundumfang_XIX_Klima.Geltungsbereich_E3_1_1_UNECE_Gen2.SP_IF_KL_Ak_Verd_hi_re_XIX_Grundumfang_XIX_Klima.DE_KL_Ak_Verd_hi_re, system-signal=KL_Ak_Verd_hi_re
        communication-direction=OUT, data-element=Grundumfang_XIX_Klima.Geltungsbereich_E3_1_1_UNECE_Gen2.SP_IF_KL_Ak_Verd_hinten_XIX_Grundumfang_XIX_Klima.DE_KL_Ak_Verd_hinten, system-signal=KL_Ak_Verd_hinten
        communication-direction=OUT, data-element=Grundumfang_XIX_Klima.Geltungsbereich_E3_1_1_UNECE_Gen2.SP_IF_KL_Ak_Verd_links_XIX_Grundumfang_XIX_Klima.DE_KL_Ak_Verd_links, system-signal=KL_Ak_Verd_links
        communication-direction=OUT, data-element=Grundumfang_XIX_Klima.Geltungsbereich_E3_1_1_UNECE_Gen2.SP_IF_KL_Ak_Verd_rechts_XIX_Grundumfang_XIX_Klima.DE_KL_Ak_Verd_rechts, system-signal=KL_Ak_Verd_rechts
        communication-direction=OUT, data-element=Grundumfang_XIX_Klima.Geltungsbereich_E3_1_1_UNECE_Gen2.SP_IF_KL_Ak_Verd_vo_li_XIX_Grundumfang_XIX_Klima.DE_KL_Ak_Verd_vo_li, system-signal=KL_Ak_Verd_vo_li
        communication-direction=OUT, data-element=Grundumfang_XIX_Klima.Geltungsbereich_E3_1_1_UNECE_Gen2.SP_IF_KL_Ak_Verd_vo_re_XIX_Grundumfang_XIX_Klima.DE_KL_Ak_Verd_vo_re, system-signal=KL_Ak_Verd_vo_re
        communication-direction=OUT, data-element=Grundumfang_XIX_Klima.Geltungsbereich_E3_1_1_UNECE_Gen2.SP_IF_KL_Ak_Verd_vorne_XIX_Grundumfang_XIX_Klima.DE_KL_Ak_Verd_vorne, system-signal=KL_Ak_Verd_vorne
        communication-direction=OUT, data-element=Grundumfang_XIX_Klima.Geltungsbereich_E3_1_1_UNECE_Gen2.SP_IF_KL_AL_HL_Anf_XIX_Grundumfang_XIX_Klima.DE_KL_AL_HL_Anf, system-signal=KL_AL_HL_Anf
        communication-direction=OUT, data-element=Grundumfang_XIX_Klima.Geltungsbereich_E3_1_1_UNECE_Gen2.SP_IF_KL_AL_HR_Anf_XIX_Grundumfang_XIX_Klima.DE_KL_AL_HR_Anf, system-signal=KL_AL_HR_Anf
        communication-direction=OUT, data-element=Grundumfang_XIX_Klima.Geltungsbereich_E3_1_1_UNECE_Gen2.SP_IF_KL_AL_VL_Anf_XIX_Grundumfang_XIX_Klima.DE_KL_AL_VL_Anf, system-signal=KL_AL_VL_Anf
        communication-direction=OUT, data-element=Grundumfang_XIX_Klima.Geltungsbereich_E3_1_1_UNECE_Gen2.SP_IF_KL_AL_VR_Anf_XIX_Grundumfang_XIX_Klima.DE_KL_AL_VR_Anf, system-signal=KL_AL_VR_Anf
        communication-direction=OUT, data-element=Grundumfang_XIX_Klima.Geltungsbereich_E3_1_1_UNECE_Gen2.SP_IF_KL_Anf_AussenspiegelHzg_XIX_Grundumfang_XIX_Klima.DE_KL_Anf_AussenspiegelHzg, system-signal=KL_Anf_AussenspiegelHzg
        communication-direction=OUT, data-element=Grundumfang_XIX_Klima.Geltungsbereich_E3_1_1_UNECE_Gen2.SP_IF_KL_Anf_KL_XIX_Grundumfang_XIX_Klima.DE_KL_Anf_KL, system-signal=KL_Anf_KL
        communication-direction=OUT, data-element=Grundumfang_XIX_Klima.Geltungsbereich_E3_1_1_UNECE_Gen2.SP_IF_KL_Anf_KV_XIX_Grundumfang_XIX_Klima.DE_KL_Anf_KV, system-signal=KL_Anf_KV
        communication-direction=OUT, data-element=Grundumfang_XIX_Klima.Geltungsbereich_E3_1_1_UNECE_Gen2.SP_IF_KL_Anf_rLM_XIX_Grundumfang_XIX_Klima.DE_KL_Anf_rLM, system-signal=KL_Anf_rLM
        communication-direction=OUT, data-element=Grundumfang_XIX_Klima.Geltungsbereich_E3_1_1_UNECE_Gen2.SP_IF_KL_Anz_auto_hl_XIX_Grundumfang_XIX_Klima.DE_KL_Anz_auto_hl, system-signal=KL_Anz_auto_hl
        communication-direction=OUT, data-element=Grundumfang_XIX_Klima.Geltungsbereich_E3_1_1_UNECE_Gen2.SP_IF_KL_Anz_Geblaese_hl_XIX_Grundumfang_XIX_Klima.DE_KL_Anz_Geblaese_hl, system-signal=KL_Anz_Geblaese_hl
        communication-direction=OUT, data-element=Grundumfang_XIX_Klima.Geltungsbereich_E3_1_1_UNECE_Gen2.SP_IF_KL_Anz_mitte_hl_XIX_Grundumfang_XIX_Klima.DE_KL_Anz_mitte_hl, system-signal=KL_Anz_mitte_hl
        communication-direction=OUT, data-element=Grundumfang_XIX_Klima.Geltungsbereich_E3_1_1_UNECE_Gen2.SP_IF_KL_Anz_oben_hl_XIX_Grundumfang_XIX_Klima.DE_KL_Anz_oben_hl, system-signal=KL_Anz_oben_hl
        communication-direction=OUT, data-element=Grundumfang_XIX_Klima.Geltungsbereich_E3_1_1_UNECE_Gen2.SP_IF_KL_Anz_seite_defog_hl_XIX_Grundumfang_XIX_Klima.DE_KL_Anz_seite_defog_hl, system-signal=KL_Anz_seite_defog_hl
        communication-direction=OUT, data-element=Grundumfang_XIX_Klima.Geltungsbereich_E3_1_1_UNECE_Gen2.SP_IF_KL_Anz_seite_hl_XIX_Grundumfang_XIX_Klima.DE_KL_Anz_seite_hl, system-signal=KL_Anz_seite_hl
        communication-direction=OUT, data-element=Grundumfang_XIX_Klima.Geltungsbereich_E3_1_1_UNECE_Gen2.SP_IF_KL_Anz_Temp_Einheit_XIX_Grundumfang_XIX_Klima.DE_KL_Anz_Temp_Einheit, system-signal=KL_Anz_Temp_Einheit
        communication-direction=OUT, data-element=Grundumfang_XIX_Klima.Geltungsbereich_E3_1_1_UNECE_Gen2.SP_IF_KL_Anz_Temp_hl_XIX_Grundumfang_XIX_Klima.DE_KL_Anz_Temp_hl, system-signal=KL_Anz_Temp_hl
        communication-direction=OUT, data-element=Grundumfang_XIX_Klima.Geltungsbereich_E3_1_1_UNECE_Gen2.SP_IF_KL_Anz_Temp_hr_XIX_Grundumfang_XIX_Klima.DE_KL_Anz_Temp_hr, system-signal=KL_Anz_Temp_hr
        communication-direction=OUT, data-element=Grundumfang_XIX_Klima.Geltungsbereich_E3_1_1_UNECE_Gen2.SP_IF_KL_Anz_unten_hl_XIX_Grundumfang_XIX_Klima.DE_KL_Anz_unten_hl, system-signal=KL_Anz_unten_hl
        communication-direction=OUT, data-element=Grundumfang_XIX_Klima.Geltungsbereich_E3_1_1_UNECE_Gen2.SP_IF_KL_AQI_Innenraum_XIX_Grundumfang_XIX_Klima.DE_KL_AQI_Innenraum, system-signal=KL_AQI_Innenraum
        communication-direction=OUT, data-element=Grundumfang_XIX_Klima.Geltungsbereich_E3_1_1_UNECE_Gen2.SP_IF_KL_Ausstattung_Klima_XIX_Grundumfang_XIX_Klima.DE_KL_Ausstattung_Klima, system-signal=KL_Ausstattung_Klima
        communication-direction=OUT, data-element=Grundumfang_XIX_Klima.Geltungsbereich_E3_1_1_UNECE_Gen2.SP_IF_KL_Batterieheizen_Freigabe_XIX_Grundumfang_XIX_Klima.DE_KL_Batterieheizen_Freigabe, system-signal=KL_Batterieheizen_Freigabe
        communication-direction=OUT, data-element=Grundumfang_XIX_Klima.Geltungsbereich_E3_1_1_UNECE_Gen2.SP_IF_KL_BattKond_WaPu_DZMax_XIX_Grundumfang_XIX_Klima.DE_KL_BattKond_WaPu_DZMax, system-signal=KL_BattKond_WaPu_DZMax
        communication-direction=OUT, data-element=Grundumfang_XIX_Klima.Geltungsbereich_E3_1_1_UNECE_Gen2.SP_IF_KL_BCmE_Livetip_Freigabe_XIX_Grundumfang_XIX_Klima.DE_KL_BCmE_Livetip_Freigabe, system-signal=KL_BCmE_Livetip_Freigabe
        communication-direction=OUT, data-element=Grundumfang_XIX_Klima.Geltungsbereich_E3_1_1_UNECE_Gen2.SP_IF_KL_Beschlagsgefahr_XIX_Grundumfang_XIX_Klima.DE_KL_Beschlagsgefahr, system-signal=KL_Beschlagsgefahr
        communication-direction=OUT, data-element=Grundumfang_XIX_Klima.Geltungsbereich_E3_1_1_UNECE_Gen2.SP_IF_KL_Charisma_FahrPr_XIX_Grundumfang_XIX_Klima.DE_KL_Charisma_FahrPr, system-signal=KL_Charisma_FahrPr
        communication-direction=OUT, data-element=Grundumfang_XIX_Klima.Geltungsbereich_E3_1_1_UNECE_Gen2.SP_IF_KL_Charisma_Status_XIX_Grundumfang_XIX_Klima.DE_KL_Charisma_Status, system-signal=KL_Charisma_Status
        communication-direction=OUT, data-element=Grundumfang_XIX_Klima.Geltungsbereich_E3_1_1_UNECE_Gen2.SP_IF_KL_Defrost_LED_XIX_Grundumfang_XIX_Klima.DE_KL_Defrost_LED, system-signal=KL_Defrost_LED
        communication-direction=OUT, data-element=Grundumfang_XIX_Klima.Geltungsbereich_E3_1_1_UNECE_Gen2.SP_IF_KL_Drehz_Anh_XIX_Grundumfang_XIX_Klima.DE_KL_Drehz_Anh, system-signal=KL_Drehz_Anh
        communication-direction=OUT, data-element=Grundumfang_XIX_Klima.Geltungsbereich_E3_1_1_UNECE_Gen2.SP_IF_KL_Einheiten_XIX_Grundumfang_XIX_Klima.DE_KL_Einheiten, system-signal=KL_Einheiten
        communication-direction=OUT, data-element=Grundumfang_XIX_Klima.Geltungsbereich_E3_1_1_UNECE_Gen2.SP_IF_KL_EKK_Strom_XIX_Grundumfang_XIX_Klima.DE_KL_EKK_Strom, system-signal=KL_EKK_Strom
        communication-direction=OUT, data-element=Grundumfang_XIX_Klima.Geltungsbereich_E3_1_1_UNECE_Gen2.SP_IF_KL_el_Zuheizer_Stufe_XIX_Grundumfang_XIX_Klima.DE_KL_el_Zuheizer_Stufe, system-signal=KL_el_Zuheizer_Stufe
        communication-direction=OUT, data-element=Grundumfang_XIX_Klima.Geltungsbereich_E3_1_1_UNECE_Gen2.SP_IF_KL_Enteisung_Anf_XIX_Grundumfang_XIX_Klima.DE_KL_Enteisung_Anf, system-signal=KL_Enteisung_Anf
        communication-direction=OUT, data-element=Grundumfang_XIX_Klima.Geltungsbereich_E3_1_1_UNECE_Gen2.SP_IF_KL_ErwVK_Anf_XIX_Grundumfang_XIX_Klima.DE_KL_ErwVK_Anf, system-signal=KL_ErwVK_Anf
        communication-direction=OUT, data-element=Grundumfang_XIX_Klima.Geltungsbereich_E3_1_1_UNECE_Gen2.SP_IF_KL_ErwVK_Beifahrerzone_XIX_Grundumfang_XIX_Klima.DE_KL_ErwVK_Beifahrerzone, system-signal=KL_ErwVK_Beifahrerzone
        communication-direction=OUT, data-element=Grundumfang_XIX_Klima.Geltungsbereich_E3_1_1_UNECE_Gen2.SP_IF_KL_ErwVK_Fahrerzone_XIX_Grundumfang_XIX_Klima.DE_KL_ErwVK_Fahrerzone, system-signal=KL_ErwVK_Fahrerzone
        communication-direction=OUT, data-element=Grundumfang_XIX_Klima.Geltungsbereich_E3_1_1_UNECE_Gen2.SP_IF_KL_ErwVK_Heckzone_links_XIX_Grundumfang_XIX_Klima.DE_KL_ErwVK_Heckzone_links, system-signal=KL_ErwVK_Heckzone_links
        communication-direction=OUT, data-element=Grundumfang_XIX_Klima.Geltungsbereich_E3_1_1_UNECE_Gen2.SP_IF_Kl_ErwVK_Heckzone_rechts_XIX_Grundumfang_XIX_Klima.DE_Kl_ErwVK_Heckzone_rechts, system-signal=Kl_ErwVK_Heckzone_rechts
        communication-direction=OUT, data-element=Grundumfang_XIX_Klima.Geltungsbereich_E3_1_1_UNECE_Gen2.SP_IF_KL_ErwVK_Scheibenheizung_XIX_Grundumfang_XIX_Klima.DE_KL_ErwVK_Scheibenheizung, system-signal=KL_ErwVK_Scheibenheizung
        communication-direction=OUT, data-element=Grundumfang_XIX_Klima.Geltungsbereich_E3_1_1_UNECE_Gen2.SP_IF_KL_ErwVK_Status_XIX_Grundumfang_XIX_Klima.DE_KL_ErwVK_Status, system-signal=KL_ErwVK_Status
        communication-direction=OUT, data-element=Grundumfang_XIX_Klima.Geltungsbereich_E3_1_1_UNECE_Gen2.SP_IF_KL_eTM_SollVolumenstrom_XIX_Grundumfang_XIX_Klima.DE_KL_eTM_SollVolumenstrom, system-signal=KL_eTM_SollVolumenstrom
        communication-direction=OUT, data-element=Grundumfang_XIX_Klima.Geltungsbereich_E3_1_1_UNECE_Gen2.SP_IF_KL_Fehler_HV_EKK_XIX_Grundumfang_XIX_Klima.DE_KL_Fehler_HV_EKK, system-signal=KL_Fehler_HV_EKK
        communication-direction=OUT, data-element=Grundumfang_XIX_Klima.Geltungsbereich_E3_1_1_UNECE_Gen2.SP_IF_KL_Fehler_HV_Heizer_XIX_Grundumfang_XIX_Klima.DE_KL_Fehler_HV_Heizer, system-signal=KL_Fehler_HV_Heizer
        communication-direction=OUT, data-element=Grundumfang_XIX_Klima.Geltungsbereich_E3_1_1_UNECE_Gen2.SP_IF_KL_Fehler_NTKreis_XIX_Grundumfang_XIX_Klima.DE_KL_Fehler_NTKreis, system-signal=KL_Fehler_NTKreis
        communication-direction=IN, data-element=Grundumfang_XIX_Klima.Geltungsbereich_E3_1_1_UNECE_Gen2.RP_IF_KL_Fond_Status_XIX_Grundumfang_XIX_Klima.DE_KL_Fond_Status, system-signal=KL_Fond_Status
        communication-direction=OUT, data-element=Grundumfang_XIX_Klima.Geltungsbereich_E3_1_1_UNECE_Gen2.SP_IF_KL_Fondbedienung_aktiv_XIX_Grundumfang_XIX_Klima.DE_KL_Fondbedienung_aktiv, system-signal=KL_Fondbedienung_aktiv
        communication-direction=OUT, data-element=Grundumfang_XIX_Klima.Geltungsbereich_E3_1_1_UNECE_Gen2.SP_IF_KL_Freilauf_Info_XIX_Grundumfang_XIX_Klima.DE_KL_Freilauf_Info, system-signal=KL_Freilauf_Info
        communication-direction=OUT, data-element=Grundumfang_XIX_Klima.Geltungsbereich_E3_1_1_UNECE_Gen2.SP_IF_KL_FSH_Automatikbetrieb_XIX_Grundumfang_XIX_Klima.DE_KL_FSH_Automatikbetrieb, system-signal=KL_FSH_Automatikbetrieb
        communication-direction=OUT, data-element=Grundumfang_XIX_Klima.Geltungsbereich_E3_1_1_UNECE_Gen2.SP_IF_KL_FSH_LED_XIX_Grundumfang_XIX_Klima.DE_KL_FSH_LED, system-signal=KL_FSH_LED
        communication-direction=OUT, data-element=Grundumfang_XIX_Klima.Geltungsbereich_E3_1_1_UNECE_Gen2.SP_IF_KL_FSH_Soll_XIX_Grundumfang_XIX_Klima.DE_KL_FSH_Soll, system-signal=KL_FSH_Soll
        communication-direction=OUT, data-element=Grundumfang_XIX_Klima.Geltungsbereich_E3_1_1_UNECE_Gen2.SP_IF_KL_Geblaese_Fond_Status_XIX_Grundumfang_XIX_Klima.DE_KL_Geblaese_Fond_Status, system-signal=KL_Geblaese_Fond_Status
        communication-direction=OUT, data-element=Grundumfang_XIX_Klima.Geltungsbereich_E3_1_1_UNECE_Gen2.SP_IF_KL_Geblaese_Status_XIX_Grundumfang_XIX_Klima.DE_KL_Geblaese_Status, system-signal=KL_Geblaese_Status
        communication-direction=OUT, data-element=Grundumfang_XIX_Klima.Geltungsbereich_E3_1_1_UNECE_Gen2.SP_IF_KL_Geblspng_Fond_Soll_XIX_Grundumfang_XIX_Klima.DE_KL_Geblspng_Fond_Soll, system-signal=KL_Geblspng_Fond_Soll
        communication-direction=OUT, data-element=Grundumfang_XIX_Klima.Geltungsbereich_E3_1_1_UNECE_Gen2.SP_IF_KL_Geblspng_Soll_XIX_Grundumfang_XIX_Klima.DE_KL_Geblspng_Soll, system-signal=KL_Geblspng_Soll
        communication-direction=OUT, data-element=Grundumfang_XIX_Klima.Geltungsbereich_E3_1_1_UNECE_Gen2.SP_IF_KL_HBT_Geblaesestufe_anzeigen_XIX_Grundumfang_XIX_Klima.DE_KL_HBT_Geblaesestufe_anzeigen, system-signal=KL_HBT_Geblaesestufe_anzeigen
        communication-direction=OUT, data-element=Grundumfang_XIX_Klima.Geltungsbereich_E3_1_1_UNECE_Gen2.SP_IF_KL_HBT_Verbausituation_XIX_Grundumfang_XIX_Klima.DE_KL_HBT_Verbausituation, system-signal=KL_HBT_Verbausituation
        communication-direction=OUT, data-element=Grundumfang_XIX_Klima.Geltungsbereich_E3_1_1_UNECE_Gen2.SP_IF_KL_Heizbedarf_XIX_Grundumfang_XIX_Klima.DE_KL_Heizbedarf, system-signal=KL_Heizbedarf
        communication-direction=OUT, data-element=Grundumfang_XIX_Klima.Geltungsbereich_E3_1_1_UNECE_Gen2.SP_IF_KL_Heizbedarf_Anf_XIX_Grundumfang_XIX_Klima.DE_KL_Heizbedarf_Anf, system-signal=KL_Heizbedarf_Anf
        communication-direction=OUT, data-element=Grundumfang_XIX_Klima.Geltungsbereich_E3_1_1_UNECE_Gen2.SP_IF_KL_Heizen_Status_XIX_Grundumfang_XIX_Klima.DE_KL_Heizen_Status, system-signal=KL_Heizen_Status
        communication-direction=OUT, data-element=Grundumfang_XIX_Klima.Geltungsbereich_E3_1_1_UNECE_Gen2.SP_IF_KL_Heizkreisventilstellung_XIX_Grundumfang_XIX_Klima.DE_KL_Heizkreisventilstellung, system-signal=KL_Heizkreisventilstellung
        communication-direction=OUT, data-element=Grundumfang_XIX_Klima.Geltungsbereich_E3_1_1_UNECE_Gen2.SP_IF_KL_Heizstufe_LSH_XIX_Grundumfang_XIX_Klima.DE_KL_Heizstufe_LSH, system-signal=KL_Heizstufe_LSH
        communication-direction=OUT, data-element=Grundumfang_XIX_Klima.Geltungsbereich_E3_1_1_UNECE_Gen2.SP_IF_KL_Hinweis_Kuehlmodus_XIX_Grundumfang_XIX_Klima.DE_KL_Hinweis_Kuehlmodus, system-signal=KL_Hinweis_Kuehlmodus
        communication-direction=OUT, data-element=Grundumfang_XIX_Klima.Geltungsbereich_E3_1_1_UNECE_Gen2.SP_IF_KL_HSH_LED_XIX_Grundumfang_XIX_Klima.DE_KL_HSH_LED, system-signal=KL_HSH_LED
        communication-direction=OUT, data-element=Grundumfang_XIX_Klima.Geltungsbereich_E3_1_1_UNECE_Gen2.SP_IF_KL_HSH_Soll_XIX_Grundumfang_XIX_Klima.DE_KL_HSH_Soll, system-signal=KL_HSH_Soll
        communication-direction=OUT, data-element=Grundumfang_XIX_Klima.Geltungsbereich_E3_1_1_UNECE_Gen2.SP_IF_KL_HUP_aktiv_XIX_Grundumfang_XIX_Klima.DE_KL_HUP_aktiv, system-signal=KL_HUP_aktiv
        communication-direction=OUT, data-element=Grundumfang_XIX_Klima.Geltungsbereich_E3_1_1_UNECE_Gen2.SP_IF_KL_HV_Energie_Anf_XIX_Grundumfang_XIX_Klima.DE_KL_HV_Energie_Anf, system-signal=KL_HV_Energie_Anf
        communication-direction=OUT, data-element=Grundumfang_XIX_Klima.Geltungsbereich_E3_1_1_UNECE_Gen2.SP_IF_KL_HV_H6_aktive_Entladung_XIX_Grundumfang_XIX_Klima.DE_KL_HV_H6_aktive_Entladung, system-signal=KL_HV_H6_aktive_Entladung
        communication-direction=OUT, data-element=Grundumfang_XIX_Klima.Geltungsbereich_E3_1_1_UNECE_Gen2.SP_IF_KL_HV_H6_Durchflussrichtung_XIX_Grundumfang_XIX_Klima.DE_KL_HV_H6_Durchflussrichtung, system-signal=KL_HV_H6_Durchflussrichtung
        communication-direction=OUT, data-element=Grundumfang_XIX_Klima.Geltungsbereich_E3_1_1_UNECE_Gen2.SP_IF_KL_HV_H6_ein_XIX_Grundumfang_XIX_Klima.DE_KL_HV_H6_ein, system-signal=KL_HV_H6_ein
        communication-direction=OUT, data-element=Grundumfang_XIX_Klima.Geltungsbereich_E3_1_1_UNECE_Gen2.SP_IF_KL_HV_H6_soll_XIX_Grundumfang_XIX_Klima.DE_KL_HV_H6_soll, system-signal=KL_HV_H6_soll
        communication-direction=OUT, data-element=Grundumfang_XIX_Klima.Geltungsbereich_E3_1_1_UNECE_Gen2.SP_IF_KL_HV_Hb_ein_XIX_Grundumfang_XIX_Klima.DE_KL_HV_Hb_ein, system-signal=KL_HV_Hb_ein
        communication-direction=OUT, data-element=Grundumfang_XIX_Klima.Geltungsbereich_E3_1_1_UNECE_Gen2.SP_IF_KL_HV_Hb_soll_XIX_Grundumfang_XIX_Klima.DE_KL_HV_Hb_soll, system-signal=KL_HV_Hb_soll
        communication-direction=OUT, data-element=Grundumfang_XIX_Klima.Geltungsbereich_E3_1_1_UNECE_Gen2.SP_IF_KL_HV_Heizer_Strom_XIX_Grundumfang_XIX_Klima.DE_KL_HV_Heizer_Strom, system-signal=KL_HV_Heizer_Strom
        communication-direction=OUT, data-element=Grundumfang_XIX_Klima.Geltungsbereich_E3_1_1_UNECE_Gen2.SP_IF_KL_HV_PTC_ein_XIX_Grundumfang_XIX_Klima.DE_KL_HV_PTC_ein, system-signal=KL_HV_PTC_ein
        communication-direction=OUT, data-element=Grundumfang_XIX_Klima.Geltungsbereich_E3_1_1_UNECE_Gen2.SP_IF_KL_HV_PTC_soll_XIX_Grundumfang_XIX_Klima.DE_KL_HV_PTC_soll, system-signal=KL_HV_PTC_soll
        communication-direction=OUT, data-element=Grundumfang_XIX_Klima.Geltungsbereich_E3_1_1_UNECE_Gen2.SP_IF_KL_HVH_1_VerbautStatus_XIX_Grundumfang_XIX_Klima.DE_KL_HVH_1_VerbautStatus, system-signal=KL_HVH_1_VerbautStatus
        communication-direction=OUT, data-element=Grundumfang_XIX_Klima.Geltungsbereich_E3_1_1_UNECE_Gen2.SP_IF_KL_HVH_2_Status_Spgfreiheit_XIX_Grundumfang_XIX_Klima.DE_KL_HVH_2_Status_Spgfreiheit, system-signal=KL_HVH_2_Status_Spgfreiheit
        communication-direction=OUT, data-element=Grundumfang_XIX_Klima.Geltungsbereich_E3_1_1_UNECE_Gen2.SP_IF_KL_HVH_2_VerbautStatus_XIX_Grundumfang_XIX_Klima.DE_KL_HVH_2_VerbautStatus, system-signal=KL_HVH_2_VerbautStatus
        communication-direction=OUT, data-element=Grundumfang_XIX_Klima.Geltungsbereich_E3_1_1_UNECE_Gen2.SP_IF_KL_HVH_3_VerbautStatus_XIX_Grundumfang_XIX_Klima.DE_KL_HVH_3_VerbautStatus, system-signal=KL_HVH_3_VerbautStatus
        communication-direction=OUT, data-element=Grundumfang_XIX_Klima.Geltungsbereich_E3_1_1_UNECE_Gen2.SP_IF_KL_HVHeizer2_ein_XIX_Grundumfang_XIX_Klima.DE_KL_HVHeizer2_ein, system-signal=KL_HVHeizer2_ein
        communication-direction=OUT, data-element=Grundumfang_XIX_Klima.Geltungsbereich_E3_1_1_UNECE_Gen2.SP_IF_KL_HVHeizer2_soll_XIX_Grundumfang_XIX_Klima.DE_KL_HVHeizer2_soll, system-signal=KL_HVHeizer2_soll
        communication-direction=OUT, data-element=Grundumfang_XIX_Klima.Geltungsbereich_E3_1_1_UNECE_Gen2.SP_IF_KL_HWT_Sollvolumenstrom_XIX_Grundumfang_XIX_Klima.DE_KL_HWT_Sollvolumenstrom, system-signal=KL_HWT_Sollvolumenstrom
        communication-direction=OUT, data-element=Grundumfang_XIX_Klima.Geltungsbereich_E3_1_1_UNECE_Gen2.SP_IF_KL_I_Geblaese_XIX_Grundumfang_XIX_Klima.DE_KL_I_Geblaese, system-signal=KL_I_Geblaese
        communication-direction=OUT, data-element=Grundumfang_XIX_Klima.Geltungsbereich_E3_1_1_UNECE_Gen2.SP_IF_KL_I_Geblaese_Fond_XIX_Grundumfang_XIX_Klima.DE_KL_I_Geblaese_Fond, system-signal=KL_I_Geblaese_Fond
        communication-direction=OUT, data-element=Grundumfang_XIX_Klima.Geltungsbereich_E3_1_1_UNECE_Gen2.SP_IF_KL_Innen_Temp_XIX_Grundumfang_XIX_Klima.DE_KL_Innen_Temp, system-signal=KL_Innen_Temp
        communication-direction=OUT, data-element=Grundumfang_XIX_Klima.Geltungsbereich_E3_1_1_UNECE_Gen2.SP_IF_KL_Innentemp_KBT_Sensor_XIX_Grundumfang_XIX_Klima.DE_KL_Innentemp_KBT_Sensor, system-signal=KL_Innentemp_KBT_Sensor
        communication-direction=OUT, data-element=Grundumfang_XIX_Klima.Geltungsbereich_E3_1_1_UNECE_Gen2.SP_IF_KL_Ionisator_XIX_Grundumfang_XIX_Klima.DE_KL_Ionisator, system-signal=KL_Ionisator
        communication-direction=OUT, data-element=Grundumfang_XIX_Klima.Geltungsbereich_E3_1_1_UNECE_Gen2.SP_IF_KL_IstLeistung_XIX_Grundumfang_XIX_Klima.DE_KL_IstLeistung, system-signal=KL_IstLeistung
        communication-direction=OUT, data-element=Grundumfang_XIX_Klima.Geltungsbereich_E3_1_1_UNECE_Gen2.SP_IF_KL_K_Status_XIX_Grundumfang_XIX_Klima.DE_KL_K_Status, system-signal=KL_K_Status
        communication-direction=OUT, data-element=Grundumfang_XIX_Klima.Geltungsbereich_E3_1_1_UNECE_Gen2.SP_IF_KL_KBF_Sync_XIX_Grundumfang_XIX_Klima.DE_KL_KBF_Sync, system-signal=KL_KBF_Sync
        communication-direction=OUT, data-element=Grundumfang_XIX_Klima.Geltungsbereich_E3_1_1_UNECE_Gen2.SP_IF_KL_KD_Fehler_XIX_Grundumfang_XIX_Klima.DE_KL_KD_Fehler, system-signal=KL_KD_Fehler
        communication-direction=OUT, data-element=Grundumfang_XIX_Klima.Geltungsbereich_E3_1_1_UNECE_Gen2.SP_IF_KL_Kennlinie_XIX_Grundumfang_XIX_Klima.DE_KL_Kennlinie, system-signal=KL_Kennlinie
        communication-direction=OUT, data-element=Grundumfang_XIX_Klima.Geltungsbereich_E3_1_1_UNECE_Gen2.SP_IF_KL_Klappe_Status_XIX_Grundumfang_XIX_Klima.DE_KL_Klappe_Status, system-signal=KL_Klappe_Status
        communication-direction=OUT, data-element=Grundumfang_XIX_Klima.Geltungsbereich_E3_1_1_UNECE_Gen2.SP_IF_KL_KLE_Fehler_Anf_XIX_Grundumfang_XIX_Klima.DE_KL_KLE_Fehler_Anf, system-signal=KL_KLE_Fehler_Anf
        communication-direction=OUT, data-element=Grundumfang_XIX_Klima.Geltungsbereich_E3_1_1_UNECE_Gen2.SP_IF_KL_KLh_aus_XIX_Grundumfang_XIX_Klima.DE_KL_KLh_aus, system-signal=KL_KLh_aus
        communication-direction=OUT, data-element=Grundumfang_XIX_Klima.Geltungsbereich_E3_1_1_UNECE_Gen2.SP_IF_KL_KLh_LastMode_XIX_Grundumfang_XIX_Klima.DE_KL_KLh_LastMode, system-signal=KL_KLh_LastMode
        communication-direction=OUT, data-element=Grundumfang_XIX_Klima.Geltungsbereich_E3_1_1_UNECE_Gen2.SP_IF_KL_KLh_lock_XIX_Grundumfang_XIX_Klima.DE_KL_KLh_lock, system-signal=KL_KLh_lock
        communication-direction=OUT, data-element=Grundumfang_XIX_Klima.Geltungsbereich_E3_1_1_UNECE_Gen2.SP_IF_Kl_Klima_Aktiv_XIX_Grundumfang_XIX_Klima.DE_Kl_Klima_Aktiv, system-signal=Kl_Klima_Aktiv
        communication-direction=OUT, data-element=Grundumfang_XIX_Klima.Geltungsbereich_E3_1_1_UNECE_Gen2.SP_IF_KL_Klimastandzeit_XIX_Grundumfang_XIX_Klima.DE_KL_Klimastandzeit, system-signal=KL_Klimastandzeit
        communication-direction=OUT, data-element=Grundumfang_XIX_Klima.Geltungsbereich_E3_1_1_UNECE_Gen2.SP_IF_KL_KM_ASV_01_Status_XIX_Grundumfang_XIX_Klima.DE_KL_KM_ASV_01_Status, system-signal=KL_KM_ASV_01_Status
        communication-direction=OUT, data-element=Grundumfang_XIX_Klima.Geltungsbereich_E3_1_1_UNECE_Gen2.SP_IF_KL_KM_ASV_02_Status_XIX_Grundumfang_XIX_Klima.DE_KL_KM_ASV_02_Status, system-signal=KL_KM_ASV_02_Status
        communication-direction=OUT, data-element=Grundumfang_XIX_Klima.Geltungsbereich_E3_1_1_UNECE_Gen2.SP_IF_KL_Komp_Moment_alt_XIX_Grundumfang_XIX_Klima.DE_KL_Komp_Moment_alt, system-signal=KL_Komp_Moment_alt
        communication-direction=OUT, data-element=Grundumfang_XIX_Klima.Geltungsbereich_E3_1_1_UNECE_Gen2.SP_IF_KL_Kompressorstrom_soll_XIX_Grundumfang_XIX_Klima.DE_KL_Kompressorstrom_soll, system-signal=KL_Kompressorstrom_soll
        communication-direction=OUT, data-element=Grundumfang_XIX_Klima.Geltungsbereich_E3_1_1_UNECE_Gen2.SP_IF_KL_Kuehlungs_Status_XIX_Grundumfang_XIX_Klima.DE_KL_Kuehlungs_Status, system-signal=KL_Kuehlungs_Status
        communication-direction=OUT, data-element=Grundumfang_XIX_Klima.Geltungsbereich_E3_1_1_UNECE_Gen2.SP_IF_KL_Kundenwunsch_Kuehlen_XIX_Grundumfang_XIX_Klima.DE_KL_Kundenwunsch_Kuehlen, system-signal=KL_Kundenwunsch_Kuehlen
        communication-direction=OUT, data-element=Grundumfang_XIX_Klima.Geltungsbereich_E3_1_1_UNECE_Gen2.SP_IF_KL_Last_Kompr_XIX_Grundumfang_XIX_Klima.DE_KL_Last_Kompr, system-signal=KL_Last_Kompr
        communication-direction=OUT, data-element=Grundumfang_XIX_Klima.Geltungsbereich_E3_1_1_UNECE_Gen2.SP_IF_KL_Leistung_BattHeizung_XIX_Grundumfang_XIX_Klima.DE_KL_Leistung_BattHeizung, system-signal=KL_Leistung_BattHeizung
        communication-direction=OUT, data-element=Grundumfang_XIX_Klima.Geltungsbereich_E3_1_1_UNECE_Gen2.SP_IF_KL_Leistung_Klima_Anf_XIX_Grundumfang_XIX_Klima.DE_KL_Leistung_Klima_Anf, system-signal=KL_Leistung_Klima_Anf
        communication-direction=OUT, data-element=Grundumfang_XIX_Klima.Geltungsbereich_E3_1_1_UNECE_Gen2.SP_IF_KL_LRH_FoD_Status_XIX_Grundumfang_XIX_Klima.DE_KL_LRH_FoD_Status, system-signal=KL_LRH_FoD_Status
        communication-direction=OUT, data-element=SC_447_FoD_Slave_8_XIX_Softwareblock_XIX_Klima.Geltungsbereich_E3_1_1_UNECE_Gen2.SP_IF_KL_LRH_FoD_Status_XIX_SC_447_FoD_Slave_8_XIX_Softwareblock_XIX_Klima.DE_KL_LRH_FoD_Status, system-signal=KL_LRH_FoD_Status
        communication-direction=OUT, data-element=Grundumfang_XIX_Klima.Geltungsbereich_E3_1_1_UNECE_Gen2.SP_IF_KL_LRH_PWM_XIX_Grundumfang_XIX_Klima.DE_KL_LRH_PWM, system-signal=KL_LRH_PWM
        communication-direction=OUT, data-element=Grundumfang_XIX_Klima.Geltungsbereich_E3_1_1_UNECE_Gen2.SP_IF_KL_LRH_Soll_XIX_Grundumfang_XIX_Klima.DE_KL_LRH_Soll, system-signal=KL_LRH_Soll
        communication-direction=OUT, data-element=Grundumfang_XIX_Klima.Geltungsbereich_E3_1_1_UNECE_Gen2.SP_IF_KL_LRH_Stufe_XIX_Grundumfang_XIX_Klima.DE_KL_LRH_Stufe, system-signal=KL_LRH_Stufe
        communication-direction=OUT, data-element=Grundumfang_XIX_Klima.Geltungsbereich_E3_1_1_UNECE_Gen2.SP_IF_KL_LRH_Taster_XIX_Grundumfang_XIX_Klima.DE_KL_LRH_Taster, system-signal=KL_LRH_Taster
        communication-direction=OUT, data-element=Grundumfang_XIX_Klima.Geltungsbereich_E3_1_1_UNECE_Gen2.SP_IF_KL_LSH_Ansteuerung_XIX_Grundumfang_XIX_Klima.DE_KL_LSH_Ansteuerung, system-signal=KL_LSH_Ansteuerung
        communication-direction=OUT, data-element=Grundumfang_XIX_Klima.Geltungsbereich_E3_1_1_UNECE_Gen2.SP_IF_KL_LSH_Betriebsdauer_XIX_Grundumfang_XIX_Klima.DE_KL_LSH_Betriebsdauer, system-signal=KL_LSH_Betriebsdauer
        communication-direction=OUT, data-element=Grundumfang_XIX_Klima.Geltungsbereich_E3_1_1_UNECE_Gen2.SP_IF_KL_LSH_DBetr_Bestaet_XIX_Grundumfang_XIX_Klima.DE_KL_LSH_DBetr_Bestaet, system-signal=KL_LSH_DBetr_Bestaet
        communication-direction=OUT, data-element=Grundumfang_XIX_Klima.Geltungsbereich_E3_1_1_UNECE_Gen2.SP_IF_KL_LSH_DBetr_Ein_XIX_Grundumfang_XIX_Klima.DE_KL_LSH_DBetr_Ein, system-signal=KL_LSH_DBetr_Ein
        communication-direction=OUT, data-element=Grundumfang_XIX_Klima.Geltungsbereich_E3_1_1_UNECE_Gen2.SP_IF_KL_Magnetventil_XIX_Grundumfang_XIX_Klima.DE_KL_Magnetventil, system-signal=KL_Magnetventil
        communication-direction=OUT, data-element=Grundumfang_XIX_Klima.Geltungsbereich_E3_1_1_UNECE_Gen2.SP_IF_KL_Meldung_Status_XIX_Grundumfang_XIX_Klima.DE_KL_Meldung_Status, system-signal=KL_Meldung_Status
        communication-direction=OUT, data-element=Grundumfang_XIX_Klima.Geltungsbereich_E3_1_1_UNECE_Gen2.SP_IF_Kl_Meldung_Status2_XIX_Grundumfang_XIX_Klima.DE_Kl_Meldung_Status2, system-signal=Kl_Meldung_Status2
        communication-direction=OUT, data-element=Grundumfang_XIX_Klima.Geltungsbereich_E3_1_1_UNECE_Gen2.SP_IF_KL_nachtr_Stopp_Anf_XIX_Grundumfang_XIX_Klima.DE_KL_nachtr_Stopp_Anf, system-signal=KL_nachtr_Stopp_Anf
        communication-direction=OUT, data-element=Grundumfang_XIX_Klima.Geltungsbereich_E3_1_1_UNECE_Gen2.SP_IF_KL_OBD_Status_XIX_Grundumfang_XIX_Klima.DE_KL_OBD_Status, system-signal=KL_OBD_Status
        communication-direction=OUT, data-element=Grundumfang_XIX_Klima.Geltungsbereich_E3_1_1_UNECE_Gen2.SP_IF_KL_OBD_Status_Auth_XIX_Grundumfang_XIX_Klima.DE_KL_OBD_Status_Auth, system-signal=KL_OBD_Status_Auth
        communication-direction=OUT, data-element=Grundumfang_XIX_Klima.Geltungsbereich_E3_1_1_UNECE_Gen2.SP_IF_KL_PTC_ein_XIX_Grundumfang_XIX_Klima.DE_KL_PTC_ein, system-signal=KL_PTC_ein
        communication-direction=OUT, data-element=Grundumfang_XIX_Klima.Geltungsbereich_E3_1_1_UNECE_Gen2.SP_IF_KL_PTC_Rampe_XIX_Grundumfang_XIX_Klima.DE_KL_PTC_Rampe, system-signal=KL_PTC_Rampe
        communication-direction=OUT, data-element=Grundumfang_XIX_Klima.Geltungsbereich_E3_1_1_UNECE_Gen2.SP_IF_KL_PTC_soll_XIX_Grundumfang_XIX_Klima.DE_KL_PTC_soll, system-signal=KL_PTC_soll
        communication-direction=OUT, data-element=Grundumfang_XIX_Klima.Geltungsbereich_E3_1_1_UNECE_Gen2.SP_IF_KL_PTC_Verbauinfo_XIX_Grundumfang_XIX_Klima.DE_KL_PTC_Verbauinfo, system-signal=KL_PTC_Verbauinfo
        communication-direction=OUT, data-element=Grundumfang_XIX_Klima.Geltungsbereich_E3_1_1_UNECE_Gen2.SP_IF_KL_Pumpe_02_Soll_XIX_Grundumfang_XIX_Klima.DE_KL_Pumpe_02_Soll, system-signal=KL_Pumpe_02_Soll
        communication-direction=OUT, data-element=Grundumfang_XIX_Klima.Geltungsbereich_E3_1_1_UNECE_Gen2.SP_IF_KL_Reheat_Innenraum_XIX_Grundumfang_XIX_Klima.DE_KL_Reheat_Innenraum, system-signal=KL_Reheat_Innenraum
        communication-direction=OUT, data-element=Grundumfang_XIX_Klima.Geltungsbereich_E3_1_1_UNECE_Gen2.SP_IF_KL_Restwaerme_aktiv_XIX_Grundumfang_XIX_Klima.DE_KL_Restwaerme_aktiv, system-signal=KL_Restwaerme_aktiv
        communication-direction=OUT, data-element=Grundumfang_XIX_Klima.Geltungsbereich_E3_1_1_UNECE_Gen2.SP_IF_KL_Scheibe_Typ_XIX_Grundumfang_XIX_Klima.DE_KL_Scheibe_Typ, system-signal=KL_Scheibe_Typ
        communication-direction=OUT, data-element=Grundumfang_XIX_Klima.Geltungsbereich_E3_1_1_UNECE_Gen2.SP_IF_KL_SDA_AQS_COBereich_XIX_Grundumfang_XIX_Klima.DE_KL_SDA_AQS_COBereich, system-signal=KL_SDA_AQS_COBereich
        communication-direction=OUT, data-element=Grundumfang_XIX_Klima.Geltungsbereich_E3_1_1_UNECE_Gen2.SP_IF_KL_SDA_AQS_COStatus_XIX_Grundumfang_XIX_Klima.DE_KL_SDA_AQS_COStatus, system-signal=KL_SDA_AQS_COStatus
        communication-direction=OUT, data-element=Grundumfang_XIX_Klima.Geltungsbereich_E3_1_1_UNECE_Gen2.SP_IF_KL_SDA_AQS_NoxBereich_XIX_Grundumfang_XIX_Klima.DE_KL_SDA_AQS_NoxBereich, system-signal=KL_SDA_AQS_NoxBereich
        communication-direction=OUT, data-element=Grundumfang_XIX_Klima.Geltungsbereich_E3_1_1_UNECE_Gen2.SP_IF_KL_SDA_AQS_NoxStatus_XIX_Grundumfang_XIX_Klima.DE_KL_SDA_AQS_NoxStatus, system-signal=KL_SDA_AQS_NoxStatus
        communication-direction=OUT, data-element=Grundumfang_XIX_Klima.Geltungsbereich_E3_1_1_UNECE_Gen2.SP_IF_KL_SDA_AQS_Traffic_XIX_Grundumfang_XIX_Klima.DE_KL_SDA_AQS_Traffic, system-signal=KL_SDA_AQS_Traffic
        communication-direction=OUT, data-element=Grundumfang_XIX_Klima.Geltungsbereich_E3_1_1_UNECE_Gen2.SP_IF_KL_SDA_AQS_VOZBereich_XIX_Grundumfang_XIX_Klima.DE_KL_SDA_AQS_VOZBereich, system-signal=KL_SDA_AQS_VOZBereich
        communication-direction=OUT, data-element=Grundumfang_XIX_Klima.Geltungsbereich_E3_1_1_UNECE_Gen2.SP_IF_KL_SDA_AQS_VOZStatus_XIX_Grundumfang_XIX_Klima.DE_KL_SDA_AQS_VOZStatus, system-signal=KL_SDA_AQS_VOZStatus
        communication-direction=OUT, data-element=Grundumfang_XIX_Klima.Geltungsbereich_E3_1_1_UNECE_Gen2.SP_IF_KL_SDA_Klima_Automatik_XIX_Grundumfang_XIX_Klima.DE_KL_SDA_Klima_Automatik, system-signal=KL_SDA_Klima_Automatik
        communication-direction=OUT, data-element=Grundumfang_XIX_Klima.Geltungsbereich_E3_1_1_UNECE_Gen2.SP_IF_KL_SDA_Luft_Feinstaub_XIX_Grundumfang_XIX_Klima.DE_KL_SDA_Luft_Feinstaub, system-signal=KL_SDA_Luft_Feinstaub
        communication-direction=OUT, data-element=Grundumfang_XIX_Klima.Geltungsbereich_E3_1_1_UNECE_Gen2.SP_IF_KL_SDA_Luft_Qualitaet_XIX_Grundumfang_XIX_Klima.DE_KL_SDA_Luft_Qualitaet, system-signal=KL_SDA_Luft_Qualitaet
        communication-direction=OUT, data-element=Grundumfang_XIX_Klima.Geltungsbereich_E3_1_1_UNECE_Gen2.SP_IF_KL_SDA_Luftverteilung_Person_XIX_Grundumfang_XIX_Klima.DE_KL_SDA_Luftverteilung_Person, system-signal=KL_SDA_Luftverteilung_Person
        communication-direction=OUT, data-element=Grundumfang_XIX_Klima.Geltungsbereich_E3_1_1_UNECE_Gen2.SP_IF_KL_SDA_Luftverteilung_Scheibe_XIX_Grundumfang_XIX_Klima.DE_KL_SDA_Luftverteilung_Scheibe, system-signal=KL_SDA_Luftverteilung_Scheibe
        communication-direction=OUT, data-element=Grundumfang_XIX_Klima.Geltungsbereich_E3_1_1_UNECE_Gen2.SP_IF_KL_SDA_Luftverteilung_Unten_XIX_Grundumfang_XIX_Klima.DE_KL_SDA_Luftverteilung_Unten, system-signal=KL_SDA_Luftverteilung_Unten
        communication-direction=OUT, data-element=Grundumfang_XIX_Klima.Geltungsbereich_E3_1_1_UNECE_Gen2.SP_IF_KL_SDA_Menutaste_XIX_Grundumfang_XIX_Klima.DE_KL_SDA_Menutaste, system-signal=KL_SDA_Menutaste
        communication-direction=OUT, data-element=Grundumfang_XIX_Klima.Geltungsbereich_E3_1_1_UNECE_Gen2.SP_IF_KL_SDA_Sitzheizung_VL_XIX_Grundumfang_XIX_Klima.DE_KL_SDA_Sitzheizung_VL, system-signal=KL_SDA_Sitzheizung_VL
        communication-direction=OUT, data-element=Grundumfang_XIX_Klima.Geltungsbereich_E3_1_1_UNECE_Gen2.SP_IF_KL_SDA_Sitzheizung_VR_XIX_Grundumfang_XIX_Klima.DE_KL_SDA_Sitzheizung_VR, system-signal=KL_SDA_Sitzheizung_VR
        communication-direction=OUT, data-element=Grundumfang_XIX_Klima.Geltungsbereich_E3_1_1_UNECE_Gen2.SP_IF_KL_SDA_Sitzlueftung_VL_XIX_Grundumfang_XIX_Klima.DE_KL_SDA_Sitzlueftung_VL, system-signal=KL_SDA_Sitzlueftung_VL
        communication-direction=OUT, data-element=Grundumfang_XIX_Klima.Geltungsbereich_E3_1_1_UNECE_Gen2.SP_IF_KL_SDA_Sitzlueftung_VR_XIX_Grundumfang_XIX_Klima.DE_KL_SDA_Sitzlueftung_VR, system-signal=KL_SDA_Sitzlueftung_VR
        communication-direction=OUT, data-element=Grundumfang_XIX_Klima.Geltungsbereich_E3_1_1_UNECE_Gen2.SP_IF_KL_SDA_Sonderfkt_AirCare_XIX_Grundumfang_XIX_Klima.DE_KL_SDA_Sonderfkt_AirCare, system-signal=KL_SDA_Sonderfkt_AirCare
        communication-direction=OUT, data-element=Grundumfang_XIX_Klima.Geltungsbereich_E3_1_1_UNECE_Gen2.SP_IF_KL_SDA_Sonderfkt_HSH_XIX_Grundumfang_XIX_Klima.DE_KL_SDA_Sonderfkt_HSH, system-signal=KL_SDA_Sonderfkt_HSH
        communication-direction=OUT, data-element=Grundumfang_XIX_Klima.Geltungsbereich_E3_1_1_UNECE_Gen2.SP_IF_KL_SDA_Sonderfkt_MaxAC_XIX_Grundumfang_XIX_Klima.DE_KL_SDA_Sonderfkt_MaxAC, system-signal=KL_SDA_Sonderfkt_MaxAC
        communication-direction=OUT, data-element=Grundumfang_XIX_Klima.Geltungsbereich_E3_1_1_UNECE_Gen2.SP_IF_KL_SDA_Sonderfkt_MaxDefrost_XIX_Grundumfang_XIX_Klima.DE_KL_SDA_Sonderfkt_MaxDefrost, system-signal=KL_SDA_Sonderfkt_MaxDefrost
        communication-direction=OUT, data-element=Grundumfang_XIX_Klima.Geltungsbereich_E3_1_1_UNECE_Gen2.SP_IF_KL_SDA_Sonderfunktionen_Sprache_XIX_Grundumfang_XIX_Klima.DE_KL_SDA_Sonderfunktionen_Sprache, system-signal=KL_SDA_Sonderfunktionen_Sprache
        communication-direction=OUT, data-element=Grundumfang_XIX_Klima.Geltungsbereich_E3_1_1_UNECE_Gen2.SP_IF_KL_SDA_Temp_Kundenwunsch_2_XIX_Grundumfang_XIX_Klima.DE_KL_SDA_Temp_Kundenwunsch_2, system-signal=KL_SDA_Temp_Kundenwunsch_2
        communication-direction=OUT, data-element=Grundumfang_XIX_Klima.Geltungsbereich_E3_1_1_UNECE_Gen2.SP_IF_KL_SDA_Temp_Kundenwunsch_3_XIX_Grundumfang_XIX_Klima.DE_KL_SDA_Temp_Kundenwunsch_3, system-signal=KL_SDA_Temp_Kundenwunsch_3
        communication-direction=OUT, data-element=Grundumfang_XIX_Klima.Geltungsbereich_E3_1_1_UNECE_Gen2.SP_IF_KL_SH_Soll_hl_XIX_Grundumfang_XIX_Klima.DE_KL_SH_Soll_hl, system-signal=KL_SH_Soll_hl
        communication-direction=OUT, data-element=Grundumfang_XIX_Klima.Geltungsbereich_E3_1_1_UNECE_Gen2.SP_IF_KL_SH_Soll_hr_XIX_Grundumfang_XIX_Klima.DE_KL_SH_Soll_hr, system-signal=KL_SH_Soll_hr
        communication-direction=OUT, data-element=Grundumfang_XIX_Klima.Geltungsbereich_E3_1_1_UNECE_Gen2.SP_IF_KL_SIH_Anforderung_hl_XIX_Grundumfang_XIX_Klima.DE_KL_SIH_Anforderung_hl, system-signal=KL_SIH_Anforderung_hl
        communication-direction=OUT, data-element=Grundumfang_XIX_Klima.Geltungsbereich_E3_1_1_UNECE_Gen2.SP_IF_KL_SIH_Anforderung_hr_XIX_Grundumfang_XIX_Klima.DE_KL_SIH_Anforderung_hr, system-signal=KL_SIH_Anforderung_hr
        communication-direction=OUT, data-element=Grundumfang_XIX_Klima.Geltungsbereich_E3_1_1_UNECE_Gen2.SP_IF_KL_SIH_hl_Leistung_XIX_Grundumfang_XIX_Klima.DE_KL_SIH_hl_Leistung, system-signal=KL_SIH_hl_Leistung
        communication-direction=OUT, data-element=Grundumfang_XIX_Klima.Geltungsbereich_E3_1_1_UNECE_Gen2.SP_IF_KL_SIH_hl_Temp_aus_XIX_Grundumfang_XIX_Klima.DE_KL_SIH_hl_Temp_aus, system-signal=KL_SIH_hl_Temp_aus
        communication-direction=OUT, data-element=Grundumfang_XIX_Klima.Geltungsbereich_E3_1_1_UNECE_Gen2.SP_IF_KL_SIH_hl_Temp_ein_XIX_Grundumfang_XIX_Klima.DE_KL_SIH_hl_Temp_ein, system-signal=KL_SIH_hl_Temp_ein
        communication-direction=OUT, data-element=Grundumfang_XIX_Klima.Geltungsbereich_E3_1_1_UNECE_Gen2.SP_IF_KL_SIH_hl_Vorgabe_XIX_Grundumfang_XIX_Klima.DE_KL_SIH_hl_Vorgabe, system-signal=KL_SIH_hl_Vorgabe
        communication-direction=OUT, data-element=Grundumfang_XIX_Klima.Geltungsbereich_E3_1_1_UNECE_Gen2.SP_IF_KL_SIH_hr_Leistung_XIX_Grundumfang_XIX_Klima.DE_KL_SIH_hr_Leistung, system-signal=KL_SIH_hr_Leistung
        communication-direction=OUT, data-element=Grundumfang_XIX_Klima.Geltungsbereich_E3_1_1_UNECE_Gen2.SP_IF_KL_SIH_hr_Temp_aus_XIX_Grundumfang_XIX_Klima.DE_KL_SIH_hr_Temp_aus, system-signal=KL_SIH_hr_Temp_aus
        communication-direction=OUT, data-element=Grundumfang_XIX_Klima.Geltungsbereich_E3_1_1_UNECE_Gen2.SP_IF_KL_SIH_hr_Temp_ein_XIX_Grundumfang_XIX_Klima.DE_KL_SIH_hr_Temp_ein, system-signal=KL_SIH_hr_Temp_ein
        communication-direction=OUT, data-element=Grundumfang_XIX_Klima.Geltungsbereich_E3_1_1_UNECE_Gen2.SP_IF_KL_SIH_hr_Vorgabe_XIX_Grundumfang_XIX_Klima.DE_KL_SIH_hr_Vorgabe, system-signal=KL_SIH_hr_Vorgabe
        communication-direction=OUT, data-element=Grundumfang_XIX_Klima.Geltungsbereich_E3_1_1_UNECE_Gen2.SP_IF_KL_SIH_LEL_Verteilung_VL_XIX_Grundumfang_XIX_Klima.DE_KL_SIH_LEL_Verteilung_VL, system-signal=KL_SIH_LEL_Verteilung_VL
        communication-direction=OUT, data-element=Grundumfang_XIX_Klima.Geltungsbereich_E3_1_1_UNECE_Gen2.SP_IF_KL_SIH_LEL_Verteilung_VR_XIX_Grundumfang_XIX_Klima.DE_KL_SIH_LEL_Verteilung_VR, system-signal=KL_SIH_LEL_Verteilung_VR
        communication-direction=OUT, data-element=Grundumfang_XIX_Klima.Geltungsbereich_E3_1_1_UNECE_Gen2.SP_IF_KL_SIH_Soll_li_XIX_Grundumfang_XIX_Klima.DE_KL_SIH_Soll_li, system-signal=KL_SIH_Soll_li
        communication-direction=OUT, data-element=Grundumfang_XIX_Klima.Geltungsbereich_E3_1_1_UNECE_Gen2.SP_IF_KL_SIH_Soll_re_XIX_Grundumfang_XIX_Klima.DE_KL_SIH_Soll_re, system-signal=KL_SIH_Soll_re
        communication-direction=OUT, data-element=Grundumfang_XIX_Klima.Geltungsbereich_E3_1_1_UNECE_Gen2.SP_IF_KL_SIL_Soll_li_XIX_Grundumfang_XIX_Klima.DE_KL_SIL_Soll_li, system-signal=KL_SIL_Soll_li
        communication-direction=OUT, data-element=Grundumfang_XIX_Klima.Geltungsbereich_E3_1_1_UNECE_Gen2.SP_IF_KL_SIL_Soll_re_XIX_Grundumfang_XIX_Klima.DE_KL_SIL_Soll_re, system-signal=KL_SIL_Soll_re
        communication-direction=OUT, data-element=Grundumfang_XIX_Klima.Geltungsbereich_E3_1_1_UNECE_Gen2.SP_IF_KL_Sitzkennlinie_Heck_XIX_Grundumfang_XIX_Klima.DE_KL_Sitzkennlinie_Heck, system-signal=KL_Sitzkennlinie_Heck
        communication-direction=IN, data-element=Grundumfang_XIX_Klima.Geltungsbereich_E3_1_1_UNECE_Gen2.RP_IF_KL_SL_Soll_hl_XIX_Grundumfang_XIX_Klima.DE_KL_SL_Soll_hl, system-signal=KL_SL_Soll_hl
        communication-direction=OUT, data-element=Grundumfang_XIX_Klima.Geltungsbereich_E3_1_1_UNECE_Gen2.SP_IF_KL_SL_Soll_hl_XIX_Grundumfang_XIX_Klima.DE_KL_SL_Soll_hl, system-signal=KL_SL_Soll_hl
        communication-direction=IN, data-element=Grundumfang_XIX_Klima.Geltungsbereich_E3_1_1_UNECE_Gen2.RP_IF_KL_SL_Soll_hr_XIX_Grundumfang_XIX_Klima.DE_KL_SL_Soll_hr, system-signal=KL_SL_Soll_hr
        communication-direction=OUT, data-element=Grundumfang_XIX_Klima.Geltungsbereich_E3_1_1_UNECE_Gen2.SP_IF_KL_SL_Soll_hr_XIX_Grundumfang_XIX_Klima.DE_KL_SL_Soll_hr, system-signal=KL_SL_Soll_hr
        communication-direction=OUT, data-element=Grundumfang_XIX_Klima.Geltungsbereich_E3_1_1_UNECE_Gen2.SP_IF_KL_SMod_SIH_Stufe_LED_hl_XIX_Grundumfang_XIX_Klima.DE_KL_SMod_SIH_Stufe_LED_hl, system-signal=KL_SMod_SIH_Stufe_LED_hl
        communication-direction=OUT, data-element=Grundumfang_XIX_Klima.Geltungsbereich_E3_1_1_UNECE_Gen2.SP_IF_KL_SMod_SIH_Stufe_LED_hr_XIX_Grundumfang_XIX_Klima.DE_KL_SMod_SIH_Stufe_LED_hr, system-signal=KL_SMod_SIH_Stufe_LED_hr
        communication-direction=OUT, data-element=Grundumfang_XIX_Klima.Geltungsbereich_E3_1_1_UNECE_Gen2.SP_IF_KL_SMod_SIL_Stufe_LED_hl_XIX_Grundumfang_XIX_Klima.DE_KL_SMod_SIL_Stufe_LED_hl, system-signal=KL_SMod_SIL_Stufe_LED_hl
        communication-direction=OUT, data-element=Grundumfang_XIX_Klima.Geltungsbereich_E3_1_1_UNECE_Gen2.SP_IF_KL_SMod_SIL_Stufe_LED_hr_XIX_Grundumfang_XIX_Klima.DE_KL_SMod_SIL_Stufe_LED_hr, system-signal=KL_SMod_SIL_Stufe_LED_hr
        communication-direction=OUT, data-element=Grundumfang_XIX_Klima.Geltungsbereich_E3_1_1_UNECE_Gen2.SP_IF_KL_SoSe_Intensitaet_BFS_XIX_Grundumfang_XIX_Klima.DE_KL_SoSe_Intensitaet_BFS, system-signal=KL_SoSe_Intensitaet_BFS
        communication-direction=OUT, data-element=Grundumfang_XIX_Klima.Geltungsbereich_E3_1_1_UNECE_Gen2.SP_IF_KL_SoSe_Intensitaet_FS_XIX_Grundumfang_XIX_Klima.DE_KL_SoSe_Intensitaet_FS, system-signal=KL_SoSe_Intensitaet_FS
        communication-direction=OUT, data-element=Grundumfang_XIX_Klima.Geltungsbereich_E3_1_1_UNECE_Gen2.SP_IF_KL_Spannungs_Anf_XIX_Grundumfang_XIX_Klima.DE_KL_Spannungs_Anf, system-signal=KL_Spannungs_Anf
        communication-direction=OUT, data-element=Grundumfang_XIX_Klima.Geltungsbereich_E3_1_1_UNECE_Gen2.SP_IF_KL_Standklima_RemoteModus_XIX_Grundumfang_XIX_Klima.DE_KL_Standklima_RemoteModus, system-signal=KL_Standklima_RemoteModus
        communication-direction=OUT, data-element=Grundumfang_XIX_Klima.Geltungsbereich_E3_1_1_UNECE_Gen2.SP_IF_KL_Standklima_Status_02_XIX_Grundumfang_XIX_Klima.DE_KL_Standklima_Status_02, system-signal=KL_Standklima_Status_02
        communication-direction=OUT, data-element=Grundumfang_XIX_Klima.Geltungsbereich_E3_1_1_UNECE_Gen2.SP_IF_KL_Standklima_Status_03_XIX_Grundumfang_XIX_Klima.DE_KL_Standklima_Status_03, system-signal=KL_Standklima_Status_03
        communication-direction=OUT, data-element=Grundumfang_XIX_Klima.Geltungsbereich_E3_1_1_UNECE_Gen2.SP_IF_KL_StartStopp_Info_XIX_Grundumfang_XIX_Klima.DE_KL_StartStopp_Info, system-signal=KL_StartStopp_Info
        communication-direction=OUT, data-element=Grundumfang_XIX_Klima.Geltungsbereich_E3_1_1_UNECE_Gen2.SP_IF_KL_Status_Battkuehlung_XIX_Grundumfang_XIX_Klima.DE_KL_Status_Battkuehlung, system-signal=KL_Status_Battkuehlung
        communication-direction=OUT, data-element=Grundumfang_XIX_Klima.Geltungsbereich_E3_1_1_UNECE_Gen2.SP_IF_KL_Status_EoHVL_EKK_XIX_Grundumfang_XIX_Klima.DE_KL_Status_EoHVL_EKK, system-signal=KL_Status_EoHVL_EKK
        communication-direction=OUT, data-element=Grundumfang_XIX_Klima.Geltungsbereich_E3_1_1_UNECE_Gen2.SP_IF_KL_Status_EoHVL_Heizer_XIX_Grundumfang_XIX_Klima.DE_KL_Status_EoHVL_Heizer, system-signal=KL_Status_EoHVL_Heizer
        communication-direction=OUT, data-element=Grundumfang_XIX_Klima.Geltungsbereich_E3_1_1_UNECE_Gen2.SP_IF_KL_Status_EoHVL_Heizer_2_XIX_Grundumfang_XIX_Klima.DE_KL_Status_EoHVL_Heizer_2, system-signal=KL_Status_EoHVL_Heizer_2
        communication-direction=OUT, data-element=Grundumfang_XIX_Klima.Geltungsbereich_E3_1_1_UNECE_Gen2.SP_IF_KL_Status_EoHVL_Heizer_3_XIX_Grundumfang_XIX_Klima.DE_KL_Status_EoHVL_Heizer_3, system-signal=KL_Status_EoHVL_Heizer_3
        communication-direction=OUT, data-element=Grundumfang_XIX_Klima.Geltungsbereich_E3_1_1_UNECE_Gen2.SP_IF_KL_Status_Soll_XIX_Grundumfang_XIX_Klima.DE_KL_Status_Soll, system-signal=KL_Status_Soll
        communication-direction=OUT, data-element=Grundumfang_XIX_Klima.Geltungsbereich_E3_1_1_UNECE_Gen2.SP_IF_KL_StellgliedtestINV_Heck_XIX_Grundumfang_XIX_Klima.DE_KL_StellgliedtestINV_Heck, system-signal=KL_StellgliedtestINV_Heck
        communication-direction=OUT, data-element=Grundumfang_XIX_Klima.Geltungsbereich_E3_1_1_UNECE_Gen2.SP_IF_KL_STH_aktiv_XIX_Grundumfang_XIX_Klima.DE_KL_STH_aktiv, system-signal=KL_STH_aktiv
        communication-direction=OUT, data-element=Grundumfang_XIX_Klima.Geltungsbereich_E3_1_1_UNECE_Gen2.SP_IF_KL_STH_Ansteuerung_XIX_Grundumfang_XIX_Klima.DE_KL_STH_Ansteuerung, system-signal=KL_STH_Ansteuerung
        communication-direction=OUT, data-element=Grundumfang_XIX_Klima.Geltungsbereich_E3_1_1_UNECE_Gen2.SP_IF_KL_STH_Betriebsdauer_XIX_Grundumfang_XIX_Klima.DE_KL_STH_Betriebsdauer, system-signal=KL_STH_Betriebsdauer
        communication-direction=OUT, data-element=Grundumfang_XIX_Klima.Geltungsbereich_E3_1_1_UNECE_Gen2.SP_IF_KL_STH_Betriebsdauer_lang_XIX_Grundumfang_XIX_Klima.DE_KL_STH_Betriebsdauer_lang, system-signal=KL_STH_Betriebsdauer_lang
        communication-direction=OUT, data-element=Grundumfang_XIX_Klima.Geltungsbereich_E3_1_1_UNECE_Gen2.SP_IF_KL_STL_aktiv_XIX_Grundumfang_XIX_Klima.DE_KL_STL_aktiv, system-signal=KL_STL_aktiv
        communication-direction=OUT, data-element=Grundumfang_XIX_Klima.Geltungsbereich_E3_1_1_UNECE_Gen2.SP_IF_KL_Stopp_Wiederstart_Anz_{01..09}_XIX_Grundumfang_XIX_Klima.DE_KL_Stopp_Wiederstart_Anz_{01..09}, system-signal=KL_Stopp_Wiederstart_Anz_{01..09}
        communication-direction=OUT, data-element=Grundumfang_XIX_Klima.Geltungsbereich_E3_1_1_UNECE_Gen2.SP_IF_KL_Stopp_Wiederstart_Anz_Std1_XIX_Grundumfang_XIX_Klima.DE_KL_Stopp_Wiederstart_Anz_Std1, system-signal=KL_Stopp_Wiederstart_Anz_Std1
        communication-direction=OUT, data-element=Grundumfang_XIX_Klima.Geltungsbereich_E3_1_1_UNECE_Gen2.SP_IF_KL_Stopp_Wiederstart_Anz_Std2_XIX_Grundumfang_XIX_Klima.DE_KL_Stopp_Wiederstart_Anz_Std2, system-signal=KL_Stopp_Wiederstart_Anz_Std2
        communication-direction=OUT, data-element=Grundumfang_XIX_Klima.Geltungsbereich_E3_1_1_UNECE_Gen2.SP_IF_KL_T_Charge_XIX_Grundumfang_XIX_Klima.DE_KL_T_Charge, system-signal=KL_T_Charge
        communication-direction=IN, data-element=Grundumfang_XIX_Klima.Geltungsbereich_E3_1_1_UNECE_Gen2.RP_IF_KL_Temp_hl_XIX_Grundumfang_XIX_Klima.DE_KL_Temp_hl, system-signal=KL_Temp_hl
        communication-direction=OUT, data-element=Grundumfang_XIX_Klima.Geltungsbereich_E3_1_1_UNECE_Gen2.SP_IF_KL_Temp_HL_Soll_XIX_Grundumfang_XIX_Klima.DE_KL_Temp_HL_Soll, system-signal=KL_Temp_HL_Soll
        communication-direction=OUT, data-element=Grundumfang_XIX_Klima.Geltungsbereich_E3_1_1_UNECE_Gen2.SP_IF_KL_Temp_Kundenwunsch_XIX_Grundumfang_XIX_Klima.DE_KL_Temp_Kundenwunsch, system-signal=KL_Temp_Kundenwunsch
        communication-direction=IN, data-element=Grundumfang_XIX_Klima.Geltungsbereich_E3_1_1_UNECE_Gen2.RP_IF_KL_Temp_Status_hl_XIX_Grundumfang_XIX_Klima.DE_KL_Temp_Status_hl, system-signal=KL_Temp_Status_hl
        communication-direction=OUT, data-element=Grundumfang_XIX_Klima.Geltungsbereich_E3_1_1_UNECE_Gen2.SP_IF_KL_Temp_vor_NTK_XIX_Grundumfang_XIX_Klima.DE_KL_Temp_vor_NTK, system-signal=KL_Temp_vor_NTK
        communication-direction=OUT, data-element=Grundumfang_XIX_Klima.Geltungsbereich_E3_1_1_UNECE_Gen2.SP_IF_KL_Temp_ZH_Soll_XIX_Grundumfang_XIX_Klima.DE_KL_Temp_ZH_Soll, system-signal=KL_Temp_ZH_Soll
        communication-direction=OUT, data-element=Grundumfang_XIX_Klima.Geltungsbereich_E3_1_1_UNECE_Gen2.SP_IF_KL_Thermomanagement_XIX_Grundumfang_XIX_Klima.DE_KL_Thermomanagement, system-signal=KL_Thermomanagement
        communication-direction=OUT, data-element=Grundumfang_XIX_Klima.Geltungsbereich_E3_1_1_UNECE_Gen2.SP_IF_KL_UIF_Parametersatz_XIX_Grundumfang_XIX_Klima.DE_KL_UIF_Parametersatz, system-signal=KL_UIF_Parametersatz
        communication-direction=OUT, data-element=Grundumfang_XIX_Klima.Geltungsbereich_E3_1_1_UNECE_Gen2.SP_IF_KL_Umluft_Taste_XIX_Grundumfang_XIX_Klima.DE_KL_Umluft_Taste, system-signal=KL_Umluft_Taste
        communication-direction=OUT, data-element=Grundumfang_XIX_Klima.Geltungsbereich_E3_1_1_UNECE_Gen2.SP_IF_KL_Umluftklappe_Status_XIX_Grundumfang_XIX_Klima.DE_KL_Umluftklappe_Status, system-signal=KL_Umluftklappe_Status
        communication-direction=OUT, data-element=Grundumfang_XIX_Klima.Geltungsbereich_E3_1_1_UNECE_Gen2.SP_IF_KL_Variante_Standheizung_XIX_Grundumfang_XIX_Klima.DE_KL_Variante_Standheizung, system-signal=KL_Variante_Standheizung
        communication-direction=OUT, data-element=Grundumfang_XIX_Klima.Geltungsbereich_E3_1_1_UNECE_Gen2.SP_IF_KL_Ventil_03_Soll_XIX_Grundumfang_XIX_Klima.DE_KL_Ventil_03_Soll, system-signal=KL_Ventil_03_Soll
        communication-direction=OUT, data-element=Grundumfang_XIX_Klima.Geltungsbereich_E3_1_1_UNECE_Gen2.SP_IF_KL_Verdeckstatus_XIX_Grundumfang_XIX_Klima.DE_KL_Verdeckstatus, system-signal=KL_Verdeckstatus
        communication-direction=OUT, data-element=Grundumfang_XIX_Klima.Geltungsbereich_E3_1_1_UNECE_Gen2.SP_IF_KL_VK_Anf_XIX_Grundumfang_XIX_Klima.DE_KL_VK_Anf, system-signal=KL_VK_Anf
        communication-direction=OUT, data-element=Grundumfang_XIX_Klima.Geltungsbereich_E3_1_1_UNECE_Gen2.SP_IF_KL_VK_Betriebsdauer_XIX_Grundumfang_XIX_Klima.DE_KL_VK_Betriebsdauer, system-signal=KL_VK_Betriebsdauer
        communication-direction=OUT, data-element=Grundumfang_XIX_Klima.Geltungsbereich_E3_1_1_UNECE_Gen2.SP_IF_KL_VoKo_LED_XIX_Grundumfang_XIX_Klima.DE_KL_VoKo_LED, system-signal=KL_VoKo_LED
        communication-direction=OUT, data-element=Grundumfang_XIX_Klima.Geltungsbereich_E3_1_1_UNECE_Gen2.SP_IF_KL_Voko_Status_XIX_Grundumfang_XIX_Klima.DE_KL_Voko_Status, system-signal=KL_Voko_Status
        communication-direction=OUT, data-element=Grundumfang_XIX_Klima.Geltungsbereich_E3_1_1_UNECE_Gen2.SP_IF_KL_Vorkond_Strategie_XIX_Grundumfang_XIX_Klima.DE_KL_Vorkond_Strategie, system-signal=KL_Vorkond_Strategie
        communication-direction=OUT, data-element=Grundumfang_XIX_Klima.Geltungsbereich_E3_1_1_UNECE_Gen2.SP_IF_KL_Vorwarn_HVHeizer_Leistung_XIX_Grundumfang_XIX_Klima.DE_KL_Vorwarn_HVHeizer_Leistung, system-signal=KL_Vorwarn_HVHeizer_Leistung
        communication-direction=OUT, data-element=Grundumfang_XIX_Klima.Geltungsbereich_E3_1_1_UNECE_Gen2.SP_IF_KL_Vorwarn_Komp_ein_XIX_Grundumfang_XIX_Klima.DE_KL_Vorwarn_Komp_ein, system-signal=KL_Vorwarn_Komp_ein
        communication-direction=OUT, data-element=Grundumfang_XIX_Klima.Geltungsbereich_E3_1_1_UNECE_Gen2.SP_IF_KL_Vorwarn_Zuheizer_ein_XIX_Grundumfang_XIX_Klima.DE_KL_Vorwarn_Zuheizer_ein, system-signal=KL_Vorwarn_Zuheizer_ein
        communication-direction=OUT, data-element=Grundumfang_XIX_Klima.Geltungsbereich_E3_1_1_UNECE_Gen2.SP_IF_KL_WaPu_XIX_Grundumfang_XIX_Klima.DE_KL_WaPu, system-signal=KL_WaPu
        communication-direction=OUT, data-element=Grundumfang_XIX_Klima.Geltungsbereich_E3_1_1_UNECE_Gen2.SP_IF_KL_Wasserheizer_Ansteuerung_XIX_Grundumfang_XIX_Klima.DE_KL_Wasserheizer_Ansteuerung, system-signal=KL_Wasserheizer_Ansteuerung
        communication-direction=OUT, data-element=Grundumfang_XIX_Klima.Geltungsbereich_E3_1_1_UNECE_Gen2.SP_IF_KL_Wasserheizer_IstTemp_Ausgang_XIX_Grundumfang_XIX_Klima.DE_KL_Wasserheizer_IstTemp_Ausgang, system-signal=KL_Wasserheizer_IstTemp_Ausgang
        communication-direction=OUT, data-element=Grundumfang_XIX_Klima.Geltungsbereich_E3_1_1_UNECE_Gen2.SP_IF_KL_Wasserheizer_IstTemp_Eingang_XIX_Grundumfang_XIX_Klima.DE_KL_Wasserheizer_IstTemp_Eingang, system-signal=KL_Wasserheizer_IstTemp_Eingang
        communication-direction=OUT, data-element=Grundumfang_XIX_Klima.Geltungsbereich_E3_1_1_UNECE_Gen2.SP_IF_KL_Wasserheizer_SollTemp_Ausgang_XIX_Grundumfang_XIX_Klima.DE_KL_Wasserheizer_SollTemp_Ausgang, system-signal=KL_Wasserheizer_SollTemp_Ausgang
        communication-direction=OUT, data-element=Grundumfang_XIX_Klima.Geltungsbereich_E3_1_1_UNECE_Gen2.SP_IF_KL_Wasserheizer_Status_XIX_Grundumfang_XIX_Klima.DE_KL_Wasserheizer_Status, system-signal=KL_Wasserheizer_Status
        communication-direction=OUT, data-element=Grundumfang_XIX_Klima.Geltungsbereich_E3_1_1_UNECE_Gen2.SP_IF_KL_ZR_Anforderung_XIX_Grundumfang_XIX_Klima.DE_KL_ZR_Anforderung, system-signal=KL_ZR_Anforderung
        communication-direction=OUT, data-element=Grundumfang_XIX_Klima.Geltungsbereich_E3_1_1_UNECE_Gen2.SP_IF_KL_Zuheizer_Freigabe_XIX_Grundumfang_XIX_Klima.DE_KL_Zuheizer_Freigabe, system-signal=KL_Zuheizer_Freigabe
        communication-direction=OUT, data-element=Grundumfang_XIX_Klima.Geltungsbereich_E3_1_1_UNECE_Gen2.SP_IF_KL_Zustand_XIX_Grundumfang_XIX_Klima.DE_KL_Zustand, system-signal=KL_Zustand
        communication-direction=OUT, data-element=Grundumfang_XIX_Klima.Geltungsbereich_E3_1_1_UNECE_Gen2.SP_IF_KL_ZZ_Betriebsmodus_XIX_Grundumfang_XIX_Klima.DE_KL_ZZ_Betriebsmodus, system-signal=KL_ZZ_Betriebsmodus
        communication-direction=OUT, data-element=Grundumfang_XIX_Klima.Geltungsbereich_E3_1_1_UNECE_Gen2.SP_IF_KL_ZZ_Minute_XIX_Grundumfang_XIX_Klima.DE_KL_ZZ_Minute, system-signal=KL_ZZ_Minute
        communication-direction=OUT, data-element=Grundumfang_XIX_Klima.Geltungsbereich_E3_1_1_UNECE_Gen2.SP_IF_KL_ZZ_Monat_XIX_Grundumfang_XIX_Klima.DE_KL_ZZ_Monat, system-signal=KL_ZZ_Monat
        communication-direction=OUT, data-element=Grundumfang_XIX_Klima.Geltungsbereich_E3_1_1_UNECE_Gen2.SP_IF_KL_ZZ_Status_Timer_XIX_Grundumfang_XIX_Klima.DE_KL_ZZ_Status_Timer, system-signal=KL_ZZ_Status_Timer
        communication-direction=OUT, data-element=Grundumfang_XIX_Klima.Geltungsbereich_E3_1_1_UNECE_Gen2.SP_IF_KL_ZZ_Stunde_XIX_Grundumfang_XIX_Klima.DE_KL_ZZ_Stunde, system-signal=KL_ZZ_Stunde
        communication-direction=OUT, data-element=Grundumfang_XIX_Klima.Geltungsbereich_E3_1_1_UNECE_Gen2.SP_IF_KL_ZZ_Tag_XIX_Grundumfang_XIX_Klima.DE_KL_ZZ_Tag, system-signal=KL_ZZ_Tag
        communication-direction=OUT, data-element=Grundumfang_XIX_Klima.Geltungsbereich_E3_1_1_UNECE_Gen2.SP_IF_Klemme_15_XIX_Grundumfang_XIX_Klima.DE_Klemme_15, system-signal=Klemme_15
        communication-direction=IN, data-element=Grundumfang_XIX_Klima.Geltungsbereich_E3_1_1_UNECE_Gen2.RP_IF_KLh_aus_XIX_Grundumfang_XIX_Klima.DE_KLh_aus, system-signal=KLh_aus
        communication-direction=IN, data-element=Grundumfang_XIX_Klima.Geltungsbereich_E3_1_1_UNECE_Gen2.RP_IF_KLh_Ausstattung_KlimaHeck_XIX_Grundumfang_XIX_Klima.DE_KLh_Ausstattung_KlimaHeck, system-signal=KLh_Ausstattung_KlimaHeck
        communication-direction=IN, data-element=Grundumfang_XIX_Klima.Geltungsbereich_E3_1_1_UNECE_Gen2.RP_IF_KLh_Fehler{1..8}_XIX_Grundumfang_XIX_Klima.DE_KLh_Fehler{1..8}, system-signal=KLh_Fehler{1..8}
        communication-direction=IN, data-element=Grundumfang_XIX_Klima.Geltungsbereich_E3_1_1_UNECE_Gen2.RP_IF_KLh_Seite_defog_hl_XIX_Grundumfang_XIX_Klima.DE_KLh_Seite_defog_hl, system-signal=KLh_Seite_defog_hl
        communication-direction=IN, data-element=Grundumfang_XIX_Klima.Geltungsbereich_E3_1_1_UNECE_Gen2.RP_IF_KLh_SIH_Last_defekt_hl_XIX_Grundumfang_XIX_Klima.DE_KLh_SIH_Last_defekt_hl, system-signal=KLh_SIH_Last_defekt_hl
        communication-direction=IN, data-element=Grundumfang_XIX_Klima.Geltungsbereich_E3_1_1_UNECE_Gen2.RP_IF_KLh_SIH_Last_defekt_hr_XIX_Grundumfang_XIX_Klima.DE_KLh_SIH_Last_defekt_hr, system-signal=KLh_SIH_Last_defekt_hr
        communication-direction=IN, data-element=Grundumfang_XIX_Klima.Geltungsbereich_E3_1_1_UNECE_Gen2.RP_IF_KLh_SIH_NTC_defekt_hl_XIX_Grundumfang_XIX_Klima.DE_KLh_SIH_NTC_defekt_hl, system-signal=KLh_SIH_NTC_defekt_hl
        communication-direction=IN, data-element=Grundumfang_XIX_Klima.Geltungsbereich_E3_1_1_UNECE_Gen2.RP_IF_KLh_SIH_NTC_defekt_hr_XIX_Grundumfang_XIX_Klima.DE_KLh_SIH_NTC_defekt_hr, system-signal=KLh_SIH_NTC_defekt_hr
        communication-direction=IN, data-element=Grundumfang_XIX_Klima.Geltungsbereich_E3_1_1_UNECE_Gen2.RP_IF_KLh_SIH_Stufe_hl_XIX_Grundumfang_XIX_Klima.DE_KLh_SIH_Stufe_hl, system-signal=KLh_SIH_Stufe_hl
        communication-direction=IN, data-element=Grundumfang_XIX_Klima.Geltungsbereich_E3_1_1_UNECE_Gen2.RP_IF_KLh_SIH_Stufe_hr_XIX_Grundumfang_XIX_Klima.DE_KLh_SIH_Stufe_hr, system-signal=KLh_SIH_Stufe_hr
        communication-direction=IN, data-element=Grundumfang_XIX_Klima.Geltungsbereich_E3_1_1_UNECE_Gen2.RP_IF_KLh_toggle_LVT_XIX_Grundumfang_XIX_Klima.DE_KLh_toggle_LVT, system-signal=KLh_toggle_LVT
        communication-direction=IN, data-element=Grundumfang_XIX_Klima.Geltungsbereich_E3_1_1_UNECE_Gen2.RP_IF_KLhl_GeblaeseSoll_XIX_Grundumfang_XIX_Klima.DE_KLhl_GeblaeseSoll, system-signal=KLhl_GeblaeseSoll
        communication-direction=IN, data-element=Grundumfang_XIX_Klima.Geltungsbereich_E3_1_1_UNECE_Gen2.RP_IF_KLhl_Luft_auto_XIX_Grundumfang_XIX_Klima.DE_KLhl_Luft_auto, system-signal=KLhl_Luft_auto
        communication-direction=IN, data-element=Grundumfang_XIX_Klima.Geltungsbereich_E3_1_1_UNECE_Gen2.RP_IF_KLhl_Luft_mitte_XIX_Grundumfang_XIX_Klima.DE_KLhl_Luft_mitte, system-signal=KLhl_Luft_mitte
        communication-direction=IN, data-element=Grundumfang_XIX_Klima.Geltungsbereich_E3_1_1_UNECE_Gen2.RP_IF_KLhl_Luft_oben_XIX_Grundumfang_XIX_Klima.DE_KLhl_Luft_oben, system-signal=KLhl_Luft_oben
        communication-direction=IN, data-element=Grundumfang_XIX_Klima.Geltungsbereich_E3_1_1_UNECE_Gen2.RP_IF_KLhl_Luft_seite_XIX_Grundumfang_XIX_Klima.DE_KLhl_Luft_seite, system-signal=KLhl_Luft_seite
        communication-direction=IN, data-element=Grundumfang_XIX_Klima.Geltungsbereich_E3_1_1_UNECE_Gen2.RP_IF_KLhl_Luft_unten_XIX_Grundumfang_XIX_Klima.DE_KLhl_Luft_unten, system-signal=KLhl_Luft_unten
        communication-direction=IN, data-element=Grundumfang_XIX_Klima.Geltungsbereich_E3_1_1_UNECE_Gen2.RP_IF_KLhl_ResponseError_XIX_Grundumfang_XIX_Klima.DE_KLhl_ResponseError, system-signal=KLhl_ResponseError
        communication-direction=IN, data-element=Grundumfang_XIX_Klima.Geltungsbereich_E3_1_1_UNECE_Gen2.RP_IF_KLhl_TempSoll_XIX_Grundumfang_XIX_Klima.DE_KLhl_TempSoll, system-signal=KLhl_TempSoll
        communication-direction=IN, data-element=Grundumfang_XIX_Klima.Geltungsbereich_E3_1_1_UNECE_Gen2.RP_IF_KLhr_TempSoll_XIX_Grundumfang_XIX_Klima.DE_KLhr_TempSoll, system-signal=KLhr_TempSoll
        communication-direction=OUT, data-element=Grundumfang_XIX_Klima.Geltungsbereich_E3_1_1_UNECE_Gen2.SP_IF_KLhs_02_alt_XIX_Grundumfang_XIX_Klima.DE_KLhs_02_alt, system-signal=KLhs_02_alt
        communication-direction=OUT, data-element=Grundumfang_XIX_Klima.Geltungsbereich_E3_1_1_UNECE_Gen2.SP_IF_Klima_Abschaltstufe_XIX_Grundumfang_XIX_Klima.DE_Klima_Abschaltstufe, system-signal=Klima_Abschaltstufe
        communication-direction=OUT, data-element=Grundumfang_XIX_Klima.Geltungsbereich_E3_1_1_UNECE_Gen2.SP_IF_Klima_Nachlauftyp_XIX_Grundumfang_XIX_Klima.DE_Klima_Nachlauftyp, system-signal=Klima_Nachlauftyp
        communication-direction=OUT, data-element=Grundumfang_XIX_Klima.Geltungsbereich_E3_1_1_UNECE_Gen2.SP_IF_Klima_Transport_Mode_XIX_Grundumfang_XIX_Klima.DE_Klima_Transport_Mode, system-signal=Klima_Transport_Mode
        communication-direction=OUT, data-element=Grundumfang_XIX_Klima.Geltungsbereich_E3_1_1_UNECE_Gen2.SP_IF_KN_KL_DiagPfad_XIX_Grundumfang_XIX_Klima.DE_KN_KL_DiagPfad, system-signal=KN_KL_DiagPfad
        communication-direction=OUT, data-element=Grundumfang_XIX_Klima.Geltungsbereich_E3_1_1_UNECE_Gen2.SP_IF_KompressorModus_XIX_Grundumfang_XIX_Klima.DE_KompressorModus, system-signal=KompressorModus
        communication-direction=IN, data-element=Grundumfang_XIX_Klima.Geltungsbereich_E3_1_1_UNECE_Gen2.RP_IF_KPV_AC_XIX_Grundumfang_XIX_Klima.DE_KPV_AC, system-signal=KPV_AC
        communication-direction=IN, data-element=Grundumfang_XIX_Klima.Geltungsbereich_E3_1_1_UNECE_Gen2.RP_IF_KPV_AC_max_XIX_Grundumfang_XIX_Klima.DE_KPV_AC_max, system-signal=KPV_AC_max
        communication-direction=IN, data-element=Grundumfang_XIX_Klima.Geltungsbereich_E3_1_1_UNECE_Gen2.RP_IF_KPV_AC_Taste_XIX_Grundumfang_XIX_Klima.DE_KPV_AC_Taste, system-signal=KPV_AC_Taste
        communication-direction=IN, data-element=Grundumfang_XIX_Klima.Geltungsbereich_E3_1_1_UNECE_Gen2.RP_IF_KPV_Auto_li_XIX_Grundumfang_XIX_Klima.DE_KPV_Auto_li, system-signal=KPV_Auto_li
        communication-direction=IN, data-element=Grundumfang_XIX_Klima.Geltungsbereich_E3_1_1_UNECE_Gen2.RP_IF_KPV_Auto_Taste_XIX_Grundumfang_XIX_Klima.DE_KPV_Auto_Taste, system-signal=KPV_Auto_Taste
        communication-direction=IN, data-element=Grundumfang_XIX_Klima.Geltungsbereich_E3_1_1_UNECE_Gen2.RP_IF_KPV_AutoSiKli_li_XIX_Grundumfang_XIX_Klima.DE_KPV_AutoSiKli_li, system-signal=KPV_AutoSiKli_li
        communication-direction=IN, data-element=Grundumfang_XIX_Klima.Geltungsbereich_E3_1_1_UNECE_Gen2.RP_IF_KPV_AutoSiKli_re_XIX_Grundumfang_XIX_Klima.DE_KPV_AutoSiKli_re, system-signal=KPV_AutoSiKli_re
        communication-direction=IN, data-element=Grundumfang_XIX_Klima.Geltungsbereich_E3_1_1_UNECE_Gen2.RP_IF_KPV_AutoUmluft_XIX_Grundumfang_XIX_Klima.DE_KPV_AutoUmluft, system-signal=KPV_AutoUmluft
        communication-direction=IN, data-element=Grundumfang_XIX_Klima.Geltungsbereich_E3_1_1_UNECE_Gen2.RP_IF_KPV_Beduftung_XIX_Grundumfang_XIX_Klima.DE_KPV_Beduftung, system-signal=KPV_Beduftung
        communication-direction=IN, data-element=Grundumfang_XIX_Klima.Geltungsbereich_E3_1_1_UNECE_Gen2.RP_IF_KPV_Defrost_XIX_Grundumfang_XIX_Klima.DE_KPV_Defrost, system-signal=KPV_Defrost
        communication-direction=IN, data-element=Grundumfang_XIX_Klima.Geltungsbereich_E3_1_1_UNECE_Gen2.RP_IF_KPV_DefrostMAX_Taste_XIX_Grundumfang_XIX_Klima.DE_KPV_DefrostMAX_Taste, system-signal=KPV_DefrostMAX_Taste
        communication-direction=IN, data-element=Grundumfang_XIX_Klima.Geltungsbereich_E3_1_1_UNECE_Gen2.RP_IF_KPV_ECO_XIX_Grundumfang_XIX_Klima.DE_KPV_ECO, system-signal=KPV_ECO
        communication-direction=IN, data-element=Grundumfang_XIX_Klima.Geltungsbereich_E3_1_1_UNECE_Gen2.RP_IF_KPV_FSH_XIX_Grundumfang_XIX_Klima.DE_KPV_FSH, system-signal=KPV_FSH
        communication-direction=IN, data-element=Grundumfang_XIX_Klima.Geltungsbereich_E3_1_1_UNECE_Gen2.RP_IF_KPV_Geblaese_Auto_li_XIX_Grundumfang_XIX_Klima.DE_KPV_Geblaese_Auto_li, system-signal=KPV_Geblaese_Auto_li
        communication-direction=IN, data-element=Grundumfang_XIX_Klima.Geltungsbereich_E3_1_1_UNECE_Gen2.RP_IF_KPV_Geblaese_Stufe_li_XIX_Grundumfang_XIX_Klima.DE_KPV_Geblaese_Stufe_li, system-signal=KPV_Geblaese_Stufe_li
        communication-direction=IN, data-element=Grundumfang_XIX_Klima.Geltungsbereich_E3_1_1_UNECE_Gen2.RP_IF_KPV_HSH_XIX_Grundumfang_XIX_Klima.DE_KPV_HSH, system-signal=KPV_HSH
        communication-direction=IN, data-element=Grundumfang_XIX_Klima.Geltungsbereich_E3_1_1_UNECE_Gen2.RP_IF_KPV_HSH_Taste_XIX_Grundumfang_XIX_Klima.DE_KPV_HSH_Taste, system-signal=KPV_HSH_Taste
        communication-direction=IN, data-element=Grundumfang_XIX_Klima.Geltungsbereich_E3_1_1_UNECE_Gen2.RP_IF_KPV_Init_XIX_Grundumfang_XIX_Klima.DE_KPV_Init, system-signal=KPV_Init
        communication-direction=IN, data-element=Grundumfang_XIX_Klima.Geltungsbereich_E3_1_1_UNECE_Gen2.RP_IF_KPV_Init_2_XIX_Grundumfang_XIX_Klima.DE_KPV_Init_2, system-signal=KPV_Init_2
        communication-direction=IN, data-element=Grundumfang_XIX_Klima.Geltungsbereich_E3_1_1_UNECE_Gen2.RP_IF_KPV_Ionisator_XIX_Grundumfang_XIX_Klima.DE_KPV_Ionisator, system-signal=KPV_Ionisator
        communication-direction=IN, data-element=Grundumfang_XIX_Klima.Geltungsbereich_E3_1_1_UNECE_Gen2.RP_IF_KPV_Joker_Taste_XIX_Grundumfang_XIX_Klima.DE_KPV_Joker_Taste, system-signal=KPV_Joker_Taste
        communication-direction=IN, data-element=Grundumfang_XIX_Klima.Geltungsbereich_E3_1_1_UNECE_Gen2.RP_IF_KPV_Klima_Menue_MMI_XIX_Grundumfang_XIX_Klima.DE_KPV_Klima_Menue_MMI, system-signal=KPV_Klima_Menue_MMI
        communication-direction=IN, data-element=Grundumfang_XIX_Klima.Geltungsbereich_E3_1_1_UNECE_Gen2.RP_IF_KPV_Konditionierung_Taste_XIX_Grundumfang_XIX_Klima.DE_KPV_Konditionierung_Taste, system-signal=KPV_Konditionierung_Taste
        communication-direction=IN, data-element=Grundumfang_XIX_Klima.Geltungsbereich_E3_1_1_UNECE_Gen2.RP_IF_KPV_Kopfraumheizung_li_XIX_Grundumfang_XIX_Klima.DE_KPV_Kopfraumheizung_li, system-signal=KPV_Kopfraumheizung_li
        communication-direction=IN, data-element=Grundumfang_XIX_Klima.Geltungsbereich_E3_1_1_UNECE_Gen2.RP_IF_KPV_Kopfraumheizung_re_XIX_Grundumfang_XIX_Klima.DE_KPV_Kopfraumheizung_re, system-signal=KPV_Kopfraumheizung_re
        communication-direction=IN, data-element=Grundumfang_XIX_Klima.Geltungsbereich_E3_1_1_UNECE_Gen2.RP_IF_KPV_Lokalaktiv_XIX_Grundumfang_XIX_Klima.DE_KPV_Lokalaktiv, system-signal=KPV_Lokalaktiv
        communication-direction=IN, data-element=Grundumfang_XIX_Klima.Geltungsbereich_E3_1_1_UNECE_Gen2.RP_IF_KPV_Luftverteilung_Auto_li_XIX_Grundumfang_XIX_Klima.DE_KPV_Luftverteilung_Auto_li, system-signal=KPV_Luftverteilung_Auto_li
        communication-direction=IN, data-element=Grundumfang_XIX_Klima.Geltungsbereich_E3_1_1_UNECE_Gen2.RP_IF_KPV_Luftverteilung_Mitte_li_XIX_Grundumfang_XIX_Klima.DE_KPV_Luftverteilung_Mitte_li, system-signal=KPV_Luftverteilung_Mitte_li
        communication-direction=IN, data-element=Grundumfang_XIX_Klima.Geltungsbereich_E3_1_1_UNECE_Gen2.RP_IF_KPV_Luftverteilung_Oben_li_XIX_Grundumfang_XIX_Klima.DE_KPV_Luftverteilung_Oben_li, system-signal=KPV_Luftverteilung_Oben_li
        communication-direction=IN, data-element=Grundumfang_XIX_Klima.Geltungsbereich_E3_1_1_UNECE_Gen2.RP_IF_KPV_Luftverteilung_Unten_li_XIX_Grundumfang_XIX_Klima.DE_KPV_Luftverteilung_Unten_li, system-signal=KPV_Luftverteilung_Unten_li
        communication-direction=IN, data-element=Grundumfang_XIX_Klima.Geltungsbereich_E3_1_1_UNECE_Gen2.RP_IF_KPV_OBD_XIX_Grundumfang_XIX_Klima.DE_KPV_OBD, system-signal=KPV_OBD
        communication-direction=IN, data-element=Grundumfang_XIX_Klima.Geltungsbereich_E3_1_1_UNECE_Gen2.RP_IF_KPV_OBD_Gruppe_XIX_Grundumfang_XIX_Klima.DE_KPV_OBD_Gruppe, system-signal=KPV_OBD_Gruppe
        communication-direction=IN, data-element=Grundumfang_XIX_Klima.Geltungsbereich_E3_1_1_UNECE_Gen2.RP_IF_KPV_Off_XIX_Grundumfang_XIX_Klima.DE_KPV_Off, system-signal=KPV_Off
        communication-direction=IN, data-element=Grundumfang_XIX_Klima.Geltungsbereich_E3_1_1_UNECE_Gen2.RP_IF_KPV_Panel_Error_XIX_Grundumfang_XIX_Klima.DE_KPV_Panel_Error, system-signal=KPV_Panel_Error
        communication-direction=IN, data-element=Grundumfang_XIX_Klima.Geltungsbereich_E3_1_1_UNECE_Gen2.RP_IF_KPV_Popup_Content_ZL1R_XIX_Grundumfang_XIX_Klima.DE_KPV_Popup_Content_ZL1R, system-signal=KPV_Popup_Content_ZL1R
        communication-direction=IN, data-element=Grundumfang_XIX_Klima.Geltungsbereich_E3_1_1_UNECE_Gen2.RP_IF_KPV_Popup_Content_ZR1R_XIX_Grundumfang_XIX_Klima.DE_KPV_Popup_Content_ZR1R, system-signal=KPV_Popup_Content_ZR1R
        communication-direction=IN, data-element=Grundumfang_XIX_Klima.Geltungsbereich_E3_1_1_UNECE_Gen2.RP_IF_KPV_PureAir_XIX_Grundumfang_XIX_Klima.DE_KPV_PureAir, system-signal=KPV_PureAir
        communication-direction=IN, data-element=Grundumfang_XIX_Klima.Geltungsbereich_E3_1_1_UNECE_Gen2.RP_IF_KPV_Rear_XIX_Grundumfang_XIX_Klima.DE_KPV_Rear, system-signal=KPV_Rear
        communication-direction=IN, data-element=Grundumfang_XIX_Klima.Geltungsbereich_E3_1_1_UNECE_Gen2.RP_IF_KPV_ResponseError_XIX_Grundumfang_XIX_Klima.DE_KPV_ResponseError, system-signal=KPV_ResponseError
        communication-direction=IN, data-element=Grundumfang_XIX_Klima.Geltungsbereich_E3_1_1_UNECE_Gen2.RP_IF_KPV_Restwaerme_XIX_Grundumfang_XIX_Klima.DE_KPV_Restwaerme, system-signal=KPV_Restwaerme
        communication-direction=IN, data-element=Grundumfang_XIX_Klima.Geltungsbereich_E3_1_1_UNECE_Gen2.RP_IF_KPV_Sitzheizung_li_XIX_Grundumfang_XIX_Klima.DE_KPV_Sitzheizung_li, system-signal=KPV_Sitzheizung_li
        communication-direction=IN, data-element=Grundumfang_XIX_Klima.Geltungsbereich_E3_1_1_UNECE_Gen2.RP_IF_KPV_Sitzheizung_re_XIX_Grundumfang_XIX_Klima.DE_KPV_Sitzheizung_re, system-signal=KPV_Sitzheizung_re
        communication-direction=IN, data-element=Grundumfang_XIX_Klima.Geltungsbereich_E3_1_1_UNECE_Gen2.RP_IF_KPV_Sitzlueftung_li_XIX_Grundumfang_XIX_Klima.DE_KPV_Sitzlueftung_li, system-signal=KPV_Sitzlueftung_li
        communication-direction=IN, data-element=Grundumfang_XIX_Klima.Geltungsbereich_E3_1_1_UNECE_Gen2.RP_IF_KPV_Sitzlueftung_re_XIX_Grundumfang_XIX_Klima.DE_KPV_Sitzlueftung_re, system-signal=KPV_Sitzlueftung_re
        communication-direction=IN, data-element=Grundumfang_XIX_Klima.Geltungsbereich_E3_1_1_UNECE_Gen2.RP_IF_KPV_Status_Spannung_XIX_Grundumfang_XIX_Klima.DE_KPV_Status_Spannung, system-signal=KPV_Status_Spannung
        communication-direction=IN, data-element=Grundumfang_XIX_Klima.Geltungsbereich_E3_1_1_UNECE_Gen2.RP_IF_KPV_Sync_XIX_Grundumfang_XIX_Klima.DE_KPV_Sync, system-signal=KPV_Sync
        communication-direction=IN, data-element=Grundumfang_XIX_Klima.Geltungsbereich_E3_1_1_UNECE_Gen2.RP_IF_KPV_Tasten_Fehler_XIX_Grundumfang_XIX_Klima.DE_KPV_Tasten_Fehler, system-signal=KPV_Tasten_Fehler
        communication-direction=IN, data-element=Grundumfang_XIX_Klima.Geltungsbereich_E3_1_1_UNECE_Gen2.RP_IF_KPV_Temp_li_XIX_Grundumfang_XIX_Klima.DE_KPV_Temp_li, system-signal=KPV_Temp_li
        communication-direction=IN, data-element=Grundumfang_XIX_Klima.Geltungsbereich_E3_1_1_UNECE_Gen2.RP_IF_KPV_Temp_Platine_XIX_Grundumfang_XIX_Klima.DE_KPV_Temp_Platine, system-signal=KPV_Temp_Platine
        communication-direction=IN, data-element=Grundumfang_XIX_Klima.Geltungsbereich_E3_1_1_UNECE_Gen2.RP_IF_KPV_Temp_re_XIX_Grundumfang_XIX_Klima.DE_KPV_Temp_re, system-signal=KPV_Temp_re
        communication-direction=IN, data-element=Grundumfang_XIX_Klima.Geltungsbereich_E3_1_1_UNECE_Gen2.RP_IF_KPV_Umluft_XIX_Grundumfang_XIX_Klima.DE_KPV_Umluft, system-signal=KPV_Umluft
        communication-direction=IN, data-element=Grundumfang_XIX_Klima.Geltungsbereich_E3_1_1_UNECE_Gen2.RP_IF_KPV_Zustand_Off_XIX_Grundumfang_XIX_Klima.DE_KPV_Zustand_Off, system-signal=KPV_Zustand_Off
        communication-direction=OUT, data-element=Grundumfang_XIX_Klima.Geltungsbereich_E3_1_1_UNECE_Gen2.SP_IF_KPVe_Auto_Toggle_XIX_Grundumfang_XIX_Klima.DE_KPVe_Auto_Toggle, system-signal=KPVe_Auto_Toggle
        communication-direction=OUT, data-element=Grundumfang_XIX_Klima.Geltungsbereich_E3_1_1_UNECE_Gen2.SP_IF_KPVe_Einheit_XIX_Grundumfang_XIX_Klima.DE_KPVe_Einheit, system-signal=KPVe_Einheit
        communication-direction=OUT, data-element=Grundumfang_XIX_Klima.Geltungsbereich_E3_1_1_UNECE_Gen2.SP_IF_KPVe_Funktion_AC_XIX_Grundumfang_XIX_Klima.DE_KPVe_Funktion_AC, system-signal=KPVe_Funktion_AC
        communication-direction=OUT, data-element=Grundumfang_XIX_Klima.Geltungsbereich_E3_1_1_UNECE_Gen2.SP_IF_KPVe_Funktion_AC_max_XIX_Grundumfang_XIX_Klima.DE_KPVe_Funktion_AC_max, system-signal=KPVe_Funktion_AC_max
        communication-direction=OUT, data-element=Grundumfang_XIX_Klima.Geltungsbereich_E3_1_1_UNECE_Gen2.SP_IF_KPVe_Funktion_Auto_li_XIX_Grundumfang_XIX_Klima.DE_KPVe_Funktion_Auto_li, system-signal=KPVe_Funktion_Auto_li
        communication-direction=OUT, data-element=Grundumfang_XIX_Klima.Geltungsbereich_E3_1_1_UNECE_Gen2.SP_IF_KPVe_Funktion_AutoSiKli_li_XIX_Grundumfang_XIX_Klima.DE_KPVe_Funktion_AutoSiKli_li, system-signal=KPVe_Funktion_AutoSiKli_li
        communication-direction=OUT, data-element=Grundumfang_XIX_Klima.Geltungsbereich_E3_1_1_UNECE_Gen2.SP_IF_KPVe_Funktion_AutoSiKli_re_XIX_Grundumfang_XIX_Klima.DE_KPVe_Funktion_AutoSiKli_re, system-signal=KPVe_Funktion_AutoSiKli_re
        communication-direction=OUT, data-element=Grundumfang_XIX_Klima.Geltungsbereich_E3_1_1_UNECE_Gen2.SP_IF_KPVe_Funktion_AutoUmluft_XIX_Grundumfang_XIX_Klima.DE_KPVe_Funktion_AutoUmluft, system-signal=KPVe_Funktion_AutoUmluft
        communication-direction=OUT, data-element=Grundumfang_XIX_Klima.Geltungsbereich_E3_1_1_UNECE_Gen2.SP_IF_KPVe_Funktion_Beduftung_XIX_Grundumfang_XIX_Klima.DE_KPVe_Funktion_Beduftung, system-signal=KPVe_Funktion_Beduftung
        communication-direction=OUT, data-element=Grundumfang_XIX_Klima.Geltungsbereich_E3_1_1_UNECE_Gen2.SP_IF_KPVe_Funktion_Defrost_XIX_Grundumfang_XIX_Klima.DE_KPVe_Funktion_Defrost, system-signal=KPVe_Funktion_Defrost
        communication-direction=OUT, data-element=Grundumfang_XIX_Klima.Geltungsbereich_E3_1_1_UNECE_Gen2.SP_IF_KPVe_Funktion_ECO_XIX_Grundumfang_XIX_Klima.DE_KPVe_Funktion_ECO, system-signal=KPVe_Funktion_ECO
        communication-direction=OUT, data-element=Grundumfang_XIX_Klima.Geltungsbereich_E3_1_1_UNECE_Gen2.SP_IF_KPVe_Funktion_ECO_Zone_XIX_Grundumfang_XIX_Klima.DE_KPVe_Funktion_ECO_Zone, system-signal=KPVe_Funktion_ECO_Zone
        communication-direction=OUT, data-element=Grundumfang_XIX_Klima.Geltungsbereich_E3_1_1_UNECE_Gen2.SP_IF_KPVe_Funktion_FSH_XIX_Grundumfang_XIX_Klima.DE_KPVe_Funktion_FSH, system-signal=KPVe_Funktion_FSH
        communication-direction=OUT, data-element=Grundumfang_XIX_Klima.Geltungsbereich_E3_1_1_UNECE_Gen2.SP_IF_KPVe_Funktion_HSH_XIX_Grundumfang_XIX_Klima.DE_KPVe_Funktion_HSH, system-signal=KPVe_Funktion_HSH
        communication-direction=OUT, data-element=Grundumfang_XIX_Klima.Geltungsbereich_E3_1_1_UNECE_Gen2.SP_IF_KPVe_Funktion_Ionisator_XIX_Grundumfang_XIX_Klima.DE_KPVe_Funktion_Ionisator, system-signal=KPVe_Funktion_Ionisator
        communication-direction=OUT, data-element=Grundumfang_XIX_Klima.Geltungsbereich_E3_1_1_UNECE_Gen2.SP_IF_KPVe_Funktion_Joker_Taste_XIX_Grundumfang_XIX_Klima.DE_KPVe_Funktion_Joker_Taste, system-signal=KPVe_Funktion_Joker_Taste
        communication-direction=OUT, data-element=Grundumfang_XIX_Klima.Geltungsbereich_E3_1_1_UNECE_Gen2.SP_IF_KPVe_Funktion_Klima_Menue_MMI_XIX_Grundumfang_XIX_Klima.DE_KPVe_Funktion_Klima_Menue_MMI, system-signal=KPVe_Funktion_Klima_Menue_MMI
        communication-direction=OUT, data-element=Grundumfang_XIX_Klima.Geltungsbereich_E3_1_1_UNECE_Gen2.SP_IF_KPVe_Funktion_Konditionierung_XIX_Grundumfang_XIX_Klima.DE_KPVe_Funktion_Konditionierung, system-signal=KPVe_Funktion_Konditionierung
        communication-direction=OUT, data-element=Grundumfang_XIX_Klima.Geltungsbereich_E3_1_1_UNECE_Gen2.SP_IF_KPVe_Funktion_Locked_XIX_Grundumfang_XIX_Klima.DE_KPVe_Funktion_Locked, system-signal=KPVe_Funktion_Locked
        communication-direction=OUT, data-element=Grundumfang_XIX_Klima.Geltungsbereich_E3_1_1_UNECE_Gen2.SP_IF_KPVe_Funktion_OBD_XIX_Grundumfang_XIX_Klima.DE_KPVe_Funktion_OBD, system-signal=KPVe_Funktion_OBD
        communication-direction=OUT, data-element=Grundumfang_XIX_Klima.Geltungsbereich_E3_1_1_UNECE_Gen2.SP_IF_KPVe_Funktion_Off_XIX_Grundumfang_XIX_Klima.DE_KPVe_Funktion_Off, system-signal=KPVe_Funktion_Off
        communication-direction=OUT, data-element=Grundumfang_XIX_Klima.Geltungsbereich_E3_1_1_UNECE_Gen2.SP_IF_KPVe_Funktion_PureAir_XIX_Grundumfang_XIX_Klima.DE_KPVe_Funktion_PureAir, system-signal=KPVe_Funktion_PureAir
        communication-direction=OUT, data-element=Grundumfang_XIX_Klima.Geltungsbereich_E3_1_1_UNECE_Gen2.SP_IF_KPVe_Funktion_Rear_XIX_Grundumfang_XIX_Klima.DE_KPVe_Funktion_Rear, system-signal=KPVe_Funktion_Rear
        communication-direction=OUT, data-element=Grundumfang_XIX_Klima.Geltungsbereich_E3_1_1_UNECE_Gen2.SP_IF_KPVe_Funktion_Restwaerme_XIX_Grundumfang_XIX_Klima.DE_KPVe_Funktion_Restwaerme, system-signal=KPVe_Funktion_Restwaerme
        communication-direction=OUT, data-element=Grundumfang_XIX_Klima.Geltungsbereich_E3_1_1_UNECE_Gen2.SP_IF_KPVe_Funktion_Sync_XIX_Grundumfang_XIX_Klima.DE_KPVe_Funktion_Sync, system-signal=KPVe_Funktion_Sync
        communication-direction=OUT, data-element=Grundumfang_XIX_Klima.Geltungsbereich_E3_1_1_UNECE_Gen2.SP_IF_KPVe_Funktion_Umluft_XIX_Grundumfang_XIX_Klima.DE_KPVe_Funktion_Umluft, system-signal=KPVe_Funktion_Umluft
        communication-direction=OUT, data-element=Grundumfang_XIX_Klima.Geltungsbereich_E3_1_1_UNECE_Gen2.SP_IF_KPVe_Funktionsbeleuchtung_XIX_Grundumfang_XIX_Klima.DE_KPVe_Funktionsbeleuchtung, system-signal=KPVe_Funktionsbeleuchtung
        communication-direction=OUT, data-element=Grundumfang_XIX_Klima.Geltungsbereich_E3_1_1_UNECE_Gen2.SP_IF_KPVe_Geblaese_Auto_li_XIX_Grundumfang_XIX_Klima.DE_KPVe_Geblaese_Auto_li, system-signal=KPVe_Geblaese_Auto_li
        communication-direction=OUT, data-element=Grundumfang_XIX_Klima.Geltungsbereich_E3_1_1_UNECE_Gen2.SP_IF_KPVe_Geblaese_Begrenzung_XIX_Grundumfang_XIX_Klima.DE_KPVe_Geblaese_Begrenzung, system-signal=KPVe_Geblaese_Begrenzung
        communication-direction=OUT, data-element=Grundumfang_XIX_Klima.Geltungsbereich_E3_1_1_UNECE_Gen2.SP_IF_KPVe_Geblaese_Stufe_li_XIX_Grundumfang_XIX_Klima.DE_KPVe_Geblaese_Stufe_li, system-signal=KPVe_Geblaese_Stufe_li
        communication-direction=OUT, data-element=Grundumfang_XIX_Klima.Geltungsbereich_E3_1_1_UNECE_Gen2.SP_IF_KPVe_Kopfraumheizung_li_XIX_Grundumfang_XIX_Klima.DE_KPVe_Kopfraumheizung_li, system-signal=KPVe_Kopfraumheizung_li
        communication-direction=OUT, data-element=Grundumfang_XIX_Klima.Geltungsbereich_E3_1_1_UNECE_Gen2.SP_IF_KPVe_Kopfraumheizung_re_XIX_Grundumfang_XIX_Klima.DE_KPVe_Kopfraumheizung_re, system-signal=KPVe_Kopfraumheizung_re
        communication-direction=OUT, data-element=Grundumfang_XIX_Klima.Geltungsbereich_E3_1_1_UNECE_Gen2.SP_IF_KPVe_LCD_XIX_Grundumfang_XIX_Klima.DE_KPVe_LCD, system-signal=KPVe_LCD
        communication-direction=OUT, data-element=Grundumfang_XIX_Klima.Geltungsbereich_E3_1_1_UNECE_Gen2.SP_IF_KPVe_Lenker_Position_XIX_Grundumfang_XIX_Klima.DE_KPVe_Lenker_Position, system-signal=KPVe_Lenker_Position
        communication-direction=OUT, data-element=Grundumfang_XIX_Klima.Geltungsbereich_E3_1_1_UNECE_Gen2.SP_IF_KPVe_Luftverteilung_Auto_li_XIX_Grundumfang_XIX_Klima.DE_KPVe_Luftverteilung_Auto_li, system-signal=KPVe_Luftverteilung_Auto_li
        communication-direction=OUT, data-element=Grundumfang_XIX_Klima.Geltungsbereich_E3_1_1_UNECE_Gen2.SP_IF_KPVe_Luftverteilung_Mitte_li_XIX_Grundumfang_XIX_Klima.DE_KPVe_Luftverteilung_Mitte_li, system-signal=KPVe_Luftverteilung_Mitte_li
        communication-direction=OUT, data-element=Grundumfang_XIX_Klima.Geltungsbereich_E3_1_1_UNECE_Gen2.SP_IF_KPVe_Luftverteilung_Oben_li_XIX_Grundumfang_XIX_Klima.DE_KPVe_Luftverteilung_Oben_li, system-signal=KPVe_Luftverteilung_Oben_li
        communication-direction=OUT, data-element=Grundumfang_XIX_Klima.Geltungsbereich_E3_1_1_UNECE_Gen2.SP_IF_KPVe_Luftverteilung_Unten_li_XIX_Grundumfang_XIX_Klima.DE_KPVe_Luftverteilung_Unten_li, system-signal=KPVe_Luftverteilung_Unten_li
        communication-direction=OUT, data-element=Grundumfang_XIX_Klima.Geltungsbereich_E3_1_1_UNECE_Gen2.SP_IF_KPVe_OBD_Gruppe_XIX_Grundumfang_XIX_Klima.DE_KPVe_OBD_Gruppe, system-signal=KPVe_OBD_Gruppe
        communication-direction=OUT, data-element=Grundumfang_XIX_Klima.Geltungsbereich_E3_1_1_UNECE_Gen2.SP_IF_KPVe_Sitzheizung_li_XIX_Grundumfang_XIX_Klima.DE_KPVe_Sitzheizung_li, system-signal=KPVe_Sitzheizung_li
        communication-direction=OUT, data-element=Grundumfang_XIX_Klima.Geltungsbereich_E3_1_1_UNECE_Gen2.SP_IF_KPVe_Sitzheizung_re_XIX_Grundumfang_XIX_Klima.DE_KPVe_Sitzheizung_re, system-signal=KPVe_Sitzheizung_re
        communication-direction=OUT, data-element=Grundumfang_XIX_Klima.Geltungsbereich_E3_1_1_UNECE_Gen2.SP_IF_KPVe_Sitzlueftung_li_XIX_Grundumfang_XIX_Klima.DE_KPVe_Sitzlueftung_li, system-signal=KPVe_Sitzlueftung_li
        communication-direction=OUT, data-element=Grundumfang_XIX_Klima.Geltungsbereich_E3_1_1_UNECE_Gen2.SP_IF_KPVe_Sitzlueftung_re_XIX_Grundumfang_XIX_Klima.DE_KPVe_Sitzlueftung_re, system-signal=KPVe_Sitzlueftung_re
        communication-direction=OUT, data-element=Grundumfang_XIX_Klima.Geltungsbereich_E3_1_1_UNECE_Gen2.SP_IF_KPVe_Suchbeleuchtung_XIX_Grundumfang_XIX_Klima.DE_KPVe_Suchbeleuchtung, system-signal=KPVe_Suchbeleuchtung
        communication-direction=OUT, data-element=Grundumfang_XIX_Klima.Geltungsbereich_E3_1_1_UNECE_Gen2.SP_IF_KPVe_Symbol_Luftmenge_li_XIX_Grundumfang_XIX_Klima.DE_KPVe_Symbol_Luftmenge_li, system-signal=KPVe_Symbol_Luftmenge_li
        communication-direction=OUT, data-element=Grundumfang_XIX_Klima.Geltungsbereich_E3_1_1_UNECE_Gen2.SP_IF_KPVe_Symbol_Luftverteilung_li_XIX_Grundumfang_XIX_Klima.DE_KPVe_Symbol_Luftverteilung_li, system-signal=KPVe_Symbol_Luftverteilung_li
        communication-direction=OUT, data-element=Grundumfang_XIX_Klima.Geltungsbereich_E3_1_1_UNECE_Gen2.SP_IF_KPVe_Temp_li_XIX_Grundumfang_XIX_Klima.DE_KPVe_Temp_li, system-signal=KPVe_Temp_li
        communication-direction=OUT, data-element=Grundumfang_XIX_Klima.Geltungsbereich_E3_1_1_UNECE_Gen2.SP_IF_KPVe_Temp_re_XIX_Grundumfang_XIX_Klima.DE_KPVe_Temp_re, system-signal=KPVe_Temp_re
        communication-direction=OUT, data-element=Grundumfang_XIX_Klima.Geltungsbereich_E3_1_1_UNECE_Gen2.SP_IF_KPVe_Verbau_AutoSikli_XIX_Grundumfang_XIX_Klima.DE_KPVe_Verbau_AutoSikli, system-signal=KPVe_Verbau_AutoSikli
        communication-direction=OUT, data-element=Grundumfang_XIX_Klima.Geltungsbereich_E3_1_1_UNECE_Gen2.SP_IF_KRH_Soll_li_XIX_Grundumfang_XIX_Klima.DE_KRH_Soll_li, system-signal=KRH_Soll_li
        communication-direction=OUT, data-element=Grundumfang_XIX_Klima.Geltungsbereich_E3_1_1_UNECE_Gen2.SP_IF_KRH_Soll_re_XIX_Grundumfang_XIX_Klima.DE_KRH_Soll_re, system-signal=KRH_Soll_re
        communication-direction=IN, data-element=Grundumfang_XIX_Klima.Geltungsbereich_E3_1_1_UNECE_Gen2.RP_IF_KST_Sonderzustand_Status_XIX_Grundumfang_XIX_Klima.DE_KST_Sonderzustand_Status, system-signal=KST_Sonderzustand_Status
        communication-direction=IN, data-element=Grundumfang_XIX_Klima.Geltungsbereich_E3_1_1_UNECE_Gen2.RP_IF_KVA_Ist_Pos_XIX_Grundumfang_XIX_Klima.DE_KVA_Ist_Pos, system-signal=KVA_Ist_Pos
        communication-direction=IN, data-element=Grundumfang_XIX_Klima.Geltungsbereich_E3_1_1_UNECE_Gen2.RP_IF_Ladezustand_02_XIX_Grundumfang_XIX_Klima.DE_Ladezustand_02, system-signal=Ladezustand_02
        communication-direction=IN, data-element=Grundumfang_XIX_Klima.Geltungsbereich_E3_1_1_UNECE_Gen2.RP_IF_LHR_01_FnAbbruch_Heizkreis_A_XIX_Grundumfang_XIX_Klima.DE_LHR_01_FnAbbruch_Heizkreis_A, system-signal=LHR_01_FnAbbruch_Heizkreis_A
        communication-direction=IN, data-element=Grundumfang_XIX_Klima.Geltungsbereich_E3_1_1_UNECE_Gen2.RP_IF_LHR_01_FnAbbruch_Heizkreis_B_XIX_Grundumfang_XIX_Klima.DE_LHR_01_FnAbbruch_Heizkreis_B, system-signal=LHR_01_FnAbbruch_Heizkreis_B
        communication-direction=IN, data-element=Grundumfang_XIX_Klima.Geltungsbereich_E3_1_1_UNECE_Gen2.RP_IF_LHR_01_NTC_Temperatur_A_XIX_Grundumfang_XIX_Klima.DE_LHR_01_NTC_Temperatur_A, system-signal=LHR_01_NTC_Temperatur_A
        communication-direction=IN, data-element=Grundumfang_XIX_Klima.Geltungsbereich_E3_1_1_UNECE_Gen2.RP_IF_LHR_01_NTC_Temperatur_B_XIX_Grundumfang_XIX_Klima.DE_LHR_01_NTC_Temperatur_B, system-signal=LHR_01_NTC_Temperatur_B
        communication-direction=IN, data-element=Grundumfang_XIX_Klima.Geltungsbereich_E3_1_1_UNECE_Gen2.RP_IF_LHR_01_ResponseError_XIX_Grundumfang_XIX_Klima.DE_LHR_01_ResponseError, system-signal=LHR_01_ResponseError
        communication-direction=IN, data-element=Grundumfang_XIX_Klima.Geltungsbereich_E3_1_1_UNECE_Gen2.RP_IF_LHR_01_SG_defekt_XIX_Grundumfang_XIX_Klima.DE_LHR_01_SG_defekt, system-signal=LHR_01_SG_defekt
        communication-direction=IN, data-element=Grundumfang_XIX_Klima.Geltungsbereich_E3_1_1_UNECE_Gen2.RP_IF_LHR_01_Status_Ausgang_A_02_XIX_Grundumfang_XIX_Klima.DE_LHR_01_Status_Ausgang_A_02, system-signal=LHR_01_Status_Ausgang_A_02
        communication-direction=IN, data-element=Grundumfang_XIX_Klima.Geltungsbereich_E3_1_1_UNECE_Gen2.RP_IF_LHR_01_Status_Ausgang_B_02_XIX_Grundumfang_XIX_Klima.DE_LHR_01_Status_Ausgang_B_02, system-signal=LHR_01_Status_Ausgang_B_02
        communication-direction=IN, data-element=Grundumfang_XIX_Klima.Geltungsbereich_E3_1_1_UNECE_Gen2.RP_IF_LHR_01_Status_CodierPins_XIX_Grundumfang_XIX_Klima.DE_LHR_01_Status_CodierPins, system-signal=LHR_01_Status_CodierPins
        communication-direction=IN, data-element=Grundumfang_XIX_Klima.Geltungsbereich_E3_1_1_UNECE_Gen2.RP_IF_LHR_01_Status_PCB_Uebertemp_XIX_Grundumfang_XIX_Klima.DE_LHR_01_Status_PCB_Uebertemp, system-signal=LHR_01_Status_PCB_Uebertemp
        communication-direction=IN, data-element=Grundumfang_XIX_Klima.Geltungsbereich_E3_1_1_UNECE_Gen2.RP_IF_LHR_01_Status_Taster_A_XIX_Grundumfang_XIX_Klima.DE_LHR_01_Status_Taster_A, system-signal=LHR_01_Status_Taster_A
        communication-direction=IN, data-element=Grundumfang_XIX_Klima.Geltungsbereich_E3_1_1_UNECE_Gen2.RP_IF_LHR_01_Status_Taster_B_XIX_Grundumfang_XIX_Klima.DE_LHR_01_Status_Taster_B, system-signal=LHR_01_Status_Taster_B
        communication-direction=OUT, data-element=Grundumfang_XIX_Klima.Geltungsbereich_E3_1_1_UNECE_Gen2.SP_IF_LHRe_01_AnsteuerVorgabe_A_XIX_Grundumfang_XIX_Klima.DE_LHRe_01_AnsteuerVorgabe_A, system-signal=LHRe_01_AnsteuerVorgabe_A
        communication-direction=OUT, data-element=Grundumfang_XIX_Klima.Geltungsbereich_E3_1_1_UNECE_Gen2.SP_IF_LHRe_01_AnsteuerVorgabe_B_XIX_Grundumfang_XIX_Klima.DE_LHRe_01_AnsteuerVorgabe_B, system-signal=LHRe_01_AnsteuerVorgabe_B
        communication-direction=OUT, data-element=Grundumfang_XIX_Klima.Geltungsbereich_E3_1_1_UNECE_Gen2.SP_IF_LHRe_01_Config_NTC_A_XIX_Grundumfang_XIX_Klima.DE_LHRe_01_Config_NTC_A, system-signal=LHRe_01_Config_NTC_A
        communication-direction=OUT, data-element=Grundumfang_XIX_Klima.Geltungsbereich_E3_1_1_UNECE_Gen2.SP_IF_LHRe_01_Config_NTC_B_XIX_Grundumfang_XIX_Klima.DE_LHRe_01_Config_NTC_B, system-signal=LHRe_01_Config_NTC_B
        communication-direction=OUT, data-element=Grundumfang_XIX_Klima.Geltungsbereich_E3_1_1_UNECE_Gen2.SP_IF_LHRe_Global_Unterbrechen_Inv_XIX_Grundumfang_XIX_Klima.DE_LHRe_Global_Unterbrechen_Inv, system-signal=LHRe_Global_Unterbrechen_Inv
        communication-direction=IN, data-element=Grundumfang_XIX_Klima.Geltungsbereich_E3_1_1_UNECE_Gen2.RP_IF_LiSi_Defrost_Taste_XIX_Grundumfang_XIX_Klima.DE_LiSi_Defrost_Taste, system-signal=LiSi_Defrost_Taste
        communication-direction=IN, data-element=Grundumfang_XIX_Klima.Geltungsbereich_E3_1_1_UNECE_Gen2.RP_IF_LiSi_FSH_Taste_XIX_Grundumfang_XIX_Klima.DE_LiSi_FSH_Taste, system-signal=LiSi_FSH_Taste
        communication-direction=IN, data-element=Grundumfang_XIX_Klima.Geltungsbereich_E3_1_1_UNECE_Gen2.RP_IF_LiSi_HSH_Taste_XIX_Grundumfang_XIX_Klima.DE_LiSi_HSH_Taste, system-signal=LiSi_HSH_Taste
        communication-direction=IN, data-element=Grundumfang_XIX_Klima.Geltungsbereich_E3_1_1_UNECE_Gen2.RP_IF_LLR_LL1_Blockierung_XIX_Grundumfang_XIX_Klima.DE_LLR_LL1_Blockierung, system-signal=LLR_LL1_Blockierung
        communication-direction=IN, data-element=Grundumfang_XIX_Klima.Geltungsbereich_E3_1_1_UNECE_Gen2.RP_IF_LLR_LL1_CodierPinError_XIX_Grundumfang_XIX_Klima.DE_LLR_LL1_CodierPinError, system-signal=LLR_LL1_CodierPinError
        communication-direction=IN, data-element=Grundumfang_XIX_Klima.Geltungsbereich_E3_1_1_UNECE_Gen2.RP_IF_LLR_LL1_Feuchte01_XIX_Grundumfang_XIX_Klima.DE_LLR_LL1_Feuchte01, system-signal=LLR_LL1_Feuchte01
        communication-direction=IN, data-element=Grundumfang_XIX_Klima.Geltungsbereich_E3_1_1_UNECE_Gen2.RP_IF_LLR_LL1_Feuchte02_XIX_Grundumfang_XIX_Klima.DE_LLR_LL1_Feuchte02, system-signal=LLR_LL1_Feuchte02
        communication-direction=IN, data-element=Grundumfang_XIX_Klima.Geltungsbereich_E3_1_1_UNECE_Gen2.RP_IF_LLR_LL1_Feuchtesensor_01_defekt_XIX_Grundumfang_XIX_Klima.DE_LLR_LL1_Feuchtesensor_01_defekt, system-signal=LLR_LL1_Feuchtesensor_01_defekt
        communication-direction=IN, data-element=Grundumfang_XIX_Klima.Geltungsbereich_E3_1_1_UNECE_Gen2.RP_IF_LLR_LL1_Feuchtesensor_02_defekt_XIX_Grundumfang_XIX_Klima.DE_LLR_LL1_Feuchtesensor_02_defekt, system-signal=LLR_LL1_Feuchtesensor_02_defekt
        communication-direction=IN, data-element=Grundumfang_XIX_Klima.Geltungsbereich_E3_1_1_UNECE_Gen2.RP_IF_LLR_LL1_Ist_Drehzahl_XIX_Grundumfang_XIX_Klima.DE_LLR_LL1_Ist_Drehzahl, system-signal=LLR_LL1_Ist_Drehzahl
        communication-direction=IN, data-element=Grundumfang_XIX_Klima.Geltungsbereich_E3_1_1_UNECE_Gen2.RP_IF_LLR_LL1_Lokalaktiv_XIX_Grundumfang_XIX_Klima.DE_LLR_LL1_Lokalaktiv, system-signal=LLR_LL1_Lokalaktiv
        communication-direction=IN, data-element=Grundumfang_XIX_Klima.Geltungsbereich_E3_1_1_UNECE_Gen2.RP_IF_LLR_LL1_Luefter_defekt_XIX_Grundumfang_XIX_Klima.DE_LLR_LL1_Luefter_defekt, system-signal=LLR_LL1_Luefter_defekt
        communication-direction=IN, data-element=Grundumfang_XIX_Klima.Geltungsbereich_E3_1_1_UNECE_Gen2.RP_IF_LLR_LL1_ResponseError_XIX_Grundumfang_XIX_Klima.DE_LLR_LL1_ResponseError, system-signal=LLR_LL1_ResponseError
        communication-direction=IN, data-element=Grundumfang_XIX_Klima.Geltungsbereich_E3_1_1_UNECE_Gen2.RP_IF_LLR_LL1_Temperatur_01_XIX_Grundumfang_XIX_Klima.DE_LLR_LL1_Temperatur_01, system-signal=LLR_LL1_Temperatur_01
        communication-direction=IN, data-element=Grundumfang_XIX_Klima.Geltungsbereich_E3_1_1_UNECE_Gen2.RP_IF_LLR_LL1_Temperatur_02_XIX_Grundumfang_XIX_Klima.DE_LLR_LL1_Temperatur_02, system-signal=LLR_LL1_Temperatur_02
        communication-direction=IN, data-element=Grundumfang_XIX_Klima.Geltungsbereich_E3_1_1_UNECE_Gen2.RP_IF_LLR_LL1_Ueberspannung_XIX_Grundumfang_XIX_Klima.DE_LLR_LL1_Ueberspannung, system-signal=LLR_LL1_Ueberspannung
        communication-direction=IN, data-element=Grundumfang_XIX_Klima.Geltungsbereich_E3_1_1_UNECE_Gen2.RP_IF_LLR_LL1_Uebertemperatur_XIX_Grundumfang_XIX_Klima.DE_LLR_LL1_Uebertemperatur, system-signal=LLR_LL1_Uebertemperatur
        communication-direction=IN, data-element=Grundumfang_XIX_Klima.Geltungsbereich_E3_1_1_UNECE_Gen2.RP_IF_LLR_LL1_Unterspannung_XIX_Grundumfang_XIX_Klima.DE_LLR_LL1_Unterspannung, system-signal=LLR_LL1_Unterspannung
        communication-direction=IN, data-element=Grundumfang_XIX_Klima.Geltungsbereich_E3_1_1_UNECE_Gen2.RP_IF_LLR_LS1_Blockierung_XIX_Grundumfang_XIX_Klima.DE_LLR_LS1_Blockierung, system-signal=LLR_LS1_Blockierung
        communication-direction=IN, data-element=Grundumfang_XIX_Klima.Geltungsbereich_E3_1_1_UNECE_Gen2.RP_IF_LLR_LS1_CodierPinError_XIX_Grundumfang_XIX_Klima.DE_LLR_LS1_CodierPinError, system-signal=LLR_LS1_CodierPinError
        communication-direction=IN, data-element=Grundumfang_XIX_Klima.Geltungsbereich_E3_1_1_UNECE_Gen2.RP_IF_LLR_LS1_Feuchte01_XIX_Grundumfang_XIX_Klima.DE_LLR_LS1_Feuchte01, system-signal=LLR_LS1_Feuchte01
        communication-direction=IN, data-element=Grundumfang_XIX_Klima.Geltungsbereich_E3_1_1_UNECE_Gen2.RP_IF_LLR_LS1_Feuchte02_XIX_Grundumfang_XIX_Klima.DE_LLR_LS1_Feuchte02, system-signal=LLR_LS1_Feuchte02
        communication-direction=IN, data-element=Grundumfang_XIX_Klima.Geltungsbereich_E3_1_1_UNECE_Gen2.RP_IF_LLR_LS1_Feuchtesensor_01_defekt_XIX_Grundumfang_XIX_Klima.DE_LLR_LS1_Feuchtesensor_01_defekt, system-signal=LLR_LS1_Feuchtesensor_01_defekt
        communication-direction=IN, data-element=Grundumfang_XIX_Klima.Geltungsbereich_E3_1_1_UNECE_Gen2.RP_IF_LLR_LS1_Feuchtesensor_02_defekt_XIX_Grundumfang_XIX_Klima.DE_LLR_LS1_Feuchtesensor_02_defekt, system-signal=LLR_LS1_Feuchtesensor_02_defekt
        communication-direction=IN, data-element=Grundumfang_XIX_Klima.Geltungsbereich_E3_1_1_UNECE_Gen2.RP_IF_LLR_LS1_Ist_Drehzahl_XIX_Grundumfang_XIX_Klima.DE_LLR_LS1_Ist_Drehzahl, system-signal=LLR_LS1_Ist_Drehzahl
        communication-direction=IN, data-element=Grundumfang_XIX_Klima.Geltungsbereich_E3_1_1_UNECE_Gen2.RP_IF_LLR_LS1_Lokalaktiv_XIX_Grundumfang_XIX_Klima.DE_LLR_LS1_Lokalaktiv, system-signal=LLR_LS1_Lokalaktiv
        communication-direction=IN, data-element=Grundumfang_XIX_Klima.Geltungsbereich_E3_1_1_UNECE_Gen2.RP_IF_LLR_LS1_Luefter_defekt_XIX_Grundumfang_XIX_Klima.DE_LLR_LS1_Luefter_defekt, system-signal=LLR_LS1_Luefter_defekt
        communication-direction=IN, data-element=Grundumfang_XIX_Klima.Geltungsbereich_E3_1_1_UNECE_Gen2.RP_IF_LLR_LS1_ResponseError_XIX_Grundumfang_XIX_Klima.DE_LLR_LS1_ResponseError, system-signal=LLR_LS1_ResponseError
        communication-direction=IN, data-element=Grundumfang_XIX_Klima.Geltungsbereich_E3_1_1_UNECE_Gen2.RP_IF_LLR_LS1_Temperatur_01_XIX_Grundumfang_XIX_Klima.DE_LLR_LS1_Temperatur_01, system-signal=LLR_LS1_Temperatur_01
        communication-direction=IN, data-element=Grundumfang_XIX_Klima.Geltungsbereich_E3_1_1_UNECE_Gen2.RP_IF_LLR_LS1_Temperatur_02_XIX_Grundumfang_XIX_Klima.DE_LLR_LS1_Temperatur_02, system-signal=LLR_LS1_Temperatur_02
        communication-direction=IN, data-element=Grundumfang_XIX_Klima.Geltungsbereich_E3_1_1_UNECE_Gen2.RP_IF_LLR_LS1_Ueberspannung_XIX_Grundumfang_XIX_Klima.DE_LLR_LS1_Ueberspannung, system-signal=LLR_LS1_Ueberspannung
        communication-direction=IN, data-element=Grundumfang_XIX_Klima.Geltungsbereich_E3_1_1_UNECE_Gen2.RP_IF_LLR_LS1_Uebertemperatur_XIX_Grundumfang_XIX_Klima.DE_LLR_LS1_Uebertemperatur, system-signal=LLR_LS1_Uebertemperatur
        communication-direction=IN, data-element=Grundumfang_XIX_Klima.Geltungsbereich_E3_1_1_UNECE_Gen2.RP_IF_LLR_LS1_Unterspannung_XIX_Grundumfang_XIX_Klima.DE_LLR_LS1_Unterspannung, system-signal=LLR_LS1_Unterspannung
        communication-direction=IN, data-element=Grundumfang_XIX_Klima.Geltungsbereich_E3_1_1_UNECE_Gen2.RP_IF_LLR_LS2_Blockierung_XIX_Grundumfang_XIX_Klima.DE_LLR_LS2_Blockierung, system-signal=LLR_LS2_Blockierung
        communication-direction=IN, data-element=Grundumfang_XIX_Klima.Geltungsbereich_E3_1_1_UNECE_Gen2.RP_IF_LLR_LS2_CodierPinError_XIX_Grundumfang_XIX_Klima.DE_LLR_LS2_CodierPinError, system-signal=LLR_LS2_CodierPinError
        communication-direction=IN, data-element=Grundumfang_XIX_Klima.Geltungsbereich_E3_1_1_UNECE_Gen2.RP_IF_LLR_LS2_Ist_Drehzahl_XIX_Grundumfang_XIX_Klima.DE_LLR_LS2_Ist_Drehzahl, system-signal=LLR_LS2_Ist_Drehzahl
        communication-direction=IN, data-element=Grundumfang_XIX_Klima.Geltungsbereich_E3_1_1_UNECE_Gen2.RP_IF_LLR_LS2_Lokalaktiv_XIX_Grundumfang_XIX_Klima.DE_LLR_LS2_Lokalaktiv, system-signal=LLR_LS2_Lokalaktiv
        communication-direction=IN, data-element=Grundumfang_XIX_Klima.Geltungsbereich_E3_1_1_UNECE_Gen2.RP_IF_LLR_LS2_Luefter_defekt_XIX_Grundumfang_XIX_Klima.DE_LLR_LS2_Luefter_defekt, system-signal=LLR_LS2_Luefter_defekt
        communication-direction=IN, data-element=Grundumfang_XIX_Klima.Geltungsbereich_E3_1_1_UNECE_Gen2.RP_IF_LLR_LS2_ResponseError_XIX_Grundumfang_XIX_Klima.DE_LLR_LS2_ResponseError, system-signal=LLR_LS2_ResponseError
        communication-direction=IN, data-element=Grundumfang_XIX_Klima.Geltungsbereich_E3_1_1_UNECE_Gen2.RP_IF_LLR_LS2_Ueberspannung_XIX_Grundumfang_XIX_Klima.DE_LLR_LS2_Ueberspannung, system-signal=LLR_LS2_Ueberspannung
        communication-direction=IN, data-element=Grundumfang_XIX_Klima.Geltungsbereich_E3_1_1_UNECE_Gen2.RP_IF_LLR_LS2_Uebertemperatur_XIX_Grundumfang_XIX_Klima.DE_LLR_LS2_Uebertemperatur, system-signal=LLR_LS2_Uebertemperatur
        communication-direction=IN, data-element=Grundumfang_XIX_Klima.Geltungsbereich_E3_1_1_UNECE_Gen2.RP_IF_LLR_LS2_Unterspannung_XIX_Grundumfang_XIX_Klima.DE_LLR_LS2_Unterspannung, system-signal=LLR_LS2_Unterspannung
        communication-direction=IN, data-element=Grundumfang_XIX_Klima.Geltungsbereich_E3_1_1_UNECE_Gen2.RP_IF_LLR_RL1_Blockierung_XIX_Grundumfang_XIX_Klima.DE_LLR_RL1_Blockierung, system-signal=LLR_RL1_Blockierung
        communication-direction=IN, data-element=Grundumfang_XIX_Klima.Geltungsbereich_E3_1_1_UNECE_Gen2.RP_IF_LLR_RL1_CodierPinError_XIX_Grundumfang_XIX_Klima.DE_LLR_RL1_CodierPinError, system-signal=LLR_RL1_CodierPinError
        communication-direction=IN, data-element=Grundumfang_XIX_Klima.Geltungsbereich_E3_1_1_UNECE_Gen2.RP_IF_LLR_RL1_Feuchte01_XIX_Grundumfang_XIX_Klima.DE_LLR_RL1_Feuchte01, system-signal=LLR_RL1_Feuchte01
        communication-direction=IN, data-element=Grundumfang_XIX_Klima.Geltungsbereich_E3_1_1_UNECE_Gen2.RP_IF_LLR_RL1_Feuchte02_XIX_Grundumfang_XIX_Klima.DE_LLR_RL1_Feuchte02, system-signal=LLR_RL1_Feuchte02
        communication-direction=IN, data-element=Grundumfang_XIX_Klima.Geltungsbereich_E3_1_1_UNECE_Gen2.RP_IF_LLR_RL1_Feuchtesensor_01_defekt_XIX_Grundumfang_XIX_Klima.DE_LLR_RL1_Feuchtesensor_01_defekt, system-signal=LLR_RL1_Feuchtesensor_01_defekt
        communication-direction=IN, data-element=Grundumfang_XIX_Klima.Geltungsbereich_E3_1_1_UNECE_Gen2.RP_IF_LLR_RL1_Feuchtesensor_02_defekt_XIX_Grundumfang_XIX_Klima.DE_LLR_RL1_Feuchtesensor_02_defekt, system-signal=LLR_RL1_Feuchtesensor_02_defekt
        communication-direction=IN, data-element=Grundumfang_XIX_Klima.Geltungsbereich_E3_1_1_UNECE_Gen2.RP_IF_LLR_RL1_Ist_Drehzahl_XIX_Grundumfang_XIX_Klima.DE_LLR_RL1_Ist_Drehzahl, system-signal=LLR_RL1_Ist_Drehzahl
        communication-direction=IN, data-element=Grundumfang_XIX_Klima.Geltungsbereich_E3_1_1_UNECE_Gen2.RP_IF_LLR_RL1_Lokalaktiv_XIX_Grundumfang_XIX_Klima.DE_LLR_RL1_Lokalaktiv, system-signal=LLR_RL1_Lokalaktiv
        communication-direction=IN, data-element=Grundumfang_XIX_Klima.Geltungsbereich_E3_1_1_UNECE_Gen2.RP_IF_LLR_RL1_Luefter_defekt_XIX_Grundumfang_XIX_Klima.DE_LLR_RL1_Luefter_defekt, system-signal=LLR_RL1_Luefter_defekt
        communication-direction=IN, data-element=Grundumfang_XIX_Klima.Geltungsbereich_E3_1_1_UNECE_Gen2.RP_IF_LLR_RL1_ResponseError_XIX_Grundumfang_XIX_Klima.DE_LLR_RL1_ResponseError, system-signal=LLR_RL1_ResponseError
        communication-direction=IN, data-element=Grundumfang_XIX_Klima.Geltungsbereich_E3_1_1_UNECE_Gen2.RP_IF_LLR_RL1_Temperatur_01_XIX_Grundumfang_XIX_Klima.DE_LLR_RL1_Temperatur_01, system-signal=LLR_RL1_Temperatur_01
        communication-direction=IN, data-element=Grundumfang_XIX_Klima.Geltungsbereich_E3_1_1_UNECE_Gen2.RP_IF_LLR_RL1_Temperatur_02_XIX_Grundumfang_XIX_Klima.DE_LLR_RL1_Temperatur_02, system-signal=LLR_RL1_Temperatur_02
        communication-direction=IN, data-element=Grundumfang_XIX_Klima.Geltungsbereich_E3_1_1_UNECE_Gen2.RP_IF_LLR_RL1_Ueberspannung_XIX_Grundumfang_XIX_Klima.DE_LLR_RL1_Ueberspannung, system-signal=LLR_RL1_Ueberspannung
        communication-direction=IN, data-element=Grundumfang_XIX_Klima.Geltungsbereich_E3_1_1_UNECE_Gen2.RP_IF_LLR_RL1_Uebertemperatur_XIX_Grundumfang_XIX_Klima.DE_LLR_RL1_Uebertemperatur, system-signal=LLR_RL1_Uebertemperatur
        communication-direction=IN, data-element=Grundumfang_XIX_Klima.Geltungsbereich_E3_1_1_UNECE_Gen2.RP_IF_LLR_RL1_Unterspannung_XIX_Grundumfang_XIX_Klima.DE_LLR_RL1_Unterspannung, system-signal=LLR_RL1_Unterspannung
        communication-direction=IN, data-element=Grundumfang_XIX_Klima.Geltungsbereich_E3_1_1_UNECE_Gen2.RP_IF_LLR_RS1_Blockierung_XIX_Grundumfang_XIX_Klima.DE_LLR_RS1_Blockierung, system-signal=LLR_RS1_Blockierung
        communication-direction=IN, data-element=Grundumfang_XIX_Klima.Geltungsbereich_E3_1_1_UNECE_Gen2.RP_IF_LLR_RS1_CodierPinError_XIX_Grundumfang_XIX_Klima.DE_LLR_RS1_CodierPinError, system-signal=LLR_RS1_CodierPinError
        communication-direction=IN, data-element=Grundumfang_XIX_Klima.Geltungsbereich_E3_1_1_UNECE_Gen2.RP_IF_LLR_RS1_Feuchte01_XIX_Grundumfang_XIX_Klima.DE_LLR_RS1_Feuchte01, system-signal=LLR_RS1_Feuchte01
        communication-direction=IN, data-element=Grundumfang_XIX_Klima.Geltungsbereich_E3_1_1_UNECE_Gen2.RP_IF_LLR_RS1_Feuchte02_XIX_Grundumfang_XIX_Klima.DE_LLR_RS1_Feuchte02, system-signal=LLR_RS1_Feuchte02
        communication-direction=IN, data-element=Grundumfang_XIX_Klima.Geltungsbereich_E3_1_1_UNECE_Gen2.RP_IF_LLR_RS1_Feuchtesensor_01_defekt_XIX_Grundumfang_XIX_Klima.DE_LLR_RS1_Feuchtesensor_01_defekt, system-signal=LLR_RS1_Feuchtesensor_01_defekt
        communication-direction=IN, data-element=Grundumfang_XIX_Klima.Geltungsbereich_E3_1_1_UNECE_Gen2.RP_IF_LLR_RS1_Feuchtesensor_02_defekt_XIX_Grundumfang_XIX_Klima.DE_LLR_RS1_Feuchtesensor_02_defekt, system-signal=LLR_RS1_Feuchtesensor_02_defekt
        communication-direction=IN, data-element=Grundumfang_XIX_Klima.Geltungsbereich_E3_1_1_UNECE_Gen2.RP_IF_LLR_RS1_Ist_Drehzahl_XIX_Grundumfang_XIX_Klima.DE_LLR_RS1_Ist_Drehzahl, system-signal=LLR_RS1_Ist_Drehzahl
        communication-direction=IN, data-element=Grundumfang_XIX_Klima.Geltungsbereich_E3_1_1_UNECE_Gen2.RP_IF_LLR_RS1_Lokalaktiv_XIX_Grundumfang_XIX_Klima.DE_LLR_RS1_Lokalaktiv, system-signal=LLR_RS1_Lokalaktiv
        communication-direction=IN, data-element=Grundumfang_XIX_Klima.Geltungsbereich_E3_1_1_UNECE_Gen2.RP_IF_LLR_RS1_Luefter_defekt_XIX_Grundumfang_XIX_Klima.DE_LLR_RS1_Luefter_defekt, system-signal=LLR_RS1_Luefter_defekt
        communication-direction=IN, data-element=Grundumfang_XIX_Klima.Geltungsbereich_E3_1_1_UNECE_Gen2.RP_IF_LLR_RS1_ResponseError_XIX_Grundumfang_XIX_Klima.DE_LLR_RS1_ResponseError, system-signal=LLR_RS1_ResponseError
        communication-direction=IN, data-element=Grundumfang_XIX_Klima.Geltungsbereich_E3_1_1_UNECE_Gen2.RP_IF_LLR_RS1_Temperatur_01_XIX_Grundumfang_XIX_Klima.DE_LLR_RS1_Temperatur_01, system-signal=LLR_RS1_Temperatur_01
        communication-direction=IN, data-element=Grundumfang_XIX_Klima.Geltungsbereich_E3_1_1_UNECE_Gen2.RP_IF_LLR_RS1_Temperatur_02_XIX_Grundumfang_XIX_Klima.DE_LLR_RS1_Temperatur_02, system-signal=LLR_RS1_Temperatur_02
        communication-direction=IN, data-element=Grundumfang_XIX_Klima.Geltungsbereich_E3_1_1_UNECE_Gen2.RP_IF_LLR_RS1_Ueberspannung_XIX_Grundumfang_XIX_Klima.DE_LLR_RS1_Ueberspannung, system-signal=LLR_RS1_Ueberspannung
        communication-direction=IN, data-element=Grundumfang_XIX_Klima.Geltungsbereich_E3_1_1_UNECE_Gen2.RP_IF_LLR_RS1_Uebertemperatur_XIX_Grundumfang_XIX_Klima.DE_LLR_RS1_Uebertemperatur, system-signal=LLR_RS1_Uebertemperatur
        communication-direction=IN, data-element=Grundumfang_XIX_Klima.Geltungsbereich_E3_1_1_UNECE_Gen2.RP_IF_LLR_RS1_Unterspannung_XIX_Grundumfang_XIX_Klima.DE_LLR_RS1_Unterspannung, system-signal=LLR_RS1_Unterspannung
        communication-direction=IN, data-element=Grundumfang_XIX_Klima.Geltungsbereich_E3_1_1_UNECE_Gen2.RP_IF_LLR_RS2_Blockierung_XIX_Grundumfang_XIX_Klima.DE_LLR_RS2_Blockierung, system-signal=LLR_RS2_Blockierung
        communication-direction=IN, data-element=Grundumfang_XIX_Klima.Geltungsbereich_E3_1_1_UNECE_Gen2.RP_IF_LLR_RS2_CodierPinError_XIX_Grundumfang_XIX_Klima.DE_LLR_RS2_CodierPinError, system-signal=LLR_RS2_CodierPinError
        communication-direction=IN, data-element=Grundumfang_XIX_Klima.Geltungsbereich_E3_1_1_UNECE_Gen2.RP_IF_LLR_RS2_Ist_Drehzahl_XIX_Grundumfang_XIX_Klima.DE_LLR_RS2_Ist_Drehzahl, system-signal=LLR_RS2_Ist_Drehzahl
        communication-direction=IN, data-element=Grundumfang_XIX_Klima.Geltungsbereich_E3_1_1_UNECE_Gen2.RP_IF_LLR_RS2_Lokalaktiv_XIX_Grundumfang_XIX_Klima.DE_LLR_RS2_Lokalaktiv, system-signal=LLR_RS2_Lokalaktiv
        communication-direction=IN, data-element=Grundumfang_XIX_Klima.Geltungsbereich_E3_1_1_UNECE_Gen2.RP_IF_LLR_RS2_Luefter_defekt_XIX_Grundumfang_XIX_Klima.DE_LLR_RS2_Luefter_defekt, system-signal=LLR_RS2_Luefter_defekt
        communication-direction=IN, data-element=Grundumfang_XIX_Klima.Geltungsbereich_E3_1_1_UNECE_Gen2.RP_IF_LLR_RS2_ResponseError_XIX_Grundumfang_XIX_Klima.DE_LLR_RS2_ResponseError, system-signal=LLR_RS2_ResponseError
        communication-direction=IN, data-element=Grundumfang_XIX_Klima.Geltungsbereich_E3_1_1_UNECE_Gen2.RP_IF_LLR_RS2_Ueberspannung_XIX_Grundumfang_XIX_Klima.DE_LLR_RS2_Ueberspannung, system-signal=LLR_RS2_Ueberspannung
        communication-direction=IN, data-element=Grundumfang_XIX_Klima.Geltungsbereich_E3_1_1_UNECE_Gen2.RP_IF_LLR_RS2_Uebertemperatur_XIX_Grundumfang_XIX_Klima.DE_LLR_RS2_Uebertemperatur, system-signal=LLR_RS2_Uebertemperatur
        communication-direction=IN, data-element=Grundumfang_XIX_Klima.Geltungsbereich_E3_1_1_UNECE_Gen2.RP_IF_LLR_RS2_Unterspannung_XIX_Grundumfang_XIX_Klima.DE_LLR_RS2_Unterspannung, system-signal=LLR_RS2_Unterspannung
        communication-direction=IN, data-element=Grundumfang_XIX_Klima.Geltungsbereich_E3_1_1_UNECE_Gen2.RP_IF_LR_HZG_Konfiguration_XIX_Grundumfang_XIX_Klima.DE_LR_HZG_Konfiguration, system-signal=LR_HZG_Konfiguration
        communication-direction=IN, data-element=Grundumfang_XIX_Klima.Geltungsbereich_E3_1_1_UNECE_Gen2.RP_IF_LR_HZG_Temp_Sensor_XIX_Grundumfang_XIX_Klima.DE_LR_HZG_Temp_Sensor, system-signal=LR_HZG_Temp_Sensor
        communication-direction=IN, data-element=Grundumfang_XIX_Klima.Geltungsbereich_E3_1_1_UNECE_Gen2.RP_IF_LRH_On_Off_XIX_Grundumfang_XIX_Klima.DE_LRH_On_Off, system-signal=LRH_On_Off
        communication-direction=IN, data-element=Grundumfang_XIX_Klima.Geltungsbereich_E3_1_1_UNECE_Gen2.RP_IF_LS_Helligkeit_IR_XIX_Grundumfang_XIX_Klima.DE_LS_Helligkeit_IR, system-signal=LS_Helligkeit_IR
        communication-direction=OUT, data-element=Grundumfang_XIX_Klima.Geltungsbereich_E3_1_1_UNECE_Gen2.SP_IF_Luftmenge_Innenraum_PMS_XIX_Grundumfang_XIX_Klima.DE_Luftmenge_Innenraum_PMS, system-signal=Luftmenge_Innenraum_PMS
        communication-direction=IN, data-element=Grundumfang_XIX_Klima.Geltungsbereich_E3_1_1_UNECE_Gen2.RP_IF_MD1_Lage_XIX_Grundumfang_XIX_Klima.DE_MD1_Lage, system-signal=MD1_Lage
        communication-direction=IN, data-element=Grundumfang_XIX_Klima.Geltungsbereich_E3_1_1_UNECE_Gen2.RP_IF_MD1_Position_XIX_Grundumfang_XIX_Klima.DE_MD1_Position, system-signal=MD1_Position
        communication-direction=OUT, data-element=Grundumfang_XIX_Klima.Geltungsbereich_E3_1_1_UNECE_Gen2.SP_IF_MD1_Position_4Bit_XIX_Grundumfang_XIX_Klima.DE_MD1_Position_4Bit, system-signal=MD1_Position_4Bit
        communication-direction=IN, data-element=Grundumfang_XIX_Klima.Geltungsbereich_E3_1_1_UNECE_Gen2.RP_IF_MD3_Lage_XIX_Grundumfang_XIX_Klima.DE_MD3_Lage, system-signal=MD3_Lage
        communication-direction=OUT, data-element=Grundumfang_XIX_Klima.Geltungsbereich_E3_1_1_UNECE_Gen2.SP_IF_Messung_Enable_PMS_XIX_Grundumfang_XIX_Klima.DE_Messung_Enable_PMS, system-signal=Messung_Enable_PMS
        communication-direction=IN, data-element=Grundumfang_XIX_Klima.Geltungsbereich_E3_1_1_UNECE_Gen2.RP_IF_MFL_Eventcode_1_XIX_Grundumfang_XIX_Klima.DE_MFL_Eventcode_1, system-signal=MFL_Eventcode_1
        communication-direction=IN, data-element=Grundumfang_XIX_Klima.Geltungsbereich_E3_1_1_UNECE_Gen2.RP_IF_MFL_Eventcode_2_XIX_Grundumfang_XIX_Klima.DE_MFL_Eventcode_2, system-signal=MFL_Eventcode_2
        communication-direction=IN, data-element=Grundumfang_XIX_Klima.Geltungsbereich_E3_1_1_UNECE_Gen2.RP_IF_MFL_Tastencode_1_XIX_Grundumfang_XIX_Klima.DE_MFL_Tastencode_1, system-signal=MFL_Tastencode_1
        communication-direction=IN, data-element=Grundumfang_XIX_Klima.Geltungsbereich_E3_1_1_UNECE_Gen2.RP_IF_MFL_Tastencode_2_XIX_Grundumfang_XIX_Klima.DE_MFL_Tastencode_2, system-signal=MFL_Tastencode_2
        communication-direction=IN, data-element=Grundumfang_XIX_Klima.Geltungsbereich_E3_1_1_UNECE_Gen2.RP_IF_MFL_Variante_XIX_Grundumfang_XIX_Klima.DE_MFL_Variante, system-signal=MFL_Variante
        communication-direction=IN, data-element=Grundumfang_XIX_Klima.Geltungsbereich_E3_1_1_UNECE_Gen2.RP_IF_MIK_PetsMode_state_XIX_Grundumfang_XIX_Klima.DE_MIK_PetsMode_state, system-signal=MIK_PetsMode_state
        communication-direction=OUT, data-element=Grundumfang_XIX_Klima.Geltungsbereich_E3_1_1_UNECE_Gen2.SP_IF_MO_FSA_Sensorheizung_XIX_Grundumfang_XIX_Klima.DE_MO_FSA_Sensorheizung, system-signal=MO_FSA_Sensorheizung
        communication-direction=IN, data-element=Grundumfang_XIX_Klima.Geltungsbereich_E3_1_1_UNECE_Gen2.RP_IF_MO_HVEM_MaxLeistung_XIX_Grundumfang_XIX_Klima.DE_MO_HVEM_MaxLeistung, system-signal=MO_HVEM_MaxLeistung
        communication-direction=IN, data-element=Grundumfang_XIX_Klima.Geltungsbereich_E3_1_1_UNECE_Gen2.RP_IF_MO_HYB_Fahrbereitschaft_XIX_Grundumfang_XIX_Klima.DE_MO_HYB_Fahrbereitschaft, system-signal=MO_HYB_Fahrbereitschaft
        communication-direction=IN, data-element=Grundumfang_XIX_Klima.Geltungsbereich_E3_1_1_UNECE_Gen2.RP_IF_MO_Hybridfahrzeug_XIX_Grundumfang_XIX_Klima.DE_MO_Hybridfahrzeug, system-signal=MO_Hybridfahrzeug
        communication-direction=IN, data-element=HVEM_Auto_NL_XIX_Klima.Geltungsbereich_E3_1_1_UNECE_Gen2.RP_IF_MO_Hybridfahrzeug_XIX_HVEM_Auto_NL_XIX_Klima.DE_MO_Hybridfahrzeug, system-signal=MO_Hybridfahrzeug
        communication-direction=IN, data-element=Grundumfang_XIX_Klima.Geltungsbereich_E3_1_1_UNECE_Gen2.RP_IF_MO_Klima_Regelmodus_XIX_Grundumfang_XIX_Klima.DE_MO_Klima_Regelmodus, system-signal=MO_Klima_Regelmodus
        communication-direction=IN, data-element=Grundumfang_XIX_Klima.Geltungsbereich_E3_1_1_UNECE_Gen2.RP_IF_MO_Kuehlerluefter_1_XIX_Grundumfang_XIX_Klima.DE_MO_Kuehlerluefter_1, system-signal=MO_Kuehlerluefter_1
        communication-direction=IN, data-element=Grundumfang_XIX_Klima.Geltungsbereich_E3_1_1_UNECE_Gen2.RP_IF_MO_Kuehlerluefter_2_XIX_Grundumfang_XIX_Klima.DE_MO_Kuehlerluefter_2, system-signal=MO_Kuehlerluefter_2
        communication-direction=IN, data-element=Grundumfang_XIX_Klima.Geltungsbereich_E3_1_1_UNECE_Gen2.RP_IF_MO_Kuehlerluefter_MUX_XIX_Grundumfang_XIX_Klima.DE_MO_Kuehlerluefter_MUX, system-signal=MO_Kuehlerluefter_MUX
        communication-direction=IN, data-element=Grundumfang_XIX_Klima.Geltungsbereich_E3_1_1_UNECE_Gen2.RP_IF_MO_OBD_Typ_XIX_Grundumfang_XIX_Klima.DE_MO_OBD_Typ, system-signal=MO_OBD_Typ
        communication-direction=IN, data-element=Grundumfang_XIX_Klima.Geltungsbereich_E3_1_1_UNECE_Gen2.RP_IF_MO_QBit_Aussen_Temp_XIX_Grundumfang_XIX_Klima.DE_MO_QBit_Aussen_Temp, system-signal=MO_QBit_Aussen_Temp
        communication-direction=IN, data-element=Grundumfang_XIX_Klima.Geltungsbereich_E3_1_1_UNECE_Gen2.RP_IF_MO_RedFahrleistung_Lampe_XIX_Grundumfang_XIX_Klima.DE_MO_RedFahrleistung_Lampe, system-signal=MO_RedFahrleistung_Lampe
        communication-direction=IN, data-element=Grundumfang_XIX_Klima.Geltungsbereich_E3_1_1_UNECE_Gen2.RP_IF_MRollo_Lage_XIX_Grundumfang_XIX_Klima.DE_MRollo_Lage, system-signal=MRollo_Lage
        communication-direction=IN, data-element=Grundumfang_XIX_Klima.Geltungsbereich_E3_1_1_UNECE_Gen2.RP_IF_MRollo_Position_XIX_Grundumfang_XIX_Klima.DE_MRollo_Position, system-signal=MRollo_Position
        communication-direction=OUT, data-element=Grundumfang_XIX_Klima.Geltungsbereich_E3_1_1_UNECE_Gen2.SP_IF_MRollo_Position_4Bit_XIX_Grundumfang_XIX_Klima.DE_MRollo_Position_4Bit, system-signal=MRollo_Position_4Bit
        communication-direction=OUT, data-element=Grundumfang_XIX_Klima.Geltungsbereich_E3_1_1_UNECE_Gen2.SP_IF_Navigationsattribute_XIX_Grundumfang_XIX_Klima.DE_Navigationsattribute, system-signal=Navigationsattribute
        communication-direction=IN, data-element=Grundumfang_XIX_Klima.Geltungsbereich_E3_1_1_UNECE_Gen2.RP_IF_ND_PSD_Tunnel_Status_XIX_Grundumfang_XIX_Klima.DE_ND_PSD_Tunnel_Status, system-signal=ND_PSD_Tunnel_Status
        communication-direction=OUT, data-element=Grundumfang_XIX_Klima.Geltungsbereich_E3_1_1_UNECE_Gen2.SP_IF_NM_Klima_CBV_AWB_XIX_Grundumfang_XIX_Klima.DE_NM_Klima_CBV_AWB, system-signal=NM_Klima_CBV_AWB
        communication-direction=OUT, data-element=Grundumfang_XIX_Klima.Geltungsbereich_E3_1_1_UNECE_Gen2.SP_IF_NM_Klima_CBV_CRI_XIX_Grundumfang_XIX_Klima.DE_NM_Klima_CBV_CRI, system-signal=NM_Klima_CBV_CRI
        communication-direction=OUT, data-element=Grundumfang_XIX_Klima.Geltungsbereich_E3_1_1_UNECE_Gen2.SP_IF_NM_Klima_NM_aktiv_Diagnose_XIX_Grundumfang_XIX_Klima.DE_NM_Klima_NM_aktiv_Diagnose, system-signal=NM_Klima_NM_aktiv_Diagnose
        communication-direction=OUT, data-element=Grundumfang_XIX_Klima.Geltungsbereich_E3_1_1_UNECE_Gen2.SP_IF_NM_Klima_NM_aktiv_KL15_XIX_Grundumfang_XIX_Klima.DE_NM_Klima_NM_aktiv_KL15, system-signal=NM_Klima_NM_aktiv_KL15
        communication-direction=OUT, data-element=Grundumfang_XIX_Klima.Geltungsbereich_E3_1_1_UNECE_Gen2.SP_IF_NM_Klima_NM_aktiv_Tmin_XIX_Grundumfang_XIX_Klima.DE_NM_Klima_NM_aktiv_Tmin, system-signal=NM_Klima_NM_aktiv_Tmin
        communication-direction=OUT, data-element=Grundumfang_XIX_Klima.Geltungsbereich_E3_1_1_UNECE_Gen2.SP_IF_NM_Klima_NM_State_XIX_Grundumfang_XIX_Klima.DE_NM_Klima_NM_State, system-signal=NM_Klima_NM_State
        communication-direction=OUT, data-element=Grundumfang_XIX_Klima.Geltungsbereich_E3_1_1_UNECE_Gen2.SP_IF_NM_Klima_UDS_CC_XIX_Grundumfang_XIX_Klima.DE_NM_Klima_UDS_CC, system-signal=NM_Klima_UDS_CC
        communication-direction=OUT, data-element=Grundumfang_XIX_Klima.Geltungsbereich_E3_1_1_UNECE_Gen2.SP_IF_NM_Klima_Wakeup_XIX_Grundumfang_XIX_Klima.DE_NM_Klima_Wakeup, system-signal=NM_Klima_Wakeup
        communication-direction=IN, data-element=Grundumfang_XIX_Klima.Geltungsbereich_E3_1_1_UNECE_Gen2.RP_IF_NVEM_Abschaltstufe_XIX_Grundumfang_XIX_Klima.DE_NVEM_Abschaltstufe, system-signal=NVEM_Abschaltstufe
        communication-direction=IN, data-element=Grundumfang_XIX_Klima.Geltungsbereich_E3_1_1_UNECE_Gen2.RP_IF_NVEM_Last_Anf_XIX_Grundumfang_XIX_Klima.DE_NVEM_Last_Anf, system-signal=NVEM_Last_Anf
        communication-direction=IN, data-element=Grundumfang_XIX_Klima.Geltungsbereich_E3_1_1_UNECE_Gen2.RP_IF_OBD_Abs_Load_Val_XIX_Grundumfang_XIX_Klima.DE_OBD_Abs_Load_Val, system-signal=OBD_Abs_Load_Val
        communication-direction=IN, data-element=Grundumfang_XIX_Klima.Geltungsbereich_E3_1_1_UNECE_Gen2.RP_IF_OBD_Abs_Pedal_Pos_XIX_Grundumfang_XIX_Klima.DE_OBD_Abs_Pedal_Pos, system-signal=OBD_Abs_Pedal_Pos
        communication-direction=IN, data-element=Grundumfang_XIX_Klima.Geltungsbereich_E3_1_1_UNECE_Gen2.RP_IF_OBD_Abs_Throttle_Pos_XIX_Grundumfang_XIX_Klima.DE_OBD_Abs_Throttle_Pos, system-signal=OBD_Abs_Throttle_Pos
        communication-direction=IN, data-element=Grundumfang_XIX_Klima.Geltungsbereich_E3_1_1_UNECE_Gen2.RP_IF_OBD_Calc_Load_Val_XIX_Grundumfang_XIX_Klima.DE_OBD_Calc_Load_Val, system-signal=OBD_Calc_Load_Val
        communication-direction=IN, data-element=Grundumfang_XIX_Klima.Geltungsbereich_E3_1_1_UNECE_Gen2.RP_IF_OBD_Driving_Cycle_XIX_Grundumfang_XIX_Klima.DE_OBD_Driving_Cycle, system-signal=OBD_Driving_Cycle
        communication-direction=IN, data-element=Grundumfang_XIX_Klima.Geltungsbereich_E3_1_1_UNECE_Gen2.RP_IF_OBD_Eng_Cool_Temp_XIX_Grundumfang_XIX_Klima.DE_OBD_Eng_Cool_Temp, system-signal=OBD_Eng_Cool_Temp
        communication-direction=IN, data-element=Grundumfang_XIX_Klima.Geltungsbereich_E3_1_1_UNECE_Gen2.RP_IF_OBD_Kaltstart_Denominator_XIX_Grundumfang_XIX_Klima.DE_OBD_Kaltstart_Denominator, system-signal=OBD_Kaltstart_Denominator
        communication-direction=IN, data-element=Grundumfang_XIX_Klima.Geltungsbereich_E3_1_1_UNECE_Gen2.RP_IF_OBD_Minimum_Trip_XIX_Grundumfang_XIX_Klima.DE_OBD_Minimum_Trip, system-signal=OBD_Minimum_Trip
        communication-direction=IN, data-element=Grundumfang_XIX_Klima.Geltungsbereich_E3_1_1_UNECE_Gen2.RP_IF_OBD_Normed_Trip_XIX_Grundumfang_XIX_Klima.DE_OBD_Normed_Trip, system-signal=OBD_Normed_Trip
        communication-direction=IN, data-element=Grundumfang_XIX_Klima.Geltungsbereich_E3_1_1_UNECE_Gen2.RP_IF_OBD_Sperrung_IUMPR_XIX_Grundumfang_XIX_Klima.DE_OBD_Sperrung_IUMPR, system-signal=OBD_Sperrung_IUMPR
        communication-direction=IN, data-element=Grundumfang_XIX_Klima.Geltungsbereich_E3_1_1_UNECE_Gen2.RP_IF_OBD_Warm_Up_Cycle_XIX_Grundumfang_XIX_Klima.DE_OBD_Warm_Up_Cycle, system-signal=OBD_Warm_Up_Cycle
        communication-direction=OUT, data-element=Grundumfang_XIX_Klima.Geltungsbereich_E3_1_1_UNECE_Gen2.SP_IF_OBDProtocol_Klima_XIX_Grundumfang_XIX_Klima.DE_OBDProtocol_Klima, system-signal=OBDProtocol_Klima
        communication-direction=IN, data-element=Grundumfang_XIX_Klima.Geltungsbereich_E3_1_1_UNECE_Gen2.RP_IF_OBDProtocol_req_XIX_Grundumfang_XIX_Klima.DE_OBDProtocol_req, system-signal=OBDProtocol_req
        communication-direction=IN, data-element=Grundumfang_XIX_Klima.Geltungsbereich_E3_1_1_UNECE_Gen2.RP_IF_OPS_ComfortReadyStatus_XIX_Grundumfang_XIX_Klima.DE_OPS_ComfortReadyStatus, system-signal=OPS_ComfortReadyStatus
        communication-direction=IN, data-element=Grundumfang_XIX_Klima.Geltungsbereich_E3_1_1_UNECE_Gen2.RP_IF_OPS_DriverPresenceStatus_XIX_Grundumfang_XIX_Klima.DE_OPS_DriverPresenceStatus, system-signal=OPS_DriverPresenceStatus
        communication-direction=IN, data-element=Grundumfang_XIX_Klima.Geltungsbereich_E3_1_1_UNECE_Gen2.RP_IF_OPS_OccupantPresenceStatus_XIX_Grundumfang_XIX_Klima.DE_OPS_OccupantPresenceStatus, system-signal=OPS_OccupantPresenceStatus
        communication-direction=IN, data-element=Grundumfang_XIX_Klima.Geltungsbereich_E3_1_1_UNECE_Gen2.RP_IF_OPS_QBit_DriverPresence_XIX_Grundumfang_XIX_Klima.DE_OPS_QBit_DriverPresence, system-signal=OPS_QBit_DriverPresence
        communication-direction=IN, data-element=Grundumfang_XIX_Klima.Geltungsbereich_E3_1_1_UNECE_Gen2.RP_IF_ORU_AP_Mode_XIX_Grundumfang_XIX_Klima.DE_ORU_AP_Mode, system-signal=ORU_AP_Mode
        communication-direction=IN, data-element=Grundumfang_XIX_Klima.Geltungsbereich_E3_1_1_UNECE_Gen2.RP_IF_ORU_EM_Anfrage_Flashdauer_XIX_Grundumfang_XIX_Klima.DE_ORU_EM_Anfrage_Flashdauer, system-signal=ORU_EM_Anfrage_Flashdauer
        communication-direction=IN, data-element=Grundumfang_XIX_Klima.Geltungsbereich_E3_1_1_UNECE_Gen2.RP_IF_ORU_EM_Anfrage_freigegebeneNetze_XIX_Grundumfang_XIX_Klima.DE_ORU_EM_Anfrage_freigegebeneNetze, system-signal=ORU_EM_Anfrage_freigegebeneNetze
        communication-direction=IN, data-element=Grundumfang_XIX_Klima.Geltungsbereich_E3_1_1_UNECE_Gen2.RP_IF_ORU_EM_Anfrage_Stromaufnahme_XIX_Grundumfang_XIX_Klima.DE_ORU_EM_Anfrage_Stromaufnahme, system-signal=ORU_EM_Anfrage_Stromaufnahme
        communication-direction=IN, data-element=Grundumfang_XIX_Klima.Geltungsbereich_E3_1_1_UNECE_Gen2.RP_IF_ORU_Status_XIX_Grundumfang_XIX_Klima.DE_ORU_Status, system-signal=ORU_Status
        communication-direction=IN, data-element=Grundumfang_XIX_Klima.Geltungsbereich_E3_1_1_UNECE_Gen2.RP_IF_PCU_Adressinhalt_XIX_Grundumfang_XIX_Klima.DE_PCU_Adressinhalt, system-signal=PCU_Adressinhalt
        communication-direction=OUT, data-element=Grundumfang_XIX_Klima.Geltungsbereich_E3_1_1_UNECE_Gen2.SP_IF_PCU_Aussentemp_gef_XIX_Grundumfang_XIX_Klima.DE_PCU_Aussentemp_gef, system-signal=PCU_Aussentemp_gef
        communication-direction=IN, data-element=Grundumfang_XIX_Klima.Geltungsbereich_E3_1_1_UNECE_Gen2.RP_IF_PCU_Betriebsstunden_XIX_Grundumfang_XIX_Klima.DE_PCU_Betriebsstunden, system-signal=PCU_Betriebsstunden
        communication-direction=IN, data-element=Grundumfang_XIX_Klima.Geltungsbereich_E3_1_1_UNECE_Gen2.RP_IF_PCU_Defekt_XIX_Grundumfang_XIX_Klima.DE_PCU_Defekt, system-signal=PCU_Defekt
        communication-direction=OUT, data-element=Grundumfang_XIX_Klima.Geltungsbereich_E3_1_1_UNECE_Gen2.SP_IF_PCU_Ein_XIX_Grundumfang_XIX_Klima.DE_PCU_Ein, system-signal=PCU_Ein
        communication-direction=IN, data-element=Grundumfang_XIX_Klima.Geltungsbereich_E3_1_1_UNECE_Gen2.RP_IF_PCU_Fehler_Emitter_XIX_Grundumfang_XIX_Klima.DE_PCU_Fehler_Emitter, system-signal=PCU_Fehler_Emitter
        communication-direction=IN, data-element=Grundumfang_XIX_Klima.Geltungsbereich_E3_1_1_UNECE_Gen2.RP_IF_PCU_Fehler_Intern_XIX_Grundumfang_XIX_Klima.DE_PCU_Fehler_Intern, system-signal=PCU_Fehler_Intern
        communication-direction=OUT, data-element=Grundumfang_XIX_Klima.Geltungsbereich_E3_1_1_UNECE_Gen2.SP_IF_PCU_FS_Luftfeuchte_rel_XIX_Grundumfang_XIX_Klima.DE_PCU_FS_Luftfeuchte_rel, system-signal=PCU_FS_Luftfeuchte_rel
        communication-direction=OUT, data-element=Grundumfang_XIX_Klima.Geltungsbereich_E3_1_1_UNECE_Gen2.SP_IF_PCU_FSA_Luftfeuchte_rel_XIX_Grundumfang_XIX_Klima.DE_PCU_FSA_Luftfeuchte_rel, system-signal=PCU_FSA_Luftfeuchte_rel
        communication-direction=OUT, data-element=Grundumfang_XIX_Klima.Geltungsbereich_E3_1_1_UNECE_Gen2.SP_IF_PCU_Funktionstest_XIX_Grundumfang_XIX_Klima.DE_PCU_Funktionstest, system-signal=PCU_Funktionstest
        communication-direction=OUT, data-element=Grundumfang_XIX_Klima.Geltungsbereich_E3_1_1_UNECE_Gen2.SP_IF_PCU_Geblaese_Status_XIX_Grundumfang_XIX_Klima.DE_PCU_Geblaese_Status, system-signal=PCU_Geblaese_Status
        communication-direction=IN, data-element=Grundumfang_XIX_Klima.Geltungsbereich_E3_1_1_UNECE_Gen2.RP_IF_PCU_I_Sec_XIX_Grundumfang_XIX_Klima.DE_PCU_I_Sec, system-signal=PCU_I_Sec
        communication-direction=OUT, data-element=Grundumfang_XIX_Klima.Geltungsbereich_E3_1_1_UNECE_Gen2.SP_IF_PCU_Innen_Temp_XIX_Grundumfang_XIX_Klima.DE_PCU_Innen_Temp, system-signal=PCU_Innen_Temp
        communication-direction=OUT, data-element=Grundumfang_XIX_Klima.Geltungsbereich_E3_1_1_UNECE_Gen2.SP_IF_PCU_Kennlinie_XIX_Grundumfang_XIX_Klima.DE_PCU_Kennlinie, system-signal=PCU_Kennlinie
        communication-direction=IN, data-element=Grundumfang_XIX_Klima.Geltungsbereich_E3_1_1_UNECE_Gen2.RP_IF_PCU_Polarisation_XIX_Grundumfang_XIX_Klima.DE_PCU_Polarisation, system-signal=PCU_Polarisation
        communication-direction=IN, data-element=Grundumfang_XIX_Klima.Geltungsbereich_E3_1_1_UNECE_Gen2.RP_IF_PCU_ResponseError_XIX_Grundumfang_XIX_Klima.DE_PCU_ResponseError, system-signal=PCU_ResponseError
        communication-direction=IN, data-element=Grundumfang_XIX_Klima.Geltungsbereich_E3_1_1_UNECE_Gen2.RP_IF_PCU_State_Polarisation_XIX_Grundumfang_XIX_Klima.DE_PCU_State_Polarisation, system-signal=PCU_State_Polarisation
        communication-direction=IN, data-element=Grundumfang_XIX_Klima.Geltungsbereich_E3_1_1_UNECE_Gen2.RP_IF_PCU_Status_XIX_Grundumfang_XIX_Klima.DE_PCU_Status, system-signal=PCU_Status
        communication-direction=IN, data-element=Grundumfang_XIX_Klima.Geltungsbereich_E3_1_1_UNECE_Gen2.RP_IF_PCU_Status_LED_XIX_Grundumfang_XIX_Klima.DE_PCU_Status_LED, system-signal=PCU_Status_LED
        communication-direction=IN, data-element=Grundumfang_XIX_Klima.Geltungsbereich_E3_1_1_UNECE_Gen2.RP_IF_PCU_Temp_PCB_XIX_Grundumfang_XIX_Klima.DE_PCU_Temp_PCB, system-signal=PCU_Temp_PCB
        communication-direction=IN, data-element=Grundumfang_XIX_Klima.Geltungsbereich_E3_1_1_UNECE_Gen2.RP_IF_PCU_U_Sec_XIX_Grundumfang_XIX_Klima.DE_PCU_U_Sec, system-signal=PCU_U_Sec
        communication-direction=OUT, data-element=Grundumfang_XIX_Klima.Geltungsbereich_E3_1_1_UNECE_Gen2.SP_IF_PCU_Umluftklappe_Status_XIX_Grundumfang_XIX_Klima.DE_PCU_Umluftklappe_Status, system-signal=PCU_Umluftklappe_Status
        communication-direction=IN, data-element=Grundumfang_XIX_Klima.Geltungsbereich_E3_1_1_UNECE_Gen2.RP_IF_Perso_Aktiv_XIX_Grundumfang_XIX_Klima.DE_Perso_Aktiv, system-signal=Perso_Aktiv
        communication-direction=IN, data-element=Grundumfang_XIX_Klima.Geltungsbereich_E3_1_1_UNECE_Gen2.RP_IF_Perso_Bedienstelle_XIX_Grundumfang_XIX_Klima.DE_Perso_Bedienstelle, system-signal=Perso_Bedienstelle
        communication-direction=IN, data-element=Grundumfang_XIX_Klima.Geltungsbereich_E3_1_1_UNECE_Gen2.RP_IF_Perso_Fahrernummer_XIX_Grundumfang_XIX_Klima.DE_Perso_Fahrernummer, system-signal=Perso_Fahrernummer
        communication-direction=IN, data-element=Grundumfang_XIX_Klima.Geltungsbereich_E3_1_1_UNECE_Gen2.RP_IF_Perso_Freigabe_Verstellung_XIX_Grundumfang_XIX_Klima.DE_Perso_Freigabe_Verstellung, system-signal=Perso_Freigabe_Verstellung
        communication-direction=IN, data-element=Grundumfang_XIX_Klima.Geltungsbereich_E3_1_1_UNECE_Gen2.RP_IF_Perso_Kontonummer_XIX_Grundumfang_XIX_Klima.DE_Perso_Kontonummer, system-signal=Perso_Kontonummer
        communication-direction=IN, data-element=Grundumfang_XIX_Klima.Geltungsbereich_E3_1_1_UNECE_Gen2.RP_IF_Perso_Schreibschutz_XIX_Grundumfang_XIX_Klima.DE_Perso_Schreibschutz, system-signal=Perso_Schreibschutz
        communication-direction=IN, data-element=Grundumfang_XIX_Klima.Geltungsbereich_E3_1_1_UNECE_Gen2.RP_IF_Perso_Status_XIX_Grundumfang_XIX_Klima.DE_Perso_Status, system-signal=Perso_Status
        communication-direction=IN, data-element=Grundumfang_XIX_Klima.Geltungsbereich_E3_1_1_UNECE_Gen2.RP_IF_Perso_Steuerung_XIX_Grundumfang_XIX_Klima.DE_Perso_Steuerung, system-signal=Perso_Steuerung
        communication-direction=IN, data-element=Grundumfang_XIX_Klima.Geltungsbereich_E3_1_1_UNECE_Gen2.RP_IF_Perso_Steuerungsparameter_XIX_Grundumfang_XIX_Klima.DE_Perso_Steuerungsparameter, system-signal=Perso_Steuerungsparameter
        communication-direction=IN, data-element=Grundumfang_XIX_Klima.Geltungsbereich_E3_1_1_UNECE_Gen2.RP_IF_PMS1_Partikel_XIX_Grundumfang_XIX_Klima.DE_PMS1_Partikel, system-signal=PMS1_Partikel
        communication-direction=IN, data-element=Grundumfang_XIX_Klima.Geltungsbereich_E3_1_1_UNECE_Gen2.RP_IF_PMS1_ResponseError_XIX_Grundumfang_XIX_Klima.DE_PMS1_ResponseError, system-signal=PMS1_ResponseError
        communication-direction=IN, data-element=Grundumfang_XIX_Klima.Geltungsbereich_E3_1_1_UNECE_Gen2.RP_IF_PMS1_Status_XIX_Grundumfang_XIX_Klima.DE_PMS1_Status, system-signal=PMS1_Status
        communication-direction=IN, data-element=Grundumfang_XIX_Klima.Geltungsbereich_E3_1_1_UNECE_Gen2.RP_IF_PSD_06_Mux_XIX_Grundumfang_XIX_Klima.DE_PSD_06_Mux, system-signal=PSD_06_Mux
        communication-direction=IN, data-element=Grundumfang_XIX_Klima.Geltungsbereich_E3_1_1_UNECE_Gen2.RP_IF_PSD_Abzweigerichtung_XIX_Grundumfang_XIX_Klima.DE_PSD_Abzweigerichtung, system-signal=PSD_Abzweigerichtung
        communication-direction=IN, data-element=Grundumfang_XIX_Klima.Geltungsbereich_E3_1_1_UNECE_Gen2.RP_IF_PSD_Abzweigewinkel_XIX_Grundumfang_XIX_Klima.DE_PSD_Abzweigewinkel, system-signal=PSD_Abzweigewinkel
        communication-direction=IN, data-element=Grundumfang_XIX_Klima.Geltungsbereich_E3_1_1_UNECE_Gen2.RP_IF_PSD_ADAS_Qualitaet_XIX_Grundumfang_XIX_Klima.DE_PSD_ADAS_Qualitaet, system-signal=PSD_ADAS_Qualitaet
        communication-direction=IN, data-element=Grundumfang_XIX_Klima.Geltungsbereich_E3_1_1_UNECE_Gen2.RP_IF_PSD_Anfangskruemmung_XIX_Grundumfang_XIX_Klima.DE_PSD_Anfangskruemmung, system-signal=PSD_Anfangskruemmung
        communication-direction=IN, data-element=Grundumfang_XIX_Klima.Geltungsbereich_E3_1_1_UNECE_Gen2.RP_IF_PSD_Anfangskruemmung_Vorz_XIX_Grundumfang_XIX_Klima.DE_PSD_Anfangskruemmung_Vorz, system-signal=PSD_Anfangskruemmung_Vorz
        communication-direction=IN, data-element=Grundumfang_XIX_Klima.Geltungsbereich_E3_1_1_UNECE_Gen2.RP_IF_PSD_Attribut_1_ID_XIX_Grundumfang_XIX_Klima.DE_PSD_Attribut_1_ID, system-signal=PSD_Attribut_1_ID
        communication-direction=IN, data-element=Grundumfang_XIX_Klima.Geltungsbereich_E3_1_1_UNECE_Gen2.RP_IF_PSD_Attribut_1_Offset_XIX_Grundumfang_XIX_Klima.DE_PSD_Attribut_1_Offset, system-signal=PSD_Attribut_1_Offset
        communication-direction=IN, data-element=Grundumfang_XIX_Klima.Geltungsbereich_E3_1_1_UNECE_Gen2.RP_IF_PSD_Attribut_1_Wert_XIX_Grundumfang_XIX_Klima.DE_PSD_Attribut_1_Wert, system-signal=PSD_Attribut_1_Wert
        communication-direction=IN, data-element=Grundumfang_XIX_Klima.Geltungsbereich_E3_1_1_UNECE_Gen2.RP_IF_PSD_Attribut_2_ID_XIX_Grundumfang_XIX_Klima.DE_PSD_Attribut_2_ID, system-signal=PSD_Attribut_2_ID
        communication-direction=IN, data-element=Grundumfang_XIX_Klima.Geltungsbereich_E3_1_1_UNECE_Gen2.RP_IF_PSD_Attribut_2_Offset_XIX_Grundumfang_XIX_Klima.DE_PSD_Attribut_2_Offset, system-signal=PSD_Attribut_2_Offset
        communication-direction=IN, data-element=Grundumfang_XIX_Klima.Geltungsbereich_E3_1_1_UNECE_Gen2.RP_IF_PSD_Attribut_2_Wert_XIX_Grundumfang_XIX_Klima.DE_PSD_Attribut_2_Wert, system-signal=PSD_Attribut_2_Wert
        communication-direction=IN, data-element=Grundumfang_XIX_Klima.Geltungsbereich_E3_1_1_UNECE_Gen2.RP_IF_PSD_Attribut_3_ID_XIX_Grundumfang_XIX_Klima.DE_PSD_Attribut_3_ID, system-signal=PSD_Attribut_3_ID
        communication-direction=IN, data-element=Grundumfang_XIX_Klima.Geltungsbereich_E3_1_1_UNECE_Gen2.RP_IF_PSD_Attribut_3_Offset_XIX_Grundumfang_XIX_Klima.DE_PSD_Attribut_3_Offset, system-signal=PSD_Attribut_3_Offset
        communication-direction=IN, data-element=Grundumfang_XIX_Klima.Geltungsbereich_E3_1_1_UNECE_Gen2.RP_IF_PSD_Attribut_3_Wert_XIX_Grundumfang_XIX_Klima.DE_PSD_Attribut_3_Wert, system-signal=PSD_Attribut_3_Wert
        communication-direction=IN, data-element=Grundumfang_XIX_Klima.Geltungsbereich_E3_1_1_UNECE_Gen2.RP_IF_PSD_Attribut_4_ID_XIX_Grundumfang_XIX_Klima.DE_PSD_Attribut_4_ID, system-signal=PSD_Attribut_4_ID
        communication-direction=IN, data-element=Grundumfang_XIX_Klima.Geltungsbereich_E3_1_1_UNECE_Gen2.RP_IF_PSD_Attribut_4_Offset_XIX_Grundumfang_XIX_Klima.DE_PSD_Attribut_4_Offset, system-signal=PSD_Attribut_4_Offset
        communication-direction=IN, data-element=Grundumfang_XIX_Klima.Geltungsbereich_E3_1_1_UNECE_Gen2.RP_IF_PSD_Attribut_4_Wert_XIX_Grundumfang_XIX_Klima.DE_PSD_Attribut_4_Wert, system-signal=PSD_Attribut_4_Wert
        communication-direction=IN, data-element=Grundumfang_XIX_Klima.Geltungsbereich_E3_1_1_UNECE_Gen2.RP_IF_PSD_Attribut_5_ID_XIX_Grundumfang_XIX_Klima.DE_PSD_Attribut_5_ID, system-signal=PSD_Attribut_5_ID
        communication-direction=IN, data-element=Grundumfang_XIX_Klima.Geltungsbereich_E3_1_1_UNECE_Gen2.RP_IF_PSD_Attribut_5_Offset_XIX_Grundumfang_XIX_Klima.DE_PSD_Attribut_5_Offset, system-signal=PSD_Attribut_5_Offset
        communication-direction=IN, data-element=Grundumfang_XIX_Klima.Geltungsbereich_E3_1_1_UNECE_Gen2.RP_IF_PSD_Attribut_5_Wert_XIX_Grundumfang_XIX_Klima.DE_PSD_Attribut_5_Wert, system-signal=PSD_Attribut_5_Wert
        communication-direction=IN, data-element=Grundumfang_XIX_Klima.Geltungsbereich_E3_1_1_UNECE_Gen2.RP_IF_PSD_Attribut_Segment_ID_XIX_Grundumfang_XIX_Klima.DE_PSD_Attribut_Segment_ID, system-signal=PSD_Attribut_Segment_ID
        communication-direction=IN, data-element=Grundumfang_XIX_Klima.Geltungsbereich_E3_1_1_UNECE_Gen2.RP_IF_PSD_Attribut_Segment_ID_05_XIX_Grundumfang_XIX_Klima.DE_PSD_Attribut_Segment_ID_05, system-signal=PSD_Attribut_Segment_ID_05
        communication-direction=IN, data-element=Grundumfang_XIX_Klima.Geltungsbereich_E3_1_1_UNECE_Gen2.RP_IF_PSD_Attribute_Komplett_05_XIX_Grundumfang_XIX_Klima.DE_PSD_Attribute_Komplett_05, system-signal=PSD_Attribute_Komplett_05
        communication-direction=IN, data-element=Grundumfang_XIX_Klima.Geltungsbereich_E3_1_1_UNECE_Gen2.RP_IF_PSD_Attribute_Komplett_06_XIX_Grundumfang_XIX_Klima.DE_PSD_Attribute_Komplett_06, system-signal=PSD_Attribute_Komplett_06
        communication-direction=IN, data-element=Grundumfang_XIX_Klima.Geltungsbereich_E3_1_1_UNECE_Gen2.RP_IF_PSD_Baum_Ausrichtung_XIX_Grundumfang_XIX_Klima.DE_PSD_Baum_Ausrichtung, system-signal=PSD_Baum_Ausrichtung
        communication-direction=IN, data-element=Grundumfang_XIX_Klima.Geltungsbereich_E3_1_1_UNECE_Gen2.RP_IF_PSD_Baum_Breite_VZ_XIX_Grundumfang_XIX_Klima.DE_PSD_Baum_Breite_VZ, system-signal=PSD_Baum_Breite_VZ
        communication-direction=IN, data-element=Grundumfang_XIX_Klima.Geltungsbereich_E3_1_1_UNECE_Gen2.RP_IF_PSD_Baum_Laenge_XIX_Grundumfang_XIX_Klima.DE_PSD_Baum_Laenge, system-signal=PSD_Baum_Laenge
        communication-direction=IN, data-element=Grundumfang_XIX_Klima.Geltungsbereich_E3_1_1_UNECE_Gen2.RP_IF_PSD_Baum_Laenge_VZ_XIX_Grundumfang_XIX_Klima.DE_PSD_Baum_Laenge_VZ, system-signal=PSD_Baum_Laenge_VZ
        communication-direction=IN, data-element=Grundumfang_XIX_Klima.Geltungsbereich_E3_1_1_UNECE_Gen2.RP_IF_PSD_Bebauung_XIX_Grundumfang_XIX_Klima.DE_PSD_Bebauung, system-signal=PSD_Bebauung
        communication-direction=IN, data-element=Grundumfang_XIX_Klima.Geltungsbereich_E3_1_1_UNECE_Gen2.RP_IF_PSD_Endkruemmung_XIX_Grundumfang_XIX_Klima.DE_PSD_Endkruemmung, system-signal=PSD_Endkruemmung
        communication-direction=IN, data-element=Grundumfang_XIX_Klima.Geltungsbereich_E3_1_1_UNECE_Gen2.RP_IF_PSD_Endkruemmung_Vorz_XIX_Grundumfang_XIX_Klima.DE_PSD_Endkruemmung_Vorz, system-signal=PSD_Endkruemmung_Vorz
        communication-direction=IN, data-element=Grundumfang_XIX_Klima.Geltungsbereich_E3_1_1_UNECE_Gen2.RP_IF_PSD_Fahrspuren_Anzahl_XIX_Grundumfang_XIX_Klima.DE_PSD_Fahrspuren_Anzahl, system-signal=PSD_Fahrspuren_Anzahl
        communication-direction=IN, data-element=Grundumfang_XIX_Klima.Geltungsbereich_E3_1_1_UNECE_Gen2.RP_IF_PSD_Geradester_Pfad_XIX_Grundumfang_XIX_Klima.DE_PSD_Geradester_Pfad, system-signal=PSD_Geradester_Pfad
        communication-direction=IN, data-element=Grundumfang_XIX_Klima.Geltungsbereich_E3_1_1_UNECE_Gen2.RP_IF_PSD_Ges_Attribute_Komplett_XIX_Grundumfang_XIX_Klima.DE_PSD_Ges_Attribute_Komplett, system-signal=PSD_Ges_Attribute_Komplett
        communication-direction=IN, data-element=Grundumfang_XIX_Klima.Geltungsbereich_E3_1_1_UNECE_Gen2.RP_IF_PSD_Ges_Geschwindigkeit_XIX_Grundumfang_XIX_Klima.DE_PSD_Ges_Geschwindigkeit, system-signal=PSD_Ges_Geschwindigkeit
        communication-direction=IN, data-element=Grundumfang_XIX_Klima.Geltungsbereich_E3_1_1_UNECE_Gen2.RP_IF_PSD_Ges_Geschwindigkeit_Gespann_XIX_Grundumfang_XIX_Klima.DE_PSD_Ges_Geschwindigkeit_Gespann, system-signal=PSD_Ges_Geschwindigkeit_Gespann
        communication-direction=IN, data-element=Grundumfang_XIX_Klima.Geltungsbereich_E3_1_1_UNECE_Gen2.RP_IF_PSD_Ges_Geschwindigkeit_Std_Anf_XIX_Grundumfang_XIX_Klima.DE_PSD_Ges_Geschwindigkeit_Std_Anf, system-signal=PSD_Ges_Geschwindigkeit_Std_Anf
        communication-direction=IN, data-element=Grundumfang_XIX_Klima.Geltungsbereich_E3_1_1_UNECE_Gen2.RP_IF_PSD_Ges_Geschwindigkeit_Std_Ende_XIX_Grundumfang_XIX_Klima.DE_PSD_Ges_Geschwindigkeit_Std_Ende, system-signal=PSD_Ges_Geschwindigkeit_Std_Ende
        communication-direction=IN, data-element=Grundumfang_XIX_Klima.Geltungsbereich_E3_1_1_UNECE_Gen2.RP_IF_PSD_Ges_Geschwindigkeit_Tag_Anf_XIX_Grundumfang_XIX_Klima.DE_PSD_Ges_Geschwindigkeit_Tag_Anf, system-signal=PSD_Ges_Geschwindigkeit_Tag_Anf
        communication-direction=IN, data-element=Grundumfang_XIX_Klima.Geltungsbereich_E3_1_1_UNECE_Gen2.RP_IF_PSD_Ges_Geschwindigkeit_Tag_Ende_XIX_Grundumfang_XIX_Klima.DE_PSD_Ges_Geschwindigkeit_Tag_Ende, system-signal=PSD_Ges_Geschwindigkeit_Tag_Ende
        communication-direction=IN, data-element=Grundumfang_XIX_Klima.Geltungsbereich_E3_1_1_UNECE_Gen2.RP_IF_PSD_Ges_Geschwindigkeit_Witter_XIX_Grundumfang_XIX_Klima.DE_PSD_Ges_Geschwindigkeit_Witter, system-signal=PSD_Ges_Geschwindigkeit_Witter
        communication-direction=IN, data-element=Grundumfang_XIX_Klima.Geltungsbereich_E3_1_1_UNECE_Gen2.RP_IF_PSD_Ges_Gesetzlich_Kategorie_XIX_Grundumfang_XIX_Klima.DE_PSD_Ges_Gesetzlich_Kategorie, system-signal=PSD_Ges_Gesetzlich_Kategorie
        communication-direction=IN, data-element=Grundumfang_XIX_Klima.Geltungsbereich_E3_1_1_UNECE_Gen2.RP_IF_PSD_Ges_Gesetzlich_Zusatz_XIX_Grundumfang_XIX_Klima.DE_PSD_Ges_Gesetzlich_Zusatz, system-signal=PSD_Ges_Gesetzlich_Zusatz
        communication-direction=IN, data-element=Grundumfang_XIX_Klima.Geltungsbereich_E3_1_1_UNECE_Gen2.RP_IF_PSD_Ges_Offset_XIX_Grundumfang_XIX_Klima.DE_PSD_Ges_Offset, system-signal=PSD_Ges_Offset
        communication-direction=IN, data-element=Grundumfang_XIX_Klima.Geltungsbereich_E3_1_1_UNECE_Gen2.RP_IF_PSD_Ges_Segment_ID_XIX_Grundumfang_XIX_Klima.DE_PSD_Ges_Segment_ID, system-signal=PSD_Ges_Segment_ID
        communication-direction=IN, data-element=Grundumfang_XIX_Klima.Geltungsbereich_E3_1_1_UNECE_Gen2.RP_IF_PSD_Ges_Spur_Geschw_Begrenzung_XIX_Grundumfang_XIX_Klima.DE_PSD_Ges_Spur_Geschw_Begrenzung, system-signal=PSD_Ges_Spur_Geschw_Begrenzung
        communication-direction=IN, data-element=Grundumfang_XIX_Klima.Geltungsbereich_E3_1_1_UNECE_Gen2.RP_IF_PSD_Ges_Typ_XIX_Grundumfang_XIX_Klima.DE_PSD_Ges_Typ, system-signal=PSD_Ges_Typ
        communication-direction=IN, data-element=Grundumfang_XIX_Klima.Geltungsbereich_E3_1_1_UNECE_Gen2.RP_IF_PSD_Ges_Ueberholverbot_XIX_Grundumfang_XIX_Klima.DE_PSD_Ges_Ueberholverbot, system-signal=PSD_Ges_Ueberholverbot
        communication-direction=IN, data-element=Grundumfang_XIX_Klima.Geltungsbereich_E3_1_1_UNECE_Gen2.RP_IF_PSD_Ges_Verkehrszeichen_Quelle_XIX_Grundumfang_XIX_Klima.DE_PSD_Ges_Verkehrszeichen_Quelle, system-signal=PSD_Ges_Verkehrszeichen_Quelle
        communication-direction=IN, data-element=Grundumfang_XIX_Klima.Geltungsbereich_E3_1_1_UNECE_Gen2.RP_IF_PSD_Ges_Wechselverkehrszeichen_XIX_Grundumfang_XIX_Klima.DE_PSD_Ges_Wechselverkehrszeichen, system-signal=PSD_Ges_Wechselverkehrszeichen
        communication-direction=IN, data-element=Grundumfang_XIX_Klima.Geltungsbereich_E3_1_1_UNECE_Gen2.RP_IF_PSD_Idenditaets_ID_XIX_Grundumfang_XIX_Klima.DE_PSD_Idenditaets_ID, system-signal=PSD_Idenditaets_ID
        communication-direction=IN, data-element=Grundumfang_XIX_Klima.Geltungsbereich_E3_1_1_UNECE_Gen2.RP_IF_PSD_LR_01_MUX_XIX_Grundumfang_XIX_Klima.DE_PSD_LR_01_MUX, system-signal=PSD_LR_01_MUX
        communication-direction=IN, data-element=Grundumfang_XIX_Klima.Geltungsbereich_E3_1_1_UNECE_Gen2.RP_IF_PSD_LR_Attribut_1_Offset_XIX_Grundumfang_XIX_Klima.DE_PSD_LR_Attribut_1_Offset, system-signal=PSD_LR_Attribut_1_Offset
        communication-direction=IN, data-element=Grundumfang_XIX_Klima.Geltungsbereich_E3_1_1_UNECE_Gen2.RP_IF_PSD_LR_Attribut_1_Wert_XIX_Grundumfang_XIX_Klima.DE_PSD_LR_Attribut_1_Wert, system-signal=PSD_LR_Attribut_1_Wert
        communication-direction=IN, data-element=Grundumfang_XIX_Klima.Geltungsbereich_E3_1_1_UNECE_Gen2.RP_IF_PSD_LR_Attribut_2_Offset_XIX_Grundumfang_XIX_Klima.DE_PSD_LR_Attribut_2_Offset, system-signal=PSD_LR_Attribut_2_Offset
        communication-direction=IN, data-element=Grundumfang_XIX_Klima.Geltungsbereich_E3_1_1_UNECE_Gen2.RP_IF_PSD_LR_Attribut_2_Wert_XIX_Grundumfang_XIX_Klima.DE_PSD_LR_Attribut_2_Wert, system-signal=PSD_LR_Attribut_2_Wert
        communication-direction=IN, data-element=Grundumfang_XIX_Klima.Geltungsbereich_E3_1_1_UNECE_Gen2.RP_IF_PSD_LR_Attribut_3_Offset_XIX_Grundumfang_XIX_Klima.DE_PSD_LR_Attribut_3_Offset, system-signal=PSD_LR_Attribut_3_Offset
        communication-direction=IN, data-element=Grundumfang_XIX_Klima.Geltungsbereich_E3_1_1_UNECE_Gen2.RP_IF_PSD_LR_Attribut_3_Wert_XIX_Grundumfang_XIX_Klima.DE_PSD_LR_Attribut_3_Wert, system-signal=PSD_LR_Attribut_3_Wert
        communication-direction=IN, data-element=Grundumfang_XIX_Klima.Geltungsbereich_E3_1_1_UNECE_Gen2.RP_IF_PSD_LR_Fahrzeug_Pos_XIX_Grundumfang_XIX_Klima.DE_PSD_LR_Fahrzeug_Pos, system-signal=PSD_LR_Fahrzeug_Pos
        communication-direction=IN, data-element=Grundumfang_XIX_Klima.Geltungsbereich_E3_1_1_UNECE_Gen2.RP_IF_PSD_LR_Globale_Steigung_XIX_Grundumfang_XIX_Klima.DE_PSD_LR_Globale_Steigung, system-signal=PSD_LR_Globale_Steigung
        communication-direction=IN, data-element=Grundumfang_XIX_Klima.Geltungsbereich_E3_1_1_UNECE_Gen2.RP_IF_PSD_LR_Globale_Steigung_Vorz_XIX_Grundumfang_XIX_Klima.DE_PSD_LR_Globale_Steigung_Vorz, system-signal=PSD_LR_Globale_Steigung_Vorz
        communication-direction=IN, data-element=Grundumfang_XIX_Klima.Geltungsbereich_E3_1_1_UNECE_Gen2.RP_IF_PSD_LR_Profil_Laenge_XIX_Grundumfang_XIX_Klima.DE_PSD_LR_Profil_Laenge, system-signal=PSD_LR_Profil_Laenge
        communication-direction=IN, data-element=Grundumfang_XIX_Klima.Geltungsbereich_E3_1_1_UNECE_Gen2.RP_IF_PSD_LR_Profil_Nummer_XIX_Grundumfang_XIX_Klima.DE_PSD_LR_Profil_Nummer, system-signal=PSD_LR_Profil_Nummer
        communication-direction=IN, data-element=Grundumfang_XIX_Klima.Geltungsbereich_E3_1_1_UNECE_Gen2.RP_IF_PSD_LR_Reset_XIX_Grundumfang_XIX_Klima.DE_PSD_LR_Reset, system-signal=PSD_LR_Reset
        communication-direction=IN, data-element=Grundumfang_XIX_Klima.Geltungsbereich_E3_1_1_UNECE_Gen2.RP_IF_PSD_LR_Steigung_1_Offset_XIX_Grundumfang_XIX_Klima.DE_PSD_LR_Steigung_1_Offset, system-signal=PSD_LR_Steigung_1_Offset
        communication-direction=IN, data-element=Grundumfang_XIX_Klima.Geltungsbereich_E3_1_1_UNECE_Gen2.RP_IF_PSD_LR_Steigung_1_Vorz_XIX_Grundumfang_XIX_Klima.DE_PSD_LR_Steigung_1_Vorz, system-signal=PSD_LR_Steigung_1_Vorz
        communication-direction=IN, data-element=Grundumfang_XIX_Klima.Geltungsbereich_E3_1_1_UNECE_Gen2.RP_IF_PSD_LR_Steigung_1_Wert_XIX_Grundumfang_XIX_Klima.DE_PSD_LR_Steigung_1_Wert, system-signal=PSD_LR_Steigung_1_Wert
        communication-direction=IN, data-element=Grundumfang_XIX_Klima.Geltungsbereich_E3_1_1_UNECE_Gen2.RP_IF_PSD_LR_Steigung_2_Offset_XIX_Grundumfang_XIX_Klima.DE_PSD_LR_Steigung_2_Offset, system-signal=PSD_LR_Steigung_2_Offset
        communication-direction=IN, data-element=Grundumfang_XIX_Klima.Geltungsbereich_E3_1_1_UNECE_Gen2.RP_IF_PSD_LR_Steigung_2_Vorz_XIX_Grundumfang_XIX_Klima.DE_PSD_LR_Steigung_2_Vorz, system-signal=PSD_LR_Steigung_2_Vorz
        communication-direction=IN, data-element=Grundumfang_XIX_Klima.Geltungsbereich_E3_1_1_UNECE_Gen2.RP_IF_PSD_LR_Steigung_2_Wert_XIX_Grundumfang_XIX_Klima.DE_PSD_LR_Steigung_2_Wert, system-signal=PSD_LR_Steigung_2_Wert
        communication-direction=IN, data-element=Grundumfang_XIX_Klima.Geltungsbereich_E3_1_1_UNECE_Gen2.RP_IF_PSD_LR_Steigung_3_Offset_XIX_Grundumfang_XIX_Klima.DE_PSD_LR_Steigung_3_Offset, system-signal=PSD_LR_Steigung_3_Offset
        communication-direction=IN, data-element=Grundumfang_XIX_Klima.Geltungsbereich_E3_1_1_UNECE_Gen2.RP_IF_PSD_LR_Steigung_3_Vorz_XIX_Grundumfang_XIX_Klima.DE_PSD_LR_Steigung_3_Vorz, system-signal=PSD_LR_Steigung_3_Vorz
        communication-direction=IN, data-element=Grundumfang_XIX_Klima.Geltungsbereich_E3_1_1_UNECE_Gen2.RP_IF_PSD_LR_Steigung_3_Wert_XIX_Grundumfang_XIX_Klima.DE_PSD_LR_Steigung_3_Wert, system-signal=PSD_LR_Steigung_3_Wert
        communication-direction=IN, data-element=Grundumfang_XIX_Klima.Geltungsbereich_E3_1_1_UNECE_Gen2.RP_IF_PSD_Pos_Fahrspur_XIX_Grundumfang_XIX_Klima.DE_PSD_Pos_Fahrspur, system-signal=PSD_Pos_Fahrspur
        communication-direction=IN, data-element=Grundumfang_XIX_Klima.Geltungsbereich_E3_1_1_UNECE_Gen2.RP_IF_PSD_Pos_Fehler_Laengsrichtung_XIX_Grundumfang_XIX_Klima.DE_PSD_Pos_Fehler_Laengsrichtung, system-signal=PSD_Pos_Fehler_Laengsrichtung
        communication-direction=IN, data-element=Grundumfang_XIX_Klima.Geltungsbereich_E3_1_1_UNECE_Gen2.RP_IF_PSD_Pos_Inhibitzeit_XIX_Grundumfang_XIX_Klima.DE_PSD_Pos_Inhibitzeit, system-signal=PSD_Pos_Inhibitzeit
        communication-direction=IN, data-element=Grundumfang_XIX_Klima.Geltungsbereich_E3_1_1_UNECE_Gen2.RP_IF_PSD_Pos_Segment_ID_XIX_Grundumfang_XIX_Klima.DE_PSD_Pos_Segment_ID, system-signal=PSD_Pos_Segment_ID
        communication-direction=IN, data-element=Grundumfang_XIX_Klima.Geltungsbereich_E3_1_1_UNECE_Gen2.RP_IF_PSD_Pos_Segmentlaenge_XIX_Grundumfang_XIX_Klima.DE_PSD_Pos_Segmentlaenge, system-signal=PSD_Pos_Segmentlaenge
        communication-direction=IN, data-element=Grundumfang_XIX_Klima.Geltungsbereich_E3_1_1_UNECE_Gen2.RP_IF_PSD_Pos_Standort_Eindeutig_XIX_Grundumfang_XIX_Klima.DE_PSD_Pos_Standort_Eindeutig, system-signal=PSD_Pos_Standort_Eindeutig
        communication-direction=IN, data-element=Grundumfang_XIX_Klima.Geltungsbereich_E3_1_1_UNECE_Gen2.RP_IF_PSD_Rampe_XIX_Grundumfang_XIX_Klima.DE_PSD_Rampe, system-signal=PSD_Rampe
        communication-direction=IN, data-element=Grundumfang_XIX_Klima.Geltungsbereich_E3_1_1_UNECE_Gen2.RP_IF_PSD_Segment_ID_XIX_Grundumfang_XIX_Klima.DE_PSD_Segment_ID, system-signal=PSD_Segment_ID
        communication-direction=IN, data-element=Grundumfang_XIX_Klima.Geltungsbereich_E3_1_1_UNECE_Gen2.RP_IF_PSD_Segment_Komplett_XIX_Grundumfang_XIX_Klima.DE_PSD_Segment_Komplett, system-signal=PSD_Segment_Komplett
        communication-direction=IN, data-element=Grundumfang_XIX_Klima.Geltungsbereich_E3_1_1_UNECE_Gen2.RP_IF_PSD_Segmentlaenge_XIX_Grundumfang_XIX_Klima.DE_PSD_Segmentlaenge, system-signal=PSD_Segmentlaenge
        communication-direction=IN, data-element=Grundumfang_XIX_Klima.Geltungsbereich_E3_1_1_UNECE_Gen2.RP_IF_PSD_Steigung_1_A_Offset_XIX_Grundumfang_XIX_Klima.DE_PSD_Steigung_1_A_Offset, system-signal=PSD_Steigung_1_A_Offset
        communication-direction=IN, data-element=Grundumfang_XIX_Klima.Geltungsbereich_E3_1_1_UNECE_Gen2.RP_IF_PSD_Steigung_1_A_Steigung_XIX_Grundumfang_XIX_Klima.DE_PSD_Steigung_1_A_Steigung, system-signal=PSD_Steigung_1_A_Steigung
        communication-direction=IN, data-element=Grundumfang_XIX_Klima.Geltungsbereich_E3_1_1_UNECE_Gen2.RP_IF_PSD_Steigung_1_A_Vorz_XIX_Grundumfang_XIX_Klima.DE_PSD_Steigung_1_A_Vorz, system-signal=PSD_Steigung_1_A_Vorz
        communication-direction=IN, data-element=Grundumfang_XIX_Klima.Geltungsbereich_E3_1_1_UNECE_Gen2.RP_IF_PSD_Steigung_1_Attribute_kompl_XIX_Grundumfang_XIX_Klima.DE_PSD_Steigung_1_Attribute_kompl, system-signal=PSD_Steigung_1_Attribute_kompl
        communication-direction=IN, data-element=Grundumfang_XIX_Klima.Geltungsbereich_E3_1_1_UNECE_Gen2.RP_IF_PSD_Steigung_1_B_Offset_XIX_Grundumfang_XIX_Klima.DE_PSD_Steigung_1_B_Offset, system-signal=PSD_Steigung_1_B_Offset
        communication-direction=IN, data-element=Grundumfang_XIX_Klima.Geltungsbereich_E3_1_1_UNECE_Gen2.RP_IF_PSD_Steigung_1_B_Steigung_XIX_Grundumfang_XIX_Klima.DE_PSD_Steigung_1_B_Steigung, system-signal=PSD_Steigung_1_B_Steigung
        communication-direction=IN, data-element=Grundumfang_XIX_Klima.Geltungsbereich_E3_1_1_UNECE_Gen2.RP_IF_PSD_Steigung_1_B_Vorz_XIX_Grundumfang_XIX_Klima.DE_PSD_Steigung_1_B_Vorz, system-signal=PSD_Steigung_1_B_Vorz
        communication-direction=IN, data-element=Grundumfang_XIX_Klima.Geltungsbereich_E3_1_1_UNECE_Gen2.RP_IF_PSD_Steigung_1_Segment_ID_XIX_Grundumfang_XIX_Klima.DE_PSD_Steigung_1_Segment_ID, system-signal=PSD_Steigung_1_Segment_ID
        communication-direction=IN, data-element=Grundumfang_XIX_Klima.Geltungsbereich_E3_1_1_UNECE_Gen2.RP_IF_PSD_Steigung_2_Attribute_kompl_XIX_Grundumfang_XIX_Klima.DE_PSD_Steigung_2_Attribute_kompl, system-signal=PSD_Steigung_2_Attribute_kompl
        communication-direction=IN, data-element=Grundumfang_XIX_Klima.Geltungsbereich_E3_1_1_UNECE_Gen2.RP_IF_PSD_Steigung_2_Offset_XIX_Grundumfang_XIX_Klima.DE_PSD_Steigung_2_Offset, system-signal=PSD_Steigung_2_Offset
        communication-direction=IN, data-element=Grundumfang_XIX_Klima.Geltungsbereich_E3_1_1_UNECE_Gen2.RP_IF_PSD_Steigung_2_Segment_ID_XIX_Grundumfang_XIX_Klima.DE_PSD_Steigung_2_Segment_ID, system-signal=PSD_Steigung_2_Segment_ID
        communication-direction=IN, data-element=Grundumfang_XIX_Klima.Geltungsbereich_E3_1_1_UNECE_Gen2.RP_IF_PSD_Steigung_2_Steigung_XIX_Grundumfang_XIX_Klima.DE_PSD_Steigung_2_Steigung, system-signal=PSD_Steigung_2_Steigung
        communication-direction=IN, data-element=Grundumfang_XIX_Klima.Geltungsbereich_E3_1_1_UNECE_Gen2.RP_IF_PSD_Steigung_2_Vorz_XIX_Grundumfang_XIX_Klima.DE_PSD_Steigung_2_Vorz, system-signal=PSD_Steigung_2_Vorz
        communication-direction=IN, data-element=Grundumfang_XIX_Klima.Geltungsbereich_E3_1_1_UNECE_Gen2.RP_IF_PSD_Strassenkategorie_XIX_Grundumfang_XIX_Klima.DE_PSD_Strassenkategorie, system-signal=PSD_Strassenkategorie
        communication-direction=IN, data-element=Grundumfang_XIX_Klima.Geltungsbereich_E3_1_1_UNECE_Gen2.RP_IF_PSD_Sys_Alter_Karte_XIX_Grundumfang_XIX_Klima.DE_PSD_Sys_Alter_Karte, system-signal=PSD_Sys_Alter_Karte
        communication-direction=IN, data-element=Grundumfang_XIX_Klima.Geltungsbereich_E3_1_1_UNECE_Gen2.RP_IF_PSD_Sys_Geometrieguete_XIX_Grundumfang_XIX_Klima.DE_PSD_Sys_Geometrieguete, system-signal=PSD_Sys_Geometrieguete
        communication-direction=IN, data-element=Grundumfang_XIX_Klima.Geltungsbereich_E3_1_1_UNECE_Gen2.RP_IF_PSD_Sys_Geometrieguete_erweitert_XIX_Grundumfang_XIX_Klima.DE_PSD_Sys_Geometrieguete_erweitert, system-signal=PSD_Sys_Geometrieguete_erweitert
        communication-direction=IN, data-element=Grundumfang_XIX_Klima.Geltungsbereich_E3_1_1_UNECE_Gen2.RP_IF_PSD_Sys_Geschwindigkeit_Einheit_XIX_Grundumfang_XIX_Klima.DE_PSD_Sys_Geschwindigkeit_Einheit, system-signal=PSD_Sys_Geschwindigkeit_Einheit
        communication-direction=IN, data-element=Grundumfang_XIX_Klima.Geltungsbereich_E3_1_1_UNECE_Gen2.RP_IF_PSD_Sys_Laendercode_XIX_Grundumfang_XIX_Klima.DE_PSD_Sys_Laendercode, system-signal=PSD_Sys_Laendercode
        communication-direction=IN, data-element=Grundumfang_XIX_Klima.Geltungsbereich_E3_1_1_UNECE_Gen2.RP_IF_PSD_Sys_Mapmatchingguete_XIX_Grundumfang_XIX_Klima.DE_PSD_Sys_Mapmatchingguete, system-signal=PSD_Sys_Mapmatchingguete
        communication-direction=IN, data-element=Grundumfang_XIX_Klima.Geltungsbereich_E3_1_1_UNECE_Gen2.RP_IF_PSD_Sys_Quali_Geometrien_XIX_Grundumfang_XIX_Klima.DE_PSD_Sys_Quali_Geometrien, system-signal=PSD_Sys_Quali_Geometrien
        communication-direction=IN, data-element=Grundumfang_XIX_Klima.Geltungsbereich_E3_1_1_UNECE_Gen2.RP_IF_PSD_Sys_Quali_Ortsinfo_XIX_Grundumfang_XIX_Klima.DE_PSD_Sys_Quali_Ortsinfo, system-signal=PSD_Sys_Quali_Ortsinfo
        communication-direction=IN, data-element=Grundumfang_XIX_Klima.Geltungsbereich_E3_1_1_UNECE_Gen2.RP_IF_PSD_Sys_Quali_sonstige_Attribute_XIX_Grundumfang_XIX_Klima.DE_PSD_Sys_Quali_sonstige_Attribute, system-signal=PSD_Sys_Quali_sonstige_Attribute
        communication-direction=IN, data-element=Grundumfang_XIX_Klima.Geltungsbereich_E3_1_1_UNECE_Gen2.RP_IF_PSD_Sys_Quali_Steigungen_XIX_Grundumfang_XIX_Klima.DE_PSD_Sys_Quali_Steigungen, system-signal=PSD_Sys_Quali_Steigungen
        communication-direction=IN, data-element=Grundumfang_XIX_Klima.Geltungsbereich_E3_1_1_UNECE_Gen2.RP_IF_PSD_Sys_Quali_Strassenkennz_XIX_Grundumfang_XIX_Klima.DE_PSD_Sys_Quali_Strassenkennz, system-signal=PSD_Sys_Quali_Strassenkennz
        communication-direction=IN, data-element=Grundumfang_XIX_Klima.Geltungsbereich_E3_1_1_UNECE_Gen2.RP_IF_PSD_Sys_Quali_Tempolimits_XIX_Grundumfang_XIX_Klima.DE_PSD_Sys_Quali_Tempolimits, system-signal=PSD_Sys_Quali_Tempolimits
        communication-direction=IN, data-element=Grundumfang_XIX_Klima.Geltungsbereich_E3_1_1_UNECE_Gen2.RP_IF_PSD_Sys_Quali_verfuegbar_XIX_Grundumfang_XIX_Klima.DE_PSD_Sys_Quali_verfuegbar, system-signal=PSD_Sys_Quali_verfuegbar
        communication-direction=IN, data-element=Grundumfang_XIX_Klima.Geltungsbereich_E3_1_1_UNECE_Gen2.RP_IF_PSD_Sys_Quali_Vorfahrtsregelung_XIX_Grundumfang_XIX_Klima.DE_PSD_Sys_Quali_Vorfahrtsregelung, system-signal=PSD_Sys_Quali_Vorfahrtsregelung
        communication-direction=IN, data-element=Grundumfang_XIX_Klima.Geltungsbereich_E3_1_1_UNECE_Gen2.RP_IF_PSD_Sys_Segment_ID_XIX_Grundumfang_XIX_Klima.DE_PSD_Sys_Segment_ID, system-signal=PSD_Sys_Segment_ID
        communication-direction=IN, data-element=Grundumfang_XIX_Klima.Geltungsbereich_E3_1_1_UNECE_Gen2.RP_IF_PSD_Sys_US_State_XIX_Grundumfang_XIX_Klima.DE_PSD_Sys_US_State, system-signal=PSD_Sys_US_State
        communication-direction=IN, data-element=Grundumfang_XIX_Klima.Geltungsbereich_E3_1_1_UNECE_Gen2.RP_IF_PSD_Sys_Verkehrsrichtung_XIX_Grundumfang_XIX_Klima.DE_PSD_Sys_Verkehrsrichtung, system-signal=PSD_Sys_Verkehrsrichtung
        communication-direction=IN, data-element=Grundumfang_XIX_Klima.Geltungsbereich_E3_1_1_UNECE_Gen2.RP_IF_PSD_Sys_Zielfuehrung_XIX_Grundumfang_XIX_Klima.DE_PSD_Sys_Zielfuehrung, system-signal=PSD_Sys_Zielfuehrung
        communication-direction=IN, data-element=Grundumfang_XIX_Klima.Geltungsbereich_E3_1_1_UNECE_Gen2.RP_IF_PSD_Sys_Zielfuehrung_geaendert_XIX_Grundumfang_XIX_Klima.DE_PSD_Sys_Zielfuehrung_geaendert, system-signal=PSD_Sys_Zielfuehrung_geaendert
        communication-direction=IN, data-element=Grundumfang_XIX_Klima.Geltungsbereich_E3_1_1_UNECE_Gen2.RP_IF_PSD_Vorgaenger_Segment_ID_XIX_Grundumfang_XIX_Klima.DE_PSD_Vorgaenger_Segment_ID, system-signal=PSD_Vorgaenger_Segment_ID
        communication-direction=IN, data-element=Grundumfang_XIX_Klima.Geltungsbereich_E3_1_1_UNECE_Gen2.RP_IF_PSD_wahrscheinlichster_Pfad_XIX_Grundumfang_XIX_Klima.DE_PSD_wahrscheinlichster_Pfad, system-signal=PSD_wahrscheinlichster_Pfad
        communication-direction=IN, data-element=Grundumfang_XIX_Klima.Geltungsbereich_E3_1_1_UNECE_Gen2.RP_IF_PSD_Wechselverkehrszeichen_Typ_XIX_Grundumfang_XIX_Klima.DE_PSD_Wechselverkehrszeichen_Typ, system-signal=PSD_Wechselverkehrszeichen_Typ
        communication-direction=OUT, data-element=Grundumfang_XIX_Klima.Geltungsbereich_E3_1_1_UNECE_Gen2.SP_IF_PTC_Aktiv_XIX_Grundumfang_XIX_Klima.DE_PTC_Aktiv, system-signal=PTC_Aktiv
        communication-direction=OUT, data-element=Grundumfang_XIX_Klima.Geltungsbereich_E3_1_1_UNECE_Gen2.SP_IF_PTC_Fehlerstatus_XIX_Grundumfang_XIX_Klima.DE_PTC_Fehlerstatus, system-signal=PTC_Fehlerstatus
        communication-direction=IN, data-element=Grundumfang_XIX_Klima.Geltungsbereich_E3_1_1_UNECE_Gen2.RP_IF_PTC_HV_ERR_XIX_Grundumfang_XIX_Klima.DE_PTC_HV_ERR, system-signal=PTC_HV_ERR
        communication-direction=IN, data-element=Grundumfang_XIX_Klima.Geltungsbereich_E3_1_1_UNECE_Gen2.RP_IF_PTC_HV_Err_Heizkreis_1_XIX_Grundumfang_XIX_Klima.DE_PTC_HV_Err_Heizkreis_1, system-signal=PTC_HV_Err_Heizkreis_1
        communication-direction=IN, data-element=Grundumfang_XIX_Klima.Geltungsbereich_E3_1_1_UNECE_Gen2.RP_IF_PTC_HV_Err_Heizkreis_1_TNCTOC_XIX_Grundumfang_XIX_Klima.DE_PTC_HV_Err_Heizkreis_1_TNCTOC, system-signal=PTC_HV_Err_Heizkreis_1_TNCTOC
        communication-direction=IN, data-element=Grundumfang_XIX_Klima.Geltungsbereich_E3_1_1_UNECE_Gen2.RP_IF_PTC_HV_Err_Heizkreis_2_XIX_Grundumfang_XIX_Klima.DE_PTC_HV_Err_Heizkreis_2, system-signal=PTC_HV_Err_Heizkreis_2
        communication-direction=IN, data-element=Grundumfang_XIX_Klima.Geltungsbereich_E3_1_1_UNECE_Gen2.RP_IF_PTC_HV_Err_Heizkreis_2_TNCTOC_XIX_Grundumfang_XIX_Klima.DE_PTC_HV_Err_Heizkreis_2_TNCTOC, system-signal=PTC_HV_Err_Heizkreis_2_TNCTOC
        communication-direction=IN, data-element=Grundumfang_XIX_Klima.Geltungsbereich_E3_1_1_UNECE_Gen2.RP_IF_PTC_HV_Err_Heizkreis_3_XIX_Grundumfang_XIX_Klima.DE_PTC_HV_Err_Heizkreis_3, system-signal=PTC_HV_Err_Heizkreis_3
        communication-direction=IN, data-element=Grundumfang_XIX_Klima.Geltungsbereich_E3_1_1_UNECE_Gen2.RP_IF_PTC_HV_Err_Heizkreis_3_TNCTOC_XIX_Grundumfang_XIX_Klima.DE_PTC_HV_Err_Heizkreis_3_TNCTOC, system-signal=PTC_HV_Err_Heizkreis_3_TNCTOC
        communication-direction=IN, data-element=Grundumfang_XIX_Klima.Geltungsbereich_E3_1_1_UNECE_Gen2.RP_IF_PTC_HV_Err_intern_XIX_Grundumfang_XIX_Klima.DE_PTC_HV_Err_intern, system-signal=PTC_HV_Err_intern
        communication-direction=IN, data-element=Grundumfang_XIX_Klima.Geltungsbereich_E3_1_1_UNECE_Gen2.RP_IF_PTC_HV_Err_Intern_TNCTOC_XIX_Grundumfang_XIX_Klima.DE_PTC_HV_Err_Intern_TNCTOC, system-signal=PTC_HV_Err_Intern_TNCTOC
        communication-direction=IN, data-element=Grundumfang_XIX_Klima.Geltungsbereich_E3_1_1_UNECE_Gen2.RP_IF_PTC_HV_Err_Leckagestrom_XIX_Grundumfang_XIX_Klima.DE_PTC_HV_Err_Leckagestrom, system-signal=PTC_HV_Err_Leckagestrom
        communication-direction=IN, data-element=Grundumfang_XIX_Klima.Geltungsbereich_E3_1_1_UNECE_Gen2.RP_IF_PTC_HV_Err_Leckagestrom_TNCTOC_XIX_Grundumfang_XIX_Klima.DE_PTC_HV_Err_Leckagestrom_TNCTOC, system-signal=PTC_HV_Err_Leckagestrom_TNCTOC
        communication-direction=IN, data-element=Grundumfang_XIX_Klima.Geltungsbereich_E3_1_1_UNECE_Gen2.RP_IF_PTC_HV_Err_Temperaturschutz_XIX_Grundumfang_XIX_Klima.DE_PTC_HV_Err_Temperaturschutz, system-signal=PTC_HV_Err_Temperaturschutz
        communication-direction=IN, data-element=Grundumfang_XIX_Klima.Geltungsbereich_E3_1_1_UNECE_Gen2.RP_IF_PTC_HV_Err_TempSchutz_TNCTOC_XIX_Grundumfang_XIX_Klima.DE_PTC_HV_Err_TempSchutz_TNCTOC, system-signal=PTC_HV_Err_TempSchutz_TNCTOC
        communication-direction=IN, data-element=Grundumfang_XIX_Klima.Geltungsbereich_E3_1_1_UNECE_Gen2.RP_IF_PTC_HV_ERR_TNCTOC_XIX_Grundumfang_XIX_Klima.DE_PTC_HV_ERR_TNCTOC, system-signal=PTC_HV_ERR_TNCTOC
        communication-direction=IN, data-element=Grundumfang_XIX_Klima.Geltungsbereich_E3_1_1_UNECE_Gen2.RP_IF_PTC_HV_Err_Ueberstromabs_TNCTOC_XIX_Grundumfang_XIX_Klima.DE_PTC_HV_Err_Ueberstromabs_TNCTOC, system-signal=PTC_HV_Err_Ueberstromabs_TNCTOC
        communication-direction=IN, data-element=Grundumfang_XIX_Klima.Geltungsbereich_E3_1_1_UNECE_Gen2.RP_IF_PTC_HV_Err_Ueberstromabschaltung_XIX_Grundumfang_XIX_Klima.DE_PTC_HV_Err_Ueberstromabschaltung, system-signal=PTC_HV_Err_Ueberstromabschaltung
        communication-direction=IN, data-element=Grundumfang_XIX_Klima.Geltungsbereich_E3_1_1_UNECE_Gen2.RP_IF_PTC_HV_Heizmedium_Sensor_1_XIX_Grundumfang_XIX_Klima.DE_PTC_HV_Heizmedium_Sensor_1, system-signal=PTC_HV_Heizmedium_Sensor_1
        communication-direction=IN, data-element=Grundumfang_XIX_Klima.Geltungsbereich_E3_1_1_UNECE_Gen2.RP_IF_PTC_HV_Heizmedium_Sensor_2_XIX_Grundumfang_XIX_Klima.DE_PTC_HV_Heizmedium_Sensor_2, system-signal=PTC_HV_Heizmedium_Sensor_2
        communication-direction=IN, data-element=Grundumfang_XIX_Klima.Geltungsbereich_E3_1_1_UNECE_Gen2.RP_IF_PTC_HV_I_ist_XIX_Grundumfang_XIX_Klima.DE_PTC_HV_I_ist, system-signal=PTC_HV_I_ist
        communication-direction=IN, data-element=Grundumfang_XIX_Klima.Geltungsbereich_E3_1_1_UNECE_Gen2.RP_IF_PTC_HV_ResponseError_XIX_Grundumfang_XIX_Klima.DE_PTC_HV_ResponseError, system-signal=PTC_HV_ResponseError
        communication-direction=IN, data-element=Grundumfang_XIX_Klima.Geltungsbereich_E3_1_1_UNECE_Gen2.RP_IF_PTC_HV_Status_PTC_XIX_Grundumfang_XIX_Klima.DE_PTC_HV_Status_PTC, system-signal=PTC_HV_Status_PTC
        communication-direction=IN, data-element=Grundumfang_XIX_Klima.Geltungsbereich_E3_1_1_UNECE_Gen2.RP_IF_PTC_HV_Status_UBatt_XIX_Grundumfang_XIX_Klima.DE_PTC_HV_Status_UBatt, system-signal=PTC_HV_Status_UBatt
        communication-direction=IN, data-element=Grundumfang_XIX_Klima.Geltungsbereich_E3_1_1_UNECE_Gen2.RP_IF_PTC_HV_Temp_PCB_XIX_Grundumfang_XIX_Klima.DE_PTC_HV_Temp_PCB, system-signal=PTC_HV_Temp_PCB
        communication-direction=IN, data-element=Grundumfang_XIX_Klima.Geltungsbereich_E3_1_1_UNECE_Gen2.RP_IF_PTC_HV_TimeOut_Fehler_XIX_Grundumfang_XIX_Klima.DE_PTC_HV_TimeOut_Fehler, system-signal=PTC_HV_TimeOut_Fehler
        communication-direction=IN, data-element=Grundumfang_XIX_Klima.Geltungsbereich_E3_1_1_UNECE_Gen2.RP_IF_PTC_HV_UBatt_XIX_Grundumfang_XIX_Klima.DE_PTC_HV_UBatt, system-signal=PTC_HV_UBatt
        communication-direction=IN, data-element=Grundumfang_XIX_Klima.Geltungsbereich_E3_1_1_UNECE_Gen2.RP_IF_PTC_HVb_ERR_XIX_Grundumfang_XIX_Klima.DE_PTC_HVb_ERR, system-signal=PTC_HVb_ERR
        communication-direction=IN, data-element=Grundumfang_XIX_Klima.Geltungsbereich_E3_1_1_UNECE_Gen2.RP_IF_PTC_HVb_Err_Heizkreis_1_XIX_Grundumfang_XIX_Klima.DE_PTC_HVb_Err_Heizkreis_1, system-signal=PTC_HVb_Err_Heizkreis_1
        communication-direction=IN, data-element=Grundumfang_XIX_Klima.Geltungsbereich_E3_1_1_UNECE_Gen2.RP_IF_PTC_HVb_Err_Heizkreis_1_TNCTOC_XIX_Grundumfang_XIX_Klima.DE_PTC_HVb_Err_Heizkreis_1_TNCTOC, system-signal=PTC_HVb_Err_Heizkreis_1_TNCTOC
        communication-direction=IN, data-element=Grundumfang_XIX_Klima.Geltungsbereich_E3_1_1_UNECE_Gen2.RP_IF_PTC_HVb_Err_Heizkreis_2_XIX_Grundumfang_XIX_Klima.DE_PTC_HVb_Err_Heizkreis_2, system-signal=PTC_HVb_Err_Heizkreis_2
        communication-direction=IN, data-element=Grundumfang_XIX_Klima.Geltungsbereich_E3_1_1_UNECE_Gen2.RP_IF_PTC_HVb_Err_Heizkreis_2_TNCTOC_XIX_Grundumfang_XIX_Klima.DE_PTC_HVb_Err_Heizkreis_2_TNCTOC, system-signal=PTC_HVb_Err_Heizkreis_2_TNCTOC
        communication-direction=IN, data-element=Grundumfang_XIX_Klima.Geltungsbereich_E3_1_1_UNECE_Gen2.RP_IF_PTC_HVb_Err_Heizkreis_3_XIX_Grundumfang_XIX_Klima.DE_PTC_HVb_Err_Heizkreis_3, system-signal=PTC_HVb_Err_Heizkreis_3
        communication-direction=IN, data-element=Grundumfang_XIX_Klima.Geltungsbereich_E3_1_1_UNECE_Gen2.RP_IF_PTC_HVb_Err_Heizkreis_3_TNCTOC_XIX_Grundumfang_XIX_Klima.DE_PTC_HVb_Err_Heizkreis_3_TNCTOC, system-signal=PTC_HVb_Err_Heizkreis_3_TNCTOC
        communication-direction=IN, data-element=Grundumfang_XIX_Klima.Geltungsbereich_E3_1_1_UNECE_Gen2.RP_IF_PTC_HVb_Err_intern_XIX_Grundumfang_XIX_Klima.DE_PTC_HVb_Err_intern, system-signal=PTC_HVb_Err_intern
