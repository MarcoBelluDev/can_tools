[part 21 of 23: package /ComponentTypes]
AUTOSAR XML (schema 4-3-0)
package /ComponentTypes  (continued)
  composition sw component type Geltungsbereich_E3_1_1_UNECE_Gen2  (continued)
    delegate Grundumfang_XIX_Klima.RP_IF_EASV2_Err_Notlaufpos_TNCTOC_XIX_Grundumfang_XIX_Klima <-> outer port RP_IF_EASV2_Err_Notlaufpos_TNCTOC_XIX_Klima
    delegate Grundumfang_XIX_Klima.RP_IF_EASV2_Err_RAMROMNADChange_TF_XIX_Grundumfang_XIX_Klima <-> outer port RP_IF_EASV2_Err_RAMROMNADChange_TF_XIX_Klima
    delegate Grundumfang_XIX_Klima.RP_IF_EASV2_Err_RAMROMNADChange_TNCTOC_XIX_Grundumfang_XIX_Klima <-> outer port RP_IF_EASV2_Err_RAMROMNADChange_TNCTOC_XIX_Klima
    delegate Grundumfang_XIX_Klima.RP_IF_EASV2_Err_Ueberspannung_TF_XIX_Grundumfang_XIX_Klima <-> outer port RP_IF_EASV2_Err_Ueberspannung_TF_XIX_Klima
    delegate Grundumfang_XIX_Klima.RP_IF_EASV2_Err_Ueberspannung_TNCTOC_XIX_Grundumfang_XIX_Klima <-> outer port RP_IF_EASV2_Err_Ueberspannung_TNCTOC_XIX_Klima
    delegate Grundumfang_XIX_Klima.RP_IF_EASV2_Err_Uebertemperatur_TF_XIX_Grundumfang_XIX_Klima <-> outer port RP_IF_EASV2_Err_Uebertemperatur_TF_XIX_Klima
    delegate Grundumfang_XIX_Klima.RP_IF_EASV2_Err_Uebertemperatur_TNCTOC_XIX_Grundumfang_XIX_Klima <-> outer port RP_IF_EASV2_Err_Uebertemperatur_TNCTOC_XIX_Klima
    delegate Grundumfang_XIX_Klima.RP_IF_EASV2_Err_Unterspannung_TF_XIX_Grundumfang_XIX_Klima <-> outer port RP_IF_EASV2_Err_Unterspannung_TF_XIX_Klima
    delegate Grundumfang_XIX_Klima.RP_IF_EASV2_Err_Unterspannung_TNCTOC_XIX_Grundumfang_XIX_Klima <-> outer port RP_IF_EASV2_Err_Unterspannung_TNCTOC_XIX_Klima
    delegate Grundumfang_XIX_Klima.RP_IF_EASV2_ErrMem_State_XIX_Grundumfang_XIX_Klima <-> outer port RP_IF_EASV2_ErrMem_State_XIX_Klima
    delegate Grundumfang_XIX_Klima.RP_IF_EASV2_Geschwindigkeitsstatus_XIX_Grundumfang_XIX_Klima <-> outer port RP_IF_EASV2_Geschwindigkeitsstatus_XIX_Klima
    delegate Grundumfang_XIX_Klima.RP_IF_EASV2_Ist_Position_Aktuator_XIX_Grundumfang_XIX_Klima <-> outer port RP_IF_EASV2_Ist_Position_Aktuator_XIX_Klima
    delegate Grundumfang_XIX_Klima.RP_IF_EASV2_ResponseError_TNCTOC_XIX_Grundumfang_XIX_Klima <-> outer port RP_IF_EASV2_ResponseError_TNCTOC_XIX_Klima
    delegate Grundumfang_XIX_Klima.RP_IF_EASV2_ResponseError_XIX_Grundumfang_XIX_Klima <-> outer port RP_IF_EASV2_ResponseError_XIX_Klima
    delegate Grundumfang_XIX_Klima.RP_IF_EASV2_Spulenbestromung_XIX_Grundumfang_XIX_Klima <-> outer port RP_IF_EASV2_Spulenbestromung_XIX_Klima
    delegate Grundumfang_XIX_Klima.RP_IF_EASV2_Temp_Warning_XIX_Grundumfang_XIX_Klima <-> outer port RP_IF_EASV2_Temp_Warning_XIX_Klima
    delegate Grundumfang_XIX_Klima.RP_IF_EASV2_Temp_XIX_Grundumfang_XIX_Klima <-> outer port RP_IF_EASV2_Temp_XIX_Klima
    delegate Grundumfang_XIX_Klima.RP_IF_EASV3_Err_Blockierung_TF_XIX_Grundumfang_XIX_Klima <-> outer port RP_IF_EASV3_Err_Blockierung_TF_XIX_Klima
    delegate Grundumfang_XIX_Klima.RP_IF_EASV3_Err_Blockierung_TNCTOC_XIX_Grundumfang_XIX_Klima <-> outer port RP_IF_EASV3_Err_Blockierung_TNCTOC_XIX_Klima
    delegate Grundumfang_XIX_Klima.RP_IF_EASV3_Err_EDefekt_MoKomp_TF_XIX_Grundumfang_XIX_Klima <-> outer port RP_IF_EASV3_Err_EDefekt_MoKomp_TF_XIX_Klima
    delegate Grundumfang_XIX_Klima.RP_IF_EASV3_Err_EDefekt_MoKomp_TNCTOC_XIX_Grundumfang_XIX_Klima <-> outer port RP_IF_EASV3_Err_EDefekt_MoKomp_TNCTOC_XIX_Klima
    delegate Grundumfang_XIX_Klima.RP_IF_EASV3_Err_EDefekt_TSens_TF_XIX_Grundumfang_XIX_Klima <-> outer port RP_IF_EASV3_Err_EDefekt_TSens_TF_XIX_Klima
    delegate Grundumfang_XIX_Klima.RP_IF_EASV3_Err_EDefekt_TSens_TNCTOC_XIX_Grundumfang_XIX_Klima <-> outer port RP_IF_EASV3_Err_EDefekt_TSens_TNCTOC_XIX_Klima
    delegate Grundumfang_XIX_Klima.RP_IF_EASV3_Err_Notlaufpos_TF_XIX_Grundumfang_XIX_Klima <-> outer port RP_IF_EASV3_Err_Notlaufpos_TF_XIX_Klima
    delegate Grundumfang_XIX_Klima.RP_IF_EASV3_Err_Notlaufpos_TNCTOC_XIX_Grundumfang_XIX_Klima <-> outer port RP_IF_EASV3_Err_Notlaufpos_TNCTOC_XIX_Klima
    delegate Grundumfang_XIX_Klima.RP_IF_EASV3_Err_RAMROMNADChange_TF_XIX_Grundumfang_XIX_Klima <-> outer port RP_IF_EASV3_Err_RAMROMNADChange_TF_XIX_Klima
    delegate Grundumfang_XIX_Klima.RP_IF_EASV3_Err_RAMROMNADChange_TNCTOC_XIX_Grundumfang_XIX_Klima <-> outer port RP_IF_EASV3_Err_RAMROMNADChange_TNCTOC_XIX_Klima
    delegate Grundumfang_XIX_Klima.RP_IF_EASV3_Err_Ueberspannung_TF_XIX_Grundumfang_XIX_Klima <-> outer port RP_IF_EASV3_Err_Ueberspannung_TF_XIX_Klima
    delegate Grundumfang_XIX_Klima.RP_IF_EASV3_Err_Ueberspannung_TNCTOC_XIX_Grundumfang_XIX_Klima <-> outer port RP_IF_EASV3_Err_Ueberspannung_TNCTOC_XIX_Klima
    delegate Grundumfang_XIX_Klima.RP_IF_EASV3_Err_Uebertemperatur_TF_XIX_Grundumfang_XIX_Klima <-> outer port RP_IF_EASV3_Err_Uebertemperatur_TF_XIX_Klima
    delegate Grundumfang_XIX_Klima.RP_IF_EASV3_Err_Uebertemperatur_TNCTOC_XIX_Grundumfang_XIX_Klima <-> outer port RP_IF_EASV3_Err_Uebertemperatur_TNCTOC_XIX_Klima
    delegate Grundumfang_XIX_Klima.RP_IF_EASV3_Err_Unterspannung_TF_XIX_Grundumfang_XIX_Klima <-> outer port RP_IF_EASV3_Err_Unterspannung_TF_XIX_Klima
    delegate Grundumfang_XIX_Klima.RP_IF_EASV3_Err_Unterspannung_TNCTOC_XIX_Grundumfang_XIX_Klima <-> outer port RP_IF_EASV3_Err_Unterspannung_TNCTOC_XIX_Klima
    delegate Grundumfang_XIX_Klima.RP_IF_EASV3_ErrMem_State_XIX_Grundumfang_XIX_Klima <-> outer port RP_IF_EASV3_ErrMem_State_XIX_Klima
    delegate Grundumfang_XIX_Klima.RP_IF_EASV3_Geschwindigkeitsstatus_XIX_Grundumfang_XIX_Klima <-> outer port RP_IF_EASV3_Geschwindigkeitsstatus_XIX_Klima
    delegate Grundumfang_XIX_Klima.RP_IF_EASV3_Ist_Position_Aktuator_XIX_Grundumfang_XIX_Klima <-> outer port RP_IF_EASV3_Ist_Position_Aktuator_XIX_Klima
    delegate Grundumfang_XIX_Klima.RP_IF_EASV3_ResponseError_TNCTOC_XIX_Grundumfang_XIX_Klima <-> outer port RP_IF_EASV3_ResponseError_TNCTOC_XIX_Klima
    delegate Grundumfang_XIX_Klima.RP_IF_EASV3_ResponseError_XIX_Grundumfang_XIX_Klima <-> outer port RP_IF_EASV3_ResponseError_XIX_Klima
    delegate Grundumfang_XIX_Klima.RP_IF_EASV3_Spulenbestromung_XIX_Grundumfang_XIX_Klima <-> outer port RP_IF_EASV3_Spulenbestromung_XIX_Klima
    delegate Grundumfang_XIX_Klima.RP_IF_EASV3_Temp_Warning_XIX_Grundumfang_XIX_Klima <-> outer port RP_IF_EASV3_Temp_Warning_XIX_Klima
    delegate Grundumfang_XIX_Klima.RP_IF_EASV3_Temp_XIX_Grundumfang_XIX_Klima <-> outer port RP_IF_EASV3_Temp_XIX_Klima
    delegate Grundumfang_XIX_Klima.RP_IF_EASV4_Err_Blockierung_TF_XIX_Grundumfang_XIX_Klima <-> outer port RP_IF_EASV4_Err_Blockierung_TF_XIX_Klima
    delegate Grundumfang_XIX_Klima.RP_IF_EASV4_Err_Blockierung_TNCTOC_XIX_Grundumfang_XIX_Klima <-> outer port RP_IF_EASV4_Err_Blockierung_TNCTOC_XIX_Klima
    delegate Grundumfang_XIX_Klima.RP_IF_EASV4_Err_EDefekt_MoKomp_TF_XIX_Grundumfang_XIX_Klima <-> outer port RP_IF_EASV4_Err_EDefekt_MoKomp_TF_XIX_Klima
    delegate Grundumfang_XIX_Klima.RP_IF_EASV4_Err_EDefekt_MoKomp_TNCTOC_XIX_Grundumfang_XIX_Klima <-> outer port RP_IF_EASV4_Err_EDefekt_MoKomp_TNCTOC_XIX_Klima
    delegate Grundumfang_XIX_Klima.RP_IF_EASV4_Err_EDefekt_TSens_TF_XIX_Grundumfang_XIX_Klima <-> outer port RP_IF_EASV4_Err_EDefekt_TSens_TF_XIX_Klima
    delegate Grundumfang_XIX_Klima.RP_IF_EASV4_Err_EDefekt_TSens_TNCTOC_XIX_Grundumfang_XIX_Klima <-> outer port RP_IF_EASV4_Err_EDefekt_TSens_TNCTOC_XIX_Klima
    delegate Grundumfang_XIX_Klima.RP_IF_EASV4_Err_Notlaufpos_TF_XIX_Grundumfang_XIX_Klima <-> outer port RP_IF_EASV4_Err_Notlaufpos_TF_XIX_Klima
    delegate Grundumfang_XIX_Klima.RP_IF_EASV4_Err_Notlaufpos_TNCTOC_XIX_Grundumfang_XIX_Klima <-> outer port RP_IF_EASV4_Err_Notlaufpos_TNCTOC_XIX_Klima
    delegate Grundumfang_XIX_Klima.RP_IF_EASV4_Err_RAMROMNADChange_TF_XIX_Grundumfang_XIX_Klima <-> outer port RP_IF_EASV4_Err_RAMROMNADChange_TF_XIX_Klima
    delegate Grundumfang_XIX_Klima.RP_IF_EASV4_Err_RAMROMNADChange_TNCTOC_XIX_Grundumfang_XIX_Klima <-> outer port RP_IF_EASV4_Err_RAMROMNADChange_TNCTOC_XIX_Klima
    delegate Grundumfang_XIX_Klima.RP_IF_EASV4_Err_Ueberspannung_TF_XIX_Grundumfang_XIX_Klima <-> outer port RP_IF_EASV4_Err_Ueberspannung_TF_XIX_Klima
    delegate Grundumfang_XIX_Klima.RP_IF_EASV4_Err_Ueberspannung_TNCTOC_XIX_Grundumfang_XIX_Klima <-> outer port RP_IF_EASV4_Err_Ueberspannung_TNCTOC_XIX_Klima
    delegate Grundumfang_XIX_Klima.RP_IF_EASV4_Err_Uebertemperatur_TF_XIX_Grundumfang_XIX_Klima <-> outer port RP_IF_EASV4_Err_Uebertemperatur_TF_XIX_Klima
    delegate Grundumfang_XIX_Klima.RP_IF_EASV4_Err_Uebertemperatur_TNCTOC_XIX_Grundumfang_XIX_Klima <-> outer port RP_IF_EASV4_Err_Uebertemperatur_TNCTOC_XIX_Klima
    delegate Grundumfang_XIX_Klima.RP_IF_EASV4_Err_Unterspannung_TF_XIX_Grundumfang_XIX_Klima <-> outer port RP_IF_EASV4_Err_Unterspannung_TF_XIX_Klima
    delegate Grundumfang_XIX_Klima.RP_IF_EASV4_Err_Unterspannung_TNCTOC_XIX_Grundumfang_XIX_Klima <-> outer port RP_IF_EASV4_Err_Unterspannung_TNCTOC_XIX_Klima
    delegate Grundumfang_XIX_Klima.RP_IF_EASV4_ErrMem_State_XIX_Grundumfang_XIX_Klima <-> outer port RP_IF_EASV4_ErrMem_State_XIX_Klima
    delegate Grundumfang_XIX_Klima.RP_IF_EASV4_Geschwindigkeitsstatus_XIX_Grundumfang_XIX_Klima <-> outer port RP_IF_EASV4_Geschwindigkeitsstatus_XIX_Klima
    delegate Grundumfang_XIX_Klima.RP_IF_EASV4_Ist_Position_Aktuator_XIX_Grundumfang_XIX_Klima <-> outer port RP_IF_EASV4_Ist_Position_Aktuator_XIX_Klima
    delegate Grundumfang_XIX_Klima.RP_IF_EASV4_ResponseError_TNCTOC_XIX_Grundumfang_XIX_Klima <-> outer port RP_IF_EASV4_ResponseError_TNCTOC_XIX_Klima
    delegate Grundumfang_XIX_Klima.RP_IF_EASV4_ResponseError_XIX_Grundumfang_XIX_Klima <-> outer port RP_IF_EASV4_ResponseError_XIX_Klima
    delegate Grundumfang_XIX_Klima.RP_IF_EASV4_Spulenbestromung_XIX_Grundumfang_XIX_Klima <-> outer port RP_IF_EASV4_Spulenbestromung_XIX_Klima
    delegate Grundumfang_XIX_Klima.RP_IF_EASV4_Temp_Warning_XIX_Grundumfang_XIX_Klima <-> outer port RP_IF_EASV4_Temp_Warning_XIX_Klima
    delegate Grundumfang_XIX_Klima.RP_IF_EASV4_Temp_XIX_Grundumfang_XIX_Klima <-> outer port RP_IF_EASV4_Temp_XIX_Klima
    delegate Grundumfang_XIX_Klima.RP_IF_EASV5_Err_Blockierung_TF_XIX_Grundumfang_XIX_Klima <-> outer port RP_IF_EASV5_Err_Blockierung_TF_XIX_Klima
    delegate Grundumfang_XIX_Klima.RP_IF_EASV5_Err_Blockierung_TNCTOC_XIX_Grundumfang_XIX_Klima <-> outer port RP_IF_EASV5_Err_Blockierung_TNCTOC_XIX_Klima
    delegate Grundumfang_XIX_Klima.RP_IF_EASV5_Err_EDefekt_MoKomp_TF_XIX_Grundumfang_XIX_Klima <-> outer port RP_IF_EASV5_Err_EDefekt_MoKomp_TF_XIX_Klima
    delegate Grundumfang_XIX_Klima.RP_IF_EASV5_Err_EDefekt_MoKomp_TNCTOC_XIX_Grundumfang_XIX_Klima <-> outer port RP_IF_EASV5_Err_EDefekt_MoKomp_TNCTOC_XIX_Klima
    delegate Grundumfang_XIX_Klima.RP_IF_EASV5_Err_EDefekt_TSens_TF_XIX_Grundumfang_XIX_Klima <-> outer port RP_IF_EASV5_Err_EDefekt_TSens_TF_XIX_Klima
    delegate Grundumfang_XIX_Klima.RP_IF_EASV5_Err_EDefekt_TSens_TNCTOC_XIX_Grundumfang_XIX_Klima <-> outer port RP_IF_EASV5_Err_EDefekt_TSens_TNCTOC_XIX_Klima
    delegate Grundumfang_XIX_Klima.RP_IF_EASV5_Err_Notlaufpos_TF_XIX_Grundumfang_XIX_Klima <-> outer port RP_IF_EASV5_Err_Notlaufpos_TF_XIX_Klima
    delegate Grundumfang_XIX_Klima.RP_IF_EASV5_Err_Notlaufpos_TNCTOC_XIX_Grundumfang_XIX_Klima <-> outer port RP_IF_EASV5_Err_Notlaufpos_TNCTOC_XIX_Klima
    delegate Grundumfang_XIX_Klima.RP_IF_EASV5_Err_RAMROMNADChange_TF_XIX_Grundumfang_XIX_Klima <-> outer port RP_IF_EASV5_Err_RAMROMNADChange_TF_XIX_Klima
    delegate Grundumfang_XIX_Klima.RP_IF_EASV5_Err_RAMROMNADChange_TNCTOC_XIX_Grundumfang_XIX_Klima <-> outer port RP_IF_EASV5_Err_RAMROMNADChange_TNCTOC_XIX_Klima
    delegate Grundumfang_XIX_Klima.RP_IF_EASV5_Err_Ueberspannung_TF_XIX_Grundumfang_XIX_Klima <-> outer port RP_IF_EASV5_Err_Ueberspannung_TF_XIX_Klima
    delegate Grundumfang_XIX_Klima.RP_IF_EASV5_Err_Ueberspannung_TNCTOC_XIX_Grundumfang_XIX_Klima <-> outer port RP_IF_EASV5_Err_Ueberspannung_TNCTOC_XIX_Klima
    delegate Grundumfang_XIX_Klima.RP_IF_EASV5_Err_Uebertemperatur_TF_XIX_Grundumfang_XIX_Klima <-> outer port RP_IF_EASV5_Err_Uebertemperatur_TF_XIX_Klima
    delegate Grundumfang_XIX_Klima.RP_IF_EASV5_Err_Uebertemperatur_TNCTOC_XIX_Grundumfang_XIX_Klima <-> outer port RP_IF_EASV5_Err_Uebertemperatur_TNCTOC_XIX_Klima
    delegate Grundumfang_XIX_Klima.RP_IF_EASV5_Err_Unterspannung_TF_XIX_Grundumfang_XIX_Klima <-> outer port RP_IF_EASV5_Err_Unterspannung_TF_XIX_Klima
    delegate Grundumfang_XIX_Klima.RP_IF_EASV5_Err_Unterspannung_TNCTOC_XIX_Grundumfang_XIX_Klima <-> outer port RP_IF_EASV5_Err_Unterspannung_TNCTOC_XIX_Klima
    delegate Grundumfang_XIX_Klima.RP_IF_EASV5_ErrMem_State_XIX_Grundumfang_XIX_Klima <-> outer port RP_IF_EASV5_ErrMem_State_XIX_Klima
    delegate Grundumfang_XIX_Klima.RP_IF_EASV5_Geschwindigkeitsstatus_XIX_Grundumfang_XIX_Klima <-> outer port RP_IF_EASV5_Geschwindigkeitsstatus_XIX_Klima
    delegate Grundumfang_XIX_Klima.RP_IF_EASV5_Ist_Position_Aktuator_XIX_Grundumfang_XIX_Klima <-> outer port RP_IF_EASV5_Ist_Position_Aktuator_XIX_Klima
    delegate Grundumfang_XIX_Klima.RP_IF_EASV5_ResponseError_TNCTOC_XIX_Grundumfang_XIX_Klima <-> outer port RP_IF_EASV5_ResponseError_TNCTOC_XIX_Klima
    delegate Grundumfang_XIX_Klima.RP_IF_EASV5_ResponseError_XIX_Grundumfang_XIX_Klima <-> outer port RP_IF_EASV5_ResponseError_XIX_Klima
    delegate Grundumfang_XIX_Klima.RP_IF_EASV5_Spulenbestromung_XIX_Grundumfang_XIX_Klima <-> outer port RP_IF_EASV5_Spulenbestromung_XIX_Klima
    delegate Grundumfang_XIX_Klima.RP_IF_EASV5_Temp_Warning_XIX_Grundumfang_XIX_Klima <-> outer port RP_IF_EASV5_Temp_Warning_XIX_Klima
    delegate Grundumfang_XIX_Klima.RP_IF_EASV5_temp_XIX_Grundumfang_XIX_Klima <-> outer port RP_IF_EASV5_temp_XIX_Klima
    delegate Grundumfang_XIX_Klima.RP_IF_eCall_Funktionsstatus_02_XIX_Grundumfang_XIX_Klima <-> outer port RP_IF_eCall_Funktionsstatus_02_XIX_Klima
    delegate Grundumfang_XIX_Klima.RP_IF_EKK4_Comp_Error_Mask_Nr_XIX_Grundumfang_XIX_Klima <-> outer port RP_IF_EKK4_Comp_Error_Mask_Nr_XIX_Klima
    delegate Grundumfang_XIX_Klima.RP_IF_EKK4_COMP_SPEED_XIX_Grundumfang_XIX_Klima <-> outer port RP_IF_EKK4_COMP_SPEED_XIX_Klima
    delegate Grundumfang_XIX_Klima.RP_IF_EKK4_COMP_ST_XIX_Grundumfang_XIX_Klima <-> outer port RP_IF_EKK4_COMP_ST_XIX_Klima
    delegate Grundumfang_XIX_Klima.RP_IF_EKK4_Err_Ind_Nr_1_8_15_22_XIX_Grundumfang_XIX_Klima <-> outer port RP_IF_EKK4_Err_Ind_Nr_1_8_15_22_XIX_Klima
    delegate Grundumfang_XIX_Klima.RP_IF_EKK4_Err_Ind_Nr_2_9_16_23_XIX_Grundumfang_XIX_Klima <-> outer port RP_IF_EKK4_Err_Ind_Nr_2_9_16_23_XIX_Klima
    delegate Grundumfang_XIX_Klima.RP_IF_EKK4_Err_Ind_Nr_3_10_17_24_XIX_Grundumfang_XIX_Klima <-> outer port RP_IF_EKK4_Err_Ind_Nr_3_10_17_24_XIX_Klima
    delegate Grundumfang_XIX_Klima.RP_IF_EKK4_Err_Ind_Nr_4_11_18_25_XIX_Grundumfang_XIX_Klima <-> outer port RP_IF_EKK4_Err_Ind_Nr_4_11_18_25_XIX_Klima
    delegate Grundumfang_XIX_Klima.RP_IF_EKK4_Err_Ind_Nr_5_12_19_26_XIX_Grundumfang_XIX_Klima <-> outer port RP_IF_EKK4_Err_Ind_Nr_5_12_19_26_XIX_Klima
    delegate Grundumfang_XIX_Klima.RP_IF_EKK4_Err_Ind_Nr_6_13_20_27_XIX_Grundumfang_XIX_Klima <-> outer port RP_IF_EKK4_Err_Ind_Nr_6_13_20_27_XIX_Klima
    delegate Grundumfang_XIX_Klima.RP_IF_EKK4_Err_Ind_Nr_7_14_21_28_XIX_Grundumfang_XIX_Klima <-> outer port RP_IF_EKK4_Err_Ind_Nr_7_14_21_28_XIX_Klima
    delegate Grundumfang_XIX_Klima.RP_IF_EKK4_Err_Ind_TF_1_7_XIX_Grundumfang_XIX_Klima <-> outer port RP_IF_EKK4_Err_Ind_TF_1_7_XIX_Klima
    delegate Grundumfang_XIX_Klima.RP_IF_EKK4_Err_Ind_TF_2_8_XIX_Grundumfang_XIX_Klima <-> outer port RP_IF_EKK4_Err_Ind_TF_2_8_XIX_Klima
    delegate Grundumfang_XIX_Klima.RP_IF_EKK4_Err_Ind_TF_3_9_XIX_Grundumfang_XIX_Klima <-> outer port RP_IF_EKK4_Err_Ind_TF_3_9_XIX_Klima
    delegate Grundumfang_XIX_Klima.RP_IF_EKK4_Err_Ind_TF_4_10_XIX_Grundumfang_XIX_Klima <-> outer port RP_IF_EKK4_Err_Ind_TF_4_10_XIX_Klima
    delegate Grundumfang_XIX_Klima.RP_IF_EKK4_Err_Ind_TF_5_11_XIX_Grundumfang_XIX_Klima <-> outer port RP_IF_EKK4_Err_Ind_TF_5_11_XIX_Klima
    delegate Grundumfang_XIX_Klima.RP_IF_EKK4_Err_Ind_TF_6_12_XIX_Grundumfang_XIX_Klima <-> outer port RP_IF_EKK4_Err_Ind_TF_6_12_XIX_Klima
    delegate Grundumfang_XIX_Klima.RP_IF_EKK4_ErrMem_State_XIX_Grundumfang_XIX_Klima <-> outer port RP_IF_EKK4_ErrMem_State_XIX_Klima
    delegate Grundumfang_XIX_Klima.RP_IF_EKK4_Fehler_AE_XIX_Grundumfang_XIX_Klima <-> outer port RP_IF_EKK4_Fehler_AE_XIX_Klima
    delegate Grundumfang_XIX_Klima.RP_IF_EKK4_HIGH_VOLTAGE_XIX_Grundumfang_XIX_Klima <-> outer port RP_IF_EKK4_HIGH_VOLTAGE_XIX_Klima
    delegate Grundumfang_XIX_Klima.RP_IF_EKK4_INPUT_CURRENT_XIX_Grundumfang_XIX_Klima <-> outer port RP_IF_EKK4_INPUT_CURRENT_XIX_Klima
    delegate Grundumfang_XIX_Klima.RP_IF_EKK4_INV_TEMP_XIX_Grundumfang_XIX_Klima <-> outer port RP_IF_EKK4_INV_TEMP_XIX_Klima
    delegate Grundumfang_XIX_Klima.RP_IF_EKK4_Level_Rsp_XIX_Grundumfang_XIX_Klima <-> outer port RP_IF_EKK4_Level_Rsp_XIX_Klima
    delegate Grundumfang_XIX_Klima.RP_IF_EKK4_Match_XIX_Grundumfang_XIX_Klima <-> outer port RP_IF_EKK4_Match_XIX_Klima
    delegate Grundumfang_XIX_Klima.RP_IF_EKK4_MUX_Err_Ind_XIX_Grundumfang_XIX_Klima <-> outer port RP_IF_EKK4_MUX_Err_Ind_XIX_Klima
    delegate Grundumfang_XIX_Klima.RP_IF_EKK4_Number_of_Err_Ind_TF_XIX_Grundumfang_XIX_Klima <-> outer port RP_IF_EKK4_Number_of_Err_Ind_TF_XIX_Klima
    delegate Grundumfang_XIX_Klima.RP_IF_EKK4_ParameterChange_XIX_Grundumfang_XIX_Klima <-> outer port RP_IF_EKK4_ParameterChange_XIX_Klima
    delegate Grundumfang_XIX_Klima.RP_IF_EKK4_Q_High_Voltage_XIX_Grundumfang_XIX_Klima <-> outer port RP_IF_EKK4_Q_High_Voltage_XIX_Klima
    delegate Grundumfang_XIX_Klima.RP_IF_EKK4_Reason_Err_Ind_TF_1_7_XIX_Grundumfang_XIX_Klima <-> outer port RP_IF_EKK4_Reason_Err_Ind_TF_1_7_XIX_Klima
    delegate Grundumfang_XIX_Klima.RP_IF_EKK4_Reason_Err_Ind_TF_2_8_XIX_Grundumfang_XIX_Klima <-> outer port RP_IF_EKK4_Reason_Err_Ind_TF_2_8_XIX_Klima
    delegate Grundumfang_XIX_Klima.RP_IF_EKK4_Reason_Err_Ind_TF_3_9_XIX_Grundumfang_XIX_Klima <-> outer port RP_IF_EKK4_Reason_Err_Ind_TF_3_9_XIX_Klima
    delegate Grundumfang_XIX_Klima.RP_IF_EKK4_Reason_Err_Ind_TF_4_10_XIX_Grundumfang_XIX_Klima <-> outer port RP_IF_EKK4_Reason_Err_Ind_TF_4_10_XIX_Klima
    delegate Grundumfang_XIX_Klima.RP_IF_EKK4_Reason_Err_Ind_TF_5_11_XIX_Grundumfang_XIX_Klima <-> outer port RP_IF_EKK4_Reason_Err_Ind_TF_5_11_XIX_Klima
    delegate Grundumfang_XIX_Klima.RP_IF_EKK4_Reason_Err_Ind_TF_6_12_XIX_Grundumfang_XIX_Klima <-> outer port RP_IF_EKK4_Reason_Err_Ind_TF_6_12_XIX_Klima
    delegate Grundumfang_XIX_Klima.RP_IF_EKK4_ResponseError_XIX_Grundumfang_XIX_Klima <-> outer port RP_IF_EKK4_ResponseError_XIX_Klima
    delegate Grundumfang_XIX_Klima.RP_IF_EKK4_TF_Change_XIX_Grundumfang_XIX_Klima <-> outer port RP_IF_EKK4_TF_Change_XIX_Klima
    delegate Grundumfang_XIX_Klima.RP_IF_EM1_MinVorlauftemperatur_XIX_Grundumfang_XIX_Klima <-> outer port RP_IF_EM1_MinVorlauftemperatur_XIX_Klima
    delegate Grundumfang_XIX_Klima.RP_IF_ESC_Anf_KV_XIX_Grundumfang_XIX_Klima <-> outer port RP_IF_ESC_Anf_KV_XIX_Klima
    delegate Grundumfang_XIX_Klima.RP_IF_ESC_Anf_Mindestreku_XIX_Grundumfang_XIX_Klima <-> outer port RP_IF_ESC_Anf_Mindestreku_XIX_Klima
    delegate Grundumfang_XIX_Klima.RP_IF_ESP_QBit_v_Signal_XIX_Grundumfang_XIX_Klima <-> outer port RP_IF_ESP_QBit_v_Signal_XIX_Klima
    delegate Grundumfang_XIX_Klima.RP_IF_ESP_v_Signal_XIX_Grundumfang_XIX_Klima <-> outer port RP_IF_ESP_v_Signal_XIX_Klima
    delegate Grundumfang_XIX_Klima.RP_IF_eTM_Batterieheizen_Anf_XIX_Grundumfang_XIX_Klima <-> outer port RP_IF_eTM_Batterieheizen_Anf_XIX_Klima
    delegate Grundumfang_XIX_Klima.RP_IF_eTM_BMS_Pumpe1_Befuellung_XIX_Grundumfang_XIX_Klima <-> outer port RP_IF_eTM_BMS_Pumpe1_Befuellung_XIX_Klima
    delegate Grundumfang_XIX_Klima.RP_IF_eTM_BMS_Pumpe1_SollAnsteuerung_XIX_Grundumfang_XIX_Klima <-> outer port RP_IF_eTM_BMS_Pumpe1_SollAnsteuerung_XIX_Klima
    delegate Grundumfang_XIX_Klima.RP_IF_eTM_BMS_ThermischeIstLeistung_XIX_Grundumfang_XIX_Klima <-> outer port RP_IF_eTM_BMS_ThermischeIstLeistung_XIX_Klima
    delegate Grundumfang_XIX_Klima.RP_IF_eTM_BMS_Ventil1_Befuellung_XIX_Grundumfang_XIX_Klima <-> outer port RP_IF_eTM_BMS_Ventil1_Befuellung_XIX_Klima
    delegate Grundumfang_XIX_Klima.RP_IF_eTM_BMS_Ventil2_Befuellung_XIX_Grundumfang_XIX_Klima <-> outer port RP_IF_eTM_BMS_Ventil2_Befuellung_XIX_Klima
    delegate Grundumfang_XIX_Klima.RP_IF_eTM_HVBatt_IstVolumenstrom_XIX_Grundumfang_XIX_Klima <-> outer port RP_IF_eTM_HVBatt_IstVolumenstrom_XIX_Klima
    delegate Grundumfang_XIX_Klima.RP_IF_eTM_HWT_IstVolumenstrom_XIX_Grundumfang_XIX_Klima <-> outer port RP_IF_eTM_HWT_IstVolumenstrom_XIX_Klima
    delegate Grundumfang_XIX_Klima.RP_IF_eTM_Ist_rLM_XIX_Grundumfang_XIX_Klima <-> outer port RP_IF_eTM_Ist_rLM_XIX_Klima
    delegate Grundumfang_XIX_Klima.RP_IF_eTM_Kuehlung_Status_XIX_Grundumfang_XIX_Klima <-> outer port RP_IF_eTM_Kuehlung_Status_XIX_Klima
    delegate Grundumfang_XIX_Klima.RP_IF_eTM_Pumpe1_Status_XIX_Grundumfang_XIX_Klima <-> outer port RP_IF_eTM_Pumpe1_Status_XIX_Klima
    delegate Grundumfang_XIX_Klima.RP_IF_eTM_Pumpe1_Volumenstrom_XIX_Grundumfang_XIX_Klima <-> outer port RP_IF_eTM_Pumpe1_Volumenstrom_XIX_Klima
    delegate Grundumfang_XIX_Klima.RP_IF_eTM_Pumpe2_Status_XIX_Grundumfang_XIX_Klima <-> outer port RP_IF_eTM_Pumpe2_Status_XIX_Klima
    delegate Grundumfang_XIX_Klima.RP_IF_eTM_Pumpe2_Volumenstrom_XIX_Grundumfang_XIX_Klima <-> outer port RP_IF_eTM_Pumpe2_Volumenstrom_XIX_Klima
    delegate Grundumfang_XIX_Klima.RP_IF_eTM_PumpeAntrieb_Ansteuerung_XIX_Grundumfang_XIX_Klima <-> outer port RP_IF_eTM_PumpeAntrieb_Ansteuerung_XIX_Klima
    delegate Grundumfang_XIX_Klima.RP_IF_eTM_PumpeBat_Ansteuerung_XIX_Grundumfang_XIX_Klima <-> outer port RP_IF_eTM_PumpeBat_Ansteuerung_XIX_Klima
    delegate Grundumfang_XIX_Klima.RP_IF_eTM_PumpeHWT_Ansteuerung_XIX_Grundumfang_XIX_Klima <-> outer port RP_IF_eTM_PumpeHWT_Ansteuerung_XIX_Klima
    delegate Grundumfang_XIX_Klima.RP_IF_eTM_PV1_Ansteuerung_XIX_Grundumfang_XIX_Klima <-> outer port RP_IF_eTM_PV1_Ansteuerung_XIX_Klima
    delegate Grundumfang_XIX_Klima.RP_IF_eTM_PV2_Ansteuerung_XIX_Grundumfang_XIX_Klima <-> outer port RP_IF_eTM_PV2_Ansteuerung_XIX_Klima
    delegate Grundumfang_XIX_Klima.RP_IF_eTM_PWR_MinVorlaufTemp_XIX_Grundumfang_XIX_Klima <-> outer port RP_IF_eTM_PWR_MinVorlaufTemp_XIX_Klima
    delegate Grundumfang_XIX_Klima.RP_IF_eTM_Temperatur_1_XIX_Grundumfang_XIX_Klima <-> outer port RP_IF_eTM_Temperatur_1_XIX_Klima
    delegate Grundumfang_XIX_Klima.RP_IF_eTM_Temperatur_2_XIX_Grundumfang_XIX_Klima <-> outer port RP_IF_eTM_Temperatur_2_XIX_Klima
    delegate Grundumfang_XIX_Klima.RP_IF_eTM_Ventil{1..3}_Status_XIX_Grundumfang_XIX_Klima <-> outer port RP_IF_eTM_Ventil{1..3}_Status_XIX_Klima
    delegate Grundumfang_XIX_Klima.RP_IF_eTM_Wasserheizer_IstVolumenstrom_XIX_Grundumfang_XIX_Klima <-> outer port RP_IF_eTM_Wasserheizer_IstVolumenstrom_XIX_Klima
    delegate Grundumfang_XIX_Klima.RP_IF_eTM_Wasserheizer_SollTemp_Ausgng_XIX_Grundumfang_XIX_Klima <-> outer port RP_IF_eTM_Wasserheizer_SollTemp_Ausgng_XIX_Klima
    delegate Grundumfang_XIX_Klima.RP_IF_EXV1_Err_Blockierung_TF_XIX_Grundumfang_XIX_Klima <-> outer port RP_IF_EXV1_Err_Blockierung_TF_XIX_Klima
    delegate Grundumfang_XIX_Klima.RP_IF_EXV1_Err_Blockierung_TNCTOC_XIX_Grundumfang_XIX_Klima <-> outer port RP_IF_EXV1_Err_Blockierung_TNCTOC_XIX_Klima
    delegate Grundumfang_XIX_Klima.RP_IF_EXV1_Err_EDefekt_MoKomp_TF_XIX_Grundumfang_XIX_Klima <-> outer port RP_IF_EXV1_Err_EDefekt_MoKomp_TF_XIX_Klima
    delegate Grundumfang_XIX_Klima.RP_IF_EXV1_Err_EDefekt_MoKomp_TNCTOC_XIX_Grundumfang_XIX_Klima <-> outer port RP_IF_EXV1_Err_EDefekt_MoKomp_TNCTOC_XIX_Klima
    delegate Grundumfang_XIX_Klima.RP_IF_EXV1_Err_EDefekt_TSens_TF_XIX_Grundumfang_XIX_Klima <-> outer port RP_IF_EXV1_Err_EDefekt_TSens_TF_XIX_Klima
    delegate Grundumfang_XIX_Klima.RP_IF_EXV1_Err_EDefekt_TSens_TNCTOC_XIX_Grundumfang_XIX_Klima <-> outer port RP_IF_EXV1_Err_EDefekt_TSens_TNCTOC_XIX_Klima
    delegate Grundumfang_XIX_Klima.RP_IF_EXV1_Err_Notlaufpos_TF_XIX_Grundumfang_XIX_Klima <-> outer port RP_IF_EXV1_Err_Notlaufpos_TF_XIX_Klima
    delegate Grundumfang_XIX_Klima.RP_IF_EXV1_Err_Notlaufpos_TNCTOC_XIX_Grundumfang_XIX_Klima <-> outer port RP_IF_EXV1_Err_Notlaufpos_TNCTOC_XIX_Klima
    delegate Grundumfang_XIX_Klima.RP_IF_EXV1_Err_RAMROMNADChange_TF_XIX_Grundumfang_XIX_Klima <-> outer port RP_IF_EXV1_Err_RAMROMNADChange_TF_XIX_Klima
    delegate Grundumfang_XIX_Klima.RP_IF_EXV1_Err_RAMROMNADChange_TNCTOC_XIX_Grundumfang_XIX_Klima <-> outer port RP_IF_EXV1_Err_RAMROMNADChange_TNCTOC_XIX_Klima
    delegate Grundumfang_XIX_Klima.RP_IF_EXV1_Err_Ueberspannung_TF_XIX_Grundumfang_XIX_Klima <-> outer port RP_IF_EXV1_Err_Ueberspannung_TF_XIX_Klima
    delegate Grundumfang_XIX_Klima.RP_IF_EXV1_Err_Ueberspannung_TNCTOC_XIX_Grundumfang_XIX_Klima <-> outer port RP_IF_EXV1_Err_Ueberspannung_TNCTOC_XIX_Klima
    delegate Grundumfang_XIX_Klima.RP_IF_EXV1_Err_Uebertemperatur_TF_XIX_Grundumfang_XIX_Klima <-> outer port RP_IF_EXV1_Err_Uebertemperatur_TF_XIX_Klima
    delegate Grundumfang_XIX_Klima.RP_IF_EXV1_Err_Uebertemperatur_TNCTOC_XIX_Grundumfang_XIX_Klima <-> outer port RP_IF_EXV1_Err_Uebertemperatur_TNCTOC_XIX_Klima
    delegate Grundumfang_XIX_Klima.RP_IF_EXV1_Err_Unterspannung_TF_XIX_Grundumfang_XIX_Klima <-> outer port RP_IF_EXV1_Err_Unterspannung_TF_XIX_Klima
    delegate Grundumfang_XIX_Klima.RP_IF_EXV1_Err_Unterspannung_TNCTOC_XIX_Grundumfang_XIX_Klima <-> outer port RP_IF_EXV1_Err_Unterspannung_TNCTOC_XIX_Klima
    delegate Grundumfang_XIX_Klima.RP_IF_EXV1_ErrMem_State_XIX_Grundumfang_XIX_Klima <-> outer port RP_IF_EXV1_ErrMem_State_XIX_Klima
    delegate Grundumfang_XIX_Klima.RP_IF_EXV1_Geschwindigkeitsstatus_XIX_Grundumfang_XIX_Klima <-> outer port RP_IF_EXV1_Geschwindigkeitsstatus_XIX_Klima
    delegate Grundumfang_XIX_Klima.RP_IF_EXV1_Ist_Position_Aktuator_XIX_Grundumfang_XIX_Klima <-> outer port RP_IF_EXV1_Ist_Position_Aktuator_XIX_Klima
    delegate Grundumfang_XIX_Klima.RP_IF_EXV1_ResponseError_TNCTOC_XIX_Grundumfang_XIX_Klima <-> outer port RP_IF_EXV1_ResponseError_TNCTOC_XIX_Klima
    delegate Grundumfang_XIX_Klima.RP_IF_EXV1_ResponseError_XIX_Grundumfang_XIX_Klima <-> outer port RP_IF_EXV1_ResponseError_XIX_Klima
    delegate Grundumfang_XIX_Klima.RP_IF_EXV1_Spulenbestromung_XIX_Grundumfang_XIX_Klima <-> outer port RP_IF_EXV1_Spulenbestromung_XIX_Klima
    delegate Grundumfang_XIX_Klima.RP_IF_EXV1_Temp_Warning_XIX_Grundumfang_XIX_Klima <-> outer port RP_IF_EXV1_Temp_Warning_XIX_Klima
    delegate Grundumfang_XIX_Klima.RP_IF_EXV1_Temp_XIX_Grundumfang_XIX_Klima <-> outer port RP_IF_EXV1_Temp_XIX_Klima
    delegate Grundumfang_XIX_Klima.RP_IF_EXV2_Err_Blockierung_TF_XIX_Grundumfang_XIX_Klima <-> outer port RP_IF_EXV2_Err_Blockierung_TF_XIX_Klima
    delegate Grundumfang_XIX_Klima.RP_IF_EXV2_Err_Blockierung_TNCTOC_XIX_Grundumfang_XIX_Klima <-> outer port RP_IF_EXV2_Err_Blockierung_TNCTOC_XIX_Klima
    delegate Grundumfang_XIX_Klima.RP_IF_EXV2_Err_EDefekt_MoKomp_TF_XIX_Grundumfang_XIX_Klima <-> outer port RP_IF_EXV2_Err_EDefekt_MoKomp_TF_XIX_Klima
    delegate Grundumfang_XIX_Klima.RP_IF_EXV2_Err_EDefekt_MoKomp_TNCTOC_XIX_Grundumfang_XIX_Klima <-> outer port RP_IF_EXV2_Err_EDefekt_MoKomp_TNCTOC_XIX_Klima
    delegate Grundumfang_XIX_Klima.RP_IF_EXV2_Err_EDefekt_TSens_TF_XIX_Grundumfang_XIX_Klima <-> outer port RP_IF_EXV2_Err_EDefekt_TSens_TF_XIX_Klima
    delegate Grundumfang_XIX_Klima.RP_IF_EXV2_Err_EDefekt_TSens_TNCTOC_XIX_Grundumfang_XIX_Klima <-> outer port RP_IF_EXV2_Err_EDefekt_TSens_TNCTOC_XIX_Klima
    delegate Grundumfang_XIX_Klima.RP_IF_EXV2_Err_Notlaufpos_TF_XIX_Grundumfang_XIX_Klima <-> outer port RP_IF_EXV2_Err_Notlaufpos_TF_XIX_Klima
    delegate Grundumfang_XIX_Klima.RP_IF_EXV2_Err_Notlaufpos_TNCTOC_XIX_Grundumfang_XIX_Klima <-> outer port RP_IF_EXV2_Err_Notlaufpos_TNCTOC_XIX_Klima
    delegate Grundumfang_XIX_Klima.RP_IF_EXV2_Err_RAMROMNADChange_TF_XIX_Grundumfang_XIX_Klima <-> outer port RP_IF_EXV2_Err_RAMROMNADChange_TF_XIX_Klima
    delegate Grundumfang_XIX_Klima.RP_IF_EXV2_Err_RAMROMNADChange_TNCTOC_XIX_Grundumfang_XIX_Klima <-> outer port RP_IF_EXV2_Err_RAMROMNADChange_TNCTOC_XIX_Klima
    delegate Grundumfang_XIX_Klima.RP_IF_EXV2_Err_Ueberspannung_TF_XIX_Grundumfang_XIX_Klima <-> outer port RP_IF_EXV2_Err_Ueberspannung_TF_XIX_Klima
    delegate Grundumfang_XIX_Klima.RP_IF_EXV2_Err_Ueberspannung_TNCTOC_XIX_Grundumfang_XIX_Klima <-> outer port RP_IF_EXV2_Err_Ueberspannung_TNCTOC_XIX_Klima
    delegate Grundumfang_XIX_Klima.RP_IF_EXV2_Err_Uebertemperatur_TF_XIX_Grundumfang_XIX_Klima <-> outer port RP_IF_EXV2_Err_Uebertemperatur_TF_XIX_Klima
    delegate Grundumfang_XIX_Klima.RP_IF_EXV2_Err_Uebertemperatur_TNCTOC_XIX_Grundumfang_XIX_Klima <-> outer port RP_IF_EXV2_Err_Uebertemperatur_TNCTOC_XIX_Klima
    delegate Grundumfang_XIX_Klima.RP_IF_EXV2_Err_Unterspannung_TF_XIX_Grundumfang_XIX_Klima <-> outer port RP_IF_EXV2_Err_Unterspannung_TF_XIX_Klima
    delegate Grundumfang_XIX_Klima.RP_IF_EXV2_Err_Unterspannung_TNCTOC_XIX_Grundumfang_XIX_Klima <-> outer port RP_IF_EXV2_Err_Unterspannung_TNCTOC_XIX_Klima
    delegate Grundumfang_XIX_Klima.RP_IF_EXV2_ErrMem_State_XIX_Grundumfang_XIX_Klima <-> outer port RP_IF_EXV2_ErrMem_State_XIX_Klima
    delegate Grundumfang_XIX_Klima.RP_IF_EXV2_Geschwindigkeitsstatus_XIX_Grundumfang_XIX_Klima <-> outer port RP_IF_EXV2_Geschwindigkeitsstatus_XIX_Klima
    delegate Grundumfang_XIX_Klima.RP_IF_EXV2_Ist_Position_Aktuator_XIX_Grundumfang_XIX_Klima <-> outer port RP_IF_EXV2_Ist_Position_Aktuator_XIX_Klima
    delegate Grundumfang_XIX_Klima.RP_IF_EXV2_ResponseError_TNCTOC_XIX_Grundumfang_XIX_Klima <-> outer port RP_IF_EXV2_ResponseError_TNCTOC_XIX_Klima
    delegate Grundumfang_XIX_Klima.RP_IF_EXV2_ResponseError_XIX_Grundumfang_XIX_Klima <-> outer port RP_IF_EXV2_ResponseError_XIX_Klima
    delegate Grundumfang_XIX_Klima.RP_IF_EXV2_Spulenbestromung_XIX_Grundumfang_XIX_Klima <-> outer port RP_IF_EXV2_Spulenbestromung_XIX_Klima
    delegate Grundumfang_XIX_Klima.RP_IF_EXV2_Temp_Warning_XIX_Grundumfang_XIX_Klima <-> outer port RP_IF_EXV2_Temp_Warning_XIX_Klima
    delegate Grundumfang_XIX_Klima.RP_IF_EXV2_Temp_XIX_Grundumfang_XIX_Klima <-> outer port RP_IF_EXV2_Temp_XIX_Klima
    delegate Grundumfang_XIX_Klima.RP_IF_EXV3_Err_Blockierung_TF_XIX_Grundumfang_XIX_Klima <-> outer port RP_IF_EXV3_Err_Blockierung_TF_XIX_Klima
    delegate Grundumfang_XIX_Klima.RP_IF_EXV3_Err_Blockierung_TNCTOC_XIX_Grundumfang_XIX_Klima <-> outer port RP_IF_EXV3_Err_Blockierung_TNCTOC_XIX_Klima
    delegate Grundumfang_XIX_Klima.RP_IF_EXV3_Err_EDefekt_MoKomp_TF_XIX_Grundumfang_XIX_Klima <-> outer port RP_IF_EXV3_Err_EDefekt_MoKomp_TF_XIX_Klima
    delegate Grundumfang_XIX_Klima.RP_IF_EXV3_Err_EDefekt_MoKomp_TNCTOC_XIX_Grundumfang_XIX_Klima <-> outer port RP_IF_EXV3_Err_EDefekt_MoKomp_TNCTOC_XIX_Klima
    delegate Grundumfang_XIX_Klima.RP_IF_EXV3_Err_EDefekt_TSens_TF_XIX_Grundumfang_XIX_Klima <-> outer port RP_IF_EXV3_Err_EDefekt_TSens_TF_XIX_Klima
    delegate Grundumfang_XIX_Klima.RP_IF_EXV3_Err_EDefekt_TSens_TNCTOC_XIX_Grundumfang_XIX_Klima <-> outer port RP_IF_EXV3_Err_EDefekt_TSens_TNCTOC_XIX_Klima
    delegate Grundumfang_XIX_Klima.RP_IF_EXV3_Err_Notlaufpos_TF_XIX_Grundumfang_XIX_Klima <-> outer port RP_IF_EXV3_Err_Notlaufpos_TF_XIX_Klima
    delegate Grundumfang_XIX_Klima.RP_IF_EXV3_Err_Notlaufpos_TNCTOC_XIX_Grundumfang_XIX_Klima <-> outer port RP_IF_EXV3_Err_Notlaufpos_TNCTOC_XIX_Klima
    delegate Grundumfang_XIX_Klima.RP_IF_EXV3_Err_RAMROMNADChange_TF_XIX_Grundumfang_XIX_Klima <-> outer port RP_IF_EXV3_Err_RAMROMNADChange_TF_XIX_Klima
    delegate Grundumfang_XIX_Klima.RP_IF_EXV3_Err_RAMROMNADChange_TNCTOC_XIX_Grundumfang_XIX_Klima <-> outer port RP_IF_EXV3_Err_RAMROMNADChange_TNCTOC_XIX_Klima
    delegate Grundumfang_XIX_Klima.RP_IF_EXV3_Err_Ueberspannung_TF_XIX_Grundumfang_XIX_Klima <-> outer port RP_IF_EXV3_Err_Ueberspannung_TF_XIX_Klima
    delegate Grundumfang_XIX_Klima.RP_IF_EXV3_Err_Ueberspannung_TNCTOC_XIX_Grundumfang_XIX_Klima <-> outer port RP_IF_EXV3_Err_Ueberspannung_TNCTOC_XIX_Klima
    delegate Grundumfang_XIX_Klima.RP_IF_EXV3_Err_Uebertemperatur_TF_XIX_Grundumfang_XIX_Klima <-> outer port RP_IF_EXV3_Err_Uebertemperatur_TF_XIX_Klima
    delegate Grundumfang_XIX_Klima.RP_IF_EXV3_Err_Uebertemperatur_TNCTOC_XIX_Grundumfang_XIX_Klima <-> outer port RP_IF_EXV3_Err_Uebertemperatur_TNCTOC_XIX_Klima
    delegate Grundumfang_XIX_Klima.RP_IF_EXV3_Err_Unterspannung_TF_XIX_Grundumfang_XIX_Klima <-> outer port RP_IF_EXV3_Err_Unterspannung_TF_XIX_Klima
    delegate Grundumfang_XIX_Klima.RP_IF_EXV3_Err_Unterspannung_TNCTOC_XIX_Grundumfang_XIX_Klima <-> outer port RP_IF_EXV3_Err_Unterspannung_TNCTOC_XIX_Klima
    delegate Grundumfang_XIX_Klima.RP_IF_EXV3_ErrMem_State_XIX_Grundumfang_XIX_Klima <-> outer port RP_IF_EXV3_ErrMem_State_XIX_Klima
    delegate Grundumfang_XIX_Klima.RP_IF_EXV3_Geschwindigkeitsstatus_XIX_Grundumfang_XIX_Klima <-> outer port RP_IF_EXV3_Geschwindigkeitsstatus_XIX_Klima
    delegate Grundumfang_XIX_Klima.RP_IF_EXV3_Ist_Position_Aktuator_XIX_Grundumfang_XIX_Klima <-> outer port RP_IF_EXV3_Ist_Position_Aktuator_XIX_Klima
    delegate Grundumfang_XIX_Klima.RP_IF_EXV3_ResponseError_TNCTOC_XIX_Grundumfang_XIX_Klima <-> outer port RP_IF_EXV3_ResponseError_TNCTOC_XIX_Klima
    delegate Grundumfang_XIX_Klima.RP_IF_EXV3_ResponseError_XIX_Grundumfang_XIX_Klima <-> outer port RP_IF_EXV3_ResponseError_XIX_Klima
    delegate Grundumfang_XIX_Klima.RP_IF_EXV3_Spulenbestromung_XIX_Grundumfang_XIX_Klima <-> outer port RP_IF_EXV3_Spulenbestromung_XIX_Klima
    delegate Grundumfang_XIX_Klima.RP_IF_EXV3_Temp_Warning_XIX_Grundumfang_XIX_Klima <-> outer port RP_IF_EXV3_Temp_Warning_XIX_Klima
    delegate Grundumfang_XIX_Klima.RP_IF_EXV3_Temp_XIX_Grundumfang_XIX_Klima <-> outer port RP_IF_EXV3_Temp_XIX_Klima
    delegate Grundumfang_XIX_Klima.RP_IF_EXV4_Err_Blockierung_TF_XIX_Grundumfang_XIX_Klima <-> outer port RP_IF_EXV4_Err_Blockierung_TF_XIX_Klima
    delegate Grundumfang_XIX_Klima.RP_IF_EXV4_Err_Blockierung_TNCTOC_XIX_Grundumfang_XIX_Klima <-> outer port RP_IF_EXV4_Err_Blockierung_TNCTOC_XIX_Klima
    delegate Grundumfang_XIX_Klima.RP_IF_EXV4_Err_EDefekt_MoKomp_TF_XIX_Grundumfang_XIX_Klima <-> outer port RP_IF_EXV4_Err_EDefekt_MoKomp_TF_XIX_Klima
    delegate Grundumfang_XIX_Klima.RP_IF_EXV4_Err_EDefekt_MoKomp_TNCTOC_XIX_Grundumfang_XIX_Klima <-> outer port RP_IF_EXV4_Err_EDefekt_MoKomp_TNCTOC_XIX_Klima
    delegate Grundumfang_XIX_Klima.RP_IF_EXV4_Err_EDefekt_TSens_TF_XIX_Grundumfang_XIX_Klima <-> outer port RP_IF_EXV4_Err_EDefekt_TSens_TF_XIX_Klima
    delegate Grundumfang_XIX_Klima.RP_IF_EXV4_Err_EDefekt_TSens_TNCTOC_XIX_Grundumfang_XIX_Klima <-> outer port RP_IF_EXV4_Err_EDefekt_TSens_TNCTOC_XIX_Klima
    delegate Grundumfang_XIX_Klima.RP_IF_EXV4_Err_Notlaufpos_TF_XIX_Grundumfang_XIX_Klima <-> outer port RP_IF_EXV4_Err_Notlaufpos_TF_XIX_Klima
    delegate Grundumfang_XIX_Klima.RP_IF_EXV4_Err_Notlaufpos_TNCTOC_XIX_Grundumfang_XIX_Klima <-> outer port RP_IF_EXV4_Err_Notlaufpos_TNCTOC_XIX_Klima
    delegate Grundumfang_XIX_Klima.RP_IF_EXV4_Err_RAMROMNADChange_TF_XIX_Grundumfang_XIX_Klima <-> outer port RP_IF_EXV4_Err_RAMROMNADChange_TF_XIX_Klima
    delegate Grundumfang_XIX_Klima.RP_IF_EXV4_Err_RAMROMNADChange_TNCTOC_XIX_Grundumfang_XIX_Klima <-> outer port RP_IF_EXV4_Err_RAMROMNADChange_TNCTOC_XIX_Klima
    delegate Grundumfang_XIX_Klima.RP_IF_EXV4_Err_Ueberspannung_TF_XIX_Grundumfang_XIX_Klima <-> outer port RP_IF_EXV4_Err_Ueberspannung_TF_XIX_Klima
    delegate Grundumfang_XIX_Klima.RP_IF_EXV4_Err_Ueberspannung_TNCTOC_XIX_Grundumfang_XIX_Klima <-> outer port RP_IF_EXV4_Err_Ueberspannung_TNCTOC_XIX_Klima
    delegate Grundumfang_XIX_Klima.RP_IF_EXV4_Err_Uebertemperatur_TF_XIX_Grundumfang_XIX_Klima <-> outer port RP_IF_EXV4_Err_Uebertemperatur_TF_XIX_Klima
    delegate Grundumfang_XIX_Klima.RP_IF_EXV4_Err_Uebertemperatur_TNCTOC_XIX_Grundumfang_XIX_Klima <-> outer port RP_IF_EXV4_Err_Uebertemperatur_TNCTOC_XIX_Klima
    delegate Grundumfang_XIX_Klima.RP_IF_EXV4_Err_Unterspannung_TF_XIX_Grundumfang_XIX_Klima <-> outer port RP_IF_EXV4_Err_Unterspannung_TF_XIX_Klima
    delegate Grundumfang_XIX_Klima.RP_IF_EXV4_Err_Unterspannung_TNCTOC_XIX_Grundumfang_XIX_Klima <-> outer port RP_IF_EXV4_Err_Unterspannung_TNCTOC_XIX_Klima
    delegate Grundumfang_XIX_Klima.RP_IF_EXV4_ErrMem_State_XIX_Grundumfang_XIX_Klima <-> outer port RP_IF_EXV4_ErrMem_State_XIX_Klima
    delegate Grundumfang_XIX_Klima.RP_IF_EXV4_Geschwindigkeitsstatus_XIX_Grundumfang_XIX_Klima <-> outer port RP_IF_EXV4_Geschwindigkeitsstatus_XIX_Klima
    delegate Grundumfang_XIX_Klima.RP_IF_EXV4_Ist_Position_Aktuator_XIX_Grundumfang_XIX_Klima <-> outer port RP_IF_EXV4_Ist_Position_Aktuator_XIX_Klima
    delegate Grundumfang_XIX_Klima.RP_IF_EXV4_ResponseError_TNCTOC_XIX_Grundumfang_XIX_Klima <-> outer port RP_IF_EXV4_ResponseError_TNCTOC_XIX_Klima
    delegate Grundumfang_XIX_Klima.RP_IF_EXV4_ResponseError_XIX_Grundumfang_XIX_Klima <-> outer port RP_IF_EXV4_ResponseError_XIX_Klima
    delegate Grundumfang_XIX_Klima.RP_IF_EXV4_Spulenbestromung_XIX_Grundumfang_XIX_Klima <-> outer port RP_IF_EXV4_Spulenbestromung_XIX_Klima
    delegate Grundumfang_XIX_Klima.RP_IF_EXV4_Temp_Warning_XIX_Grundumfang_XIX_Klima <-> outer port RP_IF_EXV4_Temp_Warning_XIX_Klima
    delegate Grundumfang_XIX_Klima.RP_IF_EXV4_Temp_XIX_Grundumfang_XIX_Klima <-> outer port RP_IF_EXV4_Temp_XIX_Klima
    delegate Grundumfang_XIX_Klima.RP_IF_FoD_Transmission_Info_XIX_Grundumfang_XIX_Klima <-> outer port RP_IF_FoD_Transmission_Info_XIX_Klima
    delegate SC_447_FoD_Slave_8_XIX_Softwareblock_XIX_Klima.RP_IF_FoD_Transmission_Info_XIX_SC_447_FoD_Slave_8_XIX_Softwareblock_XIX_Klima <-> outer port RP_IF_FoD_Transmission_Info_XIX_Klima  # _XIX_SC_446_FoD_Distribution_Master_XIX_Softwareblock_XIX_ICAS1_X_Gateway_XIX_SC_447_FoD_Slave_8_XIX_Softwareblock_XIX_Klima_XIX_FoD_Transmission_Info
    delegate Grundumfang_XIX_Klima.RP_IF_FRS_active_container_XIX_Grundumfang_XIX_Klima <-> outer port RP_IF_FRS_active_container_XIX_Klima
    delegate Grundumfang_XIX_Klima.RP_IF_FRS_CurrentIntensity_XIX_Grundumfang_XIX_Klima <-> outer port RP_IF_FRS_CurrentIntensity_XIX_Klima
    delegate Grundumfang_XIX_Klima.RP_IF_FRS_Expiry_Container_{1..3}_XIX_Grundumfang_XIX_Klima <-> outer port RP_IF_FRS_Expiry_Container_{1..3}_XIX_Klima
    delegate Grundumfang_XIX_Klima.RP_IF_FRS_Fan_status_XIX_Grundumfang_XIX_Klima <-> outer port RP_IF_FRS_Fan_status_XIX_Klima
    delegate Grundumfang_XIX_Klima.RP_IF_FRS_FragranceID_Container_{1..3}_XIX_Grundumfang_XIX_Klima <-> outer port RP_IF_FRS_FragranceID_Container_{1..3}_XIX_Klima
    delegate Grundumfang_XIX_Klima.RP_IF_FRS_Level_Container_{1..3}_XIX_Grundumfang_XIX_Klima <-> outer port RP_IF_FRS_Level_Container_{1..3}_XIX_Klima
    delegate Grundumfang_XIX_Klima.RP_IF_FRS_ResponseError_XIX_Grundumfang_XIX_Klima <-> outer port RP_IF_FRS_ResponseError_XIX_Klima
    delegate Grundumfang_XIX_Klima.RP_IF_FRS_Status_UBatt_XIX_Grundumfang_XIX_Klima <-> outer port RP_IF_FRS_Status_UBatt_XIX_Klima
    delegate Grundumfang_XIX_Klima.RP_IF_FRS_Status_XIX_Grundumfang_XIX_Klima <-> outer port RP_IF_FRS_Status_XIX_Klima
    delegate Grundumfang_XIX_Klima.RP_IF_FRS_Stepper_Status_XIX_Grundumfang_XIX_Klima <-> outer port RP_IF_FRS_Stepper_Status_XIX_Klima
    delegate Grundumfang_XIX_Klima.RP_IF_FS_Luftfeuchte_rel_XIX_Grundumfang_XIX_Klima <-> outer port RP_IF_FS_Luftfeuchte_rel_XIX_Klima
    delegate Grundumfang_XIX_Klima.RP_IF_FS_ResponseError_XIX_Grundumfang_XIX_Klima <-> outer port RP_IF_FS_ResponseError_XIX_Klima
    delegate Grundumfang_XIX_Klima.RP_IF_FS_Taupunkt_XIX_Grundumfang_XIX_Klima <-> outer port RP_IF_FS_Taupunkt_XIX_Klima
    delegate Grundumfang_XIX_Klima.RP_IF_FS_Temp_Scheibe_XIX_Grundumfang_XIX_Klima <-> outer port RP_IF_FS_Temp_Scheibe_XIX_Klima
    delegate Grundumfang_XIX_Klima.RP_IF_FS_Temp_Sensor_XIX_Grundumfang_XIX_Klima <-> outer port RP_IF_FS_Temp_Sensor_XIX_Klima
    delegate Grundumfang_XIX_Klima.RP_IF_FSA_HW_XIX_Grundumfang_XIX_Klima <-> outer port RP_IF_FSA_HW_XIX_Klima
    delegate Grundumfang_XIX_Klima.RP_IF_FSA_Luftfeuchte_rel_XIX_Grundumfang_XIX_Klima <-> outer port RP_IF_FSA_Luftfeuchte_rel_XIX_Klima
    delegate Grundumfang_XIX_Klima.RP_IF_FSA_ResponseError_XIX_Grundumfang_XIX_Klima <-> outer port RP_IF_FSA_ResponseError_XIX_Klima
    delegate Grundumfang_XIX_Klima.RP_IF_FSA_Sensorheizung_Status_XIX_Grundumfang_XIX_Klima <-> outer port RP_IF_FSA_Sensorheizung_Status_XIX_Klima
    delegate Grundumfang_XIX_Klima.RP_IF_FSA_SW_XIX_Grundumfang_XIX_Klima <-> outer port RP_IF_FSA_SW_XIX_Klima
    delegate Grundumfang_XIX_Klima.RP_IF_FSA_Taupunkt_XIX_Grundumfang_XIX_Klima <-> outer port RP_IF_FSA_Taupunkt_XIX_Klima
    delegate Grundumfang_XIX_Klima.RP_IF_FSA_Temp_Luft_XIX_Grundumfang_XIX_Klima <-> outer port RP_IF_FSA_Temp_Luft_XIX_Klima
    delegate Grundumfang_XIX_Klima.RP_IF_FSA_Temp_Sensor_XIX_Grundumfang_XIX_Klima <-> outer port RP_IF_FSA_Temp_Sensor_XIX_Klima
    delegate Grundumfang_XIX_Klima.RP_IF_FT_FH_Oeffnung_XIX_Grundumfang_XIX_Klima <-> outer port RP_IF_FT_FH_Oeffnung_XIX_Klima
    delegate Grundumfang_XIX_Klima.RP_IF_FT_Tuer_geoeffnet_XIX_Grundumfang_XIX_Klima <-> outer port RP_IF_FT_Tuer_geoeffnet_XIX_Klima
    delegate Grundumfang_XIX_Klima.RP_IF_GNSS_Breite_Ortung_XIX_Grundumfang_XIX_Klima <-> outer port RP_IF_GNSS_Breite_Ortung_XIX_Klima
    delegate Grundumfang_XIX_Klima.RP_IF_GNSS_DR_Breite_Ortung_XIX_Grundumfang_XIX_Klima <-> outer port RP_IF_GNSS_DR_Breite_Ortung_XIX_Klima
    delegate Grundumfang_XIX_Klima.RP_IF_GNSS_DR_Laenge_Ortung_XIX_Grundumfang_XIX_Klima <-> outer port RP_IF_GNSS_DR_Laenge_Ortung_XIX_Klima
    delegate Grundumfang_XIX_Klima.RP_IF_GNSS_DR_Ortung_Ausrichtung_XIX_Grundumfang_XIX_Klima <-> outer port RP_IF_GNSS_DR_Ortung_Ausrichtung_XIX_Klima
    delegate Grundumfang_XIX_Klima.RP_IF_GNSS_DR_Ortung_Hoehe_XIX_Grundumfang_XIX_Klima <-> outer port RP_IF_GNSS_DR_Ortung_Hoehe_XIX_Klima
    delegate Grundumfang_XIX_Klima.RP_IF_GNSS_DR_Richtung_Breite_Ortung_XIX_Grundumfang_XIX_Klima <-> outer port RP_IF_GNSS_DR_Richtung_Breite_Ortung_XIX_Klima
    delegate Grundumfang_XIX_Klima.RP_IF_GNSS_DR_Richtung_Laenge_Ortung_XIX_Grundumfang_XIX_Klima <-> outer port RP_IF_GNSS_DR_Richtung_Laenge_Ortung_XIX_Klima
    delegate Grundumfang_XIX_Klima.RP_IF_GNSS_DR_UTC_Zeit_XIX_Grundumfang_XIX_Klima <-> outer port RP_IF_GNSS_DR_UTC_Zeit_XIX_Klima
    delegate Grundumfang_XIX_Klima.RP_IF_GNSS_Laenge_Ortung_XIX_Grundumfang_XIX_Klima <-> outer port RP_IF_GNSS_Laenge_Ortung_XIX_Klima
    delegate Grundumfang_XIX_Klima.RP_IF_GNSS_Ortung_Ausrichtung_XIX_Grundumfang_XIX_Klima <-> outer port RP_IF_GNSS_Ortung_Ausrichtung_XIX_Klima
    delegate Grundumfang_XIX_Klima.RP_IF_GNSS_Ortung_Hoehe_XIX_Grundumfang_XIX_Klima <-> outer port RP_IF_GNSS_Ortung_Hoehe_XIX_Klima
    delegate Grundumfang_XIX_Klima.RP_IF_GNSS_Richtung_Breite_Ortung_XIX_Grundumfang_XIX_Klima <-> outer port RP_IF_GNSS_Richtung_Breite_Ortung_XIX_Klima
    delegate Grundumfang_XIX_Klima.RP_IF_GNSS_Richtung_Laenge_Ortung_XIX_Grundumfang_XIX_Klima <-> outer port RP_IF_GNSS_Richtung_Laenge_Ortung_XIX_Klima
    delegate Grundumfang_XIX_Klima.RP_IF_GNSS_UTC_Zeit_XIX_Grundumfang_XIX_Klima <-> outer port RP_IF_GNSS_UTC_Zeit_XIX_Klima
    delegate Grundumfang_XIX_Klima.RP_IF_HBFS_FH_Oeffnung_XIX_Grundumfang_XIX_Klima <-> outer port RP_IF_HBFS_FH_Oeffnung_XIX_Klima
    delegate Grundumfang_XIX_Klima.RP_IF_HBFS_Tuer_geoeffnet_XIX_Grundumfang_XIX_Klima <-> outer port RP_IF_HBFS_Tuer_geoeffnet_XIX_Klima
    delegate Grundumfang_XIX_Klima.RP_IF_HDSG_Anf_Umluftklappe_XIX_Grundumfang_XIX_Klima <-> outer port RP_IF_HDSG_Anf_Umluftklappe_XIX_Klima
    delegate Grundumfang_XIX_Klima.RP_IF_HFS_FH_Oeffnung_XIX_Grundumfang_XIX_Klima <-> outer port RP_IF_HFS_FH_Oeffnung_XIX_Klima
    delegate Grundumfang_XIX_Klima.RP_IF_HFS_Tuer_geoeffnet_XIX_Grundumfang_XIX_Klima <-> outer port RP_IF_HFS_Tuer_geoeffnet_XIX_Klima
    delegate Grundumfang_XIX_Klima.RP_IF_HLR_FSH_Freigabe_XIX_Grundumfang_XIX_Klima <-> outer port RP_IF_HLR_FSH_Freigabe_XIX_Klima
    delegate Grundumfang_XIX_Klima.RP_IF_HLR_HSH_Freigabe_XIX_Grundumfang_XIX_Klima <-> outer port RP_IF_HLR_HSH_Freigabe_XIX_Klima
    delegate Grundumfang_XIX_Klima.RP_IF_HLR_LRH_Freigabe_XIX_Grundumfang_XIX_Klima <-> outer port RP_IF_HLR_LRH_Freigabe_XIX_Klima
    delegate Grundumfang_XIX_Klima.RP_IF_HLR_SIH_Freigabe_HL_XIX_Grundumfang_XIX_Klima <-> outer port RP_IF_HLR_SIH_Freigabe_HL_XIX_Klima
    delegate Grundumfang_XIX_Klima.RP_IF_HLR_SIH_Freigabe_HR_XIX_Grundumfang_XIX_Klima <-> outer port RP_IF_HLR_SIH_Freigabe_HR_XIX_Klima
    delegate Grundumfang_XIX_Klima.RP_IF_HLR_SIH_Freigabe_VL_XIX_Grundumfang_XIX_Klima <-> outer port RP_IF_HLR_SIH_Freigabe_VL_XIX_Klima
    delegate Grundumfang_XIX_Klima.RP_IF_HLR_SIH_Freigabe_VR_XIX_Grundumfang_XIX_Klima <-> outer port RP_IF_HLR_SIH_Freigabe_VR_XIX_Klima
    delegate Grundumfang_XIX_Klima.RP_IF_HLR_SIL_Freigabe_HL_XIX_Grundumfang_XIX_Klima <-> outer port RP_IF_HLR_SIL_Freigabe_HL_XIX_Klima
    delegate Grundumfang_XIX_Klima.RP_IF_HLR_SIL_Freigabe_HR_XIX_Grundumfang_XIX_Klima <-> outer port RP_IF_HLR_SIL_Freigabe_HR_XIX_Klima
    delegate Grundumfang_XIX_Klima.RP_IF_HLR_SIL_Freigabe_VL_XIX_Grundumfang_XIX_Klima <-> outer port RP_IF_HLR_SIL_Freigabe_VL_XIX_Klima
    delegate Grundumfang_XIX_Klima.RP_IF_HLR_SIL_Freigabe_VR_XIX_Grundumfang_XIX_Klima <-> outer port RP_IF_HLR_SIL_Freigabe_VR_XIX_Klima
    delegate Grundumfang_XIX_Klima.RP_IF_HSH_Status_XIX_Grundumfang_XIX_Klima <-> outer port RP_IF_HSH_Status_XIX_Klima
    delegate Grundumfang_XIX_Klima.RP_IF_HV_Bordnetz_aktiv_XIX_Grundumfang_XIX_Klima <-> outer port RP_IF_HV_Bordnetz_aktiv_XIX_Klima
    delegate Grundumfang_XIX_Klima.RP_IF_HV_Bordnetz_Fehler_XIX_Grundumfang_XIX_Klima <-> outer port RP_IF_HV_Bordnetz_Fehler_XIX_Klima
    delegate Grundumfang_XIX_Klima.RP_IF_HV_H3_Err_intern_XIX_Grundumfang_XIX_Klima <-> outer port RP_IF_HV_H3_Err_intern_XIX_Klima
    delegate Grundumfang_XIX_Klima.RP_IF_HV_H3_Err_Leckagestrom_XIX_Grundumfang_XIX_Klima <-> outer port RP_IF_HV_H3_Err_Leckagestrom_XIX_Klima
    delegate Grundumfang_XIX_Klima.RP_IF_HV_H3_Err_Temperaturschutz_XIX_Grundumfang_XIX_Klima <-> outer port RP_IF_HV_H3_Err_Temperaturschutz_XIX_Klima
    delegate Grundumfang_XIX_Klima.RP_IF_HV_H3_Err_Ueberstromabschaltung_XIX_Grundumfang_XIX_Klima <-> outer port RP_IF_HV_H3_Err_Ueberstromabschaltung_XIX_Klima
    delegate Grundumfang_XIX_Klima.RP_IF_HV_H3_HIGH_VOLTAGE_ERR_XIX_Grundumfang_XIX_Klima <-> outer port RP_IF_HV_H3_HIGH_VOLTAGE_ERR_XIX_Klima
    delegate Grundumfang_XIX_Klima.RP_IF_HV_H3_HIGH_VOLTAGE_XIX_Grundumfang_XIX_Klima <-> outer port RP_IF_HV_H3_HIGH_VOLTAGE_XIX_Klima
    delegate Grundumfang_XIX_Klima.RP_IF_HV_H3_I_ist_XIX_Grundumfang_XIX_Klima <-> outer port RP_IF_HV_H3_I_ist_XIX_Klima
    delegate Grundumfang_XIX_Klima.RP_IF_HV_H3_ResponseError_XIX_Grundumfang_XIX_Klima <-> outer port RP_IF_HV_H3_ResponseError_XIX_Klima
    delegate Grundumfang_XIX_Klima.RP_IF_HV_H3_Status_Heizer_XIX_Grundumfang_XIX_Klima <-> outer port RP_IF_HV_H3_Status_Heizer_XIX_Klima
    delegate Grundumfang_XIX_Klima.RP_IF_HV_H3_Status_Heizkreis_{1..4}_XIX_Grundumfang_XIX_Klima <-> outer port RP_IF_HV_H3_Status_Heizkreis_{1..4}_XIX_Klima
    delegate Grundumfang_XIX_Klima.RP_IF_HV_H3_Status_UBatt_NV_XIX_Grundumfang_XIX_Klima <-> outer port RP_IF_HV_H3_Status_UBatt_NV_XIX_Klima
    delegate Grundumfang_XIX_Klima.RP_IF_HV_H3_Temp_PCB_XIX_Grundumfang_XIX_Klima <-> outer port RP_IF_HV_H3_Temp_PCB_XIX_Klima
    delegate Grundumfang_XIX_Klima.RP_IF_HV_H3_TimeOut_Fehler_XIX_Grundumfang_XIX_Klima <-> outer port RP_IF_HV_H3_TimeOut_Fehler_XIX_Klima
    delegate Grundumfang_XIX_Klima.RP_IF_HV_H3_UBatt_NV_XIX_Grundumfang_XIX_Klima <-> outer port RP_IF_HV_H3_UBatt_NV_XIX_Klima
    delegate Grundumfang_XIX_Klima.RP_IF_HV_H3b_Err_intern_XIX_Grundumfang_XIX_Klima <-> outer port RP_IF_HV_H3b_Err_intern_XIX_Klima
    delegate Grundumfang_XIX_Klima.RP_IF_HV_H3b_Err_Leckagestrom_XIX_Grundumfang_XIX_Klima <-> outer port RP_IF_HV_H3b_Err_Leckagestrom_XIX_Klima
    delegate Grundumfang_XIX_Klima.RP_IF_HV_H3b_Err_Temperaturschutz_XIX_Grundumfang_XIX_Klima <-> outer port RP_IF_HV_H3b_Err_Temperaturschutz_XIX_Klima
    delegate Grundumfang_XIX_Klima.RP_IF_HV_H3b_Err_Ueberstromabschaltung_XIX_Grundumfang_XIX_Klima <-> outer port RP_IF_HV_H3b_Err_Ueberstromabschaltung_XIX_Klima
    delegate Grundumfang_XIX_Klima.RP_IF_HV_H3b_HIGH_VOLTAGE_ERR_XIX_Grundumfang_XIX_Klima <-> outer port RP_IF_HV_H3b_HIGH_VOLTAGE_ERR_XIX_Klima
    delegate Grundumfang_XIX_Klima.RP_IF_HV_H3b_HIGH_VOLTAGE_XIX_Grundumfang_XIX_Klima <-> outer port RP_IF_HV_H3b_HIGH_VOLTAGE_XIX_Klima
    delegate Grundumfang_XIX_Klima.RP_IF_HV_H3b_I_ist_XIX_Grundumfang_XIX_Klima <-> outer port RP_IF_HV_H3b_I_ist_XIX_Klima
    delegate Grundumfang_XIX_Klima.RP_IF_HV_H3b_ResponseError_XIX_Grundumfang_XIX_Klima <-> outer port RP_IF_HV_H3b_ResponseError_XIX_Klima
    delegate Grundumfang_XIX_Klima.RP_IF_HV_H3b_Status_Heizer_XIX_Grundumfang_XIX_Klima <-> outer port RP_IF_HV_H3b_Status_Heizer_XIX_Klima
    delegate Grundumfang_XIX_Klima.RP_IF_HV_H3b_Status_Heizkreis_{1..4}_XIX_Grundumfang_XIX_Klima <-> outer port RP_IF_HV_H3b_Status_Heizkreis_{1..4}_XIX_Klima
    delegate Grundumfang_XIX_Klima.RP_IF_HV_H3b_Status_UBatt_NV_XIX_Grundumfang_XIX_Klima <-> outer port RP_IF_HV_H3b_Status_UBatt_NV_XIX_Klima
    delegate Grundumfang_XIX_Klima.RP_IF_HV_H3b_Temp_PCB_XIX_Grundumfang_XIX_Klima <-> outer port RP_IF_HV_H3b_Temp_PCB_XIX_Klima
    delegate Grundumfang_XIX_Klima.RP_IF_HV_H3b_TimeOut_Fehler_XIX_Grundumfang_XIX_Klima <-> outer port RP_IF_HV_H3b_TimeOut_Fehler_XIX_Klima
    delegate Grundumfang_XIX_Klima.RP_IF_HV_H3b_UBatt_NV_XIX_Grundumfang_XIX_Klima <-> outer port RP_IF_HV_H3b_UBatt_NV_XIX_Klima
    delegate Grundumfang_XIX_Klima.RP_IF_HV_H6_aktive_Entladung_Status_XIX_Grundumfang_XIX_Klima <-> outer port RP_IF_HV_H6_aktive_Entladung_Status_XIX_Klima
    delegate Grundumfang_XIX_Klima.RP_IF_HV_H6_Err_Leckagestrom_XIX_Grundumfang_XIX_Klima <-> outer port RP_IF_HV_H6_Err_Leckagestrom_XIX_Klima
    delegate Grundumfang_XIX_Klima.RP_IF_HV_H6_Error_HVH_XIX_Grundumfang_XIX_Klima <-> outer port RP_IF_HV_H6_Error_HVH_XIX_Klima
    delegate Grundumfang_XIX_Klima.RP_IF_HV_H6_Heizmedium_Sensor_1_XIX_Grundumfang_XIX_Klima <-> outer port RP_IF_HV_H6_Heizmedium_Sensor_1_XIX_Klima
    delegate Grundumfang_XIX_Klima.RP_IF_HV_H6_Heizmedium_Sensor_2_XIX_Grundumfang_XIX_Klima <-> outer port RP_IF_HV_H6_Heizmedium_Sensor_2_XIX_Klima
    delegate Grundumfang_XIX_Klima.RP_IF_HV_H6_High_Voltage_XIX_Grundumfang_XIX_Klima <-> outer port RP_IF_HV_H6_High_Voltage_XIX_Klima
    delegate Grundumfang_XIX_Klima.RP_IF_HV_H6_HV_ERR_XIX_Grundumfang_XIX_Klima <-> outer port RP_IF_HV_H6_HV_ERR_XIX_Klima
    delegate Grundumfang_XIX_Klima.RP_IF_HV_H6_I_ist_XIX_Grundumfang_XIX_Klima <-> outer port RP_IF_HV_H6_I_ist_XIX_Klima
    delegate Grundumfang_XIX_Klima.RP_IF_HV_H6_PTC_ResponseError_XIX_Grundumfang_XIX_Klima <-> outer port RP_IF_HV_H6_PTC_ResponseError_XIX_Klima
    delegate Grundumfang_XIX_Klima.RP_IF_HV_H6_Status_HVH_XIX_Grundumfang_XIX_Klima <-> outer port RP_IF_HV_H6_Status_HVH_XIX_Klima
    delegate Grundumfang_XIX_Klima.RP_IF_HV_H6_Status_UBatt_XIX_Grundumfang_XIX_Klima <-> outer port RP_IF_HV_H6_Status_UBatt_XIX_Klima
    delegate Grundumfang_XIX_Klima.RP_IF_HV_H6_Temp_PCB_XIX_Grundumfang_XIX_Klima <-> outer port RP_IF_HV_H6_Temp_PCB_XIX_Klima
    delegate Grundumfang_XIX_Klima.RP_IF_HV_H6_UBatt_XIX_Grundumfang_XIX_Klima <-> outer port RP_IF_HV_H6_UBatt_XIX_Klima
    delegate Grundumfang_XIX_Klima.RP_IF_HVEM_Energie_Klima_Vorgabe_HighR_XIX_Grundumfang_XIX_Klima <-> outer port RP_IF_HVEM_Energie_Klima_Vorgabe_HighR_XIX_Klima
    delegate Grundumfang_XIX_Klima.RP_IF_HVEM_Energie_Klima_Vorgabe_XIX_Grundumfang_XIX_Klima <-> outer port RP_IF_HVEM_Energie_Klima_Vorgabe_XIX_Klima
    delegate Grundumfang_XIX_Klima.RP_IF_HVEM_FreigabeBattHeizung_XIX_Grundumfang_XIX_Klima <-> outer port RP_IF_HVEM_FreigabeBattHeizung_XIX_Klima
    delegate Grundumfang_XIX_Klima.RP_IF_HVEM_FreigabeKlimatisierung_XIX_Grundumfang_XIX_Klima <-> outer port RP_IF_HVEM_FreigabeKlimatisierung_XIX_Klima
    delegate Grundumfang_XIX_Klima.RP_IF_HVEM_HV_Anf_XIX_Grundumfang_XIX_Klima <-> outer port RP_IF_HVEM_HV_Anf_XIX_Klima
    delegate Grundumfang_XIX_Klima.RP_IF_HVEM_Leistung_Bat_Kond_Vorgabe_XIX_Grundumfang_XIX_Klima <-> outer port RP_IF_HVEM_Leistung_Bat_Kond_Vorgabe_XIX_Klima
    delegate Grundumfang_XIX_Klima.RP_IF_HVEM_Leistung_Klima_Vorgabe_XIX_Grundumfang_XIX_Klima <-> outer port RP_IF_HVEM_Leistung_Klima_Vorgabe_XIX_Klima
    delegate Grundumfang_XIX_Klima.RP_IF_HVEM_Nutzbare_Energie_XIX_Grundumfang_XIX_Klima <-> outer port RP_IF_HVEM_Nutzbare_Energie_XIX_Klima
    delegate Grundumfang_XIX_Klima.RP_IF_HVH2_Err_Heizkreis_{1..3}_XIX_Grundumfang_XIX_Klima <-> outer port RP_IF_HVH2_Err_Heizkreis_{1..3}_XIX_Klima
    delegate Grundumfang_XIX_Klima.RP_IF_HVH2_Err_intern_XIX_Grundumfang_XIX_Klima <-> outer port RP_IF_HVH2_Err_intern_XIX_Klima
    delegate Grundumfang_XIX_Klima.RP_IF_HVH2_Err_Leckagestrom_XIX_Grundumfang_XIX_Klima <-> outer port RP_IF_HVH2_Err_Leckagestrom_XIX_Klima
    delegate Grundumfang_XIX_Klima.RP_IF_HVH2_Err_Temperaturschutz_XIX_Grundumfang_XIX_Klima <-> outer port RP_IF_HVH2_Err_Temperaturschutz_XIX_Klima
    delegate Grundumfang_XIX_Klima.RP_IF_HVH2_Err_Ueberstromabschaltung_XIX_Grundumfang_XIX_Klima <-> outer port RP_IF_HVH2_Err_Ueberstromabschaltung_XIX_Klima
    delegate Grundumfang_XIX_Klima.RP_IF_HVH2_Heizmedium_Sensor_1_XIX_Grundumfang_XIX_Klima <-> outer port RP_IF_HVH2_Heizmedium_Sensor_1_XIX_Klima
    delegate Grundumfang_XIX_Klima.RP_IF_HVH2_Heizmedium_Sensor_2_XIX_Grundumfang_XIX_Klima <-> outer port RP_IF_HVH2_Heizmedium_Sensor_2_XIX_Klima
    delegate Grundumfang_XIX_Klima.RP_IF_HVH2_High_Voltage_XIX_Grundumfang_XIX_Klima <-> outer port RP_IF_HVH2_High_Voltage_XIX_Klima
    delegate Grundumfang_XIX_Klima.RP_IF_HVH2_HV_ERR_XIX_Grundumfang_XIX_Klima <-> outer port RP_IF_HVH2_HV_ERR_XIX_Klima
    delegate Grundumfang_XIX_Klima.RP_IF_HVH2_I_ist_XIX_Grundumfang_XIX_Klima <-> outer port RP_IF_HVH2_I_ist_XIX_Klima
    delegate Grundumfang_XIX_Klima.RP_IF_HVH2_ResponseError_XIX_Grundumfang_XIX_Klima <-> outer port RP_IF_HVH2_ResponseError_XIX_Klima
    delegate Grundumfang_XIX_Klima.RP_IF_HVH2_Status_HVH_XIX_Grundumfang_XIX_Klima <-> outer port RP_IF_HVH2_Status_HVH_XIX_Klima
    delegate Grundumfang_XIX_Klima.RP_IF_HVH2_Status_UBatt_XIX_Grundumfang_XIX_Klima <-> outer port RP_IF_HVH2_Status_UBatt_XIX_Klima
    delegate Grundumfang_XIX_Klima.RP_IF_HVH2_Temp_PCB_XIX_Grundumfang_XIX_Klima <-> outer port RP_IF_HVH2_Temp_PCB_XIX_Klima
    delegate Grundumfang_XIX_Klima.RP_IF_HVH2_Timeout_Fehler_XIX_Grundumfang_XIX_Klima <-> outer port RP_IF_HVH2_Timeout_Fehler_XIX_Klima
    delegate Grundumfang_XIX_Klima.RP_IF_HVH2_UBatt_XIX_Grundumfang_XIX_Klima <-> outer port RP_IF_HVH2_UBatt_XIX_Klima
    delegate Grundumfang_XIX_Klima.RP_IF_HVH_ErrMem_State_XIX_Grundumfang_XIX_Klima <-> outer port RP_IF_HVH_ErrMem_State_XIX_Klima
    delegate Grundumfang_XIX_Klima.RP_IF_HVH_HV_Ilock_Status_XIX_Grundumfang_XIX_Klima <-> outer port RP_IF_HVH_HV_Ilock_Status_XIX_Klima
    delegate Grundumfang_XIX_Klima.RP_IF_HVH_HV_Voltage_Offset_XIX_Grundumfang_XIX_Klima <-> outer port RP_IF_HVH_HV_Voltage_Offset_XIX_Klima
    delegate Grundumfang_XIX_Klima.RP_IF_HVH_HV_Voltage_XIX_Grundumfang_XIX_Klima <-> outer port RP_IF_HVH_HV_Voltage_XIX_Klima
    delegate Grundumfang_XIX_Klima.RP_IF_HVH_HVb_Ilock_Status_XIX_Grundumfang_XIX_Klima <-> outer port RP_IF_HVH_HVb_Ilock_Status_XIX_Klima
    delegate Grundumfang_XIX_Klima.RP_IF_HVH_HVb_Voltage_Offset_XIX_Grundumfang_XIX_Klima <-> outer port RP_IF_HVH_HVb_Voltage_Offset_XIX_Klima
    delegate Grundumfang_XIX_Klima.RP_IF_HVH_HVb_Voltage_XIX_Grundumfang_XIX_Klima <-> outer port RP_IF_HVH_HVb_Voltage_XIX_Klima
    delegate Grundumfang_XIX_Klima.RP_IF_HVH_ParameterChange_XIX_Grundumfang_XIX_Klima <-> outer port RP_IF_HVH_ParameterChange_XIX_Klima
    delegate Grundumfang_XIX_Klima.RP_IF_HVHb_ErrMem_State_XIX_Grundumfang_XIX_Klima <-> outer port RP_IF_HVHb_ErrMem_State_XIX_Klima
    delegate Grundumfang_XIX_Klima.RP_IF_HVHb_ParameterChange_XIX_Grundumfang_XIX_Klima <-> outer port RP_IF_HVHb_ParameterChange_XIX_Klima
    delegate Grundumfang_XIX_Klima.RP_IF_HVK_AktiveEntladung_Anf_XIX_Grundumfang_XIX_Klima <-> outer port RP_IF_HVK_AktiveEntladung_Anf_XIX_Klima
    delegate Grundumfang_XIX_Klima.RP_IF_HVK_HV_Netz_Warnungen_XIX_Grundumfang_XIX_Klima <-> outer port RP_IF_HVK_HV_Netz_Warnungen_XIX_Klima
    delegate Grundumfang_XIX_Klima.RP_IF_HVK_Iso_Messung_Start_XIX_Grundumfang_XIX_Klima <-> outer port RP_IF_HVK_Iso_Messung_Start_XIX_Klima
    delegate Grundumfang_XIX_Klima.RP_IF_HVK_Notabschaltung_Anf_XIX_Grundumfang_XIX_Klima <-> outer port RP_IF_HVK_Notabschaltung_Anf_XIX_Klima
    delegate Grundumfang_XIX_Klima.RP_IF_HVK_Vorladung_aktiv_XIX_Grundumfang_XIX_Klima <-> outer port RP_IF_HVK_Vorladung_aktiv_XIX_Klima
    delegate Grundumfang_XIX_Klima.RP_IF_HVLM_DCBoostLaden_Anf_XIX_Grundumfang_XIX_Klima <-> outer port RP_IF_HVLM_DCBoostLaden_Anf_XIX_Klima
    delegate Grundumfang_XIX_Klima.RP_IF_IAA_Active_User_ID_XIX_Grundumfang_XIX_Klima <-> outer port RP_IF_IAA_Active_User_ID_XIX_Klima
    delegate Grundumfang_XIX_Klima.RP_IF_IAA_Identified_User_ID_XIX_Grundumfang_XIX_Klima <-> outer port RP_IF_IAA_Identified_User_ID_XIX_Klima
    delegate Grundumfang_XIX_Klima.RP_IF_IAA_PSO_wake_up_XIX_Grundumfang_XIX_Klima <-> outer port RP_IF_IAA_PSO_wake_up_XIX_Klima
    delegate Grundumfang_XIX_Klima.RP_IF_ICO2_Alarm_XIX_Grundumfang_XIX_Klima <-> outer port RP_IF_ICO2_Alarm_XIX_Klima
    delegate Grundumfang_XIX_Klima.RP_IF_ICO2_BZ_XIX_Grundumfang_XIX_Klima <-> outer port RP_IF_ICO2_BZ_XIX_Klima
    delegate Grundumfang_XIX_Klima.RP_IF_ICO2_CO2_Wert_XIX_Grundumfang_XIX_Klima <-> outer port RP_IF_ICO2_CO2_Wert_XIX_Klima
    delegate Grundumfang_XIX_Klima.RP_IF_ICO2_defekt_XIX_Grundumfang_XIX_Klima <-> outer port RP_IF_ICO2_defekt_XIX_Klima
    delegate Grundumfang_XIX_Klima.RP_IF_ICO2_Gradient_XIX_Grundumfang_XIX_Klima <-> outer port RP_IF_ICO2_Gradient_XIX_Klima
    delegate Grundumfang_XIX_Klima.RP_IF_ICO2_Laufzeit_XIX_Grundumfang_XIX_Klima <-> outer port RP_IF_ICO2_Laufzeit_XIX_Klima
    delegate Grundumfang_XIX_Klima.RP_IF_ICO2_Luftdruck_XIX_Grundumfang_XIX_Klima <-> outer port RP_IF_ICO2_Luftdruck_XIX_Klima
    delegate Grundumfang_XIX_Klima.RP_IF_ICO2_ResponseError_XIX_Grundumfang_XIX_Klima <-> outer port RP_IF_ICO2_ResponseError_XIX_Klima
    delegate Grundumfang_XIX_Klima.RP_IF_ICO2b_Alarm_XIX_Grundumfang_XIX_Klima <-> outer port RP_IF_ICO2b_Alarm_XIX_Klima
    delegate Grundumfang_XIX_Klima.RP_IF_ICO2b_BZ_XIX_Grundumfang_XIX_Klima <-> outer port RP_IF_ICO2b_BZ_XIX_Klima
    delegate Grundumfang_XIX_Klima.RP_IF_ICO2b_CO2_Wert_XIX_Grundumfang_XIX_Klima <-> outer port RP_IF_ICO2b_CO2_Wert_XIX_Klima
    delegate Grundumfang_XIX_Klima.RP_IF_ICO2b_defekt_XIX_Grundumfang_XIX_Klima <-> outer port RP_IF_ICO2b_defekt_XIX_Klima
    delegate Grundumfang_XIX_Klima.RP_IF_ICO2b_Gradient_XIX_Grundumfang_XIX_Klima <-> outer port RP_IF_ICO2b_Gradient_XIX_Klima
    delegate Grundumfang_XIX_Klima.RP_IF_ICO2b_Laufzeit_XIX_Grundumfang_XIX_Klima <-> outer port RP_IF_ICO2b_Laufzeit_XIX_Klima
    delegate Grundumfang_XIX_Klima.RP_IF_ICO2b_Luftdruck_XIX_Grundumfang_XIX_Klima <-> outer port RP_IF_ICO2b_Luftdruck_XIX_Klima
    delegate Grundumfang_XIX_Klima.RP_IF_ICO2b_ResponseError_XIX_Grundumfang_XIX_Klima <-> outer port RP_IF_ICO2b_ResponseError_XIX_Klima
    delegate Grundumfang_XIX_Klima.RP_IF_ION_0s_Dummy_XIX_Grundumfang_XIX_Klima <-> outer port RP_IF_ION_0s_Dummy_XIX_Klima
    delegate Grundumfang_XIX_Klima.RP_IF_ION_Adressegment_XIX_Grundumfang_XIX_Klima <-> outer port RP_IF_ION_Adressegment_XIX_Klima
    delegate Grundumfang_XIX_Klima.RP_IF_ION_Adressinhalt_XIX_Grundumfang_XIX_Klima <-> outer port RP_IF_ION_Adressinhalt_XIX_Klima
    delegate Grundumfang_XIX_Klima.RP_IF_ION_BZ_XIX_Grundumfang_XIX_Klima <-> outer port RP_IF_ION_BZ_XIX_Klima
    delegate Grundumfang_XIX_Klima.RP_IF_ION_Fehler_Emitter_2_XIX_Grundumfang_XIX_Klima <-> outer port RP_IF_ION_Fehler_Emitter_2_XIX_Klima
    delegate Grundumfang_XIX_Klima.RP_IF_ION_Fehler_Emitter_XIX_Grundumfang_XIX_Klima <-> outer port RP_IF_ION_Fehler_Emitter_XIX_Klima
    delegate Grundumfang_XIX_Klima.RP_IF_ION_Fehler_Intern_XIX_Grundumfang_XIX_Klima <-> outer port RP_IF_ION_Fehler_Intern_XIX_Klima
    delegate Grundumfang_XIX_Klima.RP_IF_ION_Fehler_LED_XIX_Grundumfang_XIX_Klima <-> outer port RP_IF_ION_Fehler_LED_XIX_Klima
    delegate Grundumfang_XIX_Klima.RP_IF_ION_Fehler_Taster_XIX_Grundumfang_XIX_Klima <-> outer port RP_IF_ION_Fehler_Taster_XIX_Klima
    delegate Grundumfang_XIX_Klima.RP_IF_ION_FehlerGueltigkeit_XIX_Grundumfang_XIX_Klima <-> outer port RP_IF_ION_FehlerGueltigkeit_XIX_Klima
    delegate Grundumfang_XIX_Klima.RP_IF_ION_HW_XIX_Grundumfang_XIX_Klima <-> outer port RP_IF_ION_HW_XIX_Klima
    delegate Grundumfang_XIX_Klima.RP_IF_ION_ResponseError_XIX_Grundumfang_XIX_Klima <-> outer port RP_IF_ION_ResponseError_XIX_Klima
    delegate Grundumfang_XIX_Klima.RP_IF_ION_Status_LED_XIX_Grundumfang_XIX_Klima <-> outer port RP_IF_ION_Status_LED_XIX_Klima
    delegate Grundumfang_XIX_Klima.RP_IF_ION_Status_Taster_XIX_Grundumfang_XIX_Klima <-> outer port RP_IF_ION_Status_Taster_XIX_Klima
    delegate Grundumfang_XIX_Klima.RP_IF_ION_Status_XIX_Grundumfang_XIX_Klima <-> outer port RP_IF_ION_Status_XIX_Klima
    delegate Grundumfang_XIX_Klima.RP_IF_ION_SW_XIX_Grundumfang_XIX_Klima <-> outer port RP_IF_ION_SW_XIX_Klima
    delegate Grundumfang_XIX_Klima.RP_IF_KBF_defekt_XIX_Grundumfang_XIX_Klima <-> outer port RP_IF_KBF_defekt_XIX_Klima
    delegate Grundumfang_XIX_Klima.RP_IF_KBF_Einheiten_XIX_Grundumfang_XIX_Klima <-> outer port RP_IF_KBF_Einheiten_XIX_Klima
    delegate Grundumfang_XIX_Klima.RP_IF_KBF_ResponseError_XIX_Grundumfang_XIX_Klima <-> outer port RP_IF_KBF_ResponseError_XIX_Klima
    delegate Grundumfang_XIX_Klima.RP_IF_KBF_SIH_Diag_XIX_Grundumfang_XIX_Klima <-> outer port RP_IF_KBF_SIH_Diag_XIX_Klima
    delegate Grundumfang_XIX_Klima.RP_IF_KBF_SIH_hl_Status_XIX_Grundumfang_XIX_Klima <-> outer port RP_IF_KBF_SIH_hl_Status_XIX_Klima
    delegate Grundumfang_XIX_Klima.RP_IF_KBF_SIH_hr_Status_XIX_Grundumfang_XIX_Klima <-> outer port RP_IF_KBF_SIH_hr_Status_XIX_Klima
    delegate Grundumfang_XIX_Klima.RP_IF_KBF_Strom_SIH_hl_XIX_Grundumfang_XIX_Klima <-> outer port RP_IF_KBF_Strom_SIH_hl_XIX_Klima
    delegate Grundumfang_XIX_Klima.RP_IF_KBF_Strom_SIH_hr_XIX_Grundumfang_XIX_Klima <-> outer port RP_IF_KBF_Strom_SIH_hr_XIX_Klima
    delegate Grundumfang_XIX_Klima.RP_IF_KBF_Tasten_Fehler_XIX_Grundumfang_XIX_Klima <-> outer port RP_IF_KBF_Tasten_Fehler_XIX_Klima
    delegate Grundumfang_XIX_Klima.RP_IF_KBF_Temp_Fuss_Fond_XIX_Grundumfang_XIX_Klima <-> outer port RP_IF_KBF_Temp_Fuss_Fond_XIX_Klima
    delegate Grundumfang_XIX_Klima.RP_IF_KBF_Temp_MA_Fond_XIX_Grundumfang_XIX_Klima <-> outer port RP_IF_KBF_Temp_MA_Fond_XIX_Klima
    delegate Grundumfang_XIX_Klima.RP_IF_KBF_Temp_SIH_hl_XIX_Grundumfang_XIX_Klima <-> outer port RP_IF_KBF_Temp_SIH_hl_XIX_Klima
    delegate Grundumfang_XIX_Klima.RP_IF_KBF_Temp_SIH_hr_XIX_Grundumfang_XIX_Klima <-> outer port RP_IF_KBF_Temp_SIH_hr_XIX_Klima
    delegate Grundumfang_XIX_Klima.RP_IF_KBI_Aussen_Temp_gef_XIX_Grundumfang_XIX_Klima <-> outer port RP_IF_KBI_Aussen_Temp_gef_XIX_Klima
    delegate Grundumfang_XIX_Klima.RP_IF_KBI_Einheit_Temp_XIX_Grundumfang_XIX_Klima <-> outer port RP_IF_KBI_Einheit_Temp_XIX_Klima
    delegate Grundumfang_XIX_Klima.RP_IF_KBI_Kilometerstand_XIX_Grundumfang_XIX_Klima <-> outer port RP_IF_KBI_Kilometerstand_XIX_Klima
    delegate Grundumfang_XIX_Klima.RP_IF_KBI_QBit_Aussen_Temp_gef_XIX_Grundumfang_XIX_Klima <-> outer port RP_IF_KBI_QBit_Aussen_Temp_gef_XIX_Klima
    delegate Grundumfang_XIX_Klima.RP_IF_KL_Fond_Status_XIX_Grundumfang_XIX_Klima <-> outer port RP_IF_KL_Fond_Status_XIX_Klima
    delegate Grundumfang_XIX_Klima.RP_IF_KL_SL_Soll_hl_XIX_Grundumfang_XIX_Klima <-> outer port RP_IF_KL_SL_Soll_hl_XIX_Klima
    delegate Grundumfang_XIX_Klima.RP_IF_KL_SL_Soll_hr_XIX_Grundumfang_XIX_Klima <-> outer port RP_IF_KL_SL_Soll_hr_XIX_Klima
    delegate Grundumfang_XIX_Klima.RP_IF_KL_Temp_hl_XIX_Grundumfang_XIX_Klima <-> outer port RP_IF_KL_Temp_hl_XIX_Klima
    delegate Grundumfang_XIX_Klima.RP_IF_KL_Temp_Status_hl_XIX_Grundumfang_XIX_Klima <-> outer port RP_IF_KL_Temp_Status_hl_XIX_Klima
    delegate Grundumfang_XIX_Klima.RP_IF_KLh_aus_XIX_Grundumfang_XIX_Klima <-> outer port RP_IF_KLh_aus_XIX_Klima
    delegate Grundumfang_XIX_Klima.RP_IF_KLh_Ausstattung_KlimaHeck_XIX_Grundumfang_XIX_Klima <-> outer port RP_IF_KLh_Ausstattung_KlimaHeck_XIX_Klima
    delegate Grundumfang_XIX_Klima.RP_IF_KLh_Fehler{1..8}_XIX_Grundumfang_XIX_Klima <-> outer port RP_IF_KLh_Fehler{1..8}_XIX_Klima
    delegate Grundumfang_XIX_Klima.RP_IF_KLh_Seite_defog_hl_XIX_Grundumfang_XIX_Klima <-> outer port RP_IF_KLh_Seite_defog_hl_XIX_Klima
    delegate Grundumfang_XIX_Klima.RP_IF_KLh_SIH_Last_defekt_hl_XIX_Grundumfang_XIX_Klima <-> outer port RP_IF_KLh_SIH_Last_defekt_hl_XIX_Klima
    delegate Grundumfang_XIX_Klima.RP_IF_KLh_SIH_Last_defekt_hr_XIX_Grundumfang_XIX_Klima <-> outer port RP_IF_KLh_SIH_Last_defekt_hr_XIX_Klima
    delegate Grundumfang_XIX_Klima.RP_IF_KLh_SIH_NTC_defekt_hl_XIX_Grundumfang_XIX_Klima <-> outer port RP_IF_KLh_SIH_NTC_defekt_hl_XIX_Klima
    delegate Grundumfang_XIX_Klima.RP_IF_KLh_SIH_NTC_defekt_hr_XIX_Grundumfang_XIX_Klima <-> outer port RP_IF_KLh_SIH_NTC_defekt_hr_XIX_Klima
    delegate Grundumfang_XIX_Klima.RP_IF_KLh_SIH_Stufe_hl_XIX_Grundumfang_XIX_Klima <-> outer port RP_IF_KLh_SIH_Stufe_hl_XIX_Klima
    delegate Grundumfang_XIX_Klima.RP_IF_KLh_SIH_Stufe_hr_XIX_Grundumfang_XIX_Klima <-> outer port RP_IF_KLh_SIH_Stufe_hr_XIX_Klima
    delegate Grundumfang_XIX_Klima.RP_IF_KLh_toggle_LVT_XIX_Grundumfang_XIX_Klima <-> outer port RP_IF_KLh_toggle_LVT_XIX_Klima
    delegate Grundumfang_XIX_Klima.RP_IF_KLhl_GeblaeseSoll_XIX_Grundumfang_XIX_Klima <-> outer port RP_IF_KLhl_GeblaeseSoll_XIX_Klima
    delegate Grundumfang_XIX_Klima.RP_IF_KLhl_Luft_auto_XIX_Grundumfang_XIX_Klima <-> outer port RP_IF_KLhl_Luft_auto_XIX_Klima
    delegate Grundumfang_XIX_Klima.RP_IF_KLhl_Luft_mitte_XIX_Grundumfang_XIX_Klima <-> outer port RP_IF_KLhl_Luft_mitte_XIX_Klima
    delegate Grundumfang_XIX_Klima.RP_IF_KLhl_Luft_oben_XIX_Grundumfang_XIX_Klima <-> outer port RP_IF_KLhl_Luft_oben_XIX_Klima
    delegate Grundumfang_XIX_Klima.RP_IF_KLhl_Luft_seite_XIX_Grundumfang_XIX_Klima <-> outer port RP_IF_KLhl_Luft_seite_XIX_Klima
    delegate Grundumfang_XIX_Klima.RP_IF_KLhl_Luft_unten_XIX_Grundumfang_XIX_Klima <-> outer port RP_IF_KLhl_Luft_unten_XIX_Klima
    delegate Grundumfang_XIX_Klima.RP_IF_KLhl_ResponseError_XIX_Grundumfang_XIX_Klima <-> outer port RP_IF_KLhl_ResponseError_XIX_Klima
    delegate Grundumfang_XIX_Klima.RP_IF_KLhl_TempSoll_XIX_Grundumfang_XIX_Klima <-> outer port RP_IF_KLhl_TempSoll_XIX_Klima
    delegate Grundumfang_XIX_Klima.RP_IF_KLhr_TempSoll_XIX_Grundumfang_XIX_Klima <-> outer port RP_IF_KLhr_TempSoll_XIX_Klima
    delegate Grundumfang_XIX_Klima.RP_IF_KPV_AC_max_XIX_Grundumfang_XIX_Klima <-> outer port RP_IF_KPV_AC_max_XIX_Klima
    delegate Grundumfang_XIX_Klima.RP_IF_KPV_AC_Taste_XIX_Grundumfang_XIX_Klima <-> outer port RP_IF_KPV_AC_Taste_XIX_Klima
    delegate Grundumfang_XIX_Klima.RP_IF_KPV_AC_XIX_Grundumfang_XIX_Klima <-> outer port RP_IF_KPV_AC_XIX_Klima
    delegate Grundumfang_XIX_Klima.RP_IF_KPV_Auto_li_XIX_Grundumfang_XIX_Klima <-> outer port RP_IF_KPV_Auto_li_XIX_Klima
    delegate Grundumfang_XIX_Klima.RP_IF_KPV_Auto_Taste_XIX_Grundumfang_XIX_Klima <-> outer port RP_IF_KPV_Auto_Taste_XIX_Klima
    delegate Grundumfang_XIX_Klima.RP_IF_KPV_AutoSiKli_li_XIX_Grundumfang_XIX_Klima <-> outer port RP_IF_KPV_AutoSiKli_li_XIX_Klima
    delegate Grundumfang_XIX_Klima.RP_IF_KPV_AutoSiKli_re_XIX_Grundumfang_XIX_Klima <-> outer port RP_IF_KPV_AutoSiKli_re_XIX_Klima
    delegate Grundumfang_XIX_Klima.RP_IF_KPV_AutoUmluft_XIX_Grundumfang_XIX_Klima <-> outer port RP_IF_KPV_AutoUmluft_XIX_Klima
    delegate Grundumfang_XIX_Klima.RP_IF_KPV_Beduftung_XIX_Grundumfang_XIX_Klima <-> outer port RP_IF_KPV_Beduftung_XIX_Klima
    delegate Grundumfang_XIX_Klima.RP_IF_KPV_Defrost_XIX_Grundumfang_XIX_Klima <-> outer port RP_IF_KPV_Defrost_XIX_Klima
    delegate Grundumfang_XIX_Klima.RP_IF_KPV_DefrostMAX_Taste_XIX_Grundumfang_XIX_Klima <-> outer port RP_IF_KPV_DefrostMAX_Taste_XIX_Klima
    delegate Grundumfang_XIX_Klima.RP_IF_KPV_ECO_XIX_Grundumfang_XIX_Klima <-> outer port RP_IF_KPV_ECO_XIX_Klima
    delegate Grundumfang_XIX_Klima.RP_IF_KPV_FSH_XIX_Grundumfang_XIX_Klima <-> outer port RP_IF_KPV_FSH_XIX_Klima
    delegate Grundumfang_XIX_Klima.RP_IF_KPV_Geblaese_Auto_li_XIX_Grundumfang_XIX_Klima <-> outer port RP_IF_KPV_Geblaese_Auto_li_XIX_Klima
    delegate Grundumfang_XIX_Klima.RP_IF_KPV_Geblaese_Stufe_li_XIX_Grundumfang_XIX_Klima <-> outer port RP_IF_KPV_Geblaese_Stufe_li_XIX_Klima
    delegate Grundumfang_XIX_Klima.RP_IF_KPV_HSH_Taste_XIX_Grundumfang_XIX_Klima <-> outer port RP_IF_KPV_HSH_Taste_XIX_Klima
    delegate Grundumfang_XIX_Klima.RP_IF_KPV_HSH_XIX_Grundumfang_XIX_Klima <-> outer port RP_IF_KPV_HSH_XIX_Klima
    delegate Grundumfang_XIX_Klima.RP_IF_KPV_Init_2_XIX_Grundumfang_XIX_Klima <-> outer port RP_IF_KPV_Init_2_XIX_Klima
    delegate Grundumfang_XIX_Klima.RP_IF_KPV_Init_XIX_Grundumfang_XIX_Klima <-> outer port RP_IF_KPV_Init_XIX_Klima
    delegate Grundumfang_XIX_Klima.RP_IF_KPV_Ionisator_XIX_Grundumfang_XIX_Klima <-> outer port RP_IF_KPV_Ionisator_XIX_Klima
    delegate Grundumfang_XIX_Klima.RP_IF_KPV_Joker_Taste_XIX_Grundumfang_XIX_Klima <-> outer port RP_IF_KPV_Joker_Taste_XIX_Klima
    delegate Grundumfang_XIX_Klima.RP_IF_KPV_Klima_Menue_MMI_XIX_Grundumfang_XIX_Klima <-> outer port RP_IF_KPV_Klima_Menue_MMI_XIX_Klima
    delegate Grundumfang_XIX_Klima.RP_IF_KPV_Konditionierung_Taste_XIX_Grundumfang_XIX_Klima <-> outer port RP_IF_KPV_Konditionierung_Taste_XIX_Klima
    delegate Grundumfang_XIX_Klima.RP_IF_KPV_Kopfraumheizung_li_XIX_Grundumfang_XIX_Klima <-> outer port RP_IF_KPV_Kopfraumheizung_li_XIX_Klima
    delegate Grundumfang_XIX_Klima.RP_IF_KPV_Kopfraumheizung_re_XIX_Grundumfang_XIX_Klima <-> outer port RP_IF_KPV_Kopfraumheizung_re_XIX_Klima
    delegate Grundumfang_XIX_Klima.RP_IF_KPV_Lokalaktiv_XIX_Grundumfang_XIX_Klima <-> outer port RP_IF_KPV_Lokalaktiv_XIX_Klima
    delegate Grundumfang_XIX_Klima.RP_IF_KPV_Luftverteilung_Auto_li_XIX_Grundumfang_XIX_Klima <-> outer port RP_IF_KPV_Luftverteilung_Auto_li_XIX_Klima
    delegate Grundumfang_XIX_Klima.RP_IF_KPV_Luftverteilung_Mitte_li_XIX_Grundumfang_XIX_Klima <-> outer port RP_IF_KPV_Luftverteilung_Mitte_li_XIX_Klima
    delegate Grundumfang_XIX_Klima.RP_IF_KPV_Luftverteilung_Oben_li_XIX_Grundumfang_XIX_Klima <-> outer port RP_IF_KPV_Luftverteilung_Oben_li_XIX_Klima
    delegate Grundumfang_XIX_Klima.RP_IF_KPV_Luftverteilung_Unten_li_XIX_Grundumfang_XIX_Klima <-> outer port RP_IF_KPV_Luftverteilung_Unten_li_XIX_Klima
    delegate Grundumfang_XIX_Klima.RP_IF_KPV_OBD_Gruppe_XIX_Grundumfang_XIX_Klima <-> outer port RP_IF_KPV_OBD_Gruppe_XIX_Klima
    delegate Grundumfang_XIX_Klima.RP_IF_KPV_OBD_XIX_Grundumfang_XIX_Klima <-> outer port RP_IF_KPV_OBD_XIX_Klima
    delegate Grundumfang_XIX_Klima.RP_IF_KPV_Off_XIX_Grundumfang_XIX_Klima <-> outer port RP_IF_KPV_Off_XIX_Klima
    delegate Grundumfang_XIX_Klima.RP_IF_KPV_Panel_Error_XIX_Grundumfang_XIX_Klima <-> outer port RP_IF_KPV_Panel_Error_XIX_Klima
    delegate Grundumfang_XIX_Klima.RP_IF_KPV_Popup_Content_ZL1R_XIX_Grundumfang_XIX_Klima <-> outer port RP_IF_KPV_Popup_Content_ZL1R_XIX_Klima
    delegate Grundumfang_XIX_Klima.RP_IF_KPV_Popup_Content_ZR1R_XIX_Grundumfang_XIX_Klima <-> outer port RP_IF_KPV_Popup_Content_ZR1R_XIX_Klima
    delegate Grundumfang_XIX_Klima.RP_IF_KPV_PureAir_XIX_Grundumfang_XIX_Klima <-> outer port RP_IF_KPV_PureAir_XIX_Klima
    delegate Grundumfang_XIX_Klima.RP_IF_KPV_Rear_XIX_Grundumfang_XIX_Klima <-> outer port RP_IF_KPV_Rear_XIX_Klima
    delegate Grundumfang_XIX_Klima.RP_IF_KPV_ResponseError_XIX_Grundumfang_XIX_Klima <-> outer port RP_IF_KPV_ResponseError_XIX_Klima
    delegate Grundumfang_XIX_Klima.RP_IF_KPV_Restwaerme_XIX_Grundumfang_XIX_Klima <-> outer port RP_IF_KPV_Restwaerme_XIX_Klima
    delegate Grundumfang_XIX_Klima.RP_IF_KPV_Sitzheizung_li_XIX_Grundumfang_XIX_Klima <-> outer port RP_IF_KPV_Sitzheizung_li_XIX_Klima
    delegate Grundumfang_XIX_Klima.RP_IF_KPV_Sitzheizung_re_XIX_Grundumfang_XIX_Klima <-> outer port RP_IF_KPV_Sitzheizung_re_XIX_Klima
    delegate Grundumfang_XIX_Klima.RP_IF_KPV_Sitzlueftung_li_XIX_Grundumfang_XIX_Klima <-> outer port RP_IF_KPV_Sitzlueftung_li_XIX_Klima
    delegate Grundumfang_XIX_Klima.RP_IF_KPV_Sitzlueftung_re_XIX_Grundumfang_XIX_Klima <-> outer port RP_IF_KPV_Sitzlueftung_re_XIX_Klima
    delegate Grundumfang_XIX_Klima.RP_IF_KPV_Status_Spannung_XIX_Grundumfang_XIX_Klima <-> outer port RP_IF_KPV_Status_Spannung_XIX_Klima
    delegate Grundumfang_XIX_Klima.RP_IF_KPV_Sync_XIX_Grundumfang_XIX_Klima <-> outer port RP_IF_KPV_Sync_XIX_Klima
    delegate Grundumfang_XIX_Klima.RP_IF_KPV_Tasten_Fehler_XIX_Grundumfang_XIX_Klima <-> outer port RP_IF_KPV_Tasten_Fehler_XIX_Klima
    delegate Grundumfang_XIX_Klima.RP_IF_KPV_Temp_li_XIX_Grundumfang_XIX_Klima <-> outer port RP_IF_KPV_Temp_li_XIX_Klima
    delegate Grundumfang_XIX_Klima.RP_IF_KPV_Temp_Platine_XIX_Grundumfang_XIX_Klima <-> outer port RP_IF_KPV_Temp_Platine_XIX_Klima
    delegate Grundumfang_XIX_Klima.RP_IF_KPV_Temp_re_XIX_Grundumfang_XIX_Klima <-> outer port RP_IF_KPV_Temp_re_XIX_Klima
    delegate Grundumfang_XIX_Klima.RP_IF_KPV_Umluft_XIX_Grundumfang_XIX_Klima <-> outer port RP_IF_KPV_Umluft_XIX_Klima
    delegate Grundumfang_XIX_Klima.RP_IF_KPV_Zustand_Off_XIX_Grundumfang_XIX_Klima <-> outer port RP_IF_KPV_Zustand_Off_XIX_Klima
    delegate Grundumfang_XIX_Klima.RP_IF_KST_Sonderzustand_Status_XIX_Grundumfang_XIX_Klima <-> outer port RP_IF_KST_Sonderzustand_Status_XIX_Klima
    delegate Grundumfang_XIX_Klima.RP_IF_KVA_Ist_Pos_XIX_Grundumfang_XIX_Klima <-> outer port RP_IF_KVA_Ist_Pos_XIX_Klima
    delegate Grundumfang_XIX_Klima.RP_IF_Ladezustand_02_XIX_Grundumfang_XIX_Klima <-> outer port RP_IF_Ladezustand_02_XIX_Klima
    delegate Grundumfang_XIX_Klima.RP_IF_LHR_01_FnAbbruch_Heizkreis_A_XIX_Grundumfang_XIX_Klima <-> outer port RP_IF_LHR_01_FnAbbruch_Heizkreis_A_XIX_Klima
    delegate Grundumfang_XIX_Klima.RP_IF_LHR_01_FnAbbruch_Heizkreis_B_XIX_Grundumfang_XIX_Klima <-> outer port RP_IF_LHR_01_FnAbbruch_Heizkreis_B_XIX_Klima
    delegate Grundumfang_XIX_Klima.RP_IF_LHR_01_NTC_Temperatur_A_XIX_Grundumfang_XIX_Klima <-> outer port RP_IF_LHR_01_NTC_Temperatur_A_XIX_Klima
    delegate Grundumfang_XIX_Klima.RP_IF_LHR_01_NTC_Temperatur_B_XIX_Grundumfang_XIX_Klima <-> outer port RP_IF_LHR_01_NTC_Temperatur_B_XIX_Klima
    delegate Grundumfang_XIX_Klima.RP_IF_LHR_01_ResponseError_XIX_Grundumfang_XIX_Klima <-> outer port RP_IF_LHR_01_ResponseError_XIX_Klima
    delegate Grundumfang_XIX_Klima.RP_IF_LHR_01_SG_defekt_XIX_Grundumfang_XIX_Klima <-> outer port RP_IF_LHR_01_SG_defekt_XIX_Klima
    delegate Grundumfang_XIX_Klima.RP_IF_LHR_01_Status_Ausgang_A_02_XIX_Grundumfang_XIX_Klima <-> outer port RP_IF_LHR_01_Status_Ausgang_A_02_XIX_Klima
    delegate Grundumfang_XIX_Klima.RP_IF_LHR_01_Status_Ausgang_B_02_XIX_Grundumfang_XIX_Klima <-> outer port RP_IF_LHR_01_Status_Ausgang_B_02_XIX_Klima
    delegate Grundumfang_XIX_Klima.RP_IF_LHR_01_Status_CodierPins_XIX_Grundumfang_XIX_Klima <-> outer port RP_IF_LHR_01_Status_CodierPins_XIX_Klima
    delegate Grundumfang_XIX_Klima.RP_IF_LHR_01_Status_PCB_Uebertemp_XIX_Grundumfang_XIX_Klima <-> outer port RP_IF_LHR_01_Status_PCB_Uebertemp_XIX_Klima
    delegate Grundumfang_XIX_Klima.RP_IF_LHR_01_Status_Taster_A_XIX_Grundumfang_XIX_Klima <-> outer port RP_IF_LHR_01_Status_Taster_A_XIX_Klima
    delegate Grundumfang_XIX_Klima.RP_IF_LHR_01_Status_Taster_B_XIX_Grundumfang_XIX_Klima <-> outer port RP_IF_LHR_01_Status_Taster_B_XIX_Klima
    delegate Grundumfang_XIX_Klima.RP_IF_LiSi_Defrost_Taste_XIX_Grundumfang_XIX_Klima <-> outer port RP_IF_LiSi_Defrost_Taste_XIX_Klima
    delegate Grundumfang_XIX_Klima.RP_IF_LiSi_FSH_Taste_XIX_Grundumfang_XIX_Klima <-> outer port RP_IF_LiSi_FSH_Taste_XIX_Klima
    delegate Grundumfang_XIX_Klima.RP_IF_LiSi_HSH_Taste_XIX_Grundumfang_XIX_Klima <-> outer port RP_IF_LiSi_HSH_Taste_XIX_Klima
    delegate Grundumfang_XIX_Klima.RP_IF_LLR_LL1_Blockierung_XIX_Grundumfang_XIX_Klima <-> outer port RP_IF_LLR_LL1_Blockierung_XIX_Klima
    delegate Grundumfang_XIX_Klima.RP_IF_LLR_LL1_CodierPinError_XIX_Grundumfang_XIX_Klima <-> outer port RP_IF_LLR_LL1_CodierPinError_XIX_Klima
    delegate Grundumfang_XIX_Klima.RP_IF_LLR_LL1_Feuchte01_XIX_Grundumfang_XIX_Klima <-> outer port RP_IF_LLR_LL1_Feuchte01_XIX_Klima
    delegate Grundumfang_XIX_Klima.RP_IF_LLR_LL1_Feuchte02_XIX_Grundumfang_XIX_Klima <-> outer port RP_IF_LLR_LL1_Feuchte02_XIX_Klima
    delegate Grundumfang_XIX_Klima.RP_IF_LLR_LL1_Feuchtesensor_01_defekt_XIX_Grundumfang_XIX_Klima <-> outer port RP_IF_LLR_LL1_Feuchtesensor_01_defekt_XIX_Klima
    delegate Grundumfang_XIX_Klima.RP_IF_LLR_LL1_Feuchtesensor_02_defekt_XIX_Grundumfang_XIX_Klima <-> outer port RP_IF_LLR_LL1_Feuchtesensor_02_defekt_XIX_Klima
    delegate Grundumfang_XIX_Klima.RP_IF_LLR_LL1_Ist_Drehzahl_XIX_Grundumfang_XIX_Klima <-> outer port RP_IF_LLR_LL1_Ist_Drehzahl_XIX_Klima
    delegate Grundumfang_XIX_Klima.RP_IF_LLR_LL1_Lokalaktiv_XIX_Grundumfang_XIX_Klima <-> outer port RP_IF_LLR_LL1_Lokalaktiv_XIX_Klima
    delegate Grundumfang_XIX_Klima.RP_IF_LLR_LL1_Luefter_defekt_XIX_Grundumfang_XIX_Klima <-> outer port RP_IF_LLR_LL1_Luefter_defekt_XIX_Klima
    delegate Grundumfang_XIX_Klima.RP_IF_LLR_LL1_ResponseError_XIX_Grundumfang_XIX_Klima <-> outer port RP_IF_LLR_LL1_ResponseError_XIX_Klima
    delegate Grundumfang_XIX_Klima.RP_IF_LLR_LL1_Temperatur_01_XIX_Grundumfang_XIX_Klima <-> outer port RP_IF_LLR_LL1_Temperatur_01_XIX_Klima
    delegate Grundumfang_XIX_Klima.RP_IF_LLR_LL1_Temperatur_02_XIX_Grundumfang_XIX_Klima <-> outer port RP_IF_LLR_LL1_Temperatur_02_XIX_Klima
    delegate Grundumfang_XIX_Klima.RP_IF_LLR_LL1_Ueberspannung_XIX_Grundumfang_XIX_Klima <-> outer port RP_IF_LLR_LL1_Ueberspannung_XIX_Klima
    delegate Grundumfang_XIX_Klima.RP_IF_LLR_LL1_Uebertemperatur_XIX_Grundumfang_XIX_Klima <-> outer port RP_IF_LLR_LL1_Uebertemperatur_XIX_Klima
    delegate Grundumfang_XIX_Klima.RP_IF_LLR_LL1_Unterspannung_XIX_Grundumfang_XIX_Klima <-> outer port RP_IF_LLR_LL1_Unterspannung_XIX_Klima
    delegate Grundumfang_XIX_Klima.RP_IF_LLR_LS1_Blockierung_XIX_Grundumfang_XIX_Klima <-> outer port RP_IF_LLR_LS1_Blockierung_XIX_Klima
    delegate Grundumfang_XIX_Klima.RP_IF_LLR_LS1_CodierPinError_XIX_Grundumfang_XIX_Klima <-> outer port RP_IF_LLR_LS1_CodierPinError_XIX_Klima
    delegate Grundumfang_XIX_Klima.RP_IF_LLR_LS1_Feuchte01_XIX_Grundumfang_XIX_Klima <-> outer port RP_IF_LLR_LS1_Feuchte01_XIX_Klima
    delegate Grundumfang_XIX_Klima.RP_IF_LLR_LS1_Feuchte02_XIX_Grundumfang_XIX_Klima <-> outer port RP_IF_LLR_LS1_Feuchte02_XIX_Klima
    delegate Grundumfang_XIX_Klima.RP_IF_LLR_LS1_Feuchtesensor_01_defekt_XIX_Grundumfang_XIX_Klima <-> outer port RP_IF_LLR_LS1_Feuchtesensor_01_defekt_XIX_Klima
    delegate Grundumfang_XIX_Klima.RP_IF_LLR_LS1_Feuchtesensor_02_defekt_XIX_Grundumfang_XIX_Klima <-> outer port RP_IF_LLR_LS1_Feuchtesensor_02_defekt_XIX_Klima
    delegate Grundumfang_XIX_Klima.RP_IF_LLR_LS1_Ist_Drehzahl_XIX_Grundumfang_XIX_Klima <-> outer port RP_IF_LLR_LS1_Ist_Drehzahl_XIX_Klima
    delegate Grundumfang_XIX_Klima.RP_IF_LLR_LS1_Lokalaktiv_XIX_Grundumfang_XIX_Klima <-> outer port RP_IF_LLR_LS1_Lokalaktiv_XIX_Klima
    delegate Grundumfang_XIX_Klima.RP_IF_LLR_LS1_Luefter_defekt_XIX_Grundumfang_XIX_Klima <-> outer port RP_IF_LLR_LS1_Luefter_defekt_XIX_Klima
    delegate Grundumfang_XIX_Klima.RP_IF_LLR_LS1_ResponseError_XIX_Grundumfang_XIX_Klima <-> outer port RP_IF_LLR_LS1_ResponseError_XIX_Klima
    delegate Grundumfang_XIX_Klima.RP_IF_LLR_LS1_Temperatur_01_XIX_Grundumfang_XIX_Klima <-> outer port RP_IF_LLR_LS1_Temperatur_01_XIX_Klima
    delegate Grundumfang_XIX_Klima.RP_IF_LLR_LS1_Temperatur_02_XIX_Grundumfang_XIX_Klima <-> outer port RP_IF_LLR_LS1_Temperatur_02_XIX_Klima
    delegate Grundumfang_XIX_Klima.RP_IF_LLR_LS1_Ueberspannung_XIX_Grundumfang_XIX_Klima <-> outer port RP_IF_LLR_LS1_Ueberspannung_XIX_Klima
    delegate Grundumfang_XIX_Klima.RP_IF_LLR_LS1_Uebertemperatur_XIX_Grundumfang_XIX_Klima <-> outer port RP_IF_LLR_LS1_Uebertemperatur_XIX_Klima
    delegate Grundumfang_XIX_Klima.RP_IF_LLR_LS1_Unterspannung_XIX_Grundumfang_XIX_Klima <-> outer port RP_IF_LLR_LS1_Unterspannung_XIX_Klima
    delegate Grundumfang_XIX_Klima.RP_IF_LLR_LS2_Blockierung_XIX_Grundumfang_XIX_Klima <-> outer port RP_IF_LLR_LS2_Blockierung_XIX_Klima
    delegate Grundumfang_XIX_Klima.RP_IF_LLR_LS2_CodierPinError_XIX_Grundumfang_XIX_Klima <-> outer port RP_IF_LLR_LS2_CodierPinError_XIX_Klima
    delegate Grundumfang_XIX_Klima.RP_IF_LLR_LS2_Ist_Drehzahl_XIX_Grundumfang_XIX_Klima <-> outer port RP_IF_LLR_LS2_Ist_Drehzahl_XIX_Klima
    delegate Grundumfang_XIX_Klima.RP_IF_LLR_LS2_Lokalaktiv_XIX_Grundumfang_XIX_Klima <-> outer port RP_IF_LLR_LS2_Lokalaktiv_XIX_Klima
    delegate Grundumfang_XIX_Klima.RP_IF_LLR_LS2_Luefter_defekt_XIX_Grundumfang_XIX_Klima <-> outer port RP_IF_LLR_LS2_Luefter_defekt_XIX_Klima
    delegate Grundumfang_XIX_Klima.RP_IF_LLR_LS2_ResponseError_XIX_Grundumfang_XIX_Klima <-> outer port RP_IF_LLR_LS2_ResponseError_XIX_Klima
    delegate Grundumfang_XIX_Klima.RP_IF_LLR_LS2_Ueberspannung_XIX_Grundumfang_XIX_Klima <-> outer port RP_IF_LLR_LS2_Ueberspannung_XIX_Klima
    delegate Grundumfang_XIX_Klima.RP_IF_LLR_LS2_Uebertemperatur_XIX_Grundumfang_XIX_Klima <-> outer port RP_IF_LLR_LS2_Uebertemperatur_XIX_Klima
    delegate Grundumfang_XIX_Klima.RP_IF_LLR_LS2_Unterspannung_XIX_Grundumfang_XIX_Klima <-> outer port RP_IF_LLR_LS2_Unterspannung_XIX_Klima
    delegate Grundumfang_XIX_Klima.RP_IF_LLR_RL1_Blockierung_XIX_Grundumfang_XIX_Klima <-> outer port RP_IF_LLR_RL1_Blockierung_XIX_Klima
    delegate Grundumfang_XIX_Klima.RP_IF_LLR_RL1_CodierPinError_XIX_Grundumfang_XIX_Klima <-> outer port RP_IF_LLR_RL1_CodierPinError_XIX_Klima
    delegate Grundumfang_XIX_Klima.RP_IF_LLR_RL1_Feuchte01_XIX_Grundumfang_XIX_Klima <-> outer port RP_IF_LLR_RL1_Feuchte01_XIX_Klima
    delegate Grundumfang_XIX_Klima.RP_IF_LLR_RL1_Feuchte02_XIX_Grundumfang_XIX_Klima <-> outer port RP_IF_LLR_RL1_Feuchte02_XIX_Klima
    delegate Grundumfang_XIX_Klima.RP_IF_LLR_RL1_Feuchtesensor_01_defekt_XIX_Grundumfang_XIX_Klima <-> outer port RP_IF_LLR_RL1_Feuchtesensor_01_defekt_XIX_Klima
    delegate Grundumfang_XIX_Klima.RP_IF_LLR_RL1_Feuchtesensor_02_defekt_XIX_Grundumfang_XIX_Klima <-> outer port RP_IF_LLR_RL1_Feuchtesensor_02_defekt_XIX_Klima
    delegate Grundumfang_XIX_Klima.RP_IF_LLR_RL1_Ist_Drehzahl_XIX_Grundumfang_XIX_Klima <-> outer port RP_IF_LLR_RL1_Ist_Drehzahl_XIX_Klima
    delegate Grundumfang_XIX_Klima.RP_IF_LLR_RL1_Lokalaktiv_XIX_Grundumfang_XIX_Klima <-> outer port RP_IF_LLR_RL1_Lokalaktiv_XIX_Klima
    delegate Grundumfang_XIX_Klima.RP_IF_LLR_RL1_Luefter_defekt_XIX_Grundumfang_XIX_Klima <-> outer port RP_IF_LLR_RL1_Luefter_defekt_XIX_Klima
    delegate Grundumfang_XIX_Klima.RP_IF_LLR_RL1_ResponseError_XIX_Grundumfang_XIX_Klima <-> outer port RP_IF_LLR_RL1_ResponseError_XIX_Klima
    delegate Grundumfang_XIX_Klima.RP_IF_LLR_RL1_Temperatur_01_XIX_Grundumfang_XIX_Klima <-> outer port RP_IF_LLR_RL1_Temperatur_01_XIX_Klima
    delegate Grundumfang_XIX_Klima.RP_IF_LLR_RL1_Temperatur_02_XIX_Grundumfang_XIX_Klima <-> outer port RP_IF_LLR_RL1_Temperatur_02_XIX_Klima
    delegate Grundumfang_XIX_Klima.RP_IF_LLR_RL1_Ueberspannung_XIX_Grundumfang_XIX_Klima <-> outer port RP_IF_LLR_RL1_Ueberspannung_XIX_Klima
    delegate Grundumfang_XIX_Klima.RP_IF_LLR_RL1_Uebertemperatur_XIX_Grundumfang_XIX_Klima <-> outer port RP_IF_LLR_RL1_Uebertemperatur_XIX_Klima
    delegate Grundumfang_XIX_Klima.RP_IF_LLR_RL1_Unterspannung_XIX_Grundumfang_XIX_Klima <-> outer port RP_IF_LLR_RL1_Unterspannung_XIX_Klima
    delegate Grundumfang_XIX_Klima.RP_IF_LLR_RS1_Blockierung_XIX_Grundumfang_XIX_Klima <-> outer port RP_IF_LLR_RS1_Blockierung_XIX_Klima
    delegate Grundumfang_XIX_Klima.RP_IF_LLR_RS1_CodierPinError_XIX_Grundumfang_XIX_Klima <-> outer port RP_IF_LLR_RS1_CodierPinError_XIX_Klima
    delegate Grundumfang_XIX_Klima.RP_IF_LLR_RS1_Feuchte01_XIX_Grundumfang_XIX_Klima <-> outer port RP_IF_LLR_RS1_Feuchte01_XIX_Klima
    delegate Grundumfang_XIX_Klima.RP_IF_LLR_RS1_Feuchte02_XIX_Grundumfang_XIX_Klima <-> outer port RP_IF_LLR_RS1_Feuchte02_XIX_Klima
    delegate Grundumfang_XIX_Klima.RP_IF_LLR_RS1_Feuchtesensor_01_defekt_XIX_Grundumfang_XIX_Klima <-> outer port RP_IF_LLR_RS1_Feuchtesensor_01_defekt_XIX_Klima
    delegate Grundumfang_XIX_Klima.RP_IF_LLR_RS1_Feuchtesensor_02_defekt_XIX_Grundumfang_XIX_Klima <-> outer port RP_IF_LLR_RS1_Feuchtesensor_02_defekt_XIX_Klima
    delegate Grundumfang_XIX_Klima.RP_IF_LLR_RS1_Ist_Drehzahl_XIX_Grundumfang_XIX_Klima <-> outer port RP_IF_LLR_RS1_Ist_Drehzahl_XIX_Klima
    delegate Grundumfang_XIX_Klima.RP_IF_LLR_RS1_Lokalaktiv_XIX_Grundumfang_XIX_Klima <-> outer port RP_IF_LLR_RS1_Lokalaktiv_XIX_Klima
    delegate Grundumfang_XIX_Klima.RP_IF_LLR_RS1_Luefter_defekt_XIX_Grundumfang_XIX_Klima <-> outer port RP_IF_LLR_RS1_Luefter_defekt_XIX_Klima
    delegate Grundumfang_XIX_Klima.RP_IF_LLR_RS1_ResponseError_XIX_Grundumfang_XIX_Klima <-> outer port RP_IF_LLR_RS1_ResponseError_XIX_Klima
    delegate Grundumfang_XIX_Klima.RP_IF_LLR_RS1_Temperatur_01_XIX_Grundumfang_XIX_Klima <-> outer port RP_IF_LLR_RS1_Temperatur_01_XIX_Klima
    delegate Grundumfang_XIX_Klima.RP_IF_LLR_RS1_Temperatur_02_XIX_Grundumfang_XIX_Klima <-> outer port RP_IF_LLR_RS1_Temperatur_02_XIX_Klima
    delegate Grundumfang_XIX_Klima.RP_IF_LLR_RS1_Ueberspannung_XIX_Grundumfang_XIX_Klima <-> outer port RP_IF_LLR_RS1_Ueberspannung_XIX_Klima
    delegate Grundumfang_XIX_Klima.RP_IF_LLR_RS1_Uebertemperatur_XIX_Grundumfang_XIX_Klima <-> outer port RP_IF_LLR_RS1_Uebertemperatur_XIX_Klima
    delegate Grundumfang_XIX_Klima.RP_IF_LLR_RS1_Unterspannung_XIX_Grundumfang_XIX_Klima <-> outer port RP_IF_LLR_RS1_Unterspannung_XIX_Klima
    delegate Grundumfang_XIX_Klima.RP_IF_LLR_RS2_Blockierung_XIX_Grundumfang_XIX_Klima <-> outer port RP_IF_LLR_RS2_Blockierung_XIX_Klima
    delegate Grundumfang_XIX_Klima.RP_IF_LLR_RS2_CodierPinError_XIX_Grundumfang_XIX_Klima <-> outer port RP_IF_LLR_RS2_CodierPinError_XIX_Klima
    delegate Grundumfang_XIX_Klima.RP_IF_LLR_RS2_Ist_Drehzahl_XIX_Grundumfang_XIX_Klima <-> outer port RP_IF_LLR_RS2_Ist_Drehzahl_XIX_Klima
    delegate Grundumfang_XIX_Klima.RP_IF_LLR_RS2_Lokalaktiv_XIX_Grundumfang_XIX_Klima <-> outer port RP_IF_LLR_RS2_Lokalaktiv_XIX_Klima
    delegate Grundumfang_XIX_Klima.RP_IF_LLR_RS2_Luefter_defekt_XIX_Grundumfang_XIX_Klima <-> outer port RP_IF_LLR_RS2_Luefter_defekt_XIX_Klima
    delegate Grundumfang_XIX_Klima.RP_IF_LLR_RS2_ResponseError_XIX_Grundumfang_XIX_Klima <-> outer port RP_IF_LLR_RS2_ResponseError_XIX_Klima
    delegate Grundumfang_XIX_Klima.RP_IF_LLR_RS2_Ueberspannung_XIX_Grundumfang_XIX_Klima <-> outer port RP_IF_LLR_RS2_Ueberspannung_XIX_Klima
    delegate Grundumfang_XIX_Klima.RP_IF_LLR_RS2_Uebertemperatur_XIX_Grundumfang_XIX_Klima <-> outer port RP_IF_LLR_RS2_Uebertemperatur_XIX_Klima
    delegate Grundumfang_XIX_Klima.RP_IF_LLR_RS2_Unterspannung_XIX_Grundumfang_XIX_Klima <-> outer port RP_IF_LLR_RS2_Unterspannung_XIX_Klima
    delegate Grundumfang_XIX_Klima.RP_IF_LR_HZG_Konfiguration_XIX_Grundumfang_XIX_Klima <-> outer port RP_IF_LR_HZG_Konfiguration_XIX_Klima
    delegate Grundumfang_XIX_Klima.RP_IF_LR_HZG_Temp_Sensor_XIX_Grundumfang_XIX_Klima <-> outer port RP_IF_LR_HZG_Temp_Sensor_XIX_Klima
    delegate Grundumfang_XIX_Klima.RP_IF_LRH_On_Off_XIX_Grundumfang_XIX_Klima <-> outer port RP_IF_LRH_On_Off_XIX_Klima
    delegate Grundumfang_XIX_Klima.RP_IF_LS_Helligkeit_IR_XIX_Grundumfang_XIX_Klima <-> outer port RP_IF_LS_Helligkeit_IR_XIX_Klima
    delegate Grundumfang_XIX_Klima.RP_IF_MD1_Lage_XIX_Grundumfang_XIX_Klima <-> outer port RP_IF_MD1_Lage_XIX_Klima
    delegate Grundumfang_XIX_Klima.RP_IF_MD1_Position_XIX_Grundumfang_XIX_Klima <-> outer port RP_IF_MD1_Position_XIX_Klima
    delegate Grundumfang_XIX_Klima.RP_IF_MD3_Lage_XIX_Grundumfang_XIX_Klima <-> outer port RP_IF_MD3_Lage_XIX_Klima
    delegate Grundumfang_XIX_Klima.RP_IF_MFL_Eventcode_1_XIX_Grundumfang_XIX_Klima <-> outer port RP_IF_MFL_Eventcode_1_XIX_Klima
    delegate Grundumfang_XIX_Klima.RP_IF_MFL_Eventcode_2_XIX_Grundumfang_XIX_Klima <-> outer port RP_IF_MFL_Eventcode_2_XIX_Klima
    delegate Grundumfang_XIX_Klima.RP_IF_MFL_Tastencode_1_XIX_Grundumfang_XIX_Klima <-> outer port RP_IF_MFL_Tastencode_1_XIX_Klima
    delegate Grundumfang_XIX_Klima.RP_IF_MFL_Tastencode_2_XIX_Grundumfang_XIX_Klima <-> outer port RP_IF_MFL_Tastencode_2_XIX_Klima
    delegate Grundumfang_XIX_Klima.RP_IF_MFL_Variante_XIX_Grundumfang_XIX_Klima <-> outer port RP_IF_MFL_Variante_XIX_Klima
    delegate Grundumfang_XIX_Klima.RP_IF_MIK_PetsMode_state_XIX_Grundumfang_XIX_Klima <-> outer port RP_IF_MIK_PetsMode_state_XIX_Klima
    delegate Grundumfang_XIX_Klima.RP_IF_MO_HVEM_MaxLeistung_XIX_Grundumfang_XIX_Klima <-> outer port RP_IF_MO_HVEM_MaxLeistung_XIX_Klima
    delegate Grundumfang_XIX_Klima.RP_IF_MO_HYB_Fahrbereitschaft_XIX_Grundumfang_XIX_Klima <-> outer port RP_IF_MO_HYB_Fahrbereitschaft_XIX_Klima
    delegate Grundumfang_XIX_Klima.RP_IF_MO_Hybridfahrzeug_XIX_Grundumfang_XIX_Klima <-> outer port RP_IF_MO_Hybridfahrzeug_XIX_Klima
    delegate HVEM_Auto_NL_XIX_Klima.RP_IF_MO_Hybridfahrzeug_XIX_HVEM_Auto_NL_XIX_Klima <-> outer port RP_IF_MO_Hybridfahrzeug_XIX_Klima
    delegate Grundumfang_XIX_Klima.RP_IF_MO_Klima_Regelmodus_XIX_Grundumfang_XIX_Klima <-> outer port RP_IF_MO_Klima_Regelmodus_XIX_Klima
    delegate Grundumfang_XIX_Klima.RP_IF_MO_Kuehlerluefter_1_XIX_Grundumfang_XIX_Klima <-> outer port RP_IF_MO_Kuehlerluefter_1_XIX_Klima
    delegate Grundumfang_XIX_Klima.RP_IF_MO_Kuehlerluefter_2_XIX_Grundumfang_XIX_Klima <-> outer port RP_IF_MO_Kuehlerluefter_2_XIX_Klima
    delegate Grundumfang_XIX_Klima.RP_IF_MO_Kuehlerluefter_MUX_XIX_Grundumfang_XIX_Klima <-> outer port RP_IF_MO_Kuehlerluefter_MUX_XIX_Klima
    delegate Grundumfang_XIX_Klima.RP_IF_MO_OBD_Typ_XIX_Grundumfang_XIX_Klima <-> outer port RP_IF_MO_OBD_Typ_XIX_Klima
    delegate Grundumfang_XIX_Klima.RP_IF_MO_QBit_Aussen_Temp_XIX_Grundumfang_XIX_Klima <-> outer port RP_IF_MO_QBit_Aussen_Temp_XIX_Klima
    delegate Grundumfang_XIX_Klima.RP_IF_MO_RedFahrleistung_Lampe_XIX_Grundumfang_XIX_Klima <-> outer port RP_IF_MO_RedFahrleistung_Lampe_XIX_Klima
    delegate Grundumfang_XIX_Klima.RP_IF_MRollo_Lage_XIX_Grundumfang_XIX_Klima <-> outer port RP_IF_MRollo_Lage_XIX_Klima
    delegate Grundumfang_XIX_Klima.RP_IF_MRollo_Position_XIX_Grundumfang_XIX_Klima <-> outer port RP_IF_MRollo_Position_XIX_Klima
    delegate Grundumfang_XIX_Klima.RP_IF_ND_PSD_Tunnel_Status_XIX_Grundumfang_XIX_Klima <-> outer port RP_IF_ND_PSD_Tunnel_Status_XIX_Klima
    delegate Grundumfang_XIX_Klima.RP_IF_NM_DCDC_NV_NM_State_XIX_Grundumfang_XIX_Klima <-> outer port RP_IF_NM_DCDC_NV_NM_State_XIX_Klima
    delegate Grundumfang_XIX_Klima.RP_IF_NM_Gateway_NM_State_XIX_Grundumfang_XIX_Klima <-> outer port RP_IF_NM_Gateway_NM_State_XIX_Klima
    delegate Grundumfang_XIX_Klima.RP_IF_NM_Hybrid_01_NM_State_XIX_Grundumfang_XIX_Klima <-> outer port RP_IF_NM_Hybrid_01_NM_State_XIX_Klima
    delegate Grundumfang_XIX_Klima.RP_IF_NM_Ladegeraet_NM_State_XIX_Grundumfang_XIX_Klima <-> outer port RP_IF_NM_Ladegeraet_NM_State_XIX_Klima
    delegate Grundumfang_XIX_Klima.RP_IF_NVEM_Abschaltstufe_XIX_Grundumfang_XIX_Klima <-> outer port RP_IF_NVEM_Abschaltstufe_XIX_Klima
    delegate Grundumfang_XIX_Klima.RP_IF_NVEM_Last_Anf_XIX_Grundumfang_XIX_Klima <-> outer port RP_IF_NVEM_Last_Anf_XIX_Klima
    delegate Grundumfang_XIX_Klima.RP_IF_OBD_Abs_Load_Val_XIX_Grundumfang_XIX_Klima <-> outer port RP_IF_OBD_Abs_Load_Val_XIX_Klima
    delegate Grundumfang_XIX_Klima.RP_IF_OBD_Abs_Pedal_Pos_XIX_Grundumfang_XIX_Klima <-> outer port RP_IF_OBD_Abs_Pedal_Pos_XIX_Klima
    delegate Grundumfang_XIX_Klima.RP_IF_OBD_Abs_Throttle_Pos_XIX_Grundumfang_XIX_Klima <-> outer port RP_IF_OBD_Abs_Throttle_Pos_XIX_Klima
    delegate Grundumfang_XIX_Klima.RP_IF_OBD_Calc_Load_Val_XIX_Grundumfang_XIX_Klima <-> outer port RP_IF_OBD_Calc_Load_Val_XIX_Klima
    delegate Grundumfang_XIX_Klima.RP_IF_OBD_Driving_Cycle_XIX_Grundumfang_XIX_Klima <-> outer port RP_IF_OBD_Driving_Cycle_XIX_Klima
    delegate Grundumfang_XIX_Klima.RP_IF_OBD_Eng_Cool_Temp_XIX_Grundumfang_XIX_Klima <-> outer port RP_IF_OBD_Eng_Cool_Temp_XIX_Klima
    delegate Grundumfang_XIX_Klima.RP_IF_OBD_Kaltstart_Denominator_XIX_Grundumfang_XIX_Klima <-> outer port RP_IF_OBD_Kaltstart_Denominator_XIX_Klima
    delegate Grundumfang_XIX_Klima.RP_IF_OBD_Minimum_Trip_XIX_Grundumfang_XIX_Klima <-> outer port RP_IF_OBD_Minimum_Trip_XIX_Klima
    delegate Grundumfang_XIX_Klima.RP_IF_OBD_Normed_Trip_XIX_Grundumfang_XIX_Klima <-> outer port RP_IF_OBD_Normed_Trip_XIX_Klima
    delegate Grundumfang_XIX_Klima.RP_IF_OBD_Sperrung_IUMPR_XIX_Grundumfang_XIX_Klima <-> outer port RP_IF_OBD_Sperrung_IUMPR_XIX_Klima
    delegate Grundumfang_XIX_Klima.RP_IF_OBD_Warm_Up_Cycle_XIX_Grundumfang_XIX_Klima <-> outer port RP_IF_OBD_Warm_Up_Cycle_XIX_Klima
    delegate Grundumfang_XIX_Klima.RP_IF_OBDProtocol_req_XIX_Grundumfang_XIX_Klima <-> outer port RP_IF_OBDProtocol_req_XIX_Klima
    delegate Grundumfang_XIX_Klima.RP_IF_OPS_ComfortReadyStatus_XIX_Grundumfang_XIX_Klima <-> outer port RP_IF_OPS_ComfortReadyStatus_XIX_Klima
    delegate Grundumfang_XIX_Klima.RP_IF_OPS_DriverPresenceStatus_XIX_Grundumfang_XIX_Klima <-> outer port RP_IF_OPS_DriverPresenceStatus_XIX_Klima
    delegate Grundumfang_XIX_Klima.RP_IF_OPS_OccupantPresenceStatus_XIX_Grundumfang_XIX_Klima <-> outer port RP_IF_OPS_OccupantPresenceStatus_XIX_Klima
    delegate Grundumfang_XIX_Klima.RP_IF_OPS_QBit_DriverPresence_XIX_Grundumfang_XIX_Klima <-> outer port RP_IF_OPS_QBit_DriverPresence_XIX_Klima
    delegate Grundumfang_XIX_Klima.RP_IF_ORU_AP_Mode_XIX_Grundumfang_XIX_Klima <-> outer port RP_IF_ORU_AP_Mode_XIX_Klima
    delegate Grundumfang_XIX_Klima.RP_IF_ORU_EM_Anfrage_Flashdauer_XIX_Grundumfang_XIX_Klima <-> outer port RP_IF_ORU_EM_Anfrage_Flashdauer_XIX_Klima
    delegate Grundumfang_XIX_Klima.RP_IF_ORU_EM_Anfrage_freigegebeneNetze_XIX_Grundumfang_XIX_Klima <-> outer port RP_IF_ORU_EM_Anfrage_freigegebeneNetze_XIX_Klima
    delegate Grundumfang_XIX_Klima.RP_IF_ORU_EM_Anfrage_Stromaufnahme_XIX_Grundumfang_XIX_Klima <-> outer port RP_IF_ORU_EM_Anfrage_Stromaufnahme_XIX_Klima
    delegate Grundumfang_XIX_Klima.RP_IF_ORU_Status_XIX_Grundumfang_XIX_Klima <-> outer port RP_IF_ORU_Status_XIX_Klima
    delegate Grundumfang_XIX_Klima.RP_IF_PCU_Adressinhalt_XIX_Grundumfang_XIX_Klima <-> outer port RP_IF_PCU_Adressinhalt_XIX_Klima
    delegate Grundumfang_XIX_Klima.RP_IF_PCU_Betriebsstunden_XIX_Grundumfang_XIX_Klima <-> outer port RP_IF_PCU_Betriebsstunden_XIX_Klima
    delegate Grundumfang_XIX_Klima.RP_IF_PCU_Defekt_XIX_Grundumfang_XIX_Klima <-> outer port RP_IF_PCU_Defekt_XIX_Klima
    delegate Grundumfang_XIX_Klima.RP_IF_PCU_Fehler_Emitter_XIX_Grundumfang_XIX_Klima <-> outer port RP_IF_PCU_Fehler_Emitter_XIX_Klima
    delegate Grundumfang_XIX_Klima.RP_IF_PCU_Fehler_Intern_XIX_Grundumfang_XIX_Klima <-> outer port RP_IF_PCU_Fehler_Intern_XIX_Klima
    delegate Grundumfang_XIX_Klima.RP_IF_PCU_I_Sec_XIX_Grundumfang_XIX_Klima <-> outer port RP_IF_PCU_I_Sec_XIX_Klima
    delegate Grundumfang_XIX_Klima.RP_IF_PCU_Polarisation_XIX_Grundumfang_XIX_Klima <-> outer port RP_IF_PCU_Polarisation_XIX_Klima
    delegate Grundumfang_XIX_Klima.RP_IF_PCU_ResponseError_XIX_Grundumfang_XIX_Klima <-> outer port RP_IF_PCU_ResponseError_XIX_Klima
    delegate Grundumfang_XIX_Klima.RP_IF_PCU_State_Polarisation_XIX_Grundumfang_XIX_Klima <-> outer port RP_IF_PCU_State_Polarisation_XIX_Klima
    delegate Grundumfang_XIX_Klima.RP_IF_PCU_Status_LED_XIX_Grundumfang_XIX_Klima <-> outer port RP_IF_PCU_Status_LED_XIX_Klima
    delegate Grundumfang_XIX_Klima.RP_IF_PCU_Status_XIX_Grundumfang_XIX_Klima <-> outer port RP_IF_PCU_Status_XIX_Klima
    delegate Grundumfang_XIX_Klima.RP_IF_PCU_Temp_PCB_XIX_Grundumfang_XIX_Klima <-> outer port RP_IF_PCU_Temp_PCB_XIX_Klima
    delegate Grundumfang_XIX_Klima.RP_IF_PCU_U_Sec_XIX_Grundumfang_XIX_Klima <-> outer port RP_IF_PCU_U_Sec_XIX_Klima
    delegate Grundumfang_XIX_Klima.RP_IF_Perso_Aktiv_XIX_Grundumfang_XIX_Klima <-> outer port RP_IF_Perso_Aktiv_XIX_Klima
    delegate Grundumfang_XIX_Klima.RP_IF_Perso_Bedienstelle_XIX_Grundumfang_XIX_Klima <-> outer port RP_IF_Perso_Bedienstelle_XIX_Klima
    delegate Grundumfang_XIX_Klima.RP_IF_Perso_Fahrernummer_XIX_Grundumfang_XIX_Klima <-> outer port RP_IF_Perso_Fahrernummer_XIX_Klima
    delegate Grundumfang_XIX_Klima.RP_IF_Perso_Freigabe_Verstellung_XIX_Grundumfang_XIX_Klima <-> outer port RP_IF_Perso_Freigabe_Verstellung_XIX_Klima
    delegate Grundumfang_XIX_Klima.RP_IF_Perso_Kontonummer_XIX_Grundumfang_XIX_Klima <-> outer port RP_IF_Perso_Kontonummer_XIX_Klima
    delegate Grundumfang_XIX_Klima.RP_IF_Perso_Schreibschutz_XIX_Grundumfang_XIX_Klima <-> outer port RP_IF_Perso_Schreibschutz_XIX_Klima
    delegate Grundumfang_XIX_Klima.RP_IF_Perso_Status_XIX_Grundumfang_XIX_Klima <-> outer port RP_IF_Perso_Status_XIX_Klima
    delegate Grundumfang_XIX_Klima.RP_IF_Perso_Steuerung_XIX_Grundumfang_XIX_Klima <-> outer port RP_IF_Perso_Steuerung_XIX_Klima
    delegate Grundumfang_XIX_Klima.RP_IF_Perso_Steuerungsparameter_XIX_Grundumfang_XIX_Klima <-> outer port RP_IF_Perso_Steuerungsparameter_XIX_Klima
    delegate Grundumfang_XIX_Klima.RP_IF_PMS1_Partikel_XIX_Grundumfang_XIX_Klima <-> outer port RP_IF_PMS1_Partikel_XIX_Klima
    delegate Grundumfang_XIX_Klima.RP_IF_PMS1_ResponseError_XIX_Grundumfang_XIX_Klima <-> outer port RP_IF_PMS1_ResponseError_XIX_Klima
    delegate Grundumfang_XIX_Klima.RP_IF_PMS1_Status_XIX_Grundumfang_XIX_Klima <-> outer port RP_IF_PMS1_Status_XIX_Klima
    delegate Grundumfang_XIX_Klima.RP_IF_PSD_06_Mux_XIX_Grundumfang_XIX_Klima <-> outer port RP_IF_PSD_06_Mux_XIX_Klima
    delegate Grundumfang_XIX_Klima.RP_IF_PSD_Abzweigerichtung_XIX_Grundumfang_XIX_Klima <-> outer port RP_IF_PSD_Abzweigerichtung_XIX_Klima
    delegate Grundumfang_XIX_Klima.RP_IF_PSD_Abzweigewinkel_XIX_Grundumfang_XIX_Klima <-> outer port RP_IF_PSD_Abzweigewinkel_XIX_Klima
    delegate Grundumfang_XIX_Klima.RP_IF_PSD_ADAS_Qualitaet_XIX_Grundumfang_XIX_Klima <-> outer port RP_IF_PSD_ADAS_Qualitaet_XIX_Klima
    delegate Grundumfang_XIX_Klima.RP_IF_PSD_Anfangskruemmung_Vorz_XIX_Grundumfang_XIX_Klima <-> outer port RP_IF_PSD_Anfangskruemmung_Vorz_XIX_Klima
    delegate Grundumfang_XIX_Klima.RP_IF_PSD_Anfangskruemmung_XIX_Grundumfang_XIX_Klima <-> outer port RP_IF_PSD_Anfangskruemmung_XIX_Klima
    delegate Grundumfang_XIX_Klima.RP_IF_PSD_Attribut_1_ID_XIX_Grundumfang_XIX_Klima <-> outer port RP_IF_PSD_Attribut_1_ID_XIX_Klima
    delegate Grundumfang_XIX_Klima.RP_IF_PSD_Attribut_1_Offset_XIX_Grundumfang_XIX_Klima <-> outer port RP_IF_PSD_Attribut_1_Offset_XIX_Klima
    delegate Grundumfang_XIX_Klima.RP_IF_PSD_Attribut_1_Wert_XIX_Grundumfang_XIX_Klima <-> outer port RP_IF_PSD_Attribut_1_Wert_XIX_Klima
    delegate Grundumfang_XIX_Klima.RP_IF_PSD_Attribut_2_ID_XIX_Grundumfang_XIX_Klima <-> outer port RP_IF_PSD_Attribut_2_ID_XIX_Klima
    delegate Grundumfang_XIX_Klima.RP_IF_PSD_Attribut_2_Offset_XIX_Grundumfang_XIX_Klima <-> outer port RP_IF_PSD_Attribut_2_Offset_XIX_Klima
    delegate Grundumfang_XIX_Klima.RP_IF_PSD_Attribut_2_Wert_XIX_Grundumfang_XIX_Klima <-> outer port RP_IF_PSD_Attribut_2_Wert_XIX_Klima
    delegate Grundumfang_XIX_Klima.RP_IF_PSD_Attribut_3_ID_XIX_Grundumfang_XIX_Klima <-> outer port RP_IF_PSD_Attribut_3_ID_XIX_Klima
    delegate Grundumfang_XIX_Klima.RP_IF_PSD_Attribut_3_Offset_XIX_Grundumfang_XIX_Klima <-> outer port RP_IF_PSD_Attribut_3_Offset_XIX_Klima
    delegate Grundumfang_XIX_Klima.RP_IF_PSD_Attribut_3_Wert_XIX_Grundumfang_XIX_Klima <-> outer port RP_IF_PSD_Attribut_3_Wert_XIX_Klima
    delegate Grundumfang_XIX_Klima.RP_IF_PSD_Attribut_4_ID_XIX_Grundumfang_XIX_Klima <-> outer port RP_IF_PSD_Attribut_4_ID_XIX_Klima
    delegate Grundumfang_XIX_Klima.RP_IF_PSD_Attribut_4_Offset_XIX_Grundumfang_XIX_Klima <-> outer port RP_IF_PSD_Attribut_4_Offset_XIX_Klima
    delegate Grundumfang_XIX_Klima.RP_IF_PSD_Attribut_4_Wert_XIX_Grundumfang_XIX_Klima <-> outer port RP_IF_PSD_Attribut_4_Wert_XIX_Klima
    delegate Grundumfang_XIX_Klima.RP_IF_PSD_Attribut_5_ID_XIX_Grundumfang_XIX_Klima <-> outer port RP_IF_PSD_Attribut_5_ID_XIX_Klima
    delegate Grundumfang_XIX_Klima.RP_IF_PSD_Attribut_5_Offset_XIX_Grundumfang_XIX_Klima <-> outer port RP_IF_PSD_Attribut_5_Offset_XIX_Klima
    delegate Grundumfang_XIX_Klima.RP_IF_PSD_Attribut_5_Wert_XIX_Grundumfang_XIX_Klima <-> outer port RP_IF_PSD_Attribut_5_Wert_XIX_Klima
    delegate Grundumfang_XIX_Klima.RP_IF_PSD_Attribut_Segment_ID_05_XIX_Grundumfang_XIX_Klima <-> outer port RP_IF_PSD_Attribut_Segment_ID_05_XIX_Klima
    delegate Grundumfang_XIX_Klima.RP_IF_PSD_Attribut_Segment_ID_XIX_Grundumfang_XIX_Klima <-> outer port RP_IF_PSD_Attribut_Segment_ID_XIX_Klima
    delegate Grundumfang_XIX_Klima.RP_IF_PSD_Attribute_Komplett_05_XIX_Grundumfang_XIX_Klima <-> outer port RP_IF_PSD_Attribute_Komplett_05_XIX_Klima
    delegate Grundumfang_XIX_Klima.RP_IF_PSD_Attribute_Komplett_06_XIX_Grundumfang_XIX_Klima <-> outer port RP_IF_PSD_Attribute_Komplett_06_XIX_Klima
    delegate Grundumfang_XIX_Klima.RP_IF_PSD_Baum_Ausrichtung_XIX_Grundumfang_XIX_Klima <-> outer port RP_IF_PSD_Baum_Ausrichtung_XIX_Klima
    delegate Grundumfang_XIX_Klima.RP_IF_PSD_Baum_Breite_VZ_XIX_Grundumfang_XIX_Klima <-> outer port RP_IF_PSD_Baum_Breite_VZ_XIX_Klima
    delegate Grundumfang_XIX_Klima.RP_IF_PSD_Baum_Laenge_VZ_XIX_Grundumfang_XIX_Klima <-> outer port RP_IF_PSD_Baum_Laenge_VZ_XIX_Klima
    delegate Grundumfang_XIX_Klima.RP_IF_PSD_Baum_Laenge_XIX_Grundumfang_XIX_Klima <-> outer port RP_IF_PSD_Baum_Laenge_XIX_Klima
    delegate Grundumfang_XIX_Klima.RP_IF_PSD_Bebauung_XIX_Grundumfang_XIX_Klima <-> outer port RP_IF_PSD_Bebauung_XIX_Klima
    delegate Grundumfang_XIX_Klima.RP_IF_PSD_Endkruemmung_Vorz_XIX_Grundumfang_XIX_Klima <-> outer port RP_IF_PSD_Endkruemmung_Vorz_XIX_Klima
    delegate Grundumfang_XIX_Klima.RP_IF_PSD_Endkruemmung_XIX_Grundumfang_XIX_Klima <-> outer port RP_IF_PSD_Endkruemmung_XIX_Klima
    delegate Grundumfang_XIX_Klima.RP_IF_PSD_Fahrspuren_Anzahl_XIX_Grundumfang_XIX_Klima <-> outer port RP_IF_PSD_Fahrspuren_Anzahl_XIX_Klima
    delegate Grundumfang_XIX_Klima.RP_IF_PSD_Geradester_Pfad_XIX_Grundumfang_XIX_Klima <-> outer port RP_IF_PSD_Geradester_Pfad_XIX_Klima
    delegate Grundumfang_XIX_Klima.RP_IF_PSD_Ges_Attribute_Komplett_XIX_Grundumfang_XIX_Klima <-> outer port RP_IF_PSD_Ges_Attribute_Komplett_XIX_Klima
    delegate Grundumfang_XIX_Klima.RP_IF_PSD_Ges_Geschwindigkeit_Gespann_XIX_Grundumfang_XIX_Klima <-> outer port RP_IF_PSD_Ges_Geschwindigkeit_Gespann_XIX_Klima
    delegate Grundumfang_XIX_Klima.RP_IF_PSD_Ges_Geschwindigkeit_Std_Anf_XIX_Grundumfang_XIX_Klima <-> outer port RP_IF_PSD_Ges_Geschwindigkeit_Std_Anf_XIX_Klima
    delegate Grundumfang_XIX_Klima.RP_IF_PSD_Ges_Geschwindigkeit_Std_Ende_XIX_Grundumfang_XIX_Klima <-> outer port RP_IF_PSD_Ges_Geschwindigkeit_Std_Ende_XIX_Klima
    delegate Grundumfang_XIX_Klima.RP_IF_PSD_Ges_Geschwindigkeit_Tag_Anf_XIX_Grundumfang_XIX_Klima <-> outer port RP_IF_PSD_Ges_Geschwindigkeit_Tag_Anf_XIX_Klima
    delegate Grundumfang_XIX_Klima.RP_IF_PSD_Ges_Geschwindigkeit_Tag_Ende_XIX_Grundumfang_XIX_Klima <-> outer port RP_IF_PSD_Ges_Geschwindigkeit_Tag_Ende_XIX_Klima
    delegate Grundumfang_XIX_Klima.RP_IF_PSD_Ges_Geschwindigkeit_Witter_XIX_Grundumfang_XIX_Klima <-> outer port RP_IF_PSD_Ges_Geschwindigkeit_Witter_XIX_Klima
    delegate Grundumfang_XIX_Klima.RP_IF_PSD_Ges_Geschwindigkeit_XIX_Grundumfang_XIX_Klima <-> outer port RP_IF_PSD_Ges_Geschwindigkeit_XIX_Klima
    delegate Grundumfang_XIX_Klima.RP_IF_PSD_Ges_Gesetzlich_Kategorie_XIX_Grundumfang_XIX_Klima <-> outer port RP_IF_PSD_Ges_Gesetzlich_Kategorie_XIX_Klima
    delegate Grundumfang_XIX_Klima.RP_IF_PSD_Ges_Gesetzlich_Zusatz_XIX_Grundumfang_XIX_Klima <-> outer port RP_IF_PSD_Ges_Gesetzlich_Zusatz_XIX_Klima
    delegate Grundumfang_XIX_Klima.RP_IF_PSD_Ges_Offset_XIX_Grundumfang_XIX_Klima <-> outer port RP_IF_PSD_Ges_Offset_XIX_Klima
    delegate Grundumfang_XIX_Klima.RP_IF_PSD_Ges_Segment_ID_XIX_Grundumfang_XIX_Klima <-> outer port RP_IF_PSD_Ges_Segment_ID_XIX_Klima
    delegate Grundumfang_XIX_Klima.RP_IF_PSD_Ges_Spur_Geschw_Begrenzung_XIX_Grundumfang_XIX_Klima <-> outer port RP_IF_PSD_Ges_Spur_Geschw_Begrenzung_XIX_Klima
    delegate Grundumfang_XIX_Klima.RP_IF_PSD_Ges_Typ_XIX_Grundumfang_XIX_Klima <-> outer port RP_IF_PSD_Ges_Typ_XIX_Klima
    delegate Grundumfang_XIX_Klima.RP_IF_PSD_Ges_Ueberholverbot_XIX_Grundumfang_XIX_Klima <-> outer port RP_IF_PSD_Ges_Ueberholverbot_XIX_Klima
    delegate Grundumfang_XIX_Klima.RP_IF_PSD_Ges_Verkehrszeichen_Quelle_XIX_Grundumfang_XIX_Klima <-> outer port RP_IF_PSD_Ges_Verkehrszeichen_Quelle_XIX_Klima
    delegate Grundumfang_XIX_Klima.RP_IF_PSD_Ges_Wechselverkehrszeichen_XIX_Grundumfang_XIX_Klima <-> outer port RP_IF_PSD_Ges_Wechselverkehrszeichen_XIX_Klima
    delegate Grundumfang_XIX_Klima.RP_IF_PSD_Idenditaets_ID_XIX_Grundumfang_XIX_Klima <-> outer port RP_IF_PSD_Idenditaets_ID_XIX_Klima
    delegate Grundumfang_XIX_Klima.RP_IF_PSD_LR_01_MUX_XIX_Grundumfang_XIX_Klima <-> outer port RP_IF_PSD_LR_01_MUX_XIX_Klima
    delegate Grundumfang_XIX_Klima.RP_IF_PSD_LR_Attribut_1_Offset_XIX_Grundumfang_XIX_Klima <-> outer port RP_IF_PSD_LR_Attribut_1_Offset_XIX_Klima
    delegate Grundumfang_XIX_Klima.RP_IF_PSD_LR_Attribut_1_Wert_XIX_Grundumfang_XIX_Klima <-> outer port RP_IF_PSD_LR_Attribut_1_Wert_XIX_Klima
    delegate Grundumfang_XIX_Klima.RP_IF_PSD_LR_Attribut_2_Offset_XIX_Grundumfang_XIX_Klima <-> outer port RP_IF_PSD_LR_Attribut_2_Offset_XIX_Klima
    delegate Grundumfang_XIX_Klima.RP_IF_PSD_LR_Attribut_2_Wert_XIX_Grundumfang_XIX_Klima <-> outer port RP_IF_PSD_LR_Attribut_2_Wert_XIX_Klima
    delegate Grundumfang_XIX_Klima.RP_IF_PSD_LR_Attribut_3_Offset_XIX_Grundumfang_XIX_Klima <-> outer port RP_IF_PSD_LR_Attribut_3_Offset_XIX_Klima
    delegate Grundumfang_XIX_Klima.RP_IF_PSD_LR_Attribut_3_Wert_XIX_Grundumfang_XIX_Klima <-> outer port RP_IF_PSD_LR_Attribut_3_Wert_XIX_Klima
    delegate Grundumfang_XIX_Klima.RP_IF_PSD_LR_Fahrzeug_Pos_XIX_Grundumfang_XIX_Klima <-> outer port RP_IF_PSD_LR_Fahrzeug_Pos_XIX_Klima
    delegate Grundumfang_XIX_Klima.RP_IF_PSD_LR_Globale_Steigung_Vorz_XIX_Grundumfang_XIX_Klima <-> outer port RP_IF_PSD_LR_Globale_Steigung_Vorz_XIX_Klima
    delegate Grundumfang_XIX_Klima.RP_IF_PSD_LR_Globale_Steigung_XIX_Grundumfang_XIX_Klima <-> outer port RP_IF_PSD_LR_Globale_Steigung_XIX_Klima
    delegate Grundumfang_XIX_Klima.RP_IF_PSD_LR_Profil_Laenge_XIX_Grundumfang_XIX_Klima <-> outer port RP_IF_PSD_LR_Profil_Laenge_XIX_Klima
    delegate Grundumfang_XIX_Klima.RP_IF_PSD_LR_Profil_Nummer_XIX_Grundumfang_XIX_Klima <-> outer port RP_IF_PSD_LR_Profil_Nummer_XIX_Klima
    delegate Grundumfang_XIX_Klima.RP_IF_PSD_LR_Reset_XIX_Grundumfang_XIX_Klima <-> outer port RP_IF_PSD_LR_Reset_XIX_Klima
    delegate Grundumfang_XIX_Klima.RP_IF_PSD_LR_Steigung_1_Offset_XIX_Grundumfang_XIX_Klima <-> outer port RP_IF_PSD_LR_Steigung_1_Offset_XIX_Klima
    delegate Grundumfang_XIX_Klima.RP_IF_PSD_LR_Steigung_1_Vorz_XIX_Grundumfang_XIX_Klima <-> outer port RP_IF_PSD_LR_Steigung_1_Vorz_XIX_Klima
    delegate Grundumfang_XIX_Klima.RP_IF_PSD_LR_Steigung_1_Wert_XIX_Grundumfang_XIX_Klima <-> outer port RP_IF_PSD_LR_Steigung_1_Wert_XIX_Klima
    delegate Grundumfang_XIX_Klima.RP_IF_PSD_LR_Steigung_2_Offset_XIX_Grundumfang_XIX_Klima <-> outer port RP_IF_PSD_LR_Steigung_2_Offset_XIX_Klima
    delegate Grundumfang_XIX_Klima.RP_IF_PSD_LR_Steigung_2_Vorz_XIX_Grundumfang_XIX_Klima <-> outer port RP_IF_PSD_LR_Steigung_2_Vorz_XIX_Klima
    delegate Grundumfang_XIX_Klima.RP_IF_PSD_LR_Steigung_2_Wert_XIX_Grundumfang_XIX_Klima <-> outer port RP_IF_PSD_LR_Steigung_2_Wert_XIX_Klima
    delegate Grundumfang_XIX_Klima.RP_IF_PSD_LR_Steigung_3_Offset_XIX_Grundumfang_XIX_Klima <-> outer port RP_IF_PSD_LR_Steigung_3_Offset_XIX_Klima
    delegate Grundumfang_XIX_Klima.RP_IF_PSD_LR_Steigung_3_Vorz_XIX_Grundumfang_XIX_Klima <-> outer port RP_IF_PSD_LR_Steigung_3_Vorz_XIX_Klima
    delegate Grundumfang_XIX_Klima.RP_IF_PSD_LR_Steigung_3_Wert_XIX_Grundumfang_XIX_Klima <-> outer port RP_IF_PSD_LR_Steigung_3_Wert_XIX_Klima
    delegate Grundumfang_XIX_Klima.RP_IF_PSD_Pos_Fahrspur_XIX_Grundumfang_XIX_Klima <-> outer port RP_IF_PSD_Pos_Fahrspur_XIX_Klima
    delegate Grundumfang_XIX_Klima.RP_IF_PSD_Pos_Fehler_Laengsrichtung_XIX_Grundumfang_XIX_Klima <-> outer port RP_IF_PSD_Pos_Fehler_Laengsrichtung_XIX_Klima
    delegate Grundumfang_XIX_Klima.RP_IF_PSD_Pos_Inhibitzeit_XIX_Grundumfang_XIX_Klima <-> outer port RP_IF_PSD_Pos_Inhibitzeit_XIX_Klima
    delegate Grundumfang_XIX_Klima.RP_IF_PSD_Pos_Segment_ID_XIX_Grundumfang_XIX_Klima <-> outer port RP_IF_PSD_Pos_Segment_ID_XIX_Klima
    delegate Grundumfang_XIX_Klima.RP_IF_PSD_Pos_Segmentlaenge_XIX_Grundumfang_XIX_Klima <-> outer port RP_IF_PSD_Pos_Segmentlaenge_XIX_Klima
    delegate Grundumfang_XIX_Klima.RP_IF_PSD_Pos_Standort_Eindeutig_XIX_Grundumfang_XIX_Klima <-> outer port RP_IF_PSD_Pos_Standort_Eindeutig_XIX_Klima
    delegate Grundumfang_XIX_Klima.RP_IF_PSD_Rampe_XIX_Grundumfang_XIX_Klima <-> outer port RP_IF_PSD_Rampe_XIX_Klima
    delegate Grundumfang_XIX_Klima.RP_IF_PSD_Segment_ID_XIX_Grundumfang_XIX_Klima <-> outer port RP_IF_PSD_Segment_ID_XIX_Klima
    delegate Grundumfang_XIX_Klima.RP_IF_PSD_Segment_Komplett_XIX_Grundumfang_XIX_Klima <-> outer port RP_IF_PSD_Segment_Komplett_XIX_Klima
    delegate Grundumfang_XIX_Klima.RP_IF_PSD_Segmentlaenge_XIX_Grundumfang_XIX_Klima <-> outer port RP_IF_PSD_Segmentlaenge_XIX_Klima
    delegate Grundumfang_XIX_Klima.RP_IF_PSD_Steigung_1_A_Offset_XIX_Grundumfang_XIX_Klima <-> outer port RP_IF_PSD_Steigung_1_A_Offset_XIX_Klima
    delegate Grundumfang_XIX_Klima.RP_IF_PSD_Steigung_1_A_Steigung_XIX_Grundumfang_XIX_Klima <-> outer port RP_IF_PSD_Steigung_1_A_Steigung_XIX_Klima
    delegate Grundumfang_XIX_Klima.RP_IF_PSD_Steigung_1_A_Vorz_XIX_Grundumfang_XIX_Klima <-> outer port RP_IF_PSD_Steigung_1_A_Vorz_XIX_Klima
    delegate Grundumfang_XIX_Klima.RP_IF_PSD_Steigung_1_Attribute_kompl_XIX_Grundumfang_XIX_Klima <-> outer port RP_IF_PSD_Steigung_1_Attribute_kompl_XIX_Klima
    delegate Grundumfang_XIX_Klima.RP_IF_PSD_Steigung_1_B_Offset_XIX_Grundumfang_XIX_Klima <-> outer port RP_IF_PSD_Steigung_1_B_Offset_XIX_Klima
    delegate Grundumfang_XIX_Klima.RP_IF_PSD_Steigung_1_B_Steigung_XIX_Grundumfang_XIX_Klima <-> outer port RP_IF_PSD_Steigung_1_B_Steigung_XIX_Klima
    delegate Grundumfang_XIX_Klima.RP_IF_PSD_Steigung_1_B_Vorz_XIX_Grundumfang_XIX_Klima <-> outer port RP_IF_PSD_Steigung_1_B_Vorz_XIX_Klima
    delegate Grundumfang_XIX_Klima.RP_IF_PSD_Steigung_1_Segment_ID_XIX_Grundumfang_XIX_Klima <-> outer port RP_IF_PSD_Steigung_1_Segment_ID_XIX_Klima
    delegate Grundumfang_XIX_Klima.RP_IF_PSD_Steigung_2_Attribute_kompl_XIX_Grundumfang_XIX_Klima <-> outer port RP_IF_PSD_Steigung_2_Attribute_kompl_XIX_Klima
    delegate Grundumfang_XIX_Klima.RP_IF_PSD_Steigung_2_Offset_XIX_Grundumfang_XIX_Klima <-> outer port RP_IF_PSD_Steigung_2_Offset_XIX_Klima
    delegate Grundumfang_XIX_Klima.RP_IF_PSD_Steigung_2_Segment_ID_XIX_Grundumfang_XIX_Klima <-> outer port RP_IF_PSD_Steigung_2_Segment_ID_XIX_Klima
    delegate Grundumfang_XIX_Klima.RP_IF_PSD_Steigung_2_Steigung_XIX_Grundumfang_XIX_Klima <-> outer port RP_IF_PSD_Steigung_2_Steigung_XIX_Klima
    delegate Grundumfang_XIX_Klima.RP_IF_PSD_Steigung_2_Vorz_XIX_Grundumfang_XIX_Klima <-> outer port RP_IF_PSD_Steigung_2_Vorz_XIX_Klima
    delegate Grundumfang_XIX_Klima.RP_IF_PSD_Strassenkategorie_XIX_Grundumfang_XIX_Klima <-> outer port RP_IF_PSD_Strassenkategorie_XIX_Klima
    delegate Grundumfang_XIX_Klima.RP_IF_PSD_Sys_Alter_Karte_XIX_Grundumfang_XIX_Klima <-> outer port RP_IF_PSD_Sys_Alter_Karte_XIX_Klima
    delegate Grundumfang_XIX_Klima.RP_IF_PSD_Sys_Geometrieguete_erweitert_XIX_Grundumfang_XIX_Klima <-> outer port RP_IF_PSD_Sys_Geometrieguete_erweitert_XIX_Klima
    delegate Grundumfang_XIX_Klima.RP_IF_PSD_Sys_Geometrieguete_XIX_Grundumfang_XIX_Klima <-> outer port RP_IF_PSD_Sys_Geometrieguete_XIX_Klima
    delegate Grundumfang_XIX_Klima.RP_IF_PSD_Sys_Geschwindigkeit_Einheit_XIX_Grundumfang_XIX_Klima <-> outer port RP_IF_PSD_Sys_Geschwindigkeit_Einheit_XIX_Klima
    delegate Grundumfang_XIX_Klima.RP_IF_PSD_Sys_Laendercode_XIX_Grundumfang_XIX_Klima <-> outer port RP_IF_PSD_Sys_Laendercode_XIX_Klima
    delegate Grundumfang_XIX_Klima.RP_IF_PSD_Sys_Mapmatchingguete_XIX_Grundumfang_XIX_Klima <-> outer port RP_IF_PSD_Sys_Mapmatchingguete_XIX_Klima
    delegate Grundumfang_XIX_Klima.RP_IF_PSD_Sys_Quali_Geometrien_XIX_Grundumfang_XIX_Klima <-> outer port RP_IF_PSD_Sys_Quali_Geometrien_XIX_Klima
    delegate Grundumfang_XIX_Klima.RP_IF_PSD_Sys_Quali_Ortsinfo_XIX_Grundumfang_XIX_Klima <-> outer port RP_IF_PSD_Sys_Quali_Ortsinfo_XIX_Klima
    delegate Grundumfang_XIX_Klima.RP_IF_PSD_Sys_Quali_sonstige_Attribute_XIX_Grundumfang_XIX_Klima <-> outer port RP_IF_PSD_Sys_Quali_sonstige_Attribute_XIX_Klima
    delegate Grundumfang_XIX_Klima.RP_IF_PSD_Sys_Quali_Steigungen_XIX_Grundumfang_XIX_Klima <-> outer port RP_IF_PSD_Sys_Quali_Steigungen_XIX_Klima
    delegate Grundumfang_XIX_Klima.RP_IF_PSD_Sys_Quali_Strassenkennz_XIX_Grundumfang_XIX_Klima <-> outer port RP_IF_PSD_Sys_Quali_Strassenkennz_XIX_Klima
    delegate Grundumfang_XIX_Klima.RP_IF_PSD_Sys_Quali_Tempolimits_XIX_Grundumfang_XIX_Klima <-> outer port RP_IF_PSD_Sys_Quali_Tempolimits_XIX_Klima
    delegate Grundumfang_XIX_Klima.RP_IF_PSD_Sys_Quali_verfuegbar_XIX_Grundumfang_XIX_Klima <-> outer port RP_IF_PSD_Sys_Quali_verfuegbar_XIX_Klima
    delegate Grundumfang_XIX_Klima.RP_IF_PSD_Sys_Quali_Vorfahrtsregelung_XIX_Grundumfang_XIX_Klima <-> outer port RP_IF_PSD_Sys_Quali_Vorfahrtsregelung_XIX_Klima
    delegate Grundumfang_XIX_Klima.RP_IF_PSD_Sys_Segment_ID_XIX_Grundumfang_XIX_Klima <-> outer port RP_IF_PSD_Sys_Segment_ID_XIX_Klima
    delegate Grundumfang_XIX_Klima.RP_IF_PSD_Sys_US_State_XIX_Grundumfang_XIX_Klima <-> outer port RP_IF_PSD_Sys_US_State_XIX_Klima
    delegate Grundumfang_XIX_Klima.RP_IF_PSD_Sys_Verkehrsrichtung_XIX_Grundumfang_XIX_Klima <-> outer port RP_IF_PSD_Sys_Verkehrsrichtung_XIX_Klima
    delegate Grundumfang_XIX_Klima.RP_IF_PSD_Sys_Zielfuehrung_geaendert_XIX_Grundumfang_XIX_Klima <-> outer port RP_IF_PSD_Sys_Zielfuehrung_geaendert_XIX_Klima
    delegate Grundumfang_XIX_Klima.RP_IF_PSD_Sys_Zielfuehrung_XIX_Grundumfang_XIX_Klima <-> outer port RP_IF_PSD_Sys_Zielfuehrung_XIX_Klima
    delegate Grundumfang_XIX_Klima.RP_IF_PSD_Vorgaenger_Segment_ID_XIX_Grundumfang_XIX_Klima <-> outer port RP_IF_PSD_Vorgaenger_Segment_ID_XIX_Klima
    delegate Grundumfang_XIX_Klima.RP_IF_PSD_wahrscheinlichster_Pfad_XIX_Grundumfang_XIX_Klima <-> outer port RP_IF_PSD_wahrscheinlichster_Pfad_XIX_Klima
    delegate Grundumfang_XIX_Klima.RP_IF_PSD_Wechselverkehrszeichen_Typ_XIX_Grundumfang_XIX_Klima <-> outer port RP_IF_PSD_Wechselverkehrszeichen_Typ_XIX_Klima
    delegate Grundumfang_XIX_Klima.RP_IF_PTC_HV_Err_Heizkreis_1_TNCTOC_XIX_Grundumfang_XIX_Klima <-> outer port RP_IF_PTC_HV_Err_Heizkreis_1_TNCTOC_XIX_Klima
    delegate Grundumfang_XIX_Klima.RP_IF_PTC_HV_Err_Heizkreis_1_XIX_Grundumfang_XIX_Klima <-> outer port RP_IF_PTC_HV_Err_Heizkreis_1_XIX_Klima
    delegate Grundumfang_XIX_Klima.RP_IF_PTC_HV_Err_Heizkreis_2_TNCTOC_XIX_Grundumfang_XIX_Klima <-> outer port RP_IF_PTC_HV_Err_Heizkreis_2_TNCTOC_XIX_Klima
    delegate Grundumfang_XIX_Klima.RP_IF_PTC_HV_Err_Heizkreis_2_XIX_Grundumfang_XIX_Klima <-> outer port RP_IF_PTC_HV_Err_Heizkreis_2_XIX_Klima
    delegate Grundumfang_XIX_Klima.RP_IF_PTC_HV_Err_Heizkreis_3_TNCTOC_XIX_Grundumfang_XIX_Klima <-> outer port RP_IF_PTC_HV_Err_Heizkreis_3_TNCTOC_XIX_Klima
    delegate Grundumfang_XIX_Klima.RP_IF_PTC_HV_Err_Heizkreis_3_XIX_Grundumfang_XIX_Klima <-> outer port RP_IF_PTC_HV_Err_Heizkreis_3_XIX_Klima
    delegate Grundumfang_XIX_Klima.RP_IF_PTC_HV_Err_Intern_TNCTOC_XIX_Grundumfang_XIX_Klima <-> outer port RP_IF_PTC_HV_Err_Intern_TNCTOC_XIX_Klima
    delegate Grundumfang_XIX_Klima.RP_IF_PTC_HV_Err_intern_XIX_Grundumfang_XIX_Klima <-> outer port RP_IF_PTC_HV_Err_intern_XIX_Klima
    delegate Grundumfang_XIX_Klima.RP_IF_PTC_HV_Err_Leckagestrom_TNCTOC_XIX_Grundumfang_XIX_Klima <-> outer port RP_IF_PTC_HV_Err_Leckagestrom_TNCTOC_XIX_Klima
    delegate Grundumfang_XIX_Klima.RP_IF_PTC_HV_Err_Leckagestrom_XIX_Grundumfang_XIX_Klima <-> outer port RP_IF_PTC_HV_Err_Leckagestrom_XIX_Klima
    delegate Grundumfang_XIX_Klima.RP_IF_PTC_HV_Err_Temperaturschutz_XIX_Grundumfang_XIX_Klima <-> outer port RP_IF_PTC_HV_Err_Temperaturschutz_XIX_Klima
    delegate Grundumfang_XIX_Klima.RP_IF_PTC_HV_Err_TempSchutz_TNCTOC_XIX_Grundumfang_XIX_Klima <-> outer port RP_IF_PTC_HV_Err_TempSchutz_TNCTOC_XIX_Klima
    delegate Grundumfang_XIX_Klima.RP_IF_PTC_HV_ERR_TNCTOC_XIX_Grundumfang_XIX_Klima <-> outer port RP_IF_PTC_HV_ERR_TNCTOC_XIX_Klima
    delegate Grundumfang_XIX_Klima.RP_IF_PTC_HV_Err_Ueberstromabs_TNCTOC_XIX_Grundumfang_XIX_Klima <-> outer port RP_IF_PTC_HV_Err_Ueberstromabs_TNCTOC_XIX_Klima
    delegate Grundumfang_XIX_Klima.RP_IF_PTC_HV_Err_Ueberstromabschaltung_XIX_Grundumfang_XIX_Klima <-> outer port RP_IF_PTC_HV_Err_Ueberstromabschaltung_XIX_Klima
    delegate Grundumfang_XIX_Klima.RP_IF_PTC_HV_ERR_XIX_Grundumfang_XIX_Klima <-> outer port RP_IF_PTC_HV_ERR_XIX_Klima
    delegate Grundumfang_XIX_Klima.RP_IF_PTC_HV_Heizmedium_Sensor_1_XIX_Grundumfang_XIX_Klima <-> outer port RP_IF_PTC_HV_Heizmedium_Sensor_1_XIX_Klima
    delegate Grundumfang_XIX_Klima.RP_IF_PTC_HV_Heizmedium_Sensor_2_XIX_Grundumfang_XIX_Klima <-> outer port RP_IF_PTC_HV_Heizmedium_Sensor_2_XIX_Klima
    delegate Grundumfang_XIX_Klima.RP_IF_PTC_HV_I_ist_XIX_Grundumfang_XIX_Klima <-> outer port RP_IF_PTC_HV_I_ist_XIX_Klima
    delegate Grundumfang_XIX_Klima.RP_IF_PTC_HV_ResponseError_XIX_Grundumfang_XIX_Klima <-> outer port RP_IF_PTC_HV_ResponseError_XIX_Klima
    delegate Grundumfang_XIX_Klima.RP_IF_PTC_HV_Status_PTC_XIX_Grundumfang_XIX_Klima <-> outer port RP_IF_PTC_HV_Status_PTC_XIX_Klima
    delegate Grundumfang_XIX_Klima.RP_IF_PTC_HV_Status_UBatt_XIX_Grundumfang_XIX_Klima <-> outer port RP_IF_PTC_HV_Status_UBatt_XIX_Klima
    delegate Grundumfang_XIX_Klima.RP_IF_PTC_HV_Temp_PCB_XIX_Grundumfang_XIX_Klima <-> outer port RP_IF_PTC_HV_Temp_PCB_XIX_Klima
    delegate Grundumfang_XIX_Klima.RP_IF_PTC_HV_TimeOut_Fehler_XIX_Grundumfang_XIX_Klima <-> outer port RP_IF_PTC_HV_TimeOut_Fehler_XIX_Klima
    delegate Grundumfang_XIX_Klima.RP_IF_PTC_HV_UBatt_XIX_Grundumfang_XIX_Klima <-> outer port RP_IF_PTC_HV_UBatt_XIX_Klima
    delegate Grundumfang_XIX_Klima.RP_IF_PTC_HVb_Err_Heizkreis_1_TNCTOC_XIX_Grundumfang_XIX_Klima <-> outer port RP_IF_PTC_HVb_Err_Heizkreis_1_TNCTOC_XIX_Klima
    delegate Grundumfang_XIX_Klima.RP_IF_PTC_HVb_Err_Heizkreis_1_XIX_Grundumfang_XIX_Klima <-> outer port RP_IF_PTC_HVb_Err_Heizkreis_1_XIX_Klima
    delegate Grundumfang_XIX_Klima.RP_IF_PTC_HVb_Err_Heizkreis_2_TNCTOC_XIX_Grundumfang_XIX_Klima <-> outer port RP_IF_PTC_HVb_Err_Heizkreis_2_TNCTOC_XIX_Klima
    delegate Grundumfang_XIX_Klima.RP_IF_PTC_HVb_Err_Heizkreis_2_XIX_Grundumfang_XIX_Klima <-> outer port RP_IF_PTC_HVb_Err_Heizkreis_2_XIX_Klima
    delegate Grundumfang_XIX_Klima.RP_IF_PTC_HVb_Err_Heizkreis_3_TNCTOC_XIX_Grundumfang_XIX_Klima <-> outer port RP_IF_PTC_HVb_Err_Heizkreis_3_TNCTOC_XIX_Klima
    delegate Grundumfang_XIX_Klima.RP_IF_PTC_HVb_Err_Heizkreis_3_XIX_Grundumfang_XIX_Klima <-> outer port RP_IF_PTC_HVb_Err_Heizkreis_3_XIX_Klima
    delegate Grundumfang_XIX_Klima.RP_IF_PTC_HVb_Err_Intern_TNCTOC_XIX_Grundumfang_XIX_Klima <-> outer port RP_IF_PTC_HVb_Err_Intern_TNCTOC_XIX_Klima
    delegate Grundumfang_XIX_Klima.RP_IF_PTC_HVb_Err_intern_XIX_Grundumfang_XIX_Klima <-> outer port RP_IF_PTC_HVb_Err_intern_XIX_Klima
    delegate Grundumfang_XIX_Klima.RP_IF_PTC_HVb_Err_Leckagestrom_TNCTOC_XIX_Grundumfang_XIX_Klima <-> outer port RP_IF_PTC_HVb_Err_Leckagestrom_TNCTOC_XIX_Klima
    delegate Grundumfang_XIX_Klima.RP_IF_PTC_HVb_Err_Leckagestrom_XIX_Grundumfang_XIX_Klima <-> outer port RP_IF_PTC_HVb_Err_Leckagestrom_XIX_Klima
    delegate Grundumfang_XIX_Klima.RP_IF_PTC_HVb_Err_Temperaturschutz_XIX_Grundumfang_XIX_Klima <-> outer port RP_IF_PTC_HVb_Err_Temperaturschutz_XIX_Klima
    delegate Grundumfang_XIX_Klima.RP_IF_PTC_HVb_Err_TempSchutz_TNCTOC_XIX_Grundumfang_XIX_Klima <-> outer port RP_IF_PTC_HVb_Err_TempSchutz_TNCTOC_XIX_Klima
    delegate Grundumfang_XIX_Klima.RP_IF_PTC_HVb_ERR_TNCTOC_XIX_Grundumfang_XIX_Klima <-> outer port RP_IF_PTC_HVb_ERR_TNCTOC_XIX_Klima
    delegate Grundumfang_XIX_Klima.RP_IF_PTC_HVb_Err_Ueberstromabs_TNCTOC_XIX_Grundumfang_XIX_Klima <-> outer port RP_IF_PTC_HVb_Err_Ueberstromabs_TNCTOC_XIX_Klima
    delegate Grundumfang_XIX_Klima.RP_IF_PTC_HVb_Err_Ueberstromabschaltung_XIX_Grundumfang_XIX_Klima <-> outer port RP_IF_PTC_HVb_Err_Ueberstromabschaltung_XIX_Klima
    delegate Grundumfang_XIX_Klima.RP_IF_PTC_HVb_ERR_XIX_Grundumfang_XIX_Klima <-> outer port RP_IF_PTC_HVb_ERR_XIX_Klima
    delegate Grundumfang_XIX_Klima.RP_IF_PTC_HVb_Heizmedium_Sensor_1_XIX_Grundumfang_XIX_Klima <-> outer port RP_IF_PTC_HVb_Heizmedium_Sensor_1_XIX_Klima
    delegate Grundumfang_XIX_Klima.RP_IF_PTC_HVb_Heizmedium_Sensor_2_XIX_Grundumfang_XIX_Klima <-> outer port RP_IF_PTC_HVb_Heizmedium_Sensor_2_XIX_Klima
    delegate Grundumfang_XIX_Klima.RP_IF_PTC_HVb_I_ist_XIX_Grundumfang_XIX_Klima <-> outer port RP_IF_PTC_HVb_I_ist_XIX_Klima
    delegate Grundumfang_XIX_Klima.RP_IF_PTC_HVb_ResponseError_XIX_Grundumfang_XIX_Klima <-> outer port RP_IF_PTC_HVb_ResponseError_XIX_Klima
    delegate Grundumfang_XIX_Klima.RP_IF_PTC_HVb_Status_PTC_XIX_Grundumfang_XIX_Klima <-> outer port RP_IF_PTC_HVb_Status_PTC_XIX_Klima
    delegate Grundumfang_XIX_Klima.RP_IF_PTC_HVb_Status_UBatt_XIX_Grundumfang_XIX_Klima <-> outer port RP_IF_PTC_HVb_Status_UBatt_XIX_Klima
    delegate Grundumfang_XIX_Klima.RP_IF_PTC_HVb_Temp_PCB_XIX_Grundumfang_XIX_Klima <-> outer port RP_IF_PTC_HVb_Temp_PCB_XIX_Klima
    delegate Grundumfang_XIX_Klima.RP_IF_PTC_HVb_TimeOut_Fehler_XIX_Grundumfang_XIX_Klima <-> outer port RP_IF_PTC_HVb_TimeOut_Fehler_XIX_Klima
    delegate Grundumfang_XIX_Klima.RP_IF_PTC_HVb_UBatt_XIX_Grundumfang_XIX_Klima <-> outer port RP_IF_PTC_HVb_UBatt_XIX_Klima
    delegate Grundumfang_XIX_Klima.RP_IF_PTC_HW_XIX_Grundumfang_XIX_Klima <-> outer port RP_IF_PTC_HW_XIX_Klima
    delegate Grundumfang_XIX_Klima.RP_IF_PTC_I_ist_XIX_Grundumfang_XIX_Klima <-> outer port RP_IF_PTC_I_ist_XIX_Klima
    delegate Grundumfang_XIX_Klima.RP_IF_PTC_P_ist_XIX_Grundumfang_XIX_Klima <-> outer port RP_IF_PTC_P_ist_XIX_Klima
    delegate Grundumfang_XIX_Klima.RP_IF_PTC_ResponseError_XIX_Grundumfang_XIX_Klima <-> outer port RP_IF_PTC_ResponseError_XIX_Klima
    delegate Grundumfang_XIX_Klima.RP_IF_PTC_Status_PTC_XIX_Grundumfang_XIX_Klima <-> outer port RP_IF_PTC_Status_PTC_XIX_Klima
    delegate Grundumfang_XIX_Klima.RP_IF_PTC_Status_UBatt_XIX_Grundumfang_XIX_Klima <-> outer port RP_IF_PTC_Status_UBatt_XIX_Klima
    delegate Grundumfang_XIX_Klima.RP_IF_PTC_Status_XIX_Grundumfang_XIX_Klima <-> outer port RP_IF_PTC_Status_XIX_Klima
    delegate Grundumfang_XIX_Klima.RP_IF_PTC_SW_XIX_Grundumfang_XIX_Klima <-> outer port RP_IF_PTC_SW_XIX_Klima
    delegate Grundumfang_XIX_Klima.RP_IF_PTC_Temp_PCB_XIX_Grundumfang_XIX_Klima <-> outer port RP_IF_PTC_Temp_PCB_XIX_Klima
    delegate Grundumfang_XIX_Klima.RP_IF_PTC_TimeOut_Fehler_XIX_Grundumfang_XIX_Klima <-> outer port RP_IF_PTC_TimeOut_Fehler_XIX_Klima
    delegate Grundumfang_XIX_Klima.RP_IF_PTC_UBatt_XIX_Grundumfang_XIX_Klima <-> outer port RP_IF_PTC_UBatt_XIX_Klima
    delegate Grundumfang_XIX_Klima.RP_IF_RS_defekt_XIX_Grundumfang_XIX_Klima <-> outer port RP_IF_RS_defekt_XIX_Klima
    delegate Grundumfang_XIX_Klima.RP_IF_RS_Regenmenge_XIX_Grundumfang_XIX_Klima <-> outer port RP_IF_RS_Regenmenge_XIX_Klima
    delegate Grundumfang_XIX_Klima.RP_IF_RS_Wischergeschwindigkeit_XIX_Grundumfang_XIX_Klima <-> outer port RP_IF_RS_Wischergeschwindigkeit_XIX_Klima
    delegate Grundumfang_XIX_Klima.RP_IF_SI_BUS_04_XIX_Grundumfang_XIX_Klima <-> outer port RP_IF_SI_BUS_04_XIX_Klima  # _XIX_SC_738_ClassicAUTOSARBasicSoftwareICAS1Gateway_XIX_Softwareblock_XIX_ICAS1_X_Gateway_XIX_Grundumfang_XIX_Klima_XIX_SI_BUS_04
    delegate Grundumfang_XIX_Klima.RP_IF_SI_CAB_V15_XIX_Grundumfang_XIX_Klima <-> outer port RP_IF_SI_CAB_V15_XIX_Klima  # _XIX_SC_738_ClassicAUTOSARBasicSoftwareICAS1Gateway_XIX_Softwareblock_XIX_ICAS1_X_Gateway_XIX_Grundumfang_XIX_Klima_XIX_SI_CAB_V15
    delegate Grundumfang_XIX_Klima.RP_IF_SI_NWDF_gueltig_XIX_Grundumfang_XIX_Klima <-> outer port RP_IF_SI_NWDF_gueltig_XIX_Klima  # _XIX_SC_738_ClassicAUTOSARBasicSoftwareICAS1Gateway_XIX_Softwareblock_XIX_ICAS1_X_Gateway_XIX_Grundumfang_XIX_Klima_XIX_SI_NWDF_gueltig
    delegate Grundumfang_XIX_Klima.RP_IF_SI_NWDF_XIX_Grundumfang_XIX_Klima <-> outer port RP_IF_SI_NWDF_XIX_Klima
    delegate Grundumfang_XIX_Klima.RP_IF_SI_P_Mode_gueltig_XIX_Grundumfang_XIX_Klima <-> outer port RP_IF_SI_P_Mode_gueltig_XIX_Klima  # _XIX_SC_738_ClassicAUTOSARBasicSoftwareICAS1Gateway_XIX_Softwareblock_XIX_ICAS1_X_Gateway_XIX_Grundumfang_XIX_Klima_XIX_SI_P_Mode_gueltig
    delegate Grundumfang_XIX_Klima.RP_IF_SI_P_Mode_XIX_Grundumfang_XIX_Klima <-> outer port RP_IF_SI_P_Mode_XIX_Klima  # _XIX_SC_738_ClassicAUTOSARBasicSoftwareICAS1Gateway_XIX_Softwareblock_XIX_ICAS1_X_Gateway_XIX_Grundumfang_XIX_Klima_XIX_SI_P_Mode
    delegate Grundumfang_XIX_Klima.RP_IF_SI_QRS_Mode_XIX_Grundumfang_XIX_Klima <-> outer port RP_IF_SI_QRS_Mode_XIX_Klima
    delegate Grundumfang_XIX_Klima.RP_IF_SI_T_Mode_XIX_Grundumfang_XIX_Klima <-> outer port RP_IF_SI_T_Mode_XIX_Klima
    delegate Grundumfang_XIX_Klima.RP_IF_SI_T_Schutz_XIX_Grundumfang_XIX_Klima <-> outer port RP_IF_SI_T_Schutz_XIX_Klima
    delegate Grundumfang_XIX_Klima.RP_IF_SIL_Stufe_LED_li_XIX_Grundumfang_XIX_Klima <-> outer port RP_IF_SIL_Stufe_LED_li_XIX_Klima
    delegate Grundumfang_XIX_Klima.RP_IF_SIL_Stufe_LED_re_XIX_Grundumfang_XIX_Klima <-> outer port RP_IF_SIL_Stufe_LED_re_XIX_Klima
    delegate Grundumfang_XIX_Klima.RP_IF_SMod_SIH_Stufe_hl_XIX_Grundumfang_XIX_Klima <-> outer port RP_IF_SMod_SIH_Stufe_hl_XIX_Klima
    delegate Grundumfang_XIX_Klima.RP_IF_SMod_SIH_Stufe_hr_XIX_Grundumfang_XIX_Klima <-> outer port RP_IF_SMod_SIH_Stufe_hr_XIX_Klima
    delegate Grundumfang_XIX_Klima.RP_IF_SMod_SIL_Stufe_hl_XIX_Grundumfang_XIX_Klima <-> outer port RP_IF_SMod_SIL_Stufe_hl_XIX_Klima
    delegate Grundumfang_XIX_Klima.RP_IF_SMod_SIL_Stufe_hr_XIX_Grundumfang_XIX_Klima <-> outer port RP_IF_SMod_SIL_Stufe_hr_XIX_Klima
    delegate Grundumfang_XIX_Klima.RP_IF_SMod_SRH_Fehler_XIX_Grundumfang_XIX_Klima <-> outer port RP_IF_SMod_SRH_Fehler_XIX_Klima
    delegate Grundumfang_XIX_Klima.RP_IF_SMod_SRH_ResponseError_XIX_Grundumfang_XIX_Klima <-> outer port RP_IF_SMod_SRH_ResponseError_XIX_Klima
    delegate Grundumfang_XIX_Klima.RP_IF_SOK_FoD_Klima_Resp_Challenge_XIX_Grundumfang_XIX_Klima <-> outer port RP_IF_SOK_FoD_Klima_Resp_Challenge_XIX_Klima
    delegate Grundumfang_XIX_Klima.RP_IF_SoSe_SunInt_2D_Li_XIX_Grundumfang_XIX_Klima <-> outer port RP_IF_SoSe_SunInt_2D_Li_XIX_Klima
    delegate Grundumfang_XIX_Klima.RP_IF_SoSe_SunInt_2D_Re_XIX_Grundumfang_XIX_Klima <-> outer port RP_IF_SoSe_SunInt_2D_Re_XIX_Klima
    delegate Grundumfang_XIX_Klima.RP_IF_ST_VLD_BLW_CTRL_1_LIN_XIX_Grundumfang_XIX_Klima <-> outer port RP_IF_ST_VLD_BLW_CTRL_1_LIN_XIX_Klima
    delegate Grundumfang_XIX_Klima.RP_IF_ST_VLD_BLWb_CTRL_1_LIN_XIX_Grundumfang_XIX_Klima <-> outer port RP_IF_ST_VLD_BLWb_CTRL_1_LIN_XIX_Klima
    delegate Grundumfang_XIX_Klima.RP_IF_ST_VLD_BLWc_CTRL_1_LIN_XIX_Grundumfang_XIX_Klima <-> outer port RP_IF_ST_VLD_BLWc_CTRL_1_LIN_XIX_Klima
    delegate Grundumfang_XIX_Klima.RP_IF_STK_AirCLeaner_Anf_XIX_Grundumfang_XIX_Klima <-> outer port RP_IF_STK_AirCLeaner_Anf_XIX_Klima
    delegate Grundumfang_XIX_Klima.RP_IF_STK_Anf_AussenspiegelHZ_XIX_Grundumfang_XIX_Klima <-> outer port RP_IF_STK_Anf_AussenspiegelHZ_XIX_Klima
    delegate Grundumfang_XIX_Klima.RP_IF_STK_Berechnungsphase_XIX_Grundumfang_XIX_Klima <-> outer port RP_IF_STK_Berechnungsphase_XIX_Klima
    delegate Grundumfang_XIX_Klima.RP_IF_STK_Betriebsdauer_XIX_Grundumfang_XIX_Klima <-> outer port RP_IF_STK_Betriebsdauer_XIX_Klima
    delegate Grundumfang_XIX_Klima.RP_IF_STK_ErwVK_Anf_XIX_Grundumfang_XIX_Klima <-> outer port RP_IF_STK_ErwVK_Anf_XIX_Klima
    delegate Grundumfang_XIX_Klima.RP_IF_STK_ErwVK_Beifahrerzone_XIX_Grundumfang_XIX_Klima <-> outer port RP_IF_STK_ErwVK_Beifahrerzone_XIX_Klima
    delegate Grundumfang_XIX_Klima.RP_IF_STK_ErwVK_Fahrerzone_XIX_Grundumfang_XIX_Klima <-> outer port RP_IF_STK_ErwVK_Fahrerzone_XIX_Klima
    delegate Grundumfang_XIX_Klima.RP_IF_STK_ErwVK_Heckzone_links_XIX_Grundumfang_XIX_Klima <-> outer port RP_IF_STK_ErwVK_Heckzone_links_XIX_Klima
    delegate Grundumfang_XIX_Klima.RP_IF_STK_ErwVK_Heckzone_rechts_XIX_Grundumfang_XIX_Klima <-> outer port RP_IF_STK_ErwVK_Heckzone_rechts_XIX_Klima
    delegate Grundumfang_XIX_Klima.RP_IF_STK_ErwVK_Modus_XIX_Grundumfang_XIX_Klima <-> outer port RP_IF_STK_ErwVK_Modus_XIX_Klima
    delegate Grundumfang_XIX_Klima.RP_IF_STK_ErwVK_Scheibenheizung_XIX_Grundumfang_XIX_Klima <-> outer port RP_IF_STK_ErwVK_Scheibenheizung_XIX_Klima
    delegate Grundumfang_XIX_Klima.RP_IF_STK_FSH_Anf_XIX_Grundumfang_XIX_Klima <-> outer port RP_IF_STK_FSH_Anf_XIX_Klima
    delegate Grundumfang_XIX_Klima.RP_IF_STK_HSH_Anf_XIX_Grundumfang_XIX_Klima <-> outer port RP_IF_STK_HSH_Anf_XIX_Klima
    delegate Grundumfang_XIX_Klima.RP_IF_STK_Klima_Temp_XIX_Grundumfang_XIX_Klima <-> outer port RP_IF_STK_Klima_Temp_XIX_Klima
    delegate Grundumfang_XIX_Klima.RP_IF_STK_KurzVK_Anf_XIX_Grundumfang_XIX_Klima <-> outer port RP_IF_STK_KurzVK_Anf_XIX_Klima
    delegate KlimaStandklimatisierung_Klima_C_XIX_Standklima_XIX_Klima.RP_IF_STK_Sofortstart_Sperre_FFB_XIX_KlimaStandklimatisierung_Klima_C_XIX_Standklima_XIX_Klima <-> outer port RP_IF_STK_Sofortstart_Sperre_FFB_XIX_Klima  # _XIX_SC_1491_STK_XIX_Softwareblock_XIX_ICAS1_X_SWCL_Embedded_XIX_KlimaStandklimatisierung_Klima_C_XIX_Standklima_XIX_Klima_XIX_STK_Sofortstart_Sperre_FFB
    delegate Grundumfang_XIX_Klima.RP_IF_STK_Standklima_Anf_XIX_Grundumfang_XIX_Klima <-> outer port RP_IF_STK_Standklima_Anf_XIX_Klima
    delegate Grundumfang_XIX_Klima.RP_IF_STK_Standklima_Timer_Status_XIX_Grundumfang_XIX_Klima <-> outer port RP_IF_STK_Standklima_Timer_Status_XIX_Klima
    delegate Grundumfang_XIX_Klima.RP_IF_STK_VK_Modus_XIX_Grundumfang_XIX_Klima <-> outer port RP_IF_STK_VK_Modus_XIX_Klima
    delegate Grundumfang_XIX_Klima.RP_IF_TSK_QBit_Steigung_XIX_Grundumfang_XIX_Klima <-> outer port RP_IF_TSK_QBit_Steigung_XIX_Klima
    delegate Grundumfang_XIX_Klima.RP_IF_TSK_Steigung_02_XIX_Grundumfang_XIX_Klima <-> outer port RP_IF_TSK_Steigung_02_XIX_Klima
    delegate Grundumfang_XIX_Klima.RP_IF_UH_Jahr_XIX_Grundumfang_XIX_Klima <-> outer port RP_IF_UH_Jahr_XIX_Klima
    delegate Grundumfang_XIX_Klima.RP_IF_UH_Minute_XIX_Grundumfang_XIX_Klima <-> outer port RP_IF_UH_Minute_XIX_Klima
    delegate Grundumfang_XIX_Klima.RP_IF_UH_Monat_XIX_Grundumfang_XIX_Klima <-> outer port RP_IF_UH_Monat_XIX_Klima
    delegate Grundumfang_XIX_Klima.RP_IF_UH_Sekunde_XIX_Grundumfang_XIX_Klima <-> outer port RP_IF_UH_Sekunde_XIX_Klima
    delegate Grundumfang_XIX_Klima.RP_IF_UH_Stunde_XIX_Grundumfang_XIX_Klima <-> outer port RP_IF_UH_Stunde_XIX_Klima
    delegate Grundumfang_XIX_Klima.RP_IF_UH_Tag_XIX_Grundumfang_XIX_Klima <-> outer port RP_IF_UH_Tag_XIX_Klima
    delegate Grundumfang_XIX_Klima.RP_IF_UIF_Itos_roh_XIX_Grundumfang_XIX_Klima <-> outer port RP_IF_UIF_Itos_roh_XIX_Klima
    delegate Grundumfang_XIX_Klima.RP_IF_UIF_Ref_roh_XIX_Grundumfang_XIX_Klima <-> outer port RP_IF_UIF_Ref_roh_XIX_Klima
    delegate Grundumfang_XIX_Klima.RP_IF_UIF_ResponseError_XIX_Grundumfang_XIX_Klima <-> outer port RP_IF_UIF_ResponseError_XIX_Klima
    delegate Grundumfang_XIX_Klima.RP_IF_UIF_Status_XIX_Grundumfang_XIX_Klima <-> outer port RP_IF_UIF_Status_XIX_Klima
    delegate Grundumfang_XIX_Klima.RP_IF_UIF_Sun_roh_XIX_Grundumfang_XIX_Klima <-> outer port RP_IF_UIF_Sun_roh_XIX_Klima
    delegate Grundumfang_XIX_Klima.RP_IF_UIF_SunInt_XIX_Grundumfang_XIX_Klima <-> outer port RP_IF_UIF_SunInt_XIX_Klima
    delegate Grundumfang_XIX_Klima.RP_IF_UIF_Temp_OutOfRange_XIX_Grundumfang_XIX_Klima <-> outer port RP_IF_UIF_Temp_OutOfRange_XIX_Klima
    delegate Grundumfang_XIX_Klima.RP_IF_UIF_Temperatur_XIX_Grundumfang_XIX_Klima <-> outer port RP_IF_UIF_Temperatur_XIX_Klima
    delegate Grundumfang_XIX_Klima.RP_IF_Vehicle_Driving_Cycle_XIX_Grundumfang_XIX_Klima <-> outer port RP_IF_Vehicle_Driving_Cycle_XIX_Klima  # _XIX_SC_738_ClassicAUTOSARBasicSoftwareICAS1Gateway_XIX_Softwareblock_XIX_ICAS1_X_Gateway_XIX_Grundumfang_XIX_Klima_XIX_Vehicle_Driving_Cycle
    delegate VKMS_XIX_Klima.RP_IF_VIN_01_MUX_XIX_VKMS_XIX_Klima <-> outer port RP_IF_VIN_01_MUX_XIX_Klima
    delegate VKMS_XIX_Klima.RP_IF_VIN_{10..17}_XIX_VKMS_XIX_Klima <-> outer port RP_IF_VIN_{10..17}_XIX_Klima
    delegate VKMS_XIX_Klima.RP_IF_VIN_{1..9}_XIX_VKMS_XIX_Klima <-> outer port RP_IF_VIN_{1..9}_XIX_Klima
    delegate Grundumfang_XIX_Klima.RP_IF_Waschen_vorne_aktiv_XIX_Grundumfang_XIX_Klima <-> outer port RP_IF_Waschen_vorne_aktiv_XIX_Klima
    delegate Grundumfang_XIX_Klima.RP_IF_Wischer1_Wischgeschwindigkeit_XIX_Grundumfang_XIX_Klima <-> outer port RP_IF_Wischer1_Wischgeschwindigkeit_XIX_Klima
    delegate Grundumfang_XIX_Klima.RP_IF_Wischer_vorne_aktiv_XIX_Grundumfang_XIX_Klima <-> outer port RP_IF_Wischer_vorne_aktiv_XIX_Klima
    delegate Grundumfang_XIX_Klima.RP_IF_Wischer_vorne_defekt_XIX_Grundumfang_XIX_Klima <-> outer port RP_IF_Wischer_vorne_defekt_XIX_Klima
    delegate Grundumfang_XIX_Klima.RP_IF_ZAS_Kl_15_XIX_Grundumfang_XIX_Klima <-> outer port RP_IF_ZAS_Kl_15_XIX_Klima
    delegate Grundumfang_XIX_Klima.RP_IF_ZAS_Kl_S_XIX_Grundumfang_XIX_Klima <-> outer port RP_IF_ZAS_Kl_S_XIX_Klima
    delegate Grundumfang_XIX_Klima.RP_IF_ZM_Standzeit_XIX_Grundumfang_XIX_Klima <-> outer port RP_IF_ZM_Standzeit_XIX_Klima
    delegate Grundumfang_XIX_Klima.RP_IF_ZV_BT_offen_XIX_Grundumfang_XIX_Klima <-> outer port RP_IF_ZV_BT_offen_XIX_Klima
    delegate Grundumfang_XIX_Klima.RP_IF_ZV_FT_offen_XIX_Grundumfang_XIX_Klima <-> outer port RP_IF_ZV_FT_offen_XIX_Klima
    delegate Grundumfang_XIX_Klima.RP_IF_ZV_gesafet_extern_ist_XIX_Grundumfang_XIX_Klima <-> outer port RP_IF_ZV_gesafet_extern_ist_XIX_Klima
    delegate Grundumfang_XIX_Klima.RP_IF_ZV_HBFS_offen_XIX_Grundumfang_XIX_Klima <-> outer port RP_IF_ZV_HBFS_offen_XIX_Klima
    delegate Grundumfang_XIX_Klima.RP_IF_ZV_HD_offen_XIX_Grundumfang_XIX_Klima <-> outer port RP_IF_ZV_HD_offen_XIX_Klima
    delegate Grundumfang_XIX_Klima.RP_IF_ZV_HFS_offen_XIX_Grundumfang_XIX_Klima <-> outer port RP_IF_ZV_HFS_offen_XIX_Klima
    delegate Grundumfang_XIX_Klima.RP_IF_ZV_Schluessel_Zugang_XIX_Grundumfang_XIX_Klima <-> outer port RP_IF_ZV_Schluessel_Zugang_XIX_Klima
    delegate Grundumfang_XIX_Klima.RP_IF_ZV_verriegelt_extern_ist_XIX_Grundumfang_XIX_Klima <-> outer port RP_IF_ZV_verriegelt_extern_ist_XIX_Klima
    delegate Grundumfang_XIX_Klima.RP_IF_ZV_verriegelt_extern_soll_XIX_Grundumfang_XIX_Klima <-> outer port RP_IF_ZV_verriegelt_extern_soll_XIX_Klima
    delegate Grundumfang_XIX_Klima.RP_IF_ZV_verriegelt_intern_ist_XIX_Grundumfang_XIX_Klima <-> outer port RP_IF_ZV_verriegelt_intern_ist_XIX_Klima
    delegate Grundumfang_XIX_Klima.RP_IF_ZV_verriegelt_intern_soll_XIX_Grundumfang_XIX_Klima <-> outer port RP_IF_ZV_verriegelt_intern_soll_XIX_Klima
    delegate Grundumfang_XIX_Klima.SP_IF_Adresse_ION_XIX_Grundumfang_XIX_Klima <-> outer port SP_IF_Adresse_ION_XIX_Klima
    delegate Grundumfang_XIX_Klima.SP_IF_Adresse_PCU_XIX_Grundumfang_XIX_Klima <-> outer port SP_IF_Adresse_PCU_XIX_Klima
    delegate Grundumfang_XIX_Klima.SP_IF_Adressegment_ION_XIX_Grundumfang_XIX_Klima <-> outer port SP_IF_Adressegment_ION_XIX_Klima
    delegate Grundumfang_XIX_Klima.SP_IF_Anlernen_LLR_li_XIX_Grundumfang_XIX_Klima <-> outer port SP_IF_Anlernen_LLR_li_XIX_Klima
    delegate Grundumfang_XIX_Klima.SP_IF_Anlernen_LLR_re_XIX_Grundumfang_XIX_Klima <-> outer port SP_IF_Anlernen_LLR_re_XIX_Klima
    delegate Grundumfang_XIX_Klima.SP_IF_AQS_Sensorheizung_XIX_Grundumfang_XIX_Klima <-> outer port SP_IF_AQS_Sensorheizung_XIX_Klima
    delegate Grundumfang_XIX_Klima.SP_IF_Aussentemp_ungef_XIX_Grundumfang_XIX_Klima <-> outer port SP_IF_Aussentemp_ungef_XIX_Klima
    delegate Grundumfang_XIX_Klima.SP_IF_BCM_Remotestart_Betrieb_XIX_Grundumfang_XIX_Klima <-> outer port SP_IF_BCM_Remotestart_Betrieb_XIX_Klima
    delegate Grundumfang_XIX_Klima.SP_IF_BLOWER1_IMAX_MAX_XIX_Grundumfang_XIX_Klima <-> outer port SP_IF_BLOWER1_IMAX_MAX_XIX_Klima
    delegate Grundumfang_XIX_Klima.SP_IF_BLOWER1_IMAX_MIN_XIX_Grundumfang_XIX_Klima <-> outer port SP_IF_BLOWER1_IMAX_MIN_XIX_Klima
    delegate Grundumfang_XIX_Klima.SP_IF_BLOWER1_RAMP_XIX_Grundumfang_XIX_Klima <-> outer port SP_IF_BLOWER1_RAMP_XIX_Klima
    delegate Grundumfang_XIX_Klima.SP_IF_BLOWER1_RX_FREQUENCY_XIX_Grundumfang_XIX_Klima <-> outer port SP_IF_BLOWER1_RX_FREQUENCY_XIX_Klima
    delegate Grundumfang_XIX_Klima.SP_IF_BLOWER1_SAFETY_SPEED_XIX_Grundumfang_XIX_Klima <-> outer port SP_IF_BLOWER1_SAFETY_SPEED_XIX_Klima
    delegate Grundumfang_XIX_Klima.SP_IF_BLOWER1_SAFETYRUN_THRESHOLD_XIX_Grundumfang_XIX_Klima <-> outer port SP_IF_BLOWER1_SAFETYRUN_THRESHOLD_XIX_Klima
    delegate Grundumfang_XIX_Klima.SP_IF_BLOWER1_SELECT_XIX_Grundumfang_XIX_Klima <-> outer port SP_IF_BLOWER1_SELECT_XIX_Klima
    delegate Grundumfang_XIX_Klima.SP_IF_BLOWER1_SPEED_XIX_Grundumfang_XIX_Klima <-> outer port SP_IF_BLOWER1_SPEED_XIX_Klima
    delegate Grundumfang_XIX_Klima.SP_IF_BLOWER1_U_KNEE_XIX_Grundumfang_XIX_Klima <-> outer port SP_IF_BLOWER1_U_KNEE_XIX_Klima
    delegate Grundumfang_XIX_Klima.SP_IF_BLOWER1b_IMAX_MAX_XIX_Grundumfang_XIX_Klima <-> outer port SP_IF_BLOWER1b_IMAX_MAX_XIX_Klima
    delegate Grundumfang_XIX_Klima.SP_IF_BLOWER1b_IMAX_MIN_XIX_Grundumfang_XIX_Klima <-> outer port SP_IF_BLOWER1b_IMAX_MIN_XIX_Klima
    delegate Grundumfang_XIX_Klima.SP_IF_BLOWER1b_RAMP_XIX_Grundumfang_XIX_Klima <-> outer port SP_IF_BLOWER1b_RAMP_XIX_Klima
    delegate Grundumfang_XIX_Klima.SP_IF_BLOWER1b_RX_FREQUENCY_XIX_Grundumfang_XIX_Klima <-> outer port SP_IF_BLOWER1b_RX_FREQUENCY_XIX_Klima
    delegate Grundumfang_XIX_Klima.SP_IF_BLOWER1b_SAFETY_SPEED_XIX_Grundumfang_XIX_Klima <-> outer port SP_IF_BLOWER1b_SAFETY_SPEED_XIX_Klima
    delegate Grundumfang_XIX_Klima.SP_IF_BLOWER1b_SAFETYRUN_THRESHOLD_XIX_Grundumfang_XIX_Klima <-> outer port SP_IF_BLOWER1b_SAFETYRUN_THRESHOLD_XIX_Klima
    delegate Grundumfang_XIX_Klima.SP_IF_BLOWER1b_SELECT_XIX_Grundumfang_XIX_Klima <-> outer port SP_IF_BLOWER1b_SELECT_XIX_Klima
    delegate Grundumfang_XIX_Klima.SP_IF_BLOWER1b_SPEED_XIX_Grundumfang_XIX_Klima <-> outer port SP_IF_BLOWER1b_SPEED_XIX_Klima
    delegate Grundumfang_XIX_Klima.SP_IF_BLOWER1b_U_KNEE_XIX_Grundumfang_XIX_Klima <-> outer port SP_IF_BLOWER1b_U_KNEE_XIX_Klima
    delegate Grundumfang_XIX_Klima.SP_IF_BLOWER1c_IMAX_MAX_XIX_Grundumfang_XIX_Klima <-> outer port SP_IF_BLOWER1c_IMAX_MAX_XIX_Klima
    delegate Grundumfang_XIX_Klima.SP_IF_BLOWER1c_IMAX_MIN_XIX_Grundumfang_XIX_Klima <-> outer port SP_IF_BLOWER1c_IMAX_MIN_XIX_Klima
    delegate Grundumfang_XIX_Klima.SP_IF_BLOWER1c_RAMP_XIX_Grundumfang_XIX_Klima <-> outer port SP_IF_BLOWER1c_RAMP_XIX_Klima
    delegate Grundumfang_XIX_Klima.SP_IF_BLOWER1c_RX_FREQUENCY_XIX_Grundumfang_XIX_Klima <-> outer port SP_IF_BLOWER1c_RX_FREQUENCY_XIX_Klima
    delegate Grundumfang_XIX_Klima.SP_IF_BLOWER1c_SAFETY_SPEED_XIX_Grundumfang_XIX_Klima <-> outer port SP_IF_BLOWER1c_SAFETY_SPEED_XIX_Klima
    delegate Grundumfang_XIX_Klima.SP_IF_BLOWER1c_SAFETYRUN_THRESHOLD_XIX_Grundumfang_XIX_Klima <-> outer port SP_IF_BLOWER1c_SAFETYRUN_THRESHOLD_XIX_Klima
    delegate Grundumfang_XIX_Klima.SP_IF_BLOWER1c_SELECT_XIX_Grundumfang_XIX_Klima <-> outer port SP_IF_BLOWER1c_SELECT_XIX_Klima
    delegate Grundumfang_XIX_Klima.SP_IF_BLOWER1c_SPEED_XIX_Grundumfang_XIX_Klima <-> outer port SP_IF_BLOWER1c_SPEED_XIX_Klima
    delegate Grundumfang_XIX_Klima.SP_IF_BLOWER1c_U_KNEE_XIX_Grundumfang_XIX_Klima <-> outer port SP_IF_BLOWER1c_U_KNEE_XIX_Klima
    delegate Grundumfang_XIX_Klima.SP_IF_BLOWER2be_IMAX_MAX_XIX_Grundumfang_XIX_Klima <-> outer port SP_IF_BLOWER2be_IMAX_MAX_XIX_Klima
    delegate Grundumfang_XIX_Klima.SP_IF_BLOWER2be_IMAX_MIN_XIX_Grundumfang_XIX_Klima <-> outer port SP_IF_BLOWER2be_IMAX_MIN_XIX_Klima
    delegate Grundumfang_XIX_Klima.SP_IF_BLOWER2be_RAMP_XIX_Grundumfang_XIX_Klima <-> outer port SP_IF_BLOWER2be_RAMP_XIX_Klima
    delegate Grundumfang_XIX_Klima.SP_IF_BLOWER2be_RX_FREQUENCY_XIX_Grundumfang_XIX_Klima <-> outer port SP_IF_BLOWER2be_RX_FREQUENCY_XIX_Klima
    delegate Grundumfang_XIX_Klima.SP_IF_BLOWER2be_SAFETY_SPEED_XIX_Grundumfang_XIX_Klima <-> outer port SP_IF_BLOWER2be_SAFETY_SPEED_XIX_Klima
    delegate Grundumfang_XIX_Klima.SP_IF_BLOWER2be_SAFETYRUN_THRESHOLD_XIX_Grundumfang_XIX_Klima <-> outer port SP_IF_BLOWER2be_SAFETYRUN_THRESHOLD_XIX_Klima
    delegate Grundumfang_XIX_Klima.SP_IF_BLOWER2be_SELECT_XIX_Grundumfang_XIX_Klima <-> outer port SP_IF_BLOWER2be_SELECT_XIX_Klima
    delegate Grundumfang_XIX_Klima.SP_IF_BLOWER2be_SPEED_XIX_Grundumfang_XIX_Klima <-> outer port SP_IF_BLOWER2be_SPEED_XIX_Klima
    delegate Grundumfang_XIX_Klima.SP_IF_BLOWER2be_U_KNEE_XIX_Grundumfang_XIX_Klima <-> outer port SP_IF_BLOWER2be_U_KNEE_XIX_Klima
    delegate Grundumfang_XIX_Klima.SP_IF_BLOWER2e_IMAX_MAX_XIX_Grundumfang_XIX_Klima <-> outer port SP_IF_BLOWER2e_IMAX_MAX_XIX_Klima
    delegate Grundumfang_XIX_Klima.SP_IF_BLOWER2e_IMAX_MIN_XIX_Grundumfang_XIX_Klima <-> outer port SP_IF_BLOWER2e_IMAX_MIN_XIX_Klima
    delegate Grundumfang_XIX_Klima.SP_IF_BLOWER2e_RAMP_XIX_Grundumfang_XIX_Klima <-> outer port SP_IF_BLOWER2e_RAMP_XIX_Klima
    delegate Grundumfang_XIX_Klima.SP_IF_BLOWER2e_RX_FREQUENCY_XIX_Grundumfang_XIX_Klima <-> outer port SP_IF_BLOWER2e_RX_FREQUENCY_XIX_Klima
    delegate Grundumfang_XIX_Klima.SP_IF_BLOWER2e_SAFETY_SPEED_XIX_Grundumfang_XIX_Klima <-> outer port SP_IF_BLOWER2e_SAFETY_SPEED_XIX_Klima
    delegate Grundumfang_XIX_Klima.SP_IF_BLOWER2e_SAFETYRUN_THRESHOLD_XIX_Grundumfang_XIX_Klima <-> outer port SP_IF_BLOWER2e_SAFETYRUN_THRESHOLD_XIX_Klima
    delegate Grundumfang_XIX_Klima.SP_IF_BLOWER2e_SELECT_XIX_Grundumfang_XIX_Klima <-> outer port SP_IF_BLOWER2e_SELECT_XIX_Klima
    delegate Grundumfang_XIX_Klima.SP_IF_BLOWER2e_SPEED_XIX_Grundumfang_XIX_Klima <-> outer port SP_IF_BLOWER2e_SPEED_XIX_Klima
    delegate Grundumfang_XIX_Klima.SP_IF_BLOWER2e_U_KNEE_XIX_Grundumfang_XIX_Klima <-> outer port SP_IF_BLOWER2e_U_KNEE_XIX_Klima
    delegate Grundumfang_XIX_Klima.SP_IF_BT_FH_Oeffnung_4Bit_XIX_Grundumfang_XIX_Klima <-> outer port SP_IF_BT_FH_Oeffnung_4Bit_XIX_Klima
    delegate Grundumfang_XIX_Klima.SP_IF_DI_KL_58xd_XIX_Grundumfang_XIX_Klima <-> outer port SP_IF_DI_KL_58xd_XIX_Klima
    delegate Grundumfang_XIX_Klima.SP_IF_DI_KL_58xs_XIX_Grundumfang_XIX_Klima <-> outer port SP_IF_DI_KL_58xs_XIX_Klima
    delegate Grundumfang_XIX_Klima.SP_IF_DS_Kaeltemittel_P_WP_XIX_Grundumfang_XIX_Klima <-> outer port SP_IF_DS_Kaeltemittel_P_WP_XIX_Klima
    delegate Grundumfang_XIX_Klima.SP_IF_EKK_Active_Discharge_XIX_Grundumfang_XIX_Klima <-> outer port SP_IF_EKK_Active_Discharge_XIX_Klima
    delegate Grundumfang_XIX_Klima.SP_IF_EKK_ENB_COMP_XIX_Grundumfang_XIX_Klima <-> outer port SP_IF_EKK_ENB_COMP_XIX_Klima
    delegate Grundumfang_XIX_Klima.SP_IF_EKK_HV_ST_XIX_Grundumfang_XIX_Klima <-> outer port SP_IF_EKK_HV_ST_XIX_Klima
    delegate Grundumfang_XIX_Klima.SP_IF_EKK_KL_15_Status_XIX_Grundumfang_XIX_Klima <-> outer port SP_IF_EKK_KL_15_Status_XIX_Klima
    delegate Grundumfang_XIX_Klima.SP_IF_EKK_REQ_COMP_SPEED_HiRes_XIX_Grundumfang_XIX_Klima <-> outer port SP_IF_EKK_REQ_COMP_SPEED_HiRes_XIX_Klima
    delegate Grundumfang_XIX_Klima.SP_IF_EKK_REQ_COMP_SPEED_XIX_Grundumfang_XIX_Klima <-> outer port SP_IF_EKK_REQ_COMP_SPEED_XIX_Klima
    delegate Grundumfang_XIX_Klima.SP_IF_EKKe_Error_Mask_Nr_XIX_Grundumfang_XIX_Klima <-> outer port SP_IF_EKKe_Error_Mask_Nr_XIX_Klima
    delegate Grundumfang_XIX_Klima.SP_IF_EKKe_Level_REQ_XIX_Grundumfang_XIX_Klima <-> outer port SP_IF_EKKe_Level_REQ_XIX_Klima
    delegate Grundumfang_XIX_Klima.SP_IF_EKKe_Q_Mask_XIX_Grundumfang_XIX_Klima <-> outer port SP_IF_EKKe_Q_Mask_XIX_Klima
    delegate Grundumfang_XIX_Klima.SP_IF_Empfindlichkeit_AQS_XIX_Grundumfang_XIX_Klima <-> outer port SP_IF_Empfindlichkeit_AQS_XIX_Klima
    delegate Grundumfang_XIX_Klima.SP_IF_ESP_v_Signal_8Bit_XIX_Grundumfang_XIX_Klima <-> outer port SP_IF_ESP_v_Signal_8Bit_XIX_Klima
    delegate Grundumfang_XIX_Klima.SP_IF_FCM_01_alt_XIX_Grundumfang_XIX_Klima <-> outer port SP_IF_FCM_01_alt_XIX_Klima
    delegate Grundumfang_XIX_Klima.SP_IF_FRS_ChannelSelect_XIX_Grundumfang_XIX_Klima <-> outer port SP_IF_FRS_ChannelSelect_XIX_Klima
    delegate Grundumfang_XIX_Klima.SP_IF_FRS_IntensityReq_XIX_Grundumfang_XIX_Klima <-> outer port SP_IF_FRS_IntensityReq_XIX_Klima
    delegate Grundumfang_XIX_Klima.SP_IF_FRS_Status_Car_XIX_Grundumfang_XIX_Klima <-> outer port SP_IF_FRS_Status_Car_XIX_Klima
    delegate Grundumfang_XIX_Klima.SP_IF_FSA_Luftfeuchte_rel_XIX_Grundumfang_XIX_Klima <-> outer port SP_IF_FSA_Luftfeuchte_rel_XIX_Klima
    delegate Grundumfang_XIX_Klima.SP_IF_FSA_Taupunkt_PMS_XIX_Grundumfang_XIX_Klima <-> outer port SP_IF_FSA_Taupunkt_PMS_XIX_Klima
    delegate Grundumfang_XIX_Klima.SP_IF_FSH_Status_XIX_Grundumfang_XIX_Klima <-> outer port SP_IF_FSH_Status_XIX_Klima
    delegate Grundumfang_XIX_Klima.SP_IF_FSH_Taster_XIX_Grundumfang_XIX_Klima <-> outer port SP_IF_FSH_Taster_XIX_Klima
    delegate Grundumfang_XIX_Klima.SP_IF_FT_FH_Oeffnung_4Bit_XIX_Grundumfang_XIX_Klima <-> outer port SP_IF_FT_FH_Oeffnung_4Bit_XIX_Klima
    delegate Grundumfang_XIX_Klima.SP_IF_Geblaesestufe_XIX_Grundumfang_XIX_Klima <-> outer port SP_IF_Geblaesestufe_XIX_Klima
    delegate Grundumfang_XIX_Klima.SP_IF_HBFS_FH_Oeffnung_4Bit_XIX_Grundumfang_XIX_Klima <-> outer port SP_IF_HBFS_FH_Oeffnung_4Bit_XIX_Klima
    delegate Grundumfang_XIX_Klima.SP_IF_HFS_FH_Oeffnung_4Bit_XIX_Grundumfang_XIX_Klima <-> outer port SP_IF_HFS_FH_Oeffnung_4Bit_XIX_Klima
    delegate Grundumfang_XIX_Klima.SP_IF_HLR_SIH_Freigabe_Fond_XIX_Grundumfang_XIX_Klima <-> outer port SP_IF_HLR_SIH_Freigabe_Fond_XIX_Klima
    delegate Grundumfang_XIX_Klima.SP_IF_HSH_Relais_Anf_XIX_Grundumfang_XIX_Klima <-> outer port SP_IF_HSH_Relais_Anf_XIX_Klima
    delegate Grundumfang_XIX_Klima.SP_IF_HSH_Taster_XIX_Grundumfang_XIX_Klima <-> outer port SP_IF_HSH_Taster_XIX_Klima
    delegate Grundumfang_XIX_Klima.SP_IF_HV_H3be_Geblaesedrehzahl_XIX_Grundumfang_XIX_Klima <-> outer port SP_IF_HV_H3be_Geblaesedrehzahl_XIX_Klima
    delegate Grundumfang_XIX_Klima.SP_IF_HV_H3be_Heizer_ein_XIX_Grundumfang_XIX_Klima <-> outer port SP_IF_HV_H3be_Heizer_ein_XIX_Klima
    delegate Grundumfang_XIX_Klima.SP_IF_HV_H3be_Heizer_links_soll_XIX_Grundumfang_XIX_Klima <-> outer port SP_IF_HV_H3be_Heizer_links_soll_XIX_Klima
    delegate Grundumfang_XIX_Klima.SP_IF_HV_H3be_Heizer_Mitte_soll_XIX_Grundumfang_XIX_Klima <-> outer port SP_IF_HV_H3be_Heizer_Mitte_soll_XIX_Klima
    delegate Grundumfang_XIX_Klima.SP_IF_HV_H3be_Heizer_rechts_soll_XIX_Grundumfang_XIX_Klima <-> outer port SP_IF_HV_H3be_Heizer_rechts_soll_XIX_Klima
    delegate Grundumfang_XIX_Klima.SP_IF_HV_H3be_Heizgaskuehler_XIX_Grundumfang_XIX_Klima <-> outer port SP_IF_HV_H3be_Heizgaskuehler_XIX_Klima
    delegate Grundumfang_XIX_Klima.SP_IF_HV_H3be_Heizsystem_XIX_Grundumfang_XIX_Klima <-> outer port SP_IF_HV_H3be_Heizsystem_XIX_Klima
    delegate Grundumfang_XIX_Klima.SP_IF_HV_H3be_PTC_Zonenanzahl_XIX_Grundumfang_XIX_Klima <-> outer port SP_IF_HV_H3be_PTC_Zonenanzahl_XIX_Klima
    delegate Grundumfang_XIX_Klima.SP_IF_HV_H3be_Tempklappenwinkel_li_XIX_Grundumfang_XIX_Klima <-> outer port SP_IF_HV_H3be_Tempklappenwinkel_li_XIX_Klima
    delegate Grundumfang_XIX_Klima.SP_IF_HV_H3be_Tempklappenwinkel_mi_XIX_Grundumfang_XIX_Klima <-> outer port SP_IF_HV_H3be_Tempklappenwinkel_mi_XIX_Klima
    delegate Grundumfang_XIX_Klima.SP_IF_HV_H3be_Tempklappenwinkel_re_XIX_Grundumfang_XIX_Klima <-> outer port SP_IF_HV_H3be_Tempklappenwinkel_re_XIX_Klima
    delegate Grundumfang_XIX_Klima.SP_IF_HV_H3be_Verdampfertemp_Delta_XIX_Grundumfang_XIX_Klima <-> outer port SP_IF_HV_H3be_Verdampfertemp_Delta_XIX_Klima
    delegate Grundumfang_XIX_Klima.SP_IF_HV_H3be_Verdampfertemp_min_XIX_Grundumfang_XIX_Klima <-> outer port SP_IF_HV_H3be_Verdampfertemp_min_XIX_Klima
    delegate Grundumfang_XIX_Klima.SP_IF_HV_H3e_Geblaesedrehzahl_XIX_Grundumfang_XIX_Klima <-> outer port SP_IF_HV_H3e_Geblaesedrehzahl_XIX_Klima
    delegate Grundumfang_XIX_Klima.SP_IF_HV_H3e_Heizer_ein_XIX_Grundumfang_XIX_Klima <-> outer port SP_IF_HV_H3e_Heizer_ein_XIX_Klima
    delegate Grundumfang_XIX_Klima.SP_IF_HV_H3e_Heizer_links_soll_XIX_Grundumfang_XIX_Klima <-> outer port SP_IF_HV_H3e_Heizer_links_soll_XIX_Klima
    delegate Grundumfang_XIX_Klima.SP_IF_HV_H3e_Heizer_Mitte_soll_XIX_Grundumfang_XIX_Klima <-> outer port SP_IF_HV_H3e_Heizer_Mitte_soll_XIX_Klima
    delegate Grundumfang_XIX_Klima.SP_IF_HV_H3e_Heizer_rechts_soll_XIX_Grundumfang_XIX_Klima <-> outer port SP_IF_HV_H3e_Heizer_rechts_soll_XIX_Klima
    delegate Grundumfang_XIX_Klima.SP_IF_HV_H3e_Heizgaskuehler_XIX_Grundumfang_XIX_Klima <-> outer port SP_IF_HV_H3e_Heizgaskuehler_XIX_Klima
    delegate Grundumfang_XIX_Klima.SP_IF_HV_H3e_Heizsystem_XIX_Grundumfang_XIX_Klima <-> outer port SP_IF_HV_H3e_Heizsystem_XIX_Klima
    delegate Grundumfang_XIX_Klima.SP_IF_HV_H3e_PTC_Zonenanzahl_XIX_Grundumfang_XIX_Klima <-> outer port SP_IF_HV_H3e_PTC_Zonenanzahl_XIX_Klima
    delegate Grundumfang_XIX_Klima.SP_IF_HV_H3e_Tempklappenwinkel_li_XIX_Grundumfang_XIX_Klima <-> outer port SP_IF_HV_H3e_Tempklappenwinkel_li_XIX_Klima
    delegate Grundumfang_XIX_Klima.SP_IF_HV_H3e_Tempklappenwinkel_mi_XIX_Grundumfang_XIX_Klima <-> outer port SP_IF_HV_H3e_Tempklappenwinkel_mi_XIX_Klima
    delegate Grundumfang_XIX_Klima.SP_IF_HV_H3e_Tempklappenwinkel_re_XIX_Grundumfang_XIX_Klima <-> outer port SP_IF_HV_H3e_Tempklappenwinkel_re_XIX_Klima
    delegate Grundumfang_XIX_Klima.SP_IF_HV_H3e_Verdampfertemp_Delta_XIX_Grundumfang_XIX_Klima <-> outer port SP_IF_HV_H3e_Verdampfertemp_Delta_XIX_Klima
    delegate Grundumfang_XIX_Klima.SP_IF_HV_H3e_Verdampfertemp_min_XIX_Grundumfang_XIX_Klima <-> outer port SP_IF_HV_H3e_Verdampfertemp_min_XIX_Klima
    delegate Grundumfang_XIX_Klima.SP_IF_ICO2_Luftdruck_2_XIX_Grundumfang_XIX_Klima <-> outer port SP_IF_ICO2_Luftdruck_2_XIX_Klima
    delegate Grundumfang_XIX_Klima.SP_IF_ICO2_Messvorgabe_XIX_Grundumfang_XIX_Klima <-> outer port SP_IF_ICO2_Messvorgabe_XIX_Klima
    delegate Grundumfang_XIX_Klima.SP_IF_ICO2_Messzyklus1_XIX_Grundumfang_XIX_Klima <-> outer port SP_IF_ICO2_Messzyklus1_XIX_Klima
    delegate Grundumfang_XIX_Klima.SP_IF_ICO2_Messzyklus2_XIX_Grundumfang_XIX_Klima <-> outer port SP_IF_ICO2_Messzyklus2_XIX_Klima
    delegate Grundumfang_XIX_Klima.SP_IF_ICO2_Status_Kabine_XIX_Grundumfang_XIX_Klima <-> outer port SP_IF_ICO2_Status_Kabine_XIX_Klima
    delegate Grundumfang_XIX_Klima.SP_IF_ICO2b_Luftdruck_2_XIX_Grundumfang_XIX_Klima <-> outer port SP_IF_ICO2b_Luftdruck_2_XIX_Klima
    delegate Grundumfang_XIX_Klima.SP_IF_ICO2b_Messvorgabe_XIX_Grundumfang_XIX_Klima <-> outer port SP_IF_ICO2b_Messvorgabe_XIX_Klima
    delegate Grundumfang_XIX_Klima.SP_IF_ICO2b_Messzyklus1_XIX_Grundumfang_XIX_Klima <-> outer port SP_IF_ICO2b_Messzyklus1_XIX_Klima
    delegate Grundumfang_XIX_Klima.SP_IF_ICO2b_Messzyklus2_XIX_Grundumfang_XIX_Klima <-> outer port SP_IF_ICO2b_Messzyklus2_XIX_Klima
    delegate Grundumfang_XIX_Klima.SP_IF_ICO2b_Status_Kabine_XIX_Grundumfang_XIX_Klima <-> outer port SP_IF_ICO2b_Status_Kabine_XIX_Klima
    delegate Grundumfang_XIX_Klima.SP_IF_ION_0e_Dummy_XIX_Grundumfang_XIX_Klima <-> outer port SP_IF_ION_0e_Dummy_XIX_Klima
    delegate Grundumfang_XIX_Klima.SP_IF_ISOALLReqB{0..7}_XIX_Grundumfang_XIX_Klima <-> outer port SP_IF_ISOALLReqB{0..7}_XIX_Klima
    delegate Grundumfang_XIX_Klima.SP_IF_KBT_CODE_VEHICLE_XIX_Grundumfang_XIX_Klima <-> outer port SP_IF_KBT_CODE_VEHICLE_XIX_Klima
    delegate Grundumfang_XIX_Klima.SP_IF_KBT_Defrost_aktiv_XIX_Grundumfang_XIX_Klima <-> outer port SP_IF_KBT_Defrost_aktiv_XIX_Klima
    delegate Grundumfang_XIX_Klima.SP_IF_KBT_RAMP_XIX_Grundumfang_XIX_Klima <-> outer port SP_IF_KBT_RAMP_XIX_Klima
    delegate Grundumfang_XIX_Klima.SP_IF_KBT_RX_FREQUENCY_XIX_Grundumfang_XIX_Klima <-> outer port SP_IF_KBT_RX_FREQUENCY_XIX_Klima
    delegate Grundumfang_XIX_Klima.SP_IF_KBT_SAFETY_SPEED_XIX_Grundumfang_XIX_Klima <-> outer port SP_IF_KBT_SAFETY_SPEED_XIX_Klima
    delegate Grundumfang_XIX_Klima.SP_IF_KBT_SPEED_XIX_Grundumfang_XIX_Klima <-> outer port SP_IF_KBT_SPEED_XIX_Klima
    delegate Grundumfang_XIX_Klima.SP_IF_KL_AC_Schalter_XIX_Grundumfang_XIX_Klima <-> outer port SP_IF_KL_AC_Schalter_XIX_Klima
    delegate Grundumfang_XIX_Klima.SP_IF_KL_ActiveDischarge_XIX_Grundumfang_XIX_Klima <-> outer port SP_IF_KL_ActiveDischarge_XIX_Klima
    delegate Grundumfang_XIX_Klima.SP_IF_KL_AirCleaner_aktiv_XIX_Grundumfang_XIX_Klima <-> outer port SP_IF_KL_AirCleaner_aktiv_XIX_Klima
    delegate Grundumfang_XIX_Klima.SP_IF_KL_Ak_Verd_hi_li_XIX_Grundumfang_XIX_Klima <-> outer port SP_IF_KL_Ak_Verd_hi_li_XIX_Klima
    delegate Grundumfang_XIX_Klima.SP_IF_KL_Ak_Verd_hi_re_XIX_Grundumfang_XIX_Klima <-> outer port SP_IF_KL_Ak_Verd_hi_re_XIX_Klima
    delegate Grundumfang_XIX_Klima.SP_IF_KL_Ak_Verd_hinten_XIX_Grundumfang_XIX_Klima <-> outer port SP_IF_KL_Ak_Verd_hinten_XIX_Klima
    delegate Grundumfang_XIX_Klima.SP_IF_KL_Ak_Verd_links_XIX_Grundumfang_XIX_Klima <-> outer port SP_IF_KL_Ak_Verd_links_XIX_Klima
    delegate Grundumfang_XIX_Klima.SP_IF_KL_Ak_Verd_rechts_XIX_Grundumfang_XIX_Klima <-> outer port SP_IF_KL_Ak_Verd_rechts_XIX_Klima
    delegate Grundumfang_XIX_Klima.SP_IF_KL_Ak_Verd_vo_li_XIX_Grundumfang_XIX_Klima <-> outer port SP_IF_KL_Ak_Verd_vo_li_XIX_Klima
    delegate Grundumfang_XIX_Klima.SP_IF_KL_Ak_Verd_vo_re_XIX_Grundumfang_XIX_Klima <-> outer port SP_IF_KL_Ak_Verd_vo_re_XIX_Klima
    delegate Grundumfang_XIX_Klima.SP_IF_KL_Ak_Verd_vorne_XIX_Grundumfang_XIX_Klima <-> outer port SP_IF_KL_Ak_Verd_vorne_XIX_Klima
    delegate Grundumfang_XIX_Klima.SP_IF_KL_AL_HL_Anf_XIX_Grundumfang_XIX_Klima <-> outer port SP_IF_KL_AL_HL_Anf_XIX_Klima
    delegate Grundumfang_XIX_Klima.SP_IF_KL_AL_HR_Anf_XIX_Grundumfang_XIX_Klima <-> outer port SP_IF_KL_AL_HR_Anf_XIX_Klima
    delegate Grundumfang_XIX_Klima.SP_IF_KL_AL_VL_Anf_XIX_Grundumfang_XIX_Klima <-> outer port SP_IF_KL_AL_VL_Anf_XIX_Klima
    delegate Grundumfang_XIX_Klima.SP_IF_KL_AL_VR_Anf_XIX_Grundumfang_XIX_Klima <-> outer port SP_IF_KL_AL_VR_Anf_XIX_Klima
    delegate Grundumfang_XIX_Klima.SP_IF_KL_Anf_AussenspiegelHzg_XIX_Grundumfang_XIX_Klima <-> outer port SP_IF_KL_Anf_AussenspiegelHzg_XIX_Klima
    delegate Grundumfang_XIX_Klima.SP_IF_KL_Anf_KL_XIX_Grundumfang_XIX_Klima <-> outer port SP_IF_KL_Anf_KL_XIX_Klima
    delegate Grundumfang_XIX_Klima.SP_IF_KL_Anf_KV_XIX_Grundumfang_XIX_Klima <-> outer port SP_IF_KL_Anf_KV_XIX_Klima
    delegate Grundumfang_XIX_Klima.SP_IF_KL_Anf_rLM_XIX_Grundumfang_XIX_Klima <-> outer port SP_IF_KL_Anf_rLM_XIX_Klima
    delegate Grundumfang_XIX_Klima.SP_IF_KL_Anz_auto_hl_XIX_Grundumfang_XIX_Klima <-> outer port SP_IF_KL_Anz_auto_hl_XIX_Klima
    delegate Grundumfang_XIX_Klima.SP_IF_KL_Anz_Geblaese_hl_XIX_Grundumfang_XIX_Klima <-> outer port SP_IF_KL_Anz_Geblaese_hl_XIX_Klima
    delegate Grundumfang_XIX_Klima.SP_IF_KL_Anz_mitte_hl_XIX_Grundumfang_XIX_Klima <-> outer port SP_IF_KL_Anz_mitte_hl_XIX_Klima
    delegate Grundumfang_XIX_Klima.SP_IF_KL_Anz_oben_hl_XIX_Grundumfang_XIX_Klima <-> outer port SP_IF_KL_Anz_oben_hl_XIX_Klima
    delegate Grundumfang_XIX_Klima.SP_IF_KL_Anz_seite_defog_hl_XIX_Grundumfang_XIX_Klima <-> outer port SP_IF_KL_Anz_seite_defog_hl_XIX_Klima
    delegate Grundumfang_XIX_Klima.SP_IF_KL_Anz_seite_hl_XIX_Grundumfang_XIX_Klima <-> outer port SP_IF_KL_Anz_seite_hl_XIX_Klima
    delegate Grundumfang_XIX_Klima.SP_IF_KL_Anz_Temp_Einheit_XIX_Grundumfang_XIX_Klima <-> outer port SP_IF_KL_Anz_Temp_Einheit_XIX_Klima
    delegate Grundumfang_XIX_Klima.SP_IF_KL_Anz_Temp_hl_XIX_Grundumfang_XIX_Klima <-> outer port SP_IF_KL_Anz_Temp_hl_XIX_Klima
    delegate Grundumfang_XIX_Klima.SP_IF_KL_Anz_Temp_hr_XIX_Grundumfang_XIX_Klima <-> outer port SP_IF_KL_Anz_Temp_hr_XIX_Klima
    delegate Grundumfang_XIX_Klima.SP_IF_KL_Anz_unten_hl_XIX_Grundumfang_XIX_Klima <-> outer port SP_IF_KL_Anz_unten_hl_XIX_Klima
    delegate Grundumfang_XIX_Klima.SP_IF_KL_AQI_Innenraum_XIX_Grundumfang_XIX_Klima <-> outer port SP_IF_KL_AQI_Innenraum_XIX_Klima
    delegate Grundumfang_XIX_Klima.SP_IF_KL_Ausstattung_Klima_XIX_Grundumfang_XIX_Klima <-> outer port SP_IF_KL_Ausstattung_Klima_XIX_Klima
    delegate Grundumfang_XIX_Klima.SP_IF_KL_Batterieheizen_Freigabe_XIX_Grundumfang_XIX_Klima <-> outer port SP_IF_KL_Batterieheizen_Freigabe_XIX_Klima
    delegate Grundumfang_XIX_Klima.SP_IF_KL_BCmE_Livetip_Freigabe_XIX_Grundumfang_XIX_Klima <-> outer port SP_IF_KL_BCmE_Livetip_Freigabe_XIX_Klima
    delegate Grundumfang_XIX_Klima.SP_IF_KL_Beschlagsgefahr_XIX_Grundumfang_XIX_Klima <-> outer port SP_IF_KL_Beschlagsgefahr_XIX_Klima
    delegate Grundumfang_XIX_Klima.SP_IF_KL_Charisma_FahrPr_XIX_Grundumfang_XIX_Klima <-> outer port SP_IF_KL_Charisma_FahrPr_XIX_Klima
    delegate Grundumfang_XIX_Klima.SP_IF_KL_Charisma_Status_XIX_Grundumfang_XIX_Klima <-> outer port SP_IF_KL_Charisma_Status_XIX_Klima
    delegate Grundumfang_XIX_Klima.SP_IF_KL_Defrost_LED_XIX_Grundumfang_XIX_Klima <-> outer port SP_IF_KL_Defrost_LED_XIX_Klima
    delegate Grundumfang_XIX_Klima.SP_IF_KL_Drehz_Anh_XIX_Grundumfang_XIX_Klima <-> outer port SP_IF_KL_Drehz_Anh_XIX_Klima
    delegate Grundumfang_XIX_Klima.SP_IF_KL_Einheiten_XIX_Grundumfang_XIX_Klima <-> outer port SP_IF_KL_Einheiten_XIX_Klima
    delegate Grundumfang_XIX_Klima.SP_IF_KL_EKK_Strom_XIX_Grundumfang_XIX_Klima <-> outer port SP_IF_KL_EKK_Strom_XIX_Klima
    delegate Grundumfang_XIX_Klima.SP_IF_KL_el_Zuheizer_Stufe_XIX_Grundumfang_XIX_Klima <-> outer port SP_IF_KL_el_Zuheizer_Stufe_XIX_Klima
    delegate Grundumfang_XIX_Klima.SP_IF_KL_Enteisung_Anf_XIX_Grundumfang_XIX_Klima <-> outer port SP_IF_KL_Enteisung_Anf_XIX_Klima
    delegate Grundumfang_XIX_Klima.SP_IF_KL_ErwVK_Anf_XIX_Grundumfang_XIX_Klima <-> outer port SP_IF_KL_ErwVK_Anf_XIX_Klima
    delegate Grundumfang_XIX_Klima.SP_IF_KL_ErwVK_Beifahrerzone_XIX_Grundumfang_XIX_Klima <-> outer port SP_IF_KL_ErwVK_Beifahrerzone_XIX_Klima
    delegate Grundumfang_XIX_Klima.SP_IF_KL_ErwVK_Fahrerzone_XIX_Grundumfang_XIX_Klima <-> outer port SP_IF_KL_ErwVK_Fahrerzone_XIX_Klima
    delegate Grundumfang_XIX_Klima.SP_IF_KL_ErwVK_Heckzone_links_XIX_Grundumfang_XIX_Klima <-> outer port SP_IF_KL_ErwVK_Heckzone_links_XIX_Klima
    delegate Grundumfang_XIX_Klima.SP_IF_Kl_ErwVK_Heckzone_rechts_XIX_Grundumfang_XIX_Klima <-> outer port SP_IF_Kl_ErwVK_Heckzone_rechts_XIX_Klima
    delegate Grundumfang_XIX_Klima.SP_IF_KL_ErwVK_Scheibenheizung_XIX_Grundumfang_XIX_Klima <-> outer port SP_IF_KL_ErwVK_Scheibenheizung_XIX_Klima
    delegate Grundumfang_XIX_Klima.SP_IF_KL_ErwVK_Status_XIX_Grundumfang_XIX_Klima <-> outer port SP_IF_KL_ErwVK_Status_XIX_Klima
    delegate Grundumfang_XIX_Klima.SP_IF_KL_eTM_SollVolumenstrom_XIX_Grundumfang_XIX_Klima <-> outer port SP_IF_KL_eTM_SollVolumenstrom_XIX_Klima
    delegate Grundumfang_XIX_Klima.SP_IF_KL_Fehler_HV_EKK_XIX_Grundumfang_XIX_Klima <-> outer port SP_IF_KL_Fehler_HV_EKK_XIX_Klima
    delegate Grundumfang_XIX_Klima.SP_IF_KL_Fehler_HV_Heizer_XIX_Grundumfang_XIX_Klima <-> outer port SP_IF_KL_Fehler_HV_Heizer_XIX_Klima
    delegate Grundumfang_XIX_Klima.SP_IF_KL_Fehler_NTKreis_XIX_Grundumfang_XIX_Klima <-> outer port SP_IF_KL_Fehler_NTKreis_XIX_Klima
    delegate Grundumfang_XIX_Klima.SP_IF_KL_Fondbedienung_aktiv_XIX_Grundumfang_XIX_Klima <-> outer port SP_IF_KL_Fondbedienung_aktiv_XIX_Klima
    delegate Grundumfang_XIX_Klima.SP_IF_KL_Freilauf_Info_XIX_Grundumfang_XIX_Klima <-> outer port SP_IF_KL_Freilauf_Info_XIX_Klima
    delegate Grundumfang_XIX_Klima.SP_IF_KL_FSH_Automatikbetrieb_XIX_Grundumfang_XIX_Klima <-> outer port SP_IF_KL_FSH_Automatikbetrieb_XIX_Klima
    delegate Grundumfang_XIX_Klima.SP_IF_KL_FSH_LED_XIX_Grundumfang_XIX_Klima <-> outer port SP_IF_KL_FSH_LED_XIX_Klima
    delegate Grundumfang_XIX_Klima.SP_IF_KL_FSH_Soll_XIX_Grundumfang_XIX_Klima <-> outer port SP_IF_KL_FSH_Soll_XIX_Klima
    delegate Grundumfang_XIX_Klima.SP_IF_KL_Geblaese_Fond_Status_XIX_Grundumfang_XIX_Klima <-> outer port SP_IF_KL_Geblaese_Fond_Status_XIX_Klima
    delegate Grundumfang_XIX_Klima.SP_IF_KL_Geblaese_Status_XIX_Grundumfang_XIX_Klima <-> outer port SP_IF_KL_Geblaese_Status_XIX_Klima
    delegate Grundumfang_XIX_Klima.SP_IF_KL_Geblspng_Fond_Soll_XIX_Grundumfang_XIX_Klima <-> outer port SP_IF_KL_Geblspng_Fond_Soll_XIX_Klima
    delegate Grundumfang_XIX_Klima.SP_IF_KL_Geblspng_Soll_XIX_Grundumfang_XIX_Klima <-> outer port SP_IF_KL_Geblspng_Soll_XIX_Klima
    delegate Grundumfang_XIX_Klima.SP_IF_KL_HBT_Geblaesestufe_anzeigen_XIX_Grundumfang_XIX_Klima <-> outer port SP_IF_KL_HBT_Geblaesestufe_anzeigen_XIX_Klima
    delegate Grundumfang_XIX_Klima.SP_IF_KL_HBT_Verbausituation_XIX_Grundumfang_XIX_Klima <-> outer port SP_IF_KL_HBT_Verbausituation_XIX_Klima
    delegate Grundumfang_XIX_Klima.SP_IF_KL_Heizbedarf_Anf_XIX_Grundumfang_XIX_Klima <-> outer port SP_IF_KL_Heizbedarf_Anf_XIX_Klima
    delegate Grundumfang_XIX_Klima.SP_IF_KL_Heizbedarf_XIX_Grundumfang_XIX_Klima <-> outer port SP_IF_KL_Heizbedarf_XIX_Klima
    delegate Grundumfang_XIX_Klima.SP_IF_KL_Heizen_Status_XIX_Grundumfang_XIX_Klima <-> outer port SP_IF_KL_Heizen_Status_XIX_Klima
    delegate Grundumfang_XIX_Klima.SP_IF_KL_Heizkreisventilstellung_XIX_Grundumfang_XIX_Klima <-> outer port SP_IF_KL_Heizkreisventilstellung_XIX_Klima
    delegate Grundumfang_XIX_Klima.SP_IF_KL_Heizstufe_LSH_XIX_Grundumfang_XIX_Klima <-> outer port SP_IF_KL_Heizstufe_LSH_XIX_Klima
    delegate Grundumfang_XIX_Klima.SP_IF_KL_HSH_LED_XIX_Grundumfang_XIX_Klima <-> outer port SP_IF_KL_HSH_LED_XIX_Klima
    delegate Grundumfang_XIX_Klima.SP_IF_KL_HSH_Soll_XIX_Grundumfang_XIX_Klima <-> outer port SP_IF_KL_HSH_Soll_XIX_Klima
    delegate Grundumfang_XIX_Klima.SP_IF_KL_HUP_aktiv_XIX_Grundumfang_XIX_Klima <-> outer port SP_IF_KL_HUP_aktiv_XIX_Klima
    delegate Grundumfang_XIX_Klima.SP_IF_KL_HV_Energie_Anf_XIX_Grundumfang_XIX_Klima <-> outer port SP_IF_KL_HV_Energie_Anf_XIX_Klima
    delegate Grundumfang_XIX_Klima.SP_IF_KL_HV_H6_aktive_Entladung_XIX_Grundumfang_XIX_Klima <-> outer port SP_IF_KL_HV_H6_aktive_Entladung_XIX_Klima
    delegate Grundumfang_XIX_Klima.SP_IF_KL_HV_H6_Durchflussrichtung_XIX_Grundumfang_XIX_Klima <-> outer port SP_IF_KL_HV_H6_Durchflussrichtung_XIX_Klima
    delegate Grundumfang_XIX_Klima.SP_IF_KL_HV_H6_ein_XIX_Grundumfang_XIX_Klima <-> outer port SP_IF_KL_HV_H6_ein_XIX_Klima
    delegate Grundumfang_XIX_Klima.SP_IF_KL_HV_H6_soll_XIX_Grundumfang_XIX_Klima <-> outer port SP_IF_KL_HV_H6_soll_XIX_Klima
    delegate Grundumfang_XIX_Klima.SP_IF_KL_HV_Hb_ein_XIX_Grundumfang_XIX_Klima <-> outer port SP_IF_KL_HV_Hb_ein_XIX_Klima
    delegate Grundumfang_XIX_Klima.SP_IF_KL_HV_Hb_soll_XIX_Grundumfang_XIX_Klima <-> outer port SP_IF_KL_HV_Hb_soll_XIX_Klima
    delegate Grundumfang_XIX_Klima.SP_IF_KL_HV_Heizer_Strom_XIX_Grundumfang_XIX_Klima <-> outer port SP_IF_KL_HV_Heizer_Strom_XIX_Klima
    delegate Grundumfang_XIX_Klima.SP_IF_KL_HV_PTC_ein_XIX_Grundumfang_XIX_Klima <-> outer port SP_IF_KL_HV_PTC_ein_XIX_Klima
    delegate Grundumfang_XIX_Klima.SP_IF_KL_HV_PTC_soll_XIX_Grundumfang_XIX_Klima <-> outer port SP_IF_KL_HV_PTC_soll_XIX_Klima
    delegate Grundumfang_XIX_Klima.SP_IF_KL_HVH_1_VerbautStatus_XIX_Grundumfang_XIX_Klima <-> outer port SP_IF_KL_HVH_1_VerbautStatus_XIX_Klima
    delegate Grundumfang_XIX_Klima.SP_IF_KL_HVH_2_Status_Spgfreiheit_XIX_Grundumfang_XIX_Klima <-> outer port SP_IF_KL_HVH_2_Status_Spgfreiheit_XIX_Klima
    delegate Grundumfang_XIX_Klima.SP_IF_KL_HVH_2_VerbautStatus_XIX_Grundumfang_XIX_Klima <-> outer port SP_IF_KL_HVH_2_VerbautStatus_XIX_Klima
    delegate Grundumfang_XIX_Klima.SP_IF_KL_HVH_3_VerbautStatus_XIX_Grundumfang_XIX_Klima <-> outer port SP_IF_KL_HVH_3_VerbautStatus_XIX_Klima
    delegate Grundumfang_XIX_Klima.SP_IF_KL_HVHeizer2_ein_XIX_Grundumfang_XIX_Klima <-> outer port SP_IF_KL_HVHeizer2_ein_XIX_Klima
    delegate Grundumfang_XIX_Klima.SP_IF_KL_HVHeizer2_soll_XIX_Grundumfang_XIX_Klima <-> outer port SP_IF_KL_HVHeizer2_soll_XIX_Klima
    delegate Grundumfang_XIX_Klima.SP_IF_KL_HWT_Sollvolumenstrom_XIX_Grundumfang_XIX_Klima <-> outer port SP_IF_KL_HWT_Sollvolumenstrom_XIX_Klima
    delegate Grundumfang_XIX_Klima.SP_IF_KL_I_Geblaese_Fond_XIX_Grundumfang_XIX_Klima <-> outer port SP_IF_KL_I_Geblaese_Fond_XIX_Klima
    delegate Grundumfang_XIX_Klima.SP_IF_KL_I_Geblaese_XIX_Grundumfang_XIX_Klima <-> outer port SP_IF_KL_I_Geblaese_XIX_Klima
    delegate Grundumfang_XIX_Klima.SP_IF_KL_Innen_Temp_XIX_Grundumfang_XIX_Klima <-> outer port SP_IF_KL_Innen_Temp_XIX_Klima
    delegate Grundumfang_XIX_Klima.SP_IF_KL_Innentemp_KBT_Sensor_XIX_Grundumfang_XIX_Klima <-> outer port SP_IF_KL_Innentemp_KBT_Sensor_XIX_Klima
    delegate Grundumfang_XIX_Klima.SP_IF_KL_Ionisator_XIX_Grundumfang_XIX_Klima <-> outer port SP_IF_KL_Ionisator_XIX_Klima
    delegate Grundumfang_XIX_Klima.SP_IF_KL_IstLeistung_XIX_Grundumfang_XIX_Klima <-> outer port SP_IF_KL_IstLeistung_XIX_Klima
    delegate Grundumfang_XIX_Klima.SP_IF_KL_K_Status_XIX_Grundumfang_XIX_Klima <-> outer port SP_IF_KL_K_Status_XIX_Klima
    delegate Grundumfang_XIX_Klima.SP_IF_KL_KBF_Sync_XIX_Grundumfang_XIX_Klima <-> outer port SP_IF_KL_KBF_Sync_XIX_Klima
    delegate Grundumfang_XIX_Klima.SP_IF_KL_KD_Fehler_XIX_Grundumfang_XIX_Klima <-> outer port SP_IF_KL_KD_Fehler_XIX_Klima  # _XIX_Grundumfang_XIX_Klima_XIX_SC_738_ClassicAUTOSARBasicSoftwareICAS1Gateway_XIX_Softwareblock_XIX_ICAS1_X_Gateway_XIX_KL_KD_Fehler
    delegate Grundumfang_XIX_Klima.SP_IF_KL_Kennlinie_XIX_Grundumfang_XIX_Klima <-> outer port SP_IF_KL_Kennlinie_XIX_Klima
    delegate Grundumfang_XIX_Klima.SP_IF_KL_Klappe_Status_XIX_Grundumfang_XIX_Klima <-> outer port SP_IF_KL_Klappe_Status_XIX_Klima
    delegate Grundumfang_XIX_Klima.SP_IF_KL_KLE_Fehler_Anf_XIX_Grundumfang_XIX_Klima <-> outer port SP_IF_KL_KLE_Fehler_Anf_XIX_Klima
    delegate Grundumfang_XIX_Klima.SP_IF_KL_KLh_aus_XIX_Grundumfang_XIX_Klima <-> outer port SP_IF_KL_KLh_aus_XIX_Klima
    delegate Grundumfang_XIX_Klima.SP_IF_KL_KLh_LastMode_XIX_Grundumfang_XIX_Klima <-> outer port SP_IF_KL_KLh_LastMode_XIX_Klima
    delegate Grundumfang_XIX_Klima.SP_IF_KL_KLh_lock_XIX_Grundumfang_XIX_Klima <-> outer port SP_IF_KL_KLh_lock_XIX_Klima
    delegate Grundumfang_XIX_Klima.SP_IF_Kl_Klima_Aktiv_XIX_Grundumfang_XIX_Klima <-> outer port SP_IF_Kl_Klima_Aktiv_XIX_Klima
    delegate Grundumfang_XIX_Klima.SP_IF_KL_Klimastandzeit_XIX_Grundumfang_XIX_Klima <-> outer port SP_IF_KL_Klimastandzeit_XIX_Klima
    delegate Grundumfang_XIX_Klima.SP_IF_KL_Komp_Moment_alt_XIX_Grundumfang_XIX_Klima <-> outer port SP_IF_KL_Komp_Moment_alt_XIX_Klima
    delegate Grundumfang_XIX_Klima.SP_IF_KL_Kompressorstrom_soll_XIX_Grundumfang_XIX_Klima <-> outer port SP_IF_KL_Kompressorstrom_soll_XIX_Klima
    delegate Grundumfang_XIX_Klima.SP_IF_KL_Kuehlungs_Status_XIX_Grundumfang_XIX_Klima <-> outer port SP_IF_KL_Kuehlungs_Status_XIX_Klima
    delegate Grundumfang_XIX_Klima.SP_IF_KL_Kundenwunsch_Kuehlen_XIX_Grundumfang_XIX_Klima <-> outer port SP_IF_KL_Kundenwunsch_Kuehlen_XIX_Klima
    delegate Grundumfang_XIX_Klima.SP_IF_KL_Last_Kompr_XIX_Grundumfang_XIX_Klima <-> outer port SP_IF_KL_Last_Kompr_XIX_Klima
    delegate Grundumfang_XIX_Klima.SP_IF_KL_Leistung_BattHeizung_XIX_Grundumfang_XIX_Klima <-> outer port SP_IF_KL_Leistung_BattHeizung_XIX_Klima
    delegate Grundumfang_XIX_Klima.SP_IF_KL_Leistung_Klima_Anf_XIX_Grundumfang_XIX_Klima <-> outer port SP_IF_KL_Leistung_Klima_Anf_XIX_Klima
    delegate Grundumfang_XIX_Klima.SP_IF_KL_LRH_FoD_Status_XIX_Grundumfang_XIX_Klima <-> outer port SP_IF_KL_LRH_FoD_Status_XIX_Klima
    delegate SC_447_FoD_Slave_8_XIX_Softwareblock_XIX_Klima.SP_IF_KL_LRH_FoD_Status_XIX_SC_447_FoD_Slave_8_XIX_Softwareblock_XIX_Klima <-> outer port SP_IF_KL_LRH_FoD_Status_XIX_Klima
    delegate Grundumfang_XIX_Klima.SP_IF_KL_LRH_PWM_XIX_Grundumfang_XIX_Klima <-> outer port SP_IF_KL_LRH_PWM_XIX_Klima
    delegate Grundumfang_XIX_Klima.SP_IF_KL_LRH_Soll_XIX_Grundumfang_XIX_Klima <-> outer port SP_IF_KL_LRH_Soll_XIX_Klima
    delegate Grundumfang_XIX_Klima.SP_IF_KL_LRH_Stufe_XIX_Grundumfang_XIX_Klima <-> outer port SP_IF_KL_LRH_Stufe_XIX_Klima
    delegate Grundumfang_XIX_Klima.SP_IF_KL_LRH_Taster_XIX_Grundumfang_XIX_Klima <-> outer port SP_IF_KL_LRH_Taster_XIX_Klima
    delegate Grundumfang_XIX_Klima.SP_IF_KL_LSH_Ansteuerung_XIX_Grundumfang_XIX_Klima <-> outer port SP_IF_KL_LSH_Ansteuerung_XIX_Klima
    delegate Grundumfang_XIX_Klima.SP_IF_KL_LSH_Betriebsdauer_XIX_Grundumfang_XIX_Klima <-> outer port SP_IF_KL_LSH_Betriebsdauer_XIX_Klima
    delegate Grundumfang_XIX_Klima.SP_IF_KL_LSH_DBetr_Bestaet_XIX_Grundumfang_XIX_Klima <-> outer port SP_IF_KL_LSH_DBetr_Bestaet_XIX_Klima
    delegate Grundumfang_XIX_Klima.SP_IF_KL_LSH_DBetr_Ein_XIX_Grundumfang_XIX_Klima <-> outer port SP_IF_KL_LSH_DBetr_Ein_XIX_Klima
    delegate Grundumfang_XIX_Klima.SP_IF_KL_Magnetventil_XIX_Grundumfang_XIX_Klima <-> outer port SP_IF_KL_Magnetventil_XIX_Klima
    delegate Grundumfang_XIX_Klima.SP_IF_KL_Meldung_Status_XIX_Grundumfang_XIX_Klima <-> outer port SP_IF_KL_Meldung_Status_XIX_Klima
    delegate Grundumfang_XIX_Klima.SP_IF_KL_nachtr_Stopp_Anf_XIX_Grundumfang_XIX_Klima <-> outer port SP_IF_KL_nachtr_Stopp_Anf_XIX_Klima
    delegate Grundumfang_XIX_Klima.SP_IF_KL_OBD_Status_XIX_Grundumfang_XIX_Klima <-> outer port SP_IF_KL_OBD_Status_XIX_Klima
    delegate Grundumfang_XIX_Klima.SP_IF_KL_PTC_ein_XIX_Grundumfang_XIX_Klima <-> outer port SP_IF_KL_PTC_ein_XIX_Klima
    delegate Grundumfang_XIX_Klima.SP_IF_KL_PTC_Rampe_XIX_Grundumfang_XIX_Klima <-> outer port SP_IF_KL_PTC_Rampe_XIX_Klima
    delegate Grundumfang_XIX_Klima.SP_IF_KL_PTC_soll_XIX_Grundumfang_XIX_Klima <-> outer port SP_IF_KL_PTC_soll_XIX_Klima
    delegate Grundumfang_XIX_Klima.SP_IF_KL_PTC_Verbauinfo_XIX_Grundumfang_XIX_Klima <-> outer port SP_IF_KL_PTC_Verbauinfo_XIX_Klima
    delegate Grundumfang_XIX_Klima.SP_IF_KL_Pumpe_02_Soll_XIX_Grundumfang_XIX_Klima <-> outer port SP_IF_KL_Pumpe_02_Soll_XIX_Klima
    delegate Grundumfang_XIX_Klima.SP_IF_KL_Reheat_Innenraum_XIX_Grundumfang_XIX_Klima <-> outer port SP_IF_KL_Reheat_Innenraum_XIX_Klima
    delegate Grundumfang_XIX_Klima.SP_IF_KL_Restwaerme_aktiv_XIX_Grundumfang_XIX_Klima <-> outer port SP_IF_KL_Restwaerme_aktiv_XIX_Klima  # _XIX_Grundumfang_XIX_Klima_XIX_SC_738_ClassicAUTOSARBasicSoftwareICAS1Gateway_XIX_Softwareblock_XIX_ICAS1_X_Gateway_XIX_KL_Restwaerme_aktiv
    delegate Grundumfang_XIX_Klima.SP_IF_KL_Scheibe_Typ_XIX_Grundumfang_XIX_Klima <-> outer port SP_IF_KL_Scheibe_Typ_XIX_Klima
    delegate Grundumfang_XIX_Klima.SP_IF_KL_SDA_Luft_Feinstaub_XIX_Grundumfang_XIX_Klima <-> outer port SP_IF_KL_SDA_Luft_Feinstaub_XIX_Klima
    delegate Grundumfang_XIX_Klima.SP_IF_KL_SH_Soll_hl_XIX_Grundumfang_XIX_Klima <-> outer port SP_IF_KL_SH_Soll_hl_XIX_Klima
    delegate Grundumfang_XIX_Klima.SP_IF_KL_SH_Soll_hr_XIX_Grundumfang_XIX_Klima <-> outer port SP_IF_KL_SH_Soll_hr_XIX_Klima
    delegate Grundumfang_XIX_Klima.SP_IF_KL_SIH_Anforderung_hl_XIX_Grundumfang_XIX_Klima <-> outer port SP_IF_KL_SIH_Anforderung_hl_XIX_Klima
    delegate Grundumfang_XIX_Klima.SP_IF_KL_SIH_Anforderung_hr_XIX_Grundumfang_XIX_Klima <-> outer port SP_IF_KL_SIH_Anforderung_hr_XIX_Klima
    delegate Grundumfang_XIX_Klima.SP_IF_KL_SIH_hl_Leistung_XIX_Grundumfang_XIX_Klima <-> outer port SP_IF_KL_SIH_hl_Leistung_XIX_Klima
    delegate Grundumfang_XIX_Klima.SP_IF_KL_SIH_hl_Temp_aus_XIX_Grundumfang_XIX_Klima <-> outer port SP_IF_KL_SIH_hl_Temp_aus_XIX_Klima
    delegate Grundumfang_XIX_Klima.SP_IF_KL_SIH_hl_Temp_ein_XIX_Grundumfang_XIX_Klima <-> outer port SP_IF_KL_SIH_hl_Temp_ein_XIX_Klima
    delegate Grundumfang_XIX_Klima.SP_IF_KL_SIH_hl_Vorgabe_XIX_Grundumfang_XIX_Klima <-> outer port SP_IF_KL_SIH_hl_Vorgabe_XIX_Klima
    delegate Grundumfang_XIX_Klima.SP_IF_KL_SIH_hr_Leistung_XIX_Grundumfang_XIX_Klima <-> outer port SP_IF_KL_SIH_hr_Leistung_XIX_Klima
    delegate Grundumfang_XIX_Klima.SP_IF_KL_SIH_hr_Temp_aus_XIX_Grundumfang_XIX_Klima <-> outer port SP_IF_KL_SIH_hr_Temp_aus_XIX_Klima
    delegate Grundumfang_XIX_Klima.SP_IF_KL_SIH_hr_Temp_ein_XIX_Grundumfang_XIX_Klima <-> outer port SP_IF_KL_SIH_hr_Temp_ein_XIX_Klima
    delegate Grundumfang_XIX_Klima.SP_IF_KL_SIH_hr_Vorgabe_XIX_Grundumfang_XIX_Klima <-> outer port SP_IF_KL_SIH_hr_Vorgabe_XIX_Klima
    delegate Grundumfang_XIX_Klima.SP_IF_KL_SIH_LEL_Verteilung_VL_XIX_Grundumfang_XIX_Klima <-> outer port SP_IF_KL_SIH_LEL_Verteilung_VL_XIX_Klima
    delegate Grundumfang_XIX_Klima.SP_IF_KL_SIH_LEL_Verteilung_VR_XIX_Grundumfang_XIX_Klima <-> outer port SP_IF_KL_SIH_LEL_Verteilung_VR_XIX_Klima
    delegate Grundumfang_XIX_Klima.SP_IF_KL_SIH_Soll_li_XIX_Grundumfang_XIX_Klima <-> outer port SP_IF_KL_SIH_Soll_li_XIX_Klima
    delegate Grundumfang_XIX_Klima.SP_IF_KL_SIH_Soll_re_XIX_Grundumfang_XIX_Klima <-> outer port SP_IF_KL_SIH_Soll_re_XIX_Klima
    delegate Grundumfang_XIX_Klima.SP_IF_KL_SIL_Soll_li_XIX_Grundumfang_XIX_Klima <-> outer port SP_IF_KL_SIL_Soll_li_XIX_Klima
    delegate Grundumfang_XIX_Klima.SP_IF_KL_SIL_Soll_re_XIX_Grundumfang_XIX_Klima <-> outer port SP_IF_KL_SIL_Soll_re_XIX_Klima
    delegate Grundumfang_XIX_Klima.SP_IF_KL_Sitzkennlinie_Heck_XIX_Grundumfang_XIX_Klima <-> outer port SP_IF_KL_Sitzkennlinie_Heck_XIX_Klima
    delegate Grundumfang_XIX_Klima.SP_IF_KL_SMod_SIH_Stufe_LED_hl_XIX_Grundumfang_XIX_Klima <-> outer port SP_IF_KL_SMod_SIH_Stufe_LED_hl_XIX_Klima
    delegate Grundumfang_XIX_Klima.SP_IF_KL_SMod_SIH_Stufe_LED_hr_XIX_Grundumfang_XIX_Klima <-> outer port SP_IF_KL_SMod_SIH_Stufe_LED_hr_XIX_Klima
    delegate Grundumfang_XIX_Klima.SP_IF_KL_SMod_SIL_Stufe_LED_hl_XIX_Grundumfang_XIX_Klima <-> outer port SP_IF_KL_SMod_SIL_Stufe_LED_hl_XIX_Klima
    delegate Grundumfang_XIX_Klima.SP_IF_KL_SMod_SIL_Stufe_LED_hr_XIX_Grundumfang_XIX_Klima <-> outer port SP_IF_KL_SMod_SIL_Stufe_LED_hr_XIX_Klima
    delegate Grundumfang_XIX_Klima.SP_IF_KL_SoSe_Intensitaet_BFS_XIX_Grundumfang_XIX_Klima <-> outer port SP_IF_KL_SoSe_Intensitaet_BFS_XIX_Klima
    delegate Grundumfang_XIX_Klima.SP_IF_KL_SoSe_Intensitaet_FS_XIX_Grundumfang_XIX_Klima <-> outer port SP_IF_KL_SoSe_Intensitaet_FS_XIX_Klima
    delegate Grundumfang_XIX_Klima.SP_IF_KL_Spannungs_Anf_XIX_Grundumfang_XIX_Klima <-> outer port SP_IF_KL_Spannungs_Anf_XIX_Klima
    delegate Grundumfang_XIX_Klima.SP_IF_KL_Standklima_RemoteModus_XIX_Grundumfang_XIX_Klima <-> outer port SP_IF_KL_Standklima_RemoteModus_XIX_Klima
    delegate Grundumfang_XIX_Klima.SP_IF_KL_Standklima_Status_02_XIX_Grundumfang_XIX_Klima <-> outer port SP_IF_KL_Standklima_Status_02_XIX_Klima
    delegate Grundumfang_XIX_Klima.SP_IF_KL_Standklima_Status_03_XIX_Grundumfang_XIX_Klima <-> outer port SP_IF_KL_Standklima_Status_03_XIX_Klima
    delegate Grundumfang_XIX_Klima.SP_IF_KL_StartStopp_Info_XIX_Grundumfang_XIX_Klima <-> outer port SP_IF_KL_StartStopp_Info_XIX_Klima
    delegate Grundumfang_XIX_Klima.SP_IF_KL_Status_EoHVL_EKK_XIX_Grundumfang_XIX_Klima <-> outer port SP_IF_KL_Status_EoHVL_EKK_XIX_Klima
    delegate Grundumfang_XIX_Klima.SP_IF_KL_Status_EoHVL_Heizer_2_XIX_Grundumfang_XIX_Klima <-> outer port SP_IF_KL_Status_EoHVL_Heizer_2_XIX_Klima
    delegate Grundumfang_XIX_Klima.SP_IF_KL_Status_EoHVL_Heizer_3_XIX_Grundumfang_XIX_Klima <-> outer port SP_IF_KL_Status_EoHVL_Heizer_3_XIX_Klima
    delegate Grundumfang_XIX_Klima.SP_IF_KL_Status_EoHVL_Heizer_XIX_Grundumfang_XIX_Klima <-> outer port SP_IF_KL_Status_EoHVL_Heizer_XIX_Klima
    delegate Grundumfang_XIX_Klima.SP_IF_KL_Status_Soll_XIX_Grundumfang_XIX_Klima <-> outer port SP_IF_KL_Status_Soll_XIX_Klima
    delegate Grundumfang_XIX_Klima.SP_IF_KL_StellgliedtestINV_Heck_XIX_Grundumfang_XIX_Klima <-> outer port SP_IF_KL_StellgliedtestINV_Heck_XIX_Klima
    delegate Grundumfang_XIX_Klima.SP_IF_KL_STH_aktiv_XIX_Grundumfang_XIX_Klima <-> outer port SP_IF_KL_STH_aktiv_XIX_Klima
    delegate Grundumfang_XIX_Klima.SP_IF_KL_STH_Ansteuerung_XIX_Grundumfang_XIX_Klima <-> outer port SP_IF_KL_STH_Ansteuerung_XIX_Klima
    delegate Grundumfang_XIX_Klima.SP_IF_KL_STH_Betriebsdauer_XIX_Grundumfang_XIX_Klima <-> outer port SP_IF_KL_STH_Betriebsdauer_XIX_Klima
    delegate Grundumfang_XIX_Klima.SP_IF_KL_STL_aktiv_XIX_Grundumfang_XIX_Klima <-> outer port SP_IF_KL_STL_aktiv_XIX_Klima
    delegate Grundumfang_XIX_Klima.SP_IF_KL_T_Charge_XIX_Grundumfang_XIX_Klima <-> outer port SP_IF_KL_T_Charge_XIX_Klima
    delegate Grundumfang_XIX_Klima.SP_IF_KL_Temp_HL_Soll_XIX_Grundumfang_XIX_Klima <-> outer port SP_IF_KL_Temp_HL_Soll_XIX_Klima
    delegate Grundumfang_XIX_Klima.SP_IF_KL_Temp_vor_NTK_XIX_Grundumfang_XIX_Klima <-> outer port SP_IF_KL_Temp_vor_NTK_XIX_Klima
    delegate Grundumfang_XIX_Klima.SP_IF_KL_Temp_ZH_Soll_XIX_Grundumfang_XIX_Klima <-> outer port SP_IF_KL_Temp_ZH_Soll_XIX_Klima
    delegate Grundumfang_XIX_Klima.SP_IF_KL_Thermomanagement_XIX_Grundumfang_XIX_Klima <-> outer port SP_IF_KL_Thermomanagement_XIX_Klima
    delegate Grundumfang_XIX_Klima.SP_IF_KL_UIF_Parametersatz_XIX_Grundumfang_XIX_Klima <-> outer port SP_IF_KL_UIF_Parametersatz_XIX_Klima
    delegate Grundumfang_XIX_Klima.SP_IF_KL_Umluft_Taste_XIX_Grundumfang_XIX_Klima <-> outer port SP_IF_KL_Umluft_Taste_XIX_Klima
    delegate Grundumfang_XIX_Klima.SP_IF_KL_Umluftklappe_Status_XIX_Grundumfang_XIX_Klima <-> outer port SP_IF_KL_Umluftklappe_Status_XIX_Klima
    delegate Grundumfang_XIX_Klima.SP_IF_KL_Variante_Standheizung_XIX_Grundumfang_XIX_Klima <-> outer port SP_IF_KL_Variante_Standheizung_XIX_Klima
    delegate Grundumfang_XIX_Klima.SP_IF_KL_Verdeckstatus_XIX_Grundumfang_XIX_Klima <-> outer port SP_IF_KL_Verdeckstatus_XIX_Klima
    delegate Grundumfang_XIX_Klima.SP_IF_KL_VK_Anf_XIX_Grundumfang_XIX_Klima <-> outer port SP_IF_KL_VK_Anf_XIX_Klima
    delegate Grundumfang_XIX_Klima.SP_IF_KL_VK_Betriebsdauer_XIX_Grundumfang_XIX_Klima <-> outer port SP_IF_KL_VK_Betriebsdauer_XIX_Klima
    delegate Grundumfang_XIX_Klima.SP_IF_KL_VoKo_LED_XIX_Grundumfang_XIX_Klima <-> outer port SP_IF_KL_VoKo_LED_XIX_Klima
    delegate Grundumfang_XIX_Klima.SP_IF_KL_Voko_Status_XIX_Grundumfang_XIX_Klima <-> outer port SP_IF_KL_Voko_Status_XIX_Klima
    delegate Grundumfang_XIX_Klima.SP_IF_KL_Vorkond_Strategie_XIX_Grundumfang_XIX_Klima <-> outer port SP_IF_KL_Vorkond_Strategie_XIX_Klima
    delegate Grundumfang_XIX_Klima.SP_IF_KL_Vorwarn_Komp_ein_XIX_Grundumfang_XIX_Klima <-> outer port SP_IF_KL_Vorwarn_Komp_ein_XIX_Klima
    delegate Grundumfang_XIX_Klima.SP_IF_KL_Vorwarn_Zuheizer_ein_XIX_Grundumfang_XIX_Klima <-> outer port SP_IF_KL_Vorwarn_Zuheizer_ein_XIX_Klima
    delegate Grundumfang_XIX_Klima.SP_IF_KL_WaPu_XIX_Grundumfang_XIX_Klima <-> outer port SP_IF_KL_WaPu_XIX_Klima
    delegate Grundumfang_XIX_Klima.SP_IF_KL_Wasserheizer_Ansteuerung_XIX_Grundumfang_XIX_Klima <-> outer port SP_IF_KL_Wasserheizer_Ansteuerung_XIX_Klima
    delegate Grundumfang_XIX_Klima.SP_IF_KL_Wasserheizer_IstTemp_Ausgang_XIX_Grundumfang_XIX_Klima <-> outer port SP_IF_KL_Wasserheizer_IstTemp_Ausgang_XIX_Klima
    delegate Grundumfang_XIX_Klima.SP_IF_KL_Wasserheizer_IstTemp_Eingang_XIX_Grundumfang_XIX_Klima <-> outer port SP_IF_KL_Wasserheizer_IstTemp_Eingang_XIX_Klima
    delegate Grundumfang_XIX_Klima.SP_IF_KL_Wasserheizer_SollTemp_Ausgang_XIX_Grundumfang_XIX_Klima <-> outer port SP_IF_KL_Wasserheizer_SollTemp_Ausgang_XIX_Klima
    delegate Grundumfang_XIX_Klima.SP_IF_KL_Wasserheizer_Status_XIX_Grundumfang_XIX_Klima <-> outer port SP_IF_KL_Wasserheizer_Status_XIX_Klima
    delegate Grundumfang_XIX_Klima.SP_IF_KL_ZR_Anforderung_XIX_Grundumfang_XIX_Klima <-> outer port SP_IF_KL_ZR_Anforderung_XIX_Klima
    delegate Grundumfang_XIX_Klima.SP_IF_KL_Zuheizer_Freigabe_XIX_Grundumfang_XIX_Klima <-> outer port SP_IF_KL_Zuheizer_Freigabe_XIX_Klima
    delegate Grundumfang_XIX_Klima.SP_IF_KL_Zustand_XIX_Grundumfang_XIX_Klima <-> outer port SP_IF_KL_Zustand_XIX_Klima
    delegate Grundumfang_XIX_Klima.SP_IF_Klemme_15_XIX_Grundumfang_XIX_Klima <-> outer port SP_IF_Klemme_15_XIX_Klima
    delegate Grundumfang_XIX_Klima.SP_IF_Klima_Nachlauftyp_XIX_Grundumfang_XIX_Klima <-> outer port SP_IF_Klima_Nachlauftyp_XIX_Klima  # _XIX_Grundumfang_XIX_Klima_XIX_SC_738_ClassicAUTOSARBasicSoftwareICAS1Gateway_XIX_Softwareblock_XIX_ICAS1_X_Gateway_XIX_Klima_Nachlauftyp
    delegate Grundumfang_XIX_Klima.SP_IF_KN_KL_DiagPfad_XIX_Grundumfang_XIX_Klima <-> outer port SP_IF_KN_KL_DiagPfad_XIX_Klima  # _XIX_Grundumfang_XIX_Klima_XIX_SC_738_ClassicAUTOSARBasicSoftwareICAS1Gateway_XIX_Softwareblock_XIX_ICAS1_X_Gateway_XIX_KN_KL_DiagPfad
    delegate Grundumfang_XIX_Klima.SP_IF_KompressorModus_XIX_Grundumfang_XIX_Klima <-> outer port SP_IF_KompressorModus_XIX_Klima
    delegate Grundumfang_XIX_Klima.SP_IF_KPVe_Auto_Toggle_XIX_Grundumfang_XIX_Klima <-> outer port SP_IF_KPVe_Auto_Toggle_XIX_Klima
    delegate Grundumfang_XIX_Klima.SP_IF_KPVe_Einheit_XIX_Grundumfang_XIX_Klima <-> outer port SP_IF_KPVe_Einheit_XIX_Klima
    delegate Grundumfang_XIX_Klima.SP_IF_KPVe_Funktion_AC_max_XIX_Grundumfang_XIX_Klima <-> outer port SP_IF_KPVe_Funktion_AC_max_XIX_Klima
    delegate Grundumfang_XIX_Klima.SP_IF_KPVe_Funktion_AC_XIX_Grundumfang_XIX_Klima <-> outer port SP_IF_KPVe_Funktion_AC_XIX_Klima
    delegate Grundumfang_XIX_Klima.SP_IF_KPVe_Funktion_Auto_li_XIX_Grundumfang_XIX_Klima <-> outer port SP_IF_KPVe_Funktion_Auto_li_XIX_Klima
    delegate Grundumfang_XIX_Klima.SP_IF_KPVe_Funktion_AutoSiKli_li_XIX_Grundumfang_XIX_Klima <-> outer port SP_IF_KPVe_Funktion_AutoSiKli_li_XIX_Klima
    delegate Grundumfang_XIX_Klima.SP_IF_KPVe_Funktion_AutoSiKli_re_XIX_Grundumfang_XIX_Klima <-> outer port SP_IF_KPVe_Funktion_AutoSiKli_re_XIX_Klima
    delegate Grundumfang_XIX_Klima.SP_IF_KPVe_Funktion_AutoUmluft_XIX_Grundumfang_XIX_Klima <-> outer port SP_IF_KPVe_Funktion_AutoUmluft_XIX_Klima
    delegate Grundumfang_XIX_Klima.SP_IF_KPVe_Funktion_Beduftung_XIX_Grundumfang_XIX_Klima <-> outer port SP_IF_KPVe_Funktion_Beduftung_XIX_Klima
    delegate Grundumfang_XIX_Klima.SP_IF_KPVe_Funktion_Defrost_XIX_Grundumfang_XIX_Klima <-> outer port SP_IF_KPVe_Funktion_Defrost_XIX_Klima
    delegate Grundumfang_XIX_Klima.SP_IF_KPVe_Funktion_ECO_XIX_Grundumfang_XIX_Klima <-> outer port SP_IF_KPVe_Funktion_ECO_XIX_Klima
    delegate Grundumfang_XIX_Klima.SP_IF_KPVe_Funktion_ECO_Zone_XIX_Grundumfang_XIX_Klima <-> outer port SP_IF_KPVe_Funktion_ECO_Zone_XIX_Klima
    delegate Grundumfang_XIX_Klima.SP_IF_KPVe_Funktion_FSH_XIX_Grundumfang_XIX_Klima <-> outer port SP_IF_KPVe_Funktion_FSH_XIX_Klima
    delegate Grundumfang_XIX_Klima.SP_IF_KPVe_Funktion_HSH_XIX_Grundumfang_XIX_Klima <-> outer port SP_IF_KPVe_Funktion_HSH_XIX_Klima
    delegate Grundumfang_XIX_Klima.SP_IF_KPVe_Funktion_Ionisator_XIX_Grundumfang_XIX_Klima <-> outer port SP_IF_KPVe_Funktion_Ionisator_XIX_Klima
    delegate Grundumfang_XIX_Klima.SP_IF_KPVe_Funktion_Joker_Taste_XIX_Grundumfang_XIX_Klima <-> outer port SP_IF_KPVe_Funktion_Joker_Taste_XIX_Klima
    delegate Grundumfang_XIX_Klima.SP_IF_KPVe_Funktion_Klima_Menue_MMI_XIX_Grundumfang_XIX_Klima <-> outer port SP_IF_KPVe_Funktion_Klima_Menue_MMI_XIX_Klima
    delegate Grundumfang_XIX_Klima.SP_IF_KPVe_Funktion_Konditionierung_XIX_Grundumfang_XIX_Klima <-> outer port SP_IF_KPVe_Funktion_Konditionierung_XIX_Klima
    delegate Grundumfang_XIX_Klima.SP_IF_KPVe_Funktion_Locked_XIX_Grundumfang_XIX_Klima <-> outer port SP_IF_KPVe_Funktion_Locked_XIX_Klima
    delegate Grundumfang_XIX_Klima.SP_IF_KPVe_Funktion_OBD_XIX_Grundumfang_XIX_Klima <-> outer port SP_IF_KPVe_Funktion_OBD_XIX_Klima
    delegate Grundumfang_XIX_Klima.SP_IF_KPVe_Funktion_Off_XIX_Grundumfang_XIX_Klima <-> outer port SP_IF_KPVe_Funktion_Off_XIX_Klima
    delegate Grundumfang_XIX_Klima.SP_IF_KPVe_Funktion_PureAir_XIX_Grundumfang_XIX_Klima <-> outer port SP_IF_KPVe_Funktion_PureAir_XIX_Klima
    delegate Grundumfang_XIX_Klima.SP_IF_KPVe_Funktion_Rear_XIX_Grundumfang_XIX_Klima <-> outer port SP_IF_KPVe_Funktion_Rear_XIX_Klima
    delegate Grundumfang_XIX_Klima.SP_IF_KPVe_Funktion_Restwaerme_XIX_Grundumfang_XIX_Klima <-> outer port SP_IF_KPVe_Funktion_Restwaerme_XIX_Klima
    delegate Grundumfang_XIX_Klima.SP_IF_KPVe_Funktion_Sync_XIX_Grundumfang_XIX_Klima <-> outer port SP_IF_KPVe_Funktion_Sync_XIX_Klima
    delegate Grundumfang_XIX_Klima.SP_IF_KPVe_Funktion_Umluft_XIX_Grundumfang_XIX_Klima <-> outer port SP_IF_KPVe_Funktion_Umluft_XIX_Klima
    delegate Grundumfang_XIX_Klima.SP_IF_KPVe_Funktionsbeleuchtung_XIX_Grundumfang_XIX_Klima <-> outer port SP_IF_KPVe_Funktionsbeleuchtung_XIX_Klima
    delegate Grundumfang_XIX_Klima.SP_IF_KPVe_Geblaese_Auto_li_XIX_Grundumfang_XIX_Klima <-> outer port SP_IF_KPVe_Geblaese_Auto_li_XIX_Klima
    delegate Grundumfang_XIX_Klima.SP_IF_KPVe_Geblaese_Begrenzung_XIX_Grundumfang_XIX_Klima <-> outer port SP_IF_KPVe_Geblaese_Begrenzung_XIX_Klima
    delegate Grundumfang_XIX_Klima.SP_IF_KPVe_Geblaese_Stufe_li_XIX_Grundumfang_XIX_Klima <-> outer port SP_IF_KPVe_Geblaese_Stufe_li_XIX_Klima
    delegate Grundumfang_XIX_Klima.SP_IF_KPVe_Kopfraumheizung_li_XIX_Grundumfang_XIX_Klima <-> outer port SP_IF_KPVe_Kopfraumheizung_li_XIX_Klima
    delegate Grundumfang_XIX_Klima.SP_IF_KPVe_Kopfraumheizung_re_XIX_Grundumfang_XIX_Klima <-> outer port SP_IF_KPVe_Kopfraumheizung_re_XIX_Klima
    delegate Grundumfang_XIX_Klima.SP_IF_KPVe_LCD_XIX_Grundumfang_XIX_Klima <-> outer port SP_IF_KPVe_LCD_XIX_Klima
    delegate Grundumfang_XIX_Klima.SP_IF_KPVe_Lenker_Position_XIX_Grundumfang_XIX_Klima <-> outer port SP_IF_KPVe_Lenker_Position_XIX_Klima
    delegate Grundumfang_XIX_Klima.SP_IF_KPVe_Luftverteilung_Auto_li_XIX_Grundumfang_XIX_Klima <-> outer port SP_IF_KPVe_Luftverteilung_Auto_li_XIX_Klima
    delegate Grundumfang_XIX_Klima.SP_IF_KPVe_Luftverteilung_Mitte_li_XIX_Grundumfang_XIX_Klima <-> outer port SP_IF_KPVe_Luftverteilung_Mitte_li_XIX_Klima
    delegate Grundumfang_XIX_Klima.SP_IF_KPVe_Luftverteilung_Oben_li_XIX_Grundumfang_XIX_Klima <-> outer port SP_IF_KPVe_Luftverteilung_Oben_li_XIX_Klima
    delegate Grundumfang_XIX_Klima.SP_IF_KPVe_Luftverteilung_Unten_li_XIX_Grundumfang_XIX_Klima <-> outer port SP_IF_KPVe_Luftverteilung_Unten_li_XIX_Klima
    delegate Grundumfang_XIX_Klima.SP_IF_KPVe_OBD_Gruppe_XIX_Grundumfang_XIX_Klima <-> outer port SP_IF_KPVe_OBD_Gruppe_XIX_Klima
    delegate Grundumfang_XIX_Klima.SP_IF_KPVe_Sitzheizung_li_XIX_Grundumfang_XIX_Klima <-> outer port SP_IF_KPVe_Sitzheizung_li_XIX_Klima
    delegate Grundumfang_XIX_Klima.SP_IF_KPVe_Sitzheizung_re_XIX_Grundumfang_XIX_Klima <-> outer port SP_IF_KPVe_Sitzheizung_re_XIX_Klima
    delegate Grundumfang_XIX_Klima.SP_IF_KPVe_Sitzlueftung_li_XIX_Grundumfang_XIX_Klima <-> outer port SP_IF_KPVe_Sitzlueftung_li_XIX_Klima
    delegate Grundumfang_XIX_Klima.SP_IF_KPVe_Sitzlueftung_re_XIX_Grundumfang_XIX_Klima <-> outer port SP_IF_KPVe_Sitzlueftung_re_XIX_Klima
    delegate Grundumfang_XIX_Klima.SP_IF_KPVe_Suchbeleuchtung_XIX_Grundumfang_XIX_Klima <-> outer port SP_IF_KPVe_Suchbeleuchtung_XIX_Klima
    delegate Grundumfang_XIX_Klima.SP_IF_KPVe_Symbol_Luftmenge_li_XIX_Grundumfang_XIX_Klima <-> outer port SP_IF_KPVe_Symbol_Luftmenge_li_XIX_Klima
    delegate Grundumfang_XIX_Klima.SP_IF_KPVe_Symbol_Luftverteilung_li_XIX_Grundumfang_XIX_Klima <-> outer port SP_IF_KPVe_Symbol_Luftverteilung_li_XIX_Klima
    delegate Grundumfang_XIX_Klima.SP_IF_KPVe_Temp_li_XIX_Grundumfang_XIX_Klima <-> outer port SP_IF_KPVe_Temp_li_XIX_Klima
    delegate Grundumfang_XIX_Klima.SP_IF_KPVe_Temp_re_XIX_Grundumfang_XIX_Klima <-> outer port SP_IF_KPVe_Temp_re_XIX_Klima
    delegate Grundumfang_XIX_Klima.SP_IF_KPVe_Verbau_AutoSikli_XIX_Grundumfang_XIX_Klima <-> outer port SP_IF_KPVe_Verbau_AutoSikli_XIX_Klima
    delegate Grundumfang_XIX_Klima.SP_IF_KRH_Soll_li_XIX_Grundumfang_XIX_Klima <-> outer port SP_IF_KRH_Soll_li_XIX_Klima
    delegate Grundumfang_XIX_Klima.SP_IF_KRH_Soll_re_XIX_Grundumfang_XIX_Klima <-> outer port SP_IF_KRH_Soll_re_XIX_Klima
    delegate Grundumfang_XIX_Klima.SP_IF_LHRe_01_AnsteuerVorgabe_A_XIX_Grundumfang_XIX_Klima <-> outer port SP_IF_LHRe_01_AnsteuerVorgabe_A_XIX_Klima
    delegate Grundumfang_XIX_Klima.SP_IF_LHRe_01_AnsteuerVorgabe_B_XIX_Grundumfang_XIX_Klima <-> outer port SP_IF_LHRe_01_AnsteuerVorgabe_B_XIX_Klima
    delegate Grundumfang_XIX_Klima.SP_IF_LHRe_01_Config_NTC_A_XIX_Grundumfang_XIX_Klima <-> outer port SP_IF_LHRe_01_Config_NTC_A_XIX_Klima
    delegate Grundumfang_XIX_Klima.SP_IF_LHRe_01_Config_NTC_B_XIX_Grundumfang_XIX_Klima <-> outer port SP_IF_LHRe_01_Config_NTC_B_XIX_Klima
    delegate Grundumfang_XIX_Klima.SP_IF_LHRe_Global_Unterbrechen_Inv_XIX_Grundumfang_XIX_Klima <-> outer port SP_IF_LHRe_Global_Unterbrechen_Inv_XIX_Klima
    delegate Grundumfang_XIX_Klima.SP_IF_Luftmenge_Innenraum_PMS_XIX_Grundumfang_XIX_Klima <-> outer port SP_IF_Luftmenge_Innenraum_PMS_XIX_Klima
    delegate Grundumfang_XIX_Klima.SP_IF_MD1_Position_4Bit_XIX_Grundumfang_XIX_Klima <-> outer port SP_IF_MD1_Position_4Bit_XIX_Klima
    delegate Grundumfang_XIX_Klima.SP_IF_Messung_Enable_PMS_XIX_Grundumfang_XIX_Klima <-> outer port SP_IF_Messung_Enable_PMS_XIX_Klima
    delegate Grundumfang_XIX_Klima.SP_IF_MO_FSA_Sensorheizung_XIX_Grundumfang_XIX_Klima <-> outer port SP_IF_MO_FSA_Sensorheizung_XIX_Klima
    delegate Grundumfang_XIX_Klima.SP_IF_MRollo_Position_4Bit_XIX_Grundumfang_XIX_Klima <-> outer port SP_IF_MRollo_Position_4Bit_XIX_Klima
    delegate Grundumfang_XIX_Klima.SP_IF_Navigationsattribute_XIX_Grundumfang_XIX_Klima <-> outer port SP_IF_Navigationsattribute_XIX_Klima
    delegate Grundumfang_XIX_Klima.SP_IF_NM_Klima_CBV_AWB_XIX_Grundumfang_XIX_Klima <-> outer port SP_IF_NM_Klima_CBV_AWB_XIX_Klima  # _XIX_Grundumfang_XIX_Klima_XIX_SC_738_ClassicAUTOSARBasicSoftwareICAS1Gateway_XIX_Softwareblock_XIX_ICAS1_X_Gateway_XIX_NM_Klima_CBV_AWB
    delegate Grundumfang_XIX_Klima.SP_IF_NM_Klima_CBV_CRI_XIX_Grundumfang_XIX_Klima <-> outer port SP_IF_NM_Klima_CBV_CRI_XIX_Klima  # _XIX_Grundumfang_XIX_Klima_XIX_SC_738_ClassicAUTOSARBasicSoftwareICAS1Gateway_XIX_Softwareblock_XIX_ICAS1_X_Gateway_XIX_NM_Klima_CBV_CRI
    delegate Grundumfang_XIX_Klima.SP_IF_NM_Klima_NM_State_XIX_Grundumfang_XIX_Klima <-> outer port SP_IF_NM_Klima_NM_State_XIX_Klima
    delegate Grundumfang_XIX_Klima.SP_IF_OBDProtocol_Klima_XIX_Grundumfang_XIX_Klima <-> outer port SP_IF_OBDProtocol_Klima_XIX_Klima
    delegate Grundumfang_XIX_Klima.SP_IF_PCU_Aussentemp_gef_XIX_Grundumfang_XIX_Klima <-> outer port SP_IF_PCU_Aussentemp_gef_XIX_Klima
    delegate Grundumfang_XIX_Klima.SP_IF_PCU_Ein_XIX_Grundumfang_XIX_Klima <-> outer port SP_IF_PCU_Ein_XIX_Klima
    delegate Grundumfang_XIX_Klima.SP_IF_PCU_FS_Luftfeuchte_rel_XIX_Grundumfang_XIX_Klima <-> outer port SP_IF_PCU_FS_Luftfeuchte_rel_XIX_Klima
    delegate Grundumfang_XIX_Klima.SP_IF_PCU_FSA_Luftfeuchte_rel_XIX_Grundumfang_XIX_Klima <-> outer port SP_IF_PCU_FSA_Luftfeuchte_rel_XIX_Klima
    delegate Grundumfang_XIX_Klima.SP_IF_PCU_Funktionstest_XIX_Grundumfang_XIX_Klima <-> outer port SP_IF_PCU_Funktionstest_XIX_Klima
    delegate Grundumfang_XIX_Klima.SP_IF_PCU_Geblaese_Status_XIX_Grundumfang_XIX_Klima <-> outer port SP_IF_PCU_Geblaese_Status_XIX_Klima
    delegate Grundumfang_XIX_Klima.SP_IF_PCU_Innen_Temp_XIX_Grundumfang_XIX_Klima <-> outer port SP_IF_PCU_Innen_Temp_XIX_Klima
    delegate Grundumfang_XIX_Klima.SP_IF_PCU_Kennlinie_XIX_Grundumfang_XIX_Klima <-> outer port SP_IF_PCU_Kennlinie_XIX_Klima
    delegate Grundumfang_XIX_Klima.SP_IF_PCU_Umluftklappe_Status_XIX_Grundumfang_XIX_Klima <-> outer port SP_IF_PCU_Umluftklappe_Status_XIX_Klima
    delegate Grundumfang_XIX_Klima.SP_IF_Scheibenreinigung_XIX_Grundumfang_XIX_Klima <-> outer port SP_IF_Scheibenreinigung_XIX_Klima
    delegate Grundumfang_XIX_Klima.SP_IF_SI_T_Mode_XIX_Grundumfang_XIX_Klima <-> outer port SP_IF_SI_T_Mode_XIX_Klima
    delegate Grundumfang_XIX_Klima.SP_IF_SI_T_Schutz_XIX_Grundumfang_XIX_Klima <-> outer port SP_IF_SI_T_Schutz_XIX_Klima
    delegate Grundumfang_XIX_Klima.SP_IF_SIL_Stufe_LED_HL_XIX_Grundumfang_XIX_Klima <-> outer port SP_IF_SIL_Stufe_LED_HL_XIX_Klima
    delegate Grundumfang_XIX_Klima.SP_IF_SIL_Stufe_LED_HR_XIX_Grundumfang_XIX_Klima <-> outer port SP_IF_SIL_Stufe_LED_HR_XIX_Klima
    delegate Grundumfang_XIX_Klima.SP_IF_SOK_FoD_Klima_Req_Challenge_XIX_Grundumfang_XIX_Klima <-> outer port SP_IF_SOK_FoD_Klima_Req_Challenge_XIX_Klima
    delegate Grundumfang_XIX_Klima.SP_IF_Soll_Lehne_LLR_li_1_XIX_Grundumfang_XIX_Klima <-> outer port SP_IF_Soll_Lehne_LLR_li_1_XIX_Klima
    delegate Grundumfang_XIX_Klima.SP_IF_Soll_Lehne_LLR_li_2_XIX_Grundumfang_XIX_Klima <-> outer port SP_IF_Soll_Lehne_LLR_li_2_XIX_Klima
    delegate Grundumfang_XIX_Klima.SP_IF_Soll_Lehne_LLR_re_1_XIX_Grundumfang_XIX_Klima <-> outer port SP_IF_Soll_Lehne_LLR_re_1_XIX_Klima
    delegate Grundumfang_XIX_Klima.SP_IF_Soll_Lehne_LLR_re_2_XIX_Grundumfang_XIX_Klima <-> outer port SP_IF_Soll_Lehne_LLR_re_2_XIX_Klima
    delegate Grundumfang_XIX_Klima.SP_IF_Soll_Sitz_LLR_li_1_XIX_Grundumfang_XIX_Klima <-> outer port SP_IF_Soll_Sitz_LLR_li_1_XIX_Klima
    delegate Grundumfang_XIX_Klima.SP_IF_Soll_Sitz_LLR_li_2_XIX_Grundumfang_XIX_Klima <-> outer port SP_IF_Soll_Sitz_LLR_li_2_XIX_Klima
    delegate Grundumfang_XIX_Klima.SP_IF_Soll_Sitz_LLR_re_1_XIX_Grundumfang_XIX_Klima <-> outer port SP_IF_Soll_Sitz_LLR_re_1_XIX_Klima
    delegate Grundumfang_XIX_Klima.SP_IF_Soll_Sitz_LLR_re_2_XIX_Grundumfang_XIX_Klima <-> outer port SP_IF_Soll_Sitz_LLR_re_2_XIX_Klima
    delegate Grundumfang_XIX_Klima.SP_IF_STRG1_Adresse_Aktuator_XIX_Grundumfang_XIX_Klima <-> outer port SP_IF_STRG1_Adresse_Aktuator_XIX_Klima
    delegate Grundumfang_XIX_Klima.SP_IF_STRG1_Geschwindigkeitsvorgabe_XIX_Grundumfang_XIX_Klima <-> outer port SP_IF_STRG1_Geschwindigkeitsvorgabe_XIX_Klima
    delegate Grundumfang_XIX_Klima.SP_IF_STRG1_Notlauffreigabe_XIX_Grundumfang_XIX_Klima <-> outer port SP_IF_STRG1_Notlauffreigabe_XIX_Klima
    delegate Grundumfang_XIX_Klima.SP_IF_STRG1_Select_Positionsvorgabe_XIX_Grundumfang_XIX_Klima <-> outer port SP_IF_STRG1_Select_Positionsvorgabe_XIX_Klima
    delegate Grundumfang_XIX_Klima.SP_IF_STRG1_Soll_Position_Aktuator_XIX_Grundumfang_XIX_Klima <-> outer port SP_IF_STRG1_Soll_Position_Aktuator_XIX_Klima
    delegate Grundumfang_XIX_Klima.SP_IF_STRG1_Spulenbestromung_XIX_Grundumfang_XIX_Klima <-> outer port SP_IF_STRG1_Spulenbestromung_XIX_Klima
    delegate Grundumfang_XIX_Klima.SP_IF_STRG4_Adresse_Aktuator_XIX_Grundumfang_XIX_Klima <-> outer port SP_IF_STRG4_Adresse_Aktuator_XIX_Klima
    delegate Grundumfang_XIX_Klima.SP_IF_STRG4_Clear_Event_Flags_XIX_Grundumfang_XIX_Klima <-> outer port SP_IF_STRG4_Clear_Event_Flags_XIX_Klima
    delegate Grundumfang_XIX_Klima.SP_IF_STRG4_Drehrichtung_XIX_Grundumfang_XIX_Klima <-> outer port SP_IF_STRG4_Drehrichtung_XIX_Klima
    delegate Grundumfang_XIX_Klima.SP_IF_STRG4_Freigabe_Blockiererkennung_XIX_Grundumfang_XIX_Klima <-> outer port SP_IF_STRG4_Freigabe_Blockiererkennung_XIX_Klima
    delegate Grundumfang_XIX_Klima.SP_IF_STRG4_Geschwindigkeitsvorgabe_XIX_Grundumfang_XIX_Klima <-> outer port SP_IF_STRG4_Geschwindigkeitsvorgabe_XIX_Klima
    delegate Grundumfang_XIX_Klima.SP_IF_STRG4_Notlauffreigabe_XIX_Grundumfang_XIX_Klima <-> outer port SP_IF_STRG4_Notlauffreigabe_XIX_Klima
    delegate Grundumfang_XIX_Klima.SP_IF_STRG4_Notlaufposition_XIX_Grundumfang_XIX_Klima <-> outer port SP_IF_STRG4_Notlaufposition_XIX_Klima
    delegate Grundumfang_XIX_Klima.SP_IF_STRG4_Programmierdaten_speichern_XIX_Grundumfang_XIX_Klima <-> outer port SP_IF_STRG4_Programmierdaten_speichern_XIX_Klima
    delegate Grundumfang_XIX_Klima.SP_IF_STRG4_Select_Positionsvorgabe_XIX_Grundumfang_XIX_Klima <-> outer port SP_IF_STRG4_Select_Positionsvorgabe_XIX_Klima
    delegate Grundumfang_XIX_Klima.SP_IF_STRG4_Soll_Position_Aktuator_XIX_Grundumfang_XIX_Klima <-> outer port SP_IF_STRG4_Soll_Position_Aktuator_XIX_Klima
    delegate Grundumfang_XIX_Klima.SP_IF_STRG4_Spulenbestromung_XIX_Grundumfang_XIX_Klima <-> outer port SP_IF_STRG4_Spulenbestromung_XIX_Klima
    delegate Grundumfang_XIX_Klima.SP_IF_STRG4_Start_Position_Aktuator_XIX_Grundumfang_XIX_Klima <-> outer port SP_IF_STRG4_Start_Position_Aktuator_XIX_Klima
    delegate Grundumfang_XIX_Klima.SP_IF_STRG4_Stopmodus_XIX_Grundumfang_XIX_Klima <-> outer port SP_IF_STRG4_Stopmodus_XIX_Klima
    delegate Grundumfang_XIX_Klima.SP_IF_Thermo_Pred_Innen_Kunde_Anf_XIX_Grundumfang_XIX_Klima <-> outer port SP_IF_Thermo_Pred_Innen_Kunde_Anf_XIX_Klima
