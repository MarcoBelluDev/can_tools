[part 16 of 23: packages /PDU to /Gateway]
AUTOSAR XML (schema 4-3-0)
package /PDU
  dcm i pdu DCM_E3V_EVCANFD_XIX_TPCHType_CANFD_ISO_Diagnose_XIX_0x1C400046_XIX_0x1C420046_XIX_Physical: length=512, diag-pdu-type=DIAG-REQUEST
  dcm i pdu DCM_E3V_EVCANFD_XIX_TPCHType_CANFD_ISO_Diagnose_XIX_0x1C410000_XIX_Functional: length=62, diag-pdu-type=DIAG-REQUEST
  dcm i pdu DCM_E3V_EVCANFD_XIX_TPCHType_CANFD_ISO_Diagnose_XIX_0x1C420046_XIX_0x1C400046_XIX_Physical: length=512, diag-pdu-type=DIAG-RESPONSE
  dcm i pdu DCM_E3V_EVCANFD_XIX_TPCHType_CANFD_OBDC_Diagnose_XIX_0x1C400246_XIX_0x1C420246_XIX_Physical: length=512, diag-pdu-type=DIAG-REQUEST
  dcm i pdu DCM_E3V_EVCANFD_XIX_TPCHType_CANFD_OBDC_Diagnose_XIX_0x1C410200_XIX_Functional: length=62, diag-pdu-type=DIAG-REQUEST
  dcm i pdu DCM_E3V_EVCANFD_XIX_TPCHType_CANFD_OBDC_Diagnose_XIX_0x1C420246_XIX_0x1C400246_XIX_Physical: length=512, diag-pdu-type=DIAG-RESPONSE
  dcm i pdu DCM_E3V_EVCANFD_XIX_TPCHType_CANHS_ISO_Diagnose_XIX_0x700_XIX_Functional: length=7, diag-pdu-type=DIAG-REQUEST
  dcm i pdu DCM_E3V_EVCANFD_XIX_TPCHType_CANHS_ISO_Diagnose_XIX_0x746_XIX_0x7B0_XIX_Physical: length=512, diag-pdu-type=DIAG-REQUEST
  dcm i pdu DCM_E3V_EVCANFD_XIX_TPCHType_CANHS_ISO_Diagnose_XIX_0x7B0_XIX_0x746_XIX_Physical: length=512, diag-pdu-type=DIAG-RESPONSE
  dcm i pdu DCM_E3V_EVCANFD_XIX_TPCHType_CANHS_OBDx_XIX_0x18DA0AF1_XIX_0x18DAF10A_XIX_Physical: length=512, diag-pdu-type=DIAG-REQUEST
  dcm i pdu DCM_E3V_EVCANFD_XIX_TPCHType_CANHS_OBDx_XIX_0x18DAF10A_XIX_0x18DA0AF1_XIX_Physical: length=512, diag-pdu-type=DIAG-RESPONSE
  dcm i pdu DCM_E3V_EVCANFD_XIX_TPCHType_CANHS_OBDx_XIX_0x18DB33F1_XIX_Functional: length=7, diag-pdu-type=DIAG-REQUEST
  dcm i pdu DCM_Klima_LIN1_XIX_TPCHType_LIN_Diagnose_XIX_0x0_XIX_0x1A_XIX_Physical: length=128
  dcm i pdu DCM_Klima_LIN1_XIX_TPCHType_LIN_Diagnose_XIX_0x0_XIX_0x40_XIX_Physical: length=128
  dcm i pdu DCM_Klima_LIN1_XIX_TPCHType_LIN_Diagnose_XIX_0x0_XIX_0x43_XIX_Physical: length=128
  dcm i pdu DCM_Klima_LIN1_XIX_TPCHType_LIN_Diagnose_XIX_0x0_XIX_0x50_XIX_Physical: length=128
  dcm i pdu DCM_Klima_LIN1_XIX_TPCHType_LIN_Diagnose_XIX_0x0_XIX_0x64_XIX_Physical: length=128
  dcm i pdu DCM_Klima_LIN1_XIX_TPCHType_LIN_Diagnose_XIX_0x0_XIX_0xA_XIX_Physical: length=128
  dcm i pdu DCM_Klima_LIN1_XIX_TPCHType_LIN_Diagnose_XIX_0x1A_XIX_0x0_XIX_Physical: length=128
  dcm i pdu DCM_Klima_LIN1_XIX_TPCHType_LIN_Diagnose_XIX_0x40_XIX_0x0_XIX_Physical: length=128
  dcm i pdu DCM_Klima_LIN1_XIX_TPCHType_LIN_Diagnose_XIX_0x43_XIX_0x0_XIX_Physical: length=128
  dcm i pdu DCM_Klima_LIN1_XIX_TPCHType_LIN_Diagnose_XIX_0x50_XIX_0x0_XIX_Physical: length=128
  dcm i pdu DCM_Klima_LIN1_XIX_TPCHType_LIN_Diagnose_XIX_0x64_XIX_0x0_XIX_Physical: length=128
  dcm i pdu DCM_Klima_LIN1_XIX_TPCHType_LIN_Diagnose_XIX_0xA_XIX_0x0_XIX_Physical: length=128
  dcm i pdu DCM_Klima_LIN2_XIX_TPCHType_LIN_Diagnose_XIX_0x0_XIX_0x10_XIX_Physical: length=128
  dcm i pdu DCM_Klima_LIN2_XIX_TPCHType_LIN_Diagnose_XIX_0x0_XIX_0x15_XIX_Physical: length=128
  dcm i pdu DCM_Klima_LIN2_XIX_TPCHType_LIN_Diagnose_XIX_0x0_XIX_0x{17..22}_XIX_Physical: length=128
  dcm i pdu DCM_Klima_LIN2_XIX_TPCHType_LIN_Diagnose_XIX_0x0_XIX_0x6D_XIX_Physical: length=128
  dcm i pdu DCM_Klima_LIN2_XIX_TPCHType_LIN_Diagnose_XIX_0x0_XIX_0xD_XIX_Physical: length=128
  dcm i pdu DCM_Klima_LIN2_XIX_TPCHType_LIN_Diagnose_XIX_0x0_XIX_0xF_XIX_Physical: length=128
  dcm i pdu DCM_Klima_LIN2_XIX_TPCHType_LIN_Diagnose_XIX_0x10_XIX_0x0_XIX_Physical: length=128
  dcm i pdu DCM_Klima_LIN2_XIX_TPCHType_LIN_Diagnose_XIX_0x15_XIX_0x0_XIX_Physical: length=128
  dcm i pdu DCM_Klima_LIN2_XIX_TPCHType_LIN_Diagnose_XIX_0x{17..22}_XIX_0x0_XIX_Physical: length=128
  dcm i pdu DCM_Klima_LIN2_XIX_TPCHType_LIN_Diagnose_XIX_0x6D_XIX_0x0_XIX_Physical: length=128
  dcm i pdu DCM_Klima_LIN2_XIX_TPCHType_LIN_Diagnose_XIX_0xD_XIX_0x0_XIX_Physical: length=128
  dcm i pdu DCM_Klima_LIN2_XIX_TPCHType_LIN_Diagnose_XIX_0xF_XIX_0x0_XIX_Physical: length=128
  dcm i pdu DCM_Klima_LIN3_XIX_TPCHType_LIN_Diagnose_XIX_0x0_XIX_0x{14..16}_XIX_Physical: length=128
  dcm i pdu DCM_Klima_LIN3_XIX_TPCHType_LIN_Diagnose_XIX_0x0_XIX_0x20_XIX_Physical: length=128
  dcm i pdu DCM_Klima_LIN3_XIX_TPCHType_LIN_Diagnose_XIX_0x0_XIX_0x39_XIX_Physical: length=128
  dcm i pdu DCM_Klima_LIN3_XIX_TPCHType_LIN_Diagnose_XIX_0x0_XIX_0x5E_XIX_Physical: length=128
  dcm i pdu DCM_Klima_LIN3_XIX_TPCHType_LIN_Diagnose_XIX_0x0_XIX_0x5F_XIX_Physical: length=128
  dcm i pdu DCM_Klima_LIN3_XIX_TPCHType_LIN_Diagnose_XIX_0x0_XIX_0x61_XIX_Physical: length=128
  dcm i pdu DCM_Klima_LIN3_XIX_TPCHType_LIN_Diagnose_XIX_0x0_XIX_0x63_XIX_Physical: length=128
  dcm i pdu DCM_Klima_LIN3_XIX_TPCHType_LIN_Diagnose_XIX_0x{14..16}_XIX_0x0_XIX_Physical: length=128
  dcm i pdu DCM_Klima_LIN3_XIX_TPCHType_LIN_Diagnose_XIX_0x20_XIX_0x0_XIX_Physical: length=128
  dcm i pdu DCM_Klima_LIN3_XIX_TPCHType_LIN_Diagnose_XIX_0x39_XIX_0x0_XIX_Physical: length=128
  dcm i pdu DCM_Klima_LIN3_XIX_TPCHType_LIN_Diagnose_XIX_0x5E_XIX_0x0_XIX_Physical: length=128
  dcm i pdu DCM_Klima_LIN3_XIX_TPCHType_LIN_Diagnose_XIX_0x5F_XIX_0x0_XIX_Physical: length=128
  dcm i pdu DCM_Klima_LIN3_XIX_TPCHType_LIN_Diagnose_XIX_0x61_XIX_0x0_XIX_Physical: length=128
  dcm i pdu DCM_Klima_LIN3_XIX_TPCHType_LIN_Diagnose_XIX_0x63_XIX_0x0_XIX_Physical: length=128
  dcm i pdu DCM_Klima_LIN4_XIX_TPCHType_LIN_Diagnose_XIX_0x0_XIX_0x15_XIX_Physical: length=128
  dcm i pdu DCM_Klima_LIN4_XIX_TPCHType_LIN_Diagnose_XIX_0x0_XIX_0x17_XIX_Physical: length=128
  dcm i pdu DCM_Klima_LIN4_XIX_TPCHType_LIN_Diagnose_XIX_0x0_XIX_0x4E_XIX_Physical: length=128
  dcm i pdu DCM_Klima_LIN4_XIX_TPCHType_LIN_Diagnose_XIX_0x0_XIX_0x50_XIX_Physical: length=128
  dcm i pdu DCM_Klima_LIN4_XIX_TPCHType_LIN_Diagnose_XIX_0x0_XIX_0xD_XIX_Physical: length=128
  dcm i pdu DCM_Klima_LIN4_XIX_TPCHType_LIN_Diagnose_XIX_0x0_XIX_0xF_XIX_Physical: length=128
  dcm i pdu DCM_Klima_LIN4_XIX_TPCHType_LIN_Diagnose_XIX_0x15_XIX_0x0_XIX_Physical: length=128
  dcm i pdu DCM_Klima_LIN4_XIX_TPCHType_LIN_Diagnose_XIX_0x17_XIX_0x0_XIX_Physical: length=128
  dcm i pdu DCM_Klima_LIN4_XIX_TPCHType_LIN_Diagnose_XIX_0x4E_XIX_0x0_XIX_Physical: length=128
  dcm i pdu DCM_Klima_LIN4_XIX_TPCHType_LIN_Diagnose_XIX_0x50_XIX_0x0_XIX_Physical: length=128
  dcm i pdu DCM_Klima_LIN4_XIX_TPCHType_LIN_Diagnose_XIX_0xD_XIX_0x0_XIX_Physical: length=128
  dcm i pdu DCM_Klima_LIN4_XIX_TPCHType_LIN_Diagnose_XIX_0xF_XIX_0x0_XIX_Physical: length=128
  dcm i pdu DCM_Klima_LIN5_XIX_TPCHType_LIN_Diagnose_XIX_0x0_XIX_0x{20..27}_XIX_Physical: length=128
  dcm i pdu DCM_Klima_LIN5_XIX_TPCHType_LIN_Diagnose_XIX_0x{20..27}_XIX_0x0_XIX_Physical: length=128
  dcm i pdu DCM_Klima_LIN6_XIX_TPCHType_LIN_Diagnose_XIX_0x0_XIX_0x1_XIX_Physical: length=128
  dcm i pdu DCM_Klima_LIN6_XIX_TPCHType_LIN_Diagnose_XIX_0x0_XIX_0x23_XIX_Physical: length=128
  dcm i pdu DCM_Klima_LIN6_XIX_TPCHType_LIN_Diagnose_XIX_0x0_XIX_0x{25..28}_XIX_Physical: length=128
  dcm i pdu DCM_Klima_LIN6_XIX_TPCHType_LIN_Diagnose_XIX_0x0_XIX_0x2_XIX_Physical: length=128
  dcm i pdu DCM_Klima_LIN6_XIX_TPCHType_LIN_Diagnose_XIX_0x0_XIX_0x3_XIX_Physical: length=128
  dcm i pdu DCM_Klima_LIN6_XIX_TPCHType_LIN_Diagnose_XIX_0x0_XIX_0x43_XIX_Physical: length=128
  dcm i pdu DCM_Klima_LIN6_XIX_TPCHType_LIN_Diagnose_XIX_0x1_XIX_0x0_XIX_Physical: length=128
  dcm i pdu DCM_Klima_LIN6_XIX_TPCHType_LIN_Diagnose_XIX_0x23_XIX_0x0_XIX_Physical: length=128
  dcm i pdu DCM_Klima_LIN6_XIX_TPCHType_LIN_Diagnose_XIX_0x{25..28}_XIX_0x0_XIX_Physical: length=128
  dcm i pdu DCM_Klima_LIN6_XIX_TPCHType_LIN_Diagnose_XIX_0x2_XIX_0x0_XIX_Physical: length=128
  dcm i pdu DCM_Klima_LIN6_XIX_TPCHType_LIN_Diagnose_XIX_0x3_XIX_0x0_XIX_Physical: length=128
  dcm i pdu DCM_Klima_LIN6_XIX_TPCHType_LIN_Diagnose_XIX_0x43_XIX_0x0_XIX_Physical: length=128
  dcm i pdu DCM_Klima_LIN7_XIX_TPCHType_LIN_Diagnose_XIX_0x0_XIX_0x2_XIX_Physical: length=128
  dcm i pdu DCM_Klima_LIN7_XIX_TPCHType_LIN_Diagnose_XIX_0x0_XIX_0x37_XIX_Physical: length=128
  dcm i pdu DCM_Klima_LIN7_XIX_TPCHType_LIN_Diagnose_XIX_0x0_XIX_0x4E_XIX_Physical: length=128
  dcm i pdu DCM_Klima_LIN7_XIX_TPCHType_LIN_Diagnose_XIX_0x0_XIX_0x50_XIX_Physical: length=128
  dcm i pdu DCM_Klima_LIN7_XIX_TPCHType_LIN_Diagnose_XIX_0x0_XIX_0x63_XIX_Physical: length=128
  dcm i pdu DCM_Klima_LIN7_XIX_TPCHType_LIN_Diagnose_XIX_0x2_XIX_0x0_XIX_Physical: length=128
  dcm i pdu DCM_Klima_LIN7_XIX_TPCHType_LIN_Diagnose_XIX_0x37_XIX_0x0_XIX_Physical: length=128
  dcm i pdu DCM_Klima_LIN7_XIX_TPCHType_LIN_Diagnose_XIX_0x4E_XIX_0x0_XIX_Physical: length=128
  dcm i pdu DCM_Klima_LIN7_XIX_TPCHType_LIN_Diagnose_XIX_0x50_XIX_0x0_XIX_Physical: length=128
  dcm i pdu DCM_Klima_LIN7_XIX_TPCHType_LIN_Diagnose_XIX_0x63_XIX_0x0_XIX_Physical: length=128
  pdu Klima_EV_10_XIX_E3V_EVCANFD: length=8, transmission-mode-true-timing=cyclic-timing={time-offset=0, time-period=0.5}, unused-bit-pattern=0
    signal KL_OBD_Status_Auth_XIX_Klima_EV_10_XIX_E3V_EVCANFD: start 12, 1 bit, little-endian, data-type-policy=OVERRIDE, i-signal-type=PRIMITIVE, init-value=0, base-type=BT_KL_OBD_Status_Auth, compu {0=Cx0_MILaus (CM_KL_OBD_Status_Auth_Cx0_MILaus), 1=Cx1_MILan (CM_KL_OBD_Status_Auth_Cx1_MILan)}, range raw 0..1, transfer-property=PENDING  # Ansteuerung der MIL-Lampe über den MIL-Master (Motorsteuergerät) Redundantes Signal (SOK gesichert) zu KL_OBD_Status
    signal OBDProtocol_Klima_XIX_Klima_EV_10_XIX_E3V_EVCANFD: start 16, 4 bit, little-endian, data-type-policy=OVERRIDE, i-signal-type=PRIMITIVE, init-value=14, base-type=BT_OBDProtocol_Klima, invalid-value=Invalid_OBDProtocol_Klima_XIX_Klima_EV_10_XIX_E3V_EVCANFD:15, compu {0=Cx0_not_available (CM_OBDProtocol_Klima_Cx0_not_available), 1=Cx1_OBDclassic (CM_OBDProtocol_Klima_Cx1_OBDclassic), 2=Cx2_OBDonUDS (CM_OBDProtocol_Klima_Cx2_OBDonUDS), 3=Cx3_ZEVonUDS (CM_OBDProtocol_Klima_Cx3_ZEVonUDS), 4=Cx4_noOBD (CM_OBDProtocol_Klima_Cx4_noOBD), 14=Cxe_Init (CM_OBDProtocol_Klima_Cxe_Init), 15=Cxf_Fehler (CM_OBDProtocol_Klima_Cxf_Fehler)}, range raw 0..15, transfer-property=PENDING  # OBD protocol response 'used OBD protocol' from PrimaryOBDECUs to MIL_Master
    signal KL_SoSe_Intensitaet_FS_XIX_Klima_EV_10_XIX_E3V_EVCANFD: start 22, 6 bit, little-endian, data-type-policy=OVERRIDE, i-signal-type=PRIMITIVE, init-value=62, base-type=BT_KL_SoSe_Intensitaet_FS, invalid-value=Invalid_KL_SoSe_Intensitaet_FS_XIX_Klima_EV_10_XIX_E3V_EVCANFD:63, compu {phys=raw*20 for raw 0..60, 62=Cx3e_init (CM_KL_SoSe_Intensitaet_FS_Cx3e_init), 63=Cx3f_Fehler (CM_KL_SoSe_Intensitaet_FS_Cx3f_Fehler); unit Unit_WattPerMeterSquar}, range phys 0..1200 Unit_WattPerMeterSquar, raw 0..63, unit=Unit_WattPerMeterSquar, transfer-property=PENDING  # Sonnenintensität Fahrerseite wird vom Klima-SG aus dem SoSe-CAN-Signal generiert
    signal KL_SoSe_Intensitaet_BFS_XIX_Klima_EV_10_XIX_E3V_EVCANFD: start 28, 6 bit, little-endian, data-type-policy=OVERRIDE, i-signal-type=PRIMITIVE, init-value=62, base-type=BT_KL_SoSe_Intensitaet_BFS, invalid-value=Invalid_KL_SoSe_Intensitaet_BFS_XIX_Klima_EV_10_XIX_E3V_EVCANFD:63, compu {phys=raw*20 for raw 0..60, 62=Cx3e_init (CM_KL_SoSe_Intensitaet_BFS_Cx3e_init), 63=Cx3f_Fehler (CM_KL_SoSe_Intensitaet_BFS_Cx3f_Fehler); unit Unit_WattPerMeterSquar}, range phys 0..1200 Unit_WattPerMeterSquar, raw 0..63, unit=Unit_WattPerMeterSquar, transfer-property=PENDING  # Sonnenintensität Beifahrerseite wird vom Klima-SG aus dem SoSe-CAN-Signal generiert
    signal PCU_FSA_Luftfeuchte_rel_XIX_Klima_EV_10_XIX_E3V_EVCANFD: start 56, 8 bit, little-endian, data-type-policy=OVERRIDE, i-signal-type=PRIMITIVE, init-value=254, base-type=BT_PCU_FSA_Luftfeuchte_rel, invalid-value=Invalid_PCU_FSA_Luftfeuchte_rel_XIX_Klima_EV_10_XIX_E3V_EVCANFD:255, compu {phys=raw*0.5 for raw 0..252, 253=Cxfd_nicht_verbaut (CM_PCU_FSA_Luftfeuchte_rel_Cxfd_nicht_verbaut), 254=Cxfe_Init (CM_PCU_FSA_Luftfeuchte_rel_Cxfe_Init), 255=Cxff_Fehler (CM_PCU_FSA_Luftfeuchte_rel_Cxff_Fehler); unit Unit_PerCent}, range phys 0..126 Unit_PerCent, raw 0..255, unit=Unit_PerCent, transfer-property=PENDING  # Luftfeuchte außen
  pdu Motor_26_Mx00_XIX_E3V_EVCANFD: length=8, transmission-mode-true-timing={cyclic-timing={time-offset=0, time-period=0.2}, event-controlled-timing={number-of-repetitions=0, repetition-period=0.0}}, unused-bit-pattern=0  # MQB - vorher Motor_06 / Umbenennung wg. ID-Wechsel
    signal MO_Kuehlerluefter_MUX_XIX_Motor_26_Mx00_XIX_E3V_EVCANFD: start 0, 1 bit, little-endian, data-type-policy=OVERRIDE, i-signal-type=PRIMITIVE, init-value=0, base-type=BT_MO_Kuehlerluefter_MUX, compu {0=Cx0_Kuehlerluefter_1 (CM_MO_Kuehlerluefter_MUX_Cx0_Kuehlerluefter_1), 1=Cx1_Kuehlerluefter_2 (CM_MO_Kuehlerluefter_MUX_Cx1_Kuehlerluefter_2)}, range raw 0..1, to Klima(timeout 1 s)  # Multiplexer für das Signal "MO_Kuehlerlüfter"
    signal MO_Kuehlerluefter_1_XIX_Motor_26_Mx00_XIX_E3V_EVCANFD: start 1, 7 bit, little-endian, data-type-policy=OVERRIDE, i-signal-type=PRIMITIVE, init-value=126, base-type=BT_MO_Kuehlerluefter_1, invalid-value=Invalid_MO_Kuehlerluefter_1_XIX_Motor_26_XIX_E3V_EVCANFD:127, compu {phys=raw for raw 0..100, 126=Cx7e_Init (CM_MO_Kuehlerluefter_1_Cx7e_Init), 127=Cx7f_Fehler (CM_MO_Kuehlerluefter_1_Cx7f_Fehler); unit Unit_PerCent}, range phys 0..100 Unit_PerCent, raw 0..127, unit=Unit_PerCent, transfer-property=TRIGGERED, to Klima(timeout 1 s)  # Ansteuertastverhaeltnis (PWM) der Kuehlerluefterendstufe 1
  pdu Motor_26_Mx01_XIX_E3V_EVCANFD: length=8, transmission-mode-true-timing={cyclic-timing={time-offset=0.1, time-period=0.2}, event-controlled-timing={number-of-repetitions=0, repetition-period=0.0}}, unused-bit-pattern=0  # MQB - vorher Motor_06 / Umbenennung wg. ID-Wechsel
    signal MO_Kuehlerluefter_MUX_XIX_Motor_26_Mx01_XIX_E3V_EVCANFD: start 0, 1 bit, little-endian, data-type-policy=OVERRIDE, i-signal-type=PRIMITIVE, init-value=1, base-type=BT_MO_Kuehlerluefter_MUX, compu {0=Cx0_Kuehlerluefter_1 (CM_MO_Kuehlerluefter_MUX_Cx0_Kuehlerluefter_1), 1=Cx1_Kuehlerluefter_2 (CM_MO_Kuehlerluefter_MUX_Cx1_Kuehlerluefter_2)}, range raw 0..1, to Klima(timeout 1 s)  # Multiplexer für das Signal "MO_Kuehlerlüfter"
    signal MO_Kuehlerluefter_2_XIX_Motor_26_Mx01_XIX_E3V_EVCANFD: start 1, 7 bit, little-endian, data-type-policy=OVERRIDE, i-signal-type=PRIMITIVE, init-value=126, base-type=BT_MO_Kuehlerluefter_2, invalid-value=Invalid_MO_Kuehlerluefter_2_XIX_Motor_26_XIX_E3V_EVCANFD:127, compu {phys=raw for raw 0..100, 126=Cx7e_Init (CM_MO_Kuehlerluefter_2_Cx7e_Init), 127=Cx7f_Fehler (CM_MO_Kuehlerluefter_2_Cx7f_Fehler); unit Unit_PerCent}, range phys 0..100 Unit_PerCent, raw 0..127, unit=Unit_PerCent, transfer-property=TRIGGERED, to Klima(timeout 1 s)  # Ansteuertastverhaeltnis (PWM) der Kuehlerluefterendstufe 2
  pdu Motor_26_MxStatic_XIX_E3V_EVCANFD: length=8, transmission-mode-true-timing=cyclic-timing={time-offset=0.0, time-period=0.1}, unused-bit-pattern=0  # MQB - vorher Motor_06 / Umbenennung wg. ID-Wechsel
    signal MO_EFLEX_Lampe_XIX_Motor_26_MxStatic_XIX_E3V_EVCANFD: start 8, 2 bit, little-endian, data-type-policy=OVERRIDE, i-signal-type=PRIMITIVE, init-value=0, base-type=BT_MO_EFLEX_Lampe, compu {0=Cx0_Lampe_aus (CM_MO_EFLEX_Lampe_Cx0_Lampe_aus), 1=Cx1_Lampe_ein (CM_MO_EFLEX_Lampe_Cx1_Lampe_ein), 2=Cx2_Lampe_blinkend (CM_MO_EFLEX_Lampe_Cx2_Lampe_blinkend), 3=Cx3_Lampe_blinkend_mit_Akustik (CM_MO_EFLEX_Lampe_Cx3_Lampe_blinkend_mit_Akustik)}, range raw 0..3, transfer-property=PENDING  # Um ein Starten mit E100 zu ermöglichen, wird Kraftstoff ggf. vorgeheizt. Das Signal dient der Anzeige des Heizungsstatus. Heizung aus -> Lampe aus Heizung ein -> Lampe ein Heizung ein und Startversuch -> Lampe blinkend Heizung nicht möglich -> Lampe blinkend & Akustik
    signal MO_KJS_nicht_bereit_XIX_Motor_26_MxStatic_XIX_E3V_EVCANFD: start 10, 1 bit, little-endian, data-type-policy=OVERRIDE, i-signal-type=PRIMITIVE, init-value=0, base-type=BT_MO_KJS_nicht_bereit, invalid-value=Invalid_MO_KJS_nicht_bereit_XIX_Motor_26_XIX_E3V_EVCANFD:1, compu {0=Cx0_kein_Fehler (CM_MO_KJS_nicht_bereit_Cx0_kein_Fehler), 1=Cx1_Fehler (CM_MO_KJS_nicht_bereit_Cx1_Fehler)}, range raw 0..1, transfer-property=PENDING  # Dieses Signal zeigen einen Fehler der Kühlerjalousie mit unbekannter Stellung der Lamellen.
    signal MO_ITM_Warnung_Pumpe_XIX_Motor_26_MxStatic_XIX_E3V_EVCANFD: start 11, 1 bit, little-endian, data-type-policy=OVERRIDE, i-signal-type=PRIMITIVE, init-value=0, base-type=BT_MO_ITM_Warnung_Pumpe, compu {0=Cx0_keine_Warnung (CM_MO_ITM_Warnung_Pumpe_Cx0_keine_Warnung), 1=Cx1_ITM_Warnung (CM_MO_ITM_Warnung_Pumpe_Cx1_ITM_Warnung)}, range raw 0..1, transfer-property=PENDING  # Textanzeige: "Motor sofort abstellen, geschaltete Wasserpumpe defekt / klemmt"
    signal WIV_Anzeige_aktiv_XIX_Motor_26_MxStatic_XIX_E3V_EVCANFD: start 12, 1 bit, little-endian, data-type-policy=OVERRIDE, i-signal-type=PRIMITIVE, init-value=0, base-type=BT_WIV_Anzeige_aktiv, compu {0=Cx0_Anzeige_aus (CM_WIV_Anzeige_aktiv_Cx0_Anzeige_aus) (Anzeige aus), 1=Cx1_WIV_Anzeige_aktiv (CM_WIV_Anzeige_aktiv_Cx1_WIV_Anzeige_aktiv) (WIV Anzeige aktiv)}, range raw 0..1, transfer-property=PENDING  # Peilstabsanzeigefunktion aktiv
    signal WIV_Oelmin_Warn_XIX_Motor_26_MxStatic_XIX_E3V_EVCANFD: start 13, 1 bit, little-endian, data-type-policy=OVERRIDE, i-signal-type=PRIMITIVE, init-value=0, base-type=BT_WIV_Oelmin_Warn, compu {0=Cx0_in_Ordnung (CM_WIV_Oelmin_Warn_Cx0_in_Ordnung), 1=Cx1_Warnung (CM_WIV_Oelmin_Warn_Cx1_Warnung)}, range raw 0..1, transfer-property=PENDING  # Signal gibt an wenn der Ölstand die Min-Schwelle unterschritten hat
    signal WIV_Sensorfehler_XIX_Motor_26_MxStatic_XIX_E3V_EVCANFD: start 14, 1 bit, little-endian, data-type-policy=OVERRIDE, i-signal-type=PRIMITIVE, init-value=0, base-type=BT_WIV_Sensorfehler, compu {0=Cx0_in_Ordnung (CM_WIV_Sensorfehler_Cx0_in_Ordnung), 1=Cx1_Sensor_defekt (CM_WIV_Sensorfehler_Cx1_Sensor_defekt)}, range raw 0..1, transfer-property=PENDING  # Ölstand/Öltemperatursensor (TOG) defekt
    signal WIV_Schieflage_XIX_Motor_26_MxStatic_XIX_E3V_EVCANFD: start 15, 1 bit, little-endian, data-type-policy=OVERRIDE, i-signal-type=PRIMITIVE, init-value=0, base-type=BT_WIV_Schieflage, compu {0=Cx0_Fahrzeug_gerade (CM_WIV_Schieflage_Cx0_Fahrzeug_gerade), 1=Cx1_Fahrzeug_in_Schieflage (CM_WIV_Schieflage_Cx1_Fahrzeug_in_Schieflage)}, range raw 0..1, transfer-property=PENDING  # Fahrzeug steht nicht waagerecht, Messung ungenau
    signal WIV_Oelstand_XIX_Motor_26_MxStatic_XIX_E3V_EVCANFD: start 16, 4 bit, little-endian, data-type-policy=OVERRIDE, i-signal-type=PRIMITIVE, init-value=0, base-type=BT_WIV_Oelstand, compu {phys=raw*12.5 for raw 0..8; unit Unit_PerCent}, range phys 0..100 Unit_PerCent, raw 0..8, unit=Unit_PerCent, transfer-property=PENDING  # 8 Segmente zur Balkenanzeige des Ölstands
    signal MO_Zustand_HWP_XIX_Motor_26_MxStatic_XIX_E3V_EVCANFD: start 20, 2 bit, little-endian, data-type-policy=OVERRIDE, i-signal-type=PRIMITIVE, init-value=1, base-type=BT_MO_Zustand_HWP, compu {0=Cx0_HWP_nicht_schaltbar (CM_MO_Zustand_HWP_Cx0_HWP_nicht_schaltbar), 1=Cx1_HWP_foerdert_nicht (CM_MO_Zustand_HWP_Cx1_HWP_foerdert_nicht), 2=Cx2_HWP_foerdert (CM_MO_Zustand_HWP_Cx2_HWP_foerdert), 3=Cx3_reserviert (CM_MO_Zustand_HWP_Cx3_reserviert)}, range raw 0..3, transfer-property=PENDING  # Rückmeldung des Ansteuerzustand der Hauptwasserpumpe an das Klima-SG . Der Zustand "HWP fördert" wird übermittelt, wenn die Schaufeln der Hauptwasserpumpe frei drehen können und die Motordrehzahl und damit die Wasserpumpendrehzahl größer als Null ist. Bei einer Wasserpumpe mit Magnetkupplung ist die Kupplung im Eingriff. Bei einer Wasserpumpe mit Topf ist der Topf zurückgezogen und gibt die Schaufeln frei. Der Zustand "HWP fördert nicht" wird gesendet, wenn die Motordrehzahl und damit die Wasserpumpendrehzahl gleich Null ist (Verbrennungsmotor steht) oder wenn die Wasserpumpe nicht aktiv ist. Bei einer Pumpe mit Magnetkupplung ist in die Kupplung geöffnet, bei einer getopften Wasserpumpe befindet sich der Topf über den Schaufeln.
    signal OLEV_Systemstoerung_XIX_Motor_26_MxStatic_XIX_E3V_EVCANFD: start 22, 1 bit, little-endian, data-type-policy=OVERRIDE, i-signal-type=PRIMITIVE, init-value=0, base-type=BT_OLEV_Systemstoerung, compu {0=Cx0_oelsystem_i_O (CM_OLEV_Systemstoerung_Cx0_oelsystem_i_O) (Ölsystem i.O.), 1=Cx1_Systemstoerung_oelsystem (CM_OLEV_Systemstoerung_Cx1_Systemstoerung_oelsystem) (Systemstörung Ölsystem)}, range raw 0..1, transfer-property=PENDING  # Systemstörung im Ölsystem
    signal MO_Oelwarnung_max_XIX_Motor_26_MxStatic_XIX_E3V_EVCANFD: start 23, 1 bit, little-endian, data-type-policy=OVERRIDE, i-signal-type=PRIMITIVE, init-value=0, base-type=BT_MO_Oelwarnung_max, compu {0=Cx0_keine_Warnung (CM_MO_Oelwarnung_max_Cx0_keine_Warnung), 1=Cx1_Warnfall_aktiv (CM_MO_Oelwarnung_max_Cx1_Warnfall_aktiv)}, range raw 0..1, transfer-property=PENDING  # Ölstandswarnung mit der Aufforderung zum Ölwechsel. Hintergrund: Bei Kraftstoffeintrag (B20) ins Öl verbleibt der RME-Anteil irreversibel im Öl.
    signal WIV_Oelsystem_aktiv_XIX_Motor_26_MxStatic_XIX_E3V_EVCANFD: start 24, 1 bit, little-endian, data-type-policy=OVERRIDE, i-signal-type=PRIMITIVE, init-value=0, base-type=BT_WIV_Oelsystem_aktiv, compu {0=Cx0_Anzeige_aus (CM_WIV_Oelsystem_aktiv_Cx0_Anzeige_aus), 1=Cx1_Anzeige_aktiv (CM_WIV_Oelsystem_aktiv_Cx1_Anzeige_aktiv)}, range raw 0..1, transfer-property=PENDING  # Gesamtölsystem aktiv (entspricht Ölsensor verbaut) und das Ölstand-Untermenu im MMI aktiv
    signal WIV_nicht_betriebswarm_XIX_Motor_26_MxStatic_XIX_E3V_EVCANFD: start 25, 1 bit, little-endian, data-type-policy=OVERRIDE, i-signal-type=PRIMITIVE, init-value=0, base-type=BT_WIV_nicht_betriebswarm, compu {0=Cx0_Motor_warm (CM_WIV_nicht_betriebswarm_Cx0_Motor_warm), 1=Cx1_Motor_nicht_betriebswarm (CM_WIV_nicht_betriebswarm_Cx1_Motor_nicht_betriebswarm)}, range raw 0..1, transfer-property=PENDING  # Motor nicht betriebswarm, Messung ungenau
    signal WIV_Ueberfuell_Warn_XIX_Motor_26_MxStatic_XIX_E3V_EVCANFD: start 26, 1 bit, little-endian, data-type-policy=OVERRIDE, i-signal-type=PRIMITIVE, init-value=0, base-type=BT_WIV_Ueberfuell_Warn, compu {0=Cx0_in_Ordnung (CM_WIV_Ueberfuell_Warn_Cx0_in_Ordnung), 1=Cx1_Ueberfuellwarnung (CM_WIV_Ueberfuell_Warn_Cx1_Ueberfuellwarnung)}, range raw 0..1, transfer-property=PENDING  # Ölstand hat die Überfüllschwelle überschritten
    signal WIV_laufender_Motor_XIX_Motor_26_MxStatic_XIX_E3V_EVCANFD: start 27, 1 bit, little-endian, data-type-policy=OVERRIDE, i-signal-type=PRIMITIVE, init-value=0, base-type=BT_WIV_laufender_Motor, compu {0=Cx0_Messung_moeglich (CM_WIV_laufender_Motor_Cx0_Messung_moeglich), 1=Cx1_Messung_nicht_moeglich (CM_WIV_laufender_Motor_Cx1_Messung_nicht_moeglich)}, range raw 0..1, transfer-property=PENDING  # Messung bei laufendem Motor nicht möglich
    signal MO_E_Warnungen_XIX_Motor_26_MxStatic_XIX_E3V_EVCANFD: start 28, 4 bit, little-endian, data-type-policy=OVERRIDE, i-signal-type=PRIMITIVE, init-value=0, base-type=BT_MO_E_Warnungen, compu {0=Cx0_keine_Anzeige (CM_MO_E_Warnungen_Cx0_keine_Anzeige), 1=Cx1_Fehler_Elektrosystem_Anhalten (CM_MO_E_Warnungen_Cx1_Fehler_Elektrosystem_Anhalten), 2=Cx2_Fehler_Elektrosystem_Werkstatt (CM_MO_E_Warnungen_Cx2_Fehler_Elektrosystem_Werkstatt), 3=Cx3_Elektrosystem_ueberhitzt_Stopp (CM_MO_E_Warnungen_Cx3_Elektrosystem_ueberhitzt_Stopp), 4=Cx4_Fehler_Hybridsystem_Anhalten (CM_MO_E_Warnungen_Cx4_Fehler_Hybridsystem_Anhalten), 5=Cx5_Fehler_Hybridsystem_Werkstatt (CM_MO_E_Warnungen_Cx5_Fehler_Hybridsystem_Werkstatt), 6=Cx6_Fehler_Wasserstoffsystem_Anhalte (CM_MO_E_Warnungen_Cx6_Fehler_Wasserstoffsystem_Anhalte), 7=Cx7_Fehler_Wasserstoffsystem_Werksta (CM_MO_E_Warnungen_Cx7_Fehler_Wasserstoffsystem_Werksta), 8=Cx8_reserviert_keine_Anzeige (CM_MO_E_Warnungen_Cx8_reserviert_keine_Anzeige), 9=Cx9_reserviert_keine_Anzeige (CM_MO_E_Warnungen_Cx9_reserviert_keine_Anzeige), 10=Cxa_reserviert_keine_Anzeige (CM_MO_E_Warnungen_Cxa_reserviert_keine_Anzeige), 11=Cxb_reserviert_keine_Anzeige (CM_MO_E_Warnungen_Cxb_reserviert_keine_Anzeige), 12=Cxc_reserviert_keine_Anzeige (CM_MO_E_Warnungen_Cxc_reserviert_keine_Anzeige), 13=Cxd_reserviert_keine_Anzeige (CM_MO_E_Warnungen_Cxd_reserviert_keine_Anzeige), 14=Cxe_reserviert_keine_Anzeige (CM_MO_E_Warnungen_Cxe_reserviert_keine_Anzeige), 15=Cxf_reserviert_keine_Anzeige (CM_MO_E_Warnungen_Cxf_reserviert_keine_Anzeige)}, range raw 0..15, transfer-property=PENDING  # Anforderung von Warnanzeigen des E-Systems separat für HEV/BEV bzw. erweiterbar für PHEV
    signal MO_Text_Motorstart_XIX_Motor_26_MxStatic_XIX_E3V_EVCANFD: start 32, 4 bit, little-endian, data-type-policy=OVERRIDE, i-signal-type=PRIMITIVE, init-value=0, base-type=BT_MO_Text_Motorstart, compu {0=Cx0_keine_Anzeige (CM_MO_Text_Motorstart_Cx0_keine_Anzeige), 1=Cx1_Motor_im_Stoppbetrieb (CM_MO_Text_Motorstart_Cx1_Motor_im_Stoppbetrieb), 2=Cx2_StartStopp_sicherheitsbedingt_deaktiviert (CM_MO_Text_Motorstart_Cx2_StartStopp_sicherheitsbedingt_deaktiviert), 3=Cx3_System_fordert_Wiederstart (CM_MO_Text_Motorstart_Cx3_System_fordert_Wiederstart), 4=Cx4_Aufforderung_Motorstart (CM_MO_Text_Motorstart_Cx4_Aufforderung_Motorstart), 5=Cx5_Motorlauf_noetig (CM_MO_Text_Motorstart_Cx5_Motorlauf_noetig), 6=Cx6_Motorlaufwarnung (CM_MO_Text_Motorstart_Cx6_Motorlaufwarnung), 9=Cx9_Unerwuenschter_Motorstillstand (CM_MO_Text_Motorstart_Cx9_Unerwuenschter_Motorstillstand), 10=Cxa_Motorstart_nicht_moeglich (CM_MO_Text_Motorstart_Cxa_Motorstart_nicht_moeglich), 11=Cxb_Fehler_Kupplungsschalter (CM_MO_Text_Motorstart_Cxb_Fehler_Kupplungsschalter), 12=Cxc_Motor_startet (CM_MO_Text_Motorstart_Cxc_Motor_startet), 13=Cxd_Kupplung_betaetigen (CM_MO_Text_Motorstart_Cxd_Kupplung_betaetigen), 14=Cxe_Waehlhebel_in_PN_Position (CM_MO_Text_Motorstart_Cxe_Waehlhebel_in_PN_Position), 15=Cxf_Bremse_treten (CM_MO_Text_Motorstart_Cxf_Bremse_treten)}, range raw 0..15, transfer-property=PENDING  # Anzeigetexte für Start/Stopp und Motor-Start 0xB Fehler_Kupplungsschalter nur für PAG-MLB
    signal MO_E_Texte_XIX_Motor_26_MxStatic_XIX_E3V_EVCANFD: start 36, 4 bit, little-endian, data-type-policy=OVERRIDE, i-signal-type=PRIMITIVE, init-value=0, base-type=BT_MO_E_Texte, compu {0=Cx0_keine_Anzeige (CM_MO_E_Texte_Cx0_keine_Anzeige), 1=Cx1_Batterie_fast_leer (CM_MO_E_Texte_Cx1_Batterie_fast_leer), 2=Cx2_Ladestecker_nicht_fahrbereit (CM_MO_E_Texte_Cx2_Ladestecker_nicht_fahrbereit), 3=Cx3_VM_Betrieb_erforderlich (CM_MO_E_Texte_Cx3_VM_Betrieb_erforderlich), 4=Cx4_Batterie_laedt_Nicht_ausschalten (CM_MO_E_Texte_Cx4_Batterie_laedt_Nicht_ausschalten), 5=Cx5_Bitte_Bremse_treten (CM_MO_E_Texte_Cx5_Bitte_Bremse_treten), 6=Cx6_manueller_Neustart_erforderlich (CM_MO_E_Texte_Cx6_manueller_Neustart_erforderlich), 7=Cx7_Stopp_Fahrzeug_nicht_abschleppen (CM_MO_E_Texte_Cx7_Stopp_Fahrzeug_nicht_abschleppen), 8=Cx8_kein_Neustart_Haube_nicht_oeffnen (CM_MO_E_Texte_Cx8_kein_Neustart_Haube_nicht_oeffnen), 9=Cx9_Motorstart_im_naechsten_Zyklus (CM_MO_E_Texte_Cx9_Motorstart_im_naechsten_Zyklus), 10=Cxa_VM_erforderlich_EVMode_abwaehlen (CM_MO_E_Texte_Cxa_VM_erforderlich_EVMode_abwaehlen), 11=Cxb_laengerer_VMBetrieb_Bordbuch (CM_MO_E_Texte_Cxb_laengerer_VMBetrieb_Bordbuch), 12=Cxc_Tank_leer_VM_nicht_verfuegbar (CM_MO_E_Texte_Cxc_Tank_leer_VM_nicht_verfuegbar), 13=Cxd_Bitte_warten_Motor_startet (CM_MO_E_Texte_Cxd_Bitte_warten_Motor_startet), 14=Cxe_kein_Start_Batterietemperatur (CM_MO_E_Texte_Cxe_kein_Start_Batterietemperatur), 15=Cxf_Ende_elektrische_Reichweite_erreicht (CM_MO_E_Texte_Cxf_Ende_elektrische_Reichweite_erreicht)}, range raw 0..15, transfer-property=PENDING  # Anforderung von Hinweistexten des E-Systems separat für HEV/BEV bzw. erweiterbar für PHEV
    signal WIV_Oeldyn_avl_XIX_Motor_26_MxStatic_XIX_E3V_EVCANFD: start 40, 1 bit, little-endian, data-type-policy=OVERRIDE, i-signal-type=PRIMITIVE, init-value=0, base-type=BT_WIV_Oeldyn_avl, compu {0=Cx0_Oeldyn_nicht_vorhanden (CM_WIV_Oeldyn_avl_Cx0_Oeldyn_nicht_vorhanden), 1=Cx1_Oeldyn_vorhanden (CM_WIV_Oeldyn_avl_Cx1_Oeldyn_vorhanden)}, range raw 0..1, transfer-property=PENDING  # Ölstand aus dynamischer Messung vorhanden
    signal MO_Text_Partikelfil_Reg_XIX_Motor_26_MxStatic_XIX_E3V_EVCANFD: start 41, 1 bit, little-endian, data-type-policy=OVERRIDE, i-signal-type=PRIMITIVE, init-value=0, base-type=BT_MO_Text_Partikelfil_Reg, compu {phys=raw for raw 0..1}, range phys 0..1, raw 0..1, transfer-property=PENDING  # Über dieses Bit im Kombi wird ein Klartextanzeige erzeugt werden: "Partikelfilter benötigt Regeneration".
    signal OLEV_Oelstand_nicht_vorhanden_XIX_Motor_26_MxStatic_XIX_E3V_EVCANFD: start 42, 1 bit, little-endian, data-type-policy=OVERRIDE, i-signal-type=PRIMITIVE, init-value=0, base-type=BT_OLEV_Oelstand_nicht_vorhanden, compu {0=Cx0_oelstand_vorhanden (CM_OLEV_Oelstand_nicht_vorhanden_Cx0_oelstand_vorhanden) (Ölstand vorhanden), 1=Cx1_oelstand_nicht_vorhanden (CM_OLEV_Oelstand_nicht_vorhanden_Cx1_oelstand_nicht_vorhanden) (Ölstand nicht vorhanden)}, range raw 0..1, transfer-property=PENDING  # Kein aktueller Ölstand vorhanden
    signal WIV_Oelmenge_XIX_Motor_26_MxStatic_XIX_E3V_EVCANFD: start 43, 5 bit, little-endian, data-type-policy=OVERRIDE, i-signal-type=PRIMITIVE, init-value=0, base-type=BT_WIV_Oelmenge, compu {phys=raw*125 for raw 0..31; unit Unit_MilliLiter}, range phys 0..3875 Unit_MilliLiter, raw 0..31, unit=Unit_MilliLiter, transfer-property=PENDING  # Ölmenge zwischen Min und Max
    signal MO_Systemlampe_XIX_Motor_26_MxStatic_XIX_E3V_EVCANFD: start 48, 1 bit, little-endian, data-type-policy=OVERRIDE, i-signal-type=PRIMITIVE, init-value=0, base-type=BT_MO_Systemlampe, compu {0=Cx0_Lampe_aus (CM_MO_Systemlampe_Cx0_Lampe_aus) (Lampe aus), 1=Cx1_Lampe_ein (CM_MO_Systemlampe_Cx1_Lampe_ein) (Lampe ein)}, range raw 0..1, transfer-property=PENDING  # EGas Systemlampe (EPC) oder Vorglühlampe im Kombi, Kombi steuert immer gleiche LED an, nur über Ziffernblatt wird die EPC von der Vorglühlampe differenziert
    signal MO_OBD2_Lampe_XIX_Motor_26_MxStatic_XIX_E3V_EVCANFD: start 49, 1 bit, little-endian, data-type-policy=OVERRIDE, i-signal-type=PRIMITIVE, init-value=0, base-type=BT_MO_OBD2_Lampe, compu {0=Cx0_Lampe_aus (CM_MO_OBD2_Lampe_Cx0_Lampe_aus) (Lampe aus), 1=Cx1_Lampe_ein (CM_MO_OBD2_Lampe_Cx1_Lampe_ein) (Lampe ein)}, range raw 0..1, transfer-property=PENDING  # OBD bzw. MIL-Lampe wird vom Motorsteuergerät angesteuert, die Information im Signal GE_OBD_Status wird vom Motorsteuergerät an das Kombi weitergereicht
    signal MO_Heissleuchte_XIX_Motor_26_MxStatic_XIX_E3V_EVCANFD: start 50, 1 bit, little-endian, data-type-policy=OVERRIDE, i-signal-type=PRIMITIVE, init-value=0, base-type=BT_MO_Heissleuchte, compu {0=Cx0_Lampe_aus (CM_MO_Heissleuchte_Cx0_Lampe_aus) (Lampe aus), 1=Cx1_Lampe_ein (CM_MO_Heissleuchte_Cx1_Lampe_ein) (Lampe ein)}, range raw 0..1, transfer-property=PENDING  # Ansteuerung der Kühlwassertemperatur-Heißleuchte (Sensor nur noch am Motorsteuergerät): Temperaturschaltschwellen mit Hysterese (bei VW D1/Colorado Kombi derzeit noch nicht genutzt).
    signal MO_Partikel_Lampe_XIX_Motor_26_MxStatic_XIX_E3V_EVCANFD: start 51, 1 bit, little-endian, data-type-policy=OVERRIDE, i-signal-type=PRIMITIVE, init-value=0, base-type=BT_MO_Partikel_Lampe, compu {0=Cx0_Lampe_aus (CM_MO_Partikel_Lampe_Cx0_Lampe_aus) (Lampe aus), 1=Cx1_Lampe_ein (CM_MO_Partikel_Lampe_Cx1_Lampe_ein) (Lampe ein)}, range raw 0..1, transfer-property=PENDING  # Partikelfilter-Lampe wird eingeschaltet
    signal MO_RedFahrleistung_Lampe_XIX_Motor_26_MxStatic_XIX_E3V_EVCANFD: start 52, 1 bit, little-endian, data-type-policy=OVERRIDE, i-signal-type=PRIMITIVE, init-value=0, base-type=BT_MO_RedFahrleistung_Lampe, compu {0=Cx0_Lampe_aus (CM_MO_RedFahrleistung_Lampe_Cx0_Lampe_aus), 1=Cx1_Lampe_ein (CM_MO_RedFahrleistung_Lampe_Cx1_Lampe_ein)}, range raw 0..1, transfer-property=PENDING, to Klima(timeout 1 s)  # Ansteuerung der Turtle-Mode Lampe für E-Traktion Fahrzeuge
    signal WIV_Oelstand_nicht_vorhanden_XIX_Motor_26_MxStatic_XIX_E3V_EVCANFD: start 53, 1 bit, little-endian, data-type-policy=OVERRIDE, i-signal-type=PRIMITIVE, init-value=0, base-type=BT_WIV_Oelstand_nicht_vorhanden, compu {0=Cx0_oelstand_vorhanden (CM_WIV_Oelstand_nicht_vorhanden_Cx0_oelstand_vorhanden) (Ölstand vorhanden), 1=Cx1_oelstand_nicht_vorhanden (CM_WIV_Oelstand_nicht_vorhanden_Cx1_oelstand_nicht_vorhanden) (Ölstand nicht vorhanden)}, range raw 0..1, transfer-property=PENDING  # Kein aktueller Ölstand vorhanden
    signal WIV_nachfuellanzeige_ein_XIX_Motor_26_MxStatic_XIX_E3V_EVCANFD: start 54, 1 bit, little-endian, data-type-policy=OVERRIDE, i-signal-type=PRIMITIVE, init-value=0, base-type=BT_WIV_nachfuellanzeige_ein, compu {0=Cx0_keine_Nachfuellanzeige (CM_WIV_nachfuellanzeige_ein_Cx0_keine_Nachfuellanzeige), 1=Cx1_Nachfuellanzeige (CM_WIV_nachfuellanzeige_ein_Cx1_Nachfuellanzeige)}, range raw 0..1, transfer-property=PENDING  # Steuert das Aufblenden der Nachfüllanzeige im Kombi, nach Klemme 15 ein und geöffneter Motorhaube
    signal WIV_Ueberfuell_deaktiv_XIX_Motor_26_MxStatic_XIX_E3V_EVCANFD: start 55, 1 bit, little-endian, data-type-policy=OVERRIDE, i-signal-type=PRIMITIVE, init-value=0, base-type=BT_WIV_Ueberfuell_deaktiv, compu {0=Cx0_Ueberfuellwarnung_am_Kombi_aktiv (CM_WIV_Ueberfuell_deaktiv_Cx0_Ueberfuellwarnung_am_Kombi_aktiv), 1=Cx1_Ueberfuellwarnung_am_Kombi_deaktiv (CM_WIV_Ueberfuell_deaktiv_Cx1_Ueberfuellwarnung_am_Kombi_deaktiv)}, range raw 0..1, transfer-property=PENDING  # Unterdrückung der Warnung im Kombi die durch Signal WIV_Ueberfuel_Warn ausgelöst wird
    signal WIV_Unterfuell_Warn_XIX_Motor_26_MxStatic_XIX_E3V_EVCANFD: start 56, 1 bit, little-endian, data-type-policy=OVERRIDE, i-signal-type=PRIMITIVE, init-value=0, base-type=BT_WIV_Unterfuell_Warn, compu {0=Cx0_in_Ordnung (CM_WIV_Unterfuell_Warn_Cx0_in_Ordnung), 1=Cx1_Unterfuellwarnung (CM_WIV_Unterfuell_Warn_Cx1_Unterfuellwarnung)}, range raw 0..1, transfer-property=PENDING  # Ölstand hat die Unterfüllschwelle unterschritten
    signal MO_Tankdeckel_Lampe_XIX_Motor_26_MxStatic_XIX_E3V_EVCANFD: start 57, 1 bit, little-endian, data-type-policy=OVERRIDE, i-signal-type=PRIMITIVE, init-value=0, base-type=BT_MO_Tankdeckel_Lampe, compu {0=Cx0_Lampe_aus (CM_MO_Tankdeckel_Lampe_Cx0_Lampe_aus) (Lampe aus), 1=Cx1_Lampe_ein (CM_MO_Tankdeckel_Lampe_Cx1_Lampe_ein) (Lampe ein)}, range raw 0..1, transfer-property=PENDING  # Ansteuerung Tankdeckel-Warnlampe Kombiinstrument (nur Ottomotoren) z.Zt. Vorhalt VW
    signal MO_Text_Tankdeckelwarn_XIX_Motor_26_MxStatic_XIX_E3V_EVCANFD: start 58, 1 bit, little-endian, data-type-policy=OVERRIDE, i-signal-type=PRIMITIVE, init-value=0, base-type=BT_MO_Text_Tankdeckelwarn, compu {0=Cx0_kein_Text (CM_MO_Text_Tankdeckelwarn_Cx0_kein_Text), 1=Cx1_Anzeige_Text_Tankdeckelwarnung_im_Kombi (CM_MO_Text_Tankdeckelwarn_Cx1_Anzeige_Text_Tankdeckelwarnung_im_Kombi)}, range raw 0..1, transfer-property=PENDING  # Textbit der Tankdeckelwarnung, z.Zt. Vorhalt VW
    signal MO_Vorglueh_Lampe_XIX_Motor_26_MxStatic_XIX_E3V_EVCANFD: start 59, 1 bit, little-endian, data-type-policy=OVERRIDE, i-signal-type=PRIMITIVE, init-value=0, base-type=BT_MO_Vorglueh_Lampe, compu {0=Cx0_Lampe_aus (CM_MO_Vorglueh_Lampe_Cx0_Lampe_aus), 1=Cx1_Lampe_ein (CM_MO_Vorglueh_Lampe_Cx1_Lampe_ein)}, range raw 0..1, transfer-property=PENDING  # Vorglühlampe im Kombi, Kombi steuert immer gleiche LED an. Mit Einführung des Einheits-Kombis sind getrennte Signalwege für Vorglühlampe und EPCL notwendig.
    signal WIV_Oeldr_Warn_Motor_XIX_Motor_26_MxStatic_XIX_E3V_EVCANFD: start 60, 1 bit, little-endian, data-type-policy=OVERRIDE, i-signal-type=PRIMITIVE, init-value=0, base-type=BT_WIV_Oeldr_Warn_Motor, compu {0=Cx0_keine_Warnung (CM_WIV_Oeldr_Warn_Motor_Cx0_keine_Warnung), 1=Cx1_niedrige_Oeldruckstufe_nicht_erreicht (CM_WIV_Oeldr_Warn_Motor_Cx1_niedrige_Oeldruckstufe_nicht_erreicht)}, range raw 0..1, transfer-property=PENDING  # Löst im Kombiinstrument die rote Prio1-Öldruckwarnung (inkl. 3xBeep) aus. nur MLB: die Warnauslösung erfolgt nur bei gleichzeitig gesetztem "WIV_Enable_Oeldr_Motor"
    signal MO_E_Mode_XIX_Motor_26_MxStatic_XIX_E3V_EVCANFD: start 61, 3 bit, little-endian, data-type-policy=OVERRIDE, i-signal-type=PRIMITIVE, init-value=0, base-type=BT_MO_E_Mode, compu {0=Cx0_keine_Anzeige (CM_MO_E_Mode_Cx0_keine_Anzeige), 1=Cx1_E_Mode_passiv (CM_MO_E_Mode_Cx1_E_Mode_passiv), 2=Cx2_E_Mode_aktiv (CM_MO_E_Mode_Cx2_E_Mode_aktiv), 3=Cx3_E_Mode_inaktiv_nicht_verfuegbar (CM_MO_E_Mode_Cx3_E_Mode_inaktiv_nicht_verfuegbar), 4=Cx4_E_Mode_aktiv_nicht_verfuegbar (CM_MO_E_Mode_Cx4_E_Mode_aktiv_nicht_verfuegbar), 5=Cx5_reserviert_keine_Anzeige (CM_MO_E_Mode_Cx5_reserviert_keine_Anzeige), 6=Cx6_reserviert_keine_Anzeige (CM_MO_E_Mode_Cx6_reserviert_keine_Anzeige), 7=Cx7_reserviert_keine_Anzeige (CM_MO_E_Mode_Cx7_reserviert_keine_Anzeige)}, range raw 0..7, transfer-property=PENDING  # Anforderung der E-Mode Statusanzeige
  pdu PSD_06_Mx00_XIX_E3V_EVCANFD: length=8, transmission-mode-true-timing={cyclic-timing={time-offset=0, time-period=0.15}, event-controlled-timing={number-of-repetitions=0, repetition-period=0.0}}, unused-bit-pattern=0
    signal PSD_06_Mux_XIX_PSD_06_Mx00_XIX_E3V_EVCANFD: start 0, 3 bit, little-endian, data-type-policy=OVERRIDE, i-signal-type=PRIMITIVE, init-value=0, base-type=BT_PSD_06_Mux, compu {0=Cx0_Init (CM_PSD_06_Mux_Cx0_Init)}, range raw 0, to Klima(timeout 1.5 s)  # Multiplex Zähler für die PSD_06-Botschaft. Die unterschiedlichen Muxe folgen keiner festen Reihenfolge. Je nach Inhalt des PSD-Protokolls an der aktuellen Position werden jeweils die notwendigen PSD6-Botschaften gesendet.
    signal PSD_Sys_Segment_ID_XIX_PSD_06_Mx00_XIX_E3V_EVCANFD: start 3, 6 bit, little-endian, data-type-policy=OVERRIDE, i-signal-type=PRIMITIVE, init-value=0, base-type=BT_PSD_Sys_Segment_ID, compu {0=Cx0_keine_Segmentinformationen_vorhanden (CM_PSD_Sys_Segment_ID_Cx0_keine_Segmentinformationen_vorhanden) (keine Segmentinformationen vorhanden), 1=Cx1_nicht_zulaessig (CM_PSD_Sys_Segment_ID_Cx1_nicht_zulaessig) (nicht zulaessig), phys=raw for raw 2..63}, range phys 2..63, raw 0..63, transfer-property=TRIGGERED, to Klima(timeout 1.5 s)  # Identifier des prädiktiven Streckensegments ab dem die Systeminformationen gültig sind.
    signal PSD_Sys_Laendercode_XIX_PSD_06_Mx00_XIX_E3V_EVCANFD: start 9, 8 bit, little-endian, data-type-policy=OVERRIDE, i-signal-type=PRIMITIVE, init-value=0, base-type=BT_PSD_Sys_Laendercode, compu {phys=raw for raw 0..255; unit Unit_None}, range phys 0..255 Unit_None, raw 0..255, unit=Unit_None, transfer-property=TRIGGERED, to Klima(timeout 1.5 s)  # Ländercode
    signal PSD_Sys_Geschwindigkeit_Einheit_XIX_PSD_06_Mx00_XIX_E3V_EVCANFD: start 17, 1 bit, little-endian, data-type-policy=OVERRIDE, i-signal-type=PRIMITIVE, init-value=0, base-type=BT_PSD_Sys_Geschwindigkeit_Einheit, compu {0=Cx0_km_h (CM_PSD_Sys_Geschwindigkeit_Einheit_Cx0_km_h) (km/h), 1=Cx1_mph (CM_PSD_Sys_Geschwindigkeit_Einheit_Cx1_mph)}, range raw 0..1, transfer-property=TRIGGERED, to Klima(timeout 1.5 s)  # Unterscheidung zwischen km/h und miles/h
    signal PSD_Sys_Verkehrsrichtung_XIX_PSD_06_Mx00_XIX_E3V_EVCANFD: start 18, 1 bit, little-endian, data-type-policy=OVERRIDE, i-signal-type=PRIMITIVE, init-value=0, base-type=BT_PSD_Sys_Verkehrsrichtung, compu {0=Cx0_Rechtsverkehr (CM_PSD_Sys_Verkehrsrichtung_Cx0_Rechtsverkehr), 1=Cx1_Linksverkehr (CM_PSD_Sys_Verkehrsrichtung_Cx1_Linksverkehr)}, range raw 0..1, transfer-property=TRIGGERED, to Klima(timeout 1.5 s)  # Unterscheidung zwischen Linksverkehr und Rechtsverkehr
    signal PSD_Sys_Geometrieguete_XIX_PSD_06_Mx00_XIX_E3V_EVCANFD: start 19, 2 bit, little-endian, data-type-policy=OVERRIDE, i-signal-type=PRIMITIVE, init-value=0, base-type=BT_PSD_Sys_Geometrieguete, compu {0=Cx0_Geringe_Guete (CM_PSD_Sys_Geometrieguete_Cx0_Geringe_Guete), 1=Cx1_tbd (CM_PSD_Sys_Geometrieguete_Cx1_tbd), 2=Cx2_tbd (CM_PSD_Sys_Geometrieguete_Cx2_tbd), 3=Cx3_Hohe_Guete (CM_PSD_Sys_Geometrieguete_Cx3_Hohe_Guete)}, range raw 0..3, transfer-property=TRIGGERED, to Klima(timeout 1.5 s)  # Maß für die Güte der Klothoidengeometrie.
    signal PSD_Sys_Mapmatchingguete_XIX_PSD_06_Mx00_XIX_E3V_EVCANFD: start 21, 2 bit, little-endian, data-type-policy=OVERRIDE, i-signal-type=PRIMITIVE, init-value=0, base-type=BT_PSD_Sys_Mapmatchingguete, compu {0=Cx0_geringe_Guete (CM_PSD_Sys_Mapmatchingguete_Cx0_geringe_Guete), 1=Cx1_res (CM_PSD_Sys_Mapmatchingguete_Cx1_res), 2=Cx2_res (CM_PSD_Sys_Mapmatchingguete_Cx2_res), 3=Cx3_hohe_Guete (CM_PSD_Sys_Mapmatchingguete_Cx3_hohe_Guete)}, range raw 0..3, transfer-property=TRIGGERED, to Klima(timeout 1.5 s)  # Güte des Mapmatchings
    signal PSD_Sys_Alter_Karte_XIX_PSD_06_Mx00_XIX_E3V_EVCANFD: start 23, 3 bit, little-endian, data-type-policy=OVERRIDE, i-signal-type=PRIMITIVE, init-value=0, base-type=BT_PSD_Sys_Alter_Karte, compu {0=Cx0_kleiner_1_Jahr (CM_PSD_Sys_Alter_Karte_Cx0_kleiner_1_Jahr), 1=Cx1_1_Jahr (CM_PSD_Sys_Alter_Karte_Cx1_1_Jahr), 2=Cx2_2_Jahre (CM_PSD_Sys_Alter_Karte_Cx2_2_Jahre), 3=Cx3_3_Jahre (CM_PSD_Sys_Alter_Karte_Cx3_3_Jahre), 4=Cx4_4_Jahre (CM_PSD_Sys_Alter_Karte_Cx4_4_Jahre), 5=Cx5_5_Jahre (CM_PSD_Sys_Alter_Karte_Cx5_5_Jahre), 6=Cx6_6_Jahre (CM_PSD_Sys_Alter_Karte_Cx6_6_Jahre), 7=Cx7_groesser_7_Jahre (CM_PSD_Sys_Alter_Karte_Cx7_groesser_7_Jahre)}, range raw 0..7, transfer-property=TRIGGERED, to Klima(timeout 1.5 s)  # Alter der Karte
    signal PSD_Sys_Zielfuehrung_XIX_PSD_06_Mx00_XIX_E3V_EVCANFD: start 26, 1 bit, little-endian, data-type-policy=OVERRIDE, i-signal-type=PRIMITIVE, init-value=0, base-type=BT_PSD_Sys_Zielfuehrung, compu {0=Cx0_Zielfuehrung_nicht_aktiv (CM_PSD_Sys_Zielfuehrung_Cx0_Zielfuehrung_nicht_aktiv) (Zielfuehrung nicht aktiv), 1=Cx1_Zielfuehrung_aktiv (CM_PSD_Sys_Zielfuehrung_Cx1_Zielfuehrung_aktiv) (Zielfuehrung aktiv)}, range raw 0..1, transfer-property=TRIGGERED, to Klima(timeout 1.5 s)  # Zielfuehrung im Navigationssystem. Damit lässt sich der wahrscheinlichste Pfad des Fahrzeuges zuverlässig angeben.
    signal PSD_Sys_US_State_XIX_PSD_06_Mx00_XIX_E3V_EVCANFD: start 27, 6 bit, little-endian, data-type-policy=OVERRIDE, i-signal-type=PRIMITIVE, init-value=0, base-type=BT_PSD_Sys_US_State, compu {0=Cx0_kein_US_State (CM_PSD_Sys_US_State_Cx0_kein_US_State), 1=Cx1_Alabama (CM_PSD_Sys_US_State_Cx1_Alabama), 2=Cx2_Alaska (CM_PSD_Sys_US_State_Cx2_Alaska), 3=Cx3_Arkansas (CM_PSD_Sys_US_State_Cx3_Arkansas), 4=Cx4_Arizona (CM_PSD_Sys_US_State_Cx4_Arizona), 5=Cx5_California (CM_PSD_Sys_US_State_Cx5_California), 6=Cx6_Colorado (CM_PSD_Sys_US_State_Cx6_Colorado), 7=Cx7_Conneticut (CM_PSD_Sys_US_State_Cx7_Conneticut), 8=Cx8_District_of_Columbia (CM_PSD_Sys_US_State_Cx8_District_of_Columbia), 9=Cx9_Delaware (CM_PSD_Sys_US_State_Cx9_Delaware), 10=Cxa_Florida (CM_PSD_Sys_US_State_Cxa_Florida), 11=Cxb_Georgia (CM_PSD_Sys_US_State_Cxb_Georgia), 12=Cxc_Hawaii (CM_PSD_Sys_US_State_Cxc_Hawaii), 13=Cxd_Idaho (CM_PSD_Sys_US_State_Cxd_Idaho), 14=Cxe_Illinois (CM_PSD_Sys_US_State_Cxe_Illinois), 15=Cxf_Iowa (CM_PSD_Sys_US_State_Cxf_Iowa), 16=Cx10_Indiana (CM_PSD_Sys_US_State_Cx10_Indiana), 17=Cx11_Kansas (CM_PSD_Sys_US_State_Cx11_Kansas), 18=Cx12_Kentucky (CM_PSD_Sys_US_State_Cx12_Kentucky), 19=Cx13_Louisiana (CM_PSD_Sys_US_State_Cx13_Louisiana), 20=Cx14_Massachusetts (CM_PSD_Sys_US_State_Cx14_Massachusetts), 21=Cx15_Maryland (CM_PSD_Sys_US_State_Cx15_Maryland), 22=Cx16_Maine (CM_PSD_Sys_US_State_Cx16_Maine), 23=Cx17_Michigan (CM_PSD_Sys_US_State_Cx17_Michigan), 24=Cx18_Minnesota (CM_PSD_Sys_US_State_Cx18_Minnesota), 25=Cx19_Missouri (CM_PSD_Sys_US_State_Cx19_Missouri), 26=Cx1a_Mississippi (CM_PSD_Sys_US_State_Cx1a_Mississippi), 27=Cx1b_Montana (CM_PSD_Sys_US_State_Cx1b_Montana), 28=Cx1c_North_Carolina (CM_PSD_Sys_US_State_Cx1c_North_Carolina), 29=Cx1d_North_Dakota (CM_PSD_Sys_US_State_Cx1d_North_Dakota), 30=Cx1e_Nebraska (CM_PSD_Sys_US_State_Cx1e_Nebraska), 31=Cx1f_Nevada (CM_PSD_Sys_US_State_Cx1f_Nevada), 32=Cx20_New_Hampshire (CM_PSD_Sys_US_State_Cx20_New_Hampshire), 33=Cx21_New_Jersey (CM_PSD_Sys_US_State_Cx21_New_Jersey), 34=Cx22_New_Mexico (CM_PSD_Sys_US_State_Cx22_New_Mexico), 35=Cx23_New_York (CM_PSD_Sys_US_State_Cx23_New_York), 36=Cx24_Ohio (CM_PSD_Sys_US_State_Cx24_Ohio), 37=Cx25_Oklahoma (CM_PSD_Sys_US_State_Cx25_Oklahoma), 38=Cx26_Oregon (CM_PSD_Sys_US_State_Cx26_Oregon), 39=Cx27_Pennsylvania (CM_PSD_Sys_US_State_Cx27_Pennsylvania), 40=Cx28_Puerto_Rico (CM_PSD_Sys_US_State_Cx28_Puerto_Rico), 41=Cx29_Rhode_Island (CM_PSD_Sys_US_State_Cx29_Rhode_Island), 42=Cx2a_South_Carolina (CM_PSD_Sys_US_State_Cx2a_South_Carolina), 43=Cx2b_South_Dakota (CM_PSD_Sys_US_State_Cx2b_South_Dakota), 44=Cx2c_Tennessee (CM_PSD_Sys_US_State_Cx2c_Tennessee), 45=Cx2d_Texas (CM_PSD_Sys_US_State_Cx2d_Texas), 46=Cx2e_Utah (CM_PSD_Sys_US_State_Cx2e_Utah), 47=Cx2f_Virginia (CM_PSD_Sys_US_State_Cx2f_Virginia), 48=Cx30_Virgin_Islands (CM_PSD_Sys_US_State_Cx30_Virgin_Islands), 49=Cx31_Vermont (CM_PSD_Sys_US_State_Cx31_Vermont), 50=Cx32_Washington (CM_PSD_Sys_US_State_Cx32_Washington), 51=Cx33_Wisconsin (CM_PSD_Sys_US_State_Cx33_Wisconsin), 52=Cx34_West_Virginia (CM_PSD_Sys_US_State_Cx34_West_Virginia), 53=Cx35_Wyoming (CM_PSD_Sys_US_State_Cx35_Wyoming)}, range raw 0..53, transfer-property=TRIGGERED, to Klima(timeout 1.5 s)  # Name des USA-State
    signal PSD_Sys_Quali_Geometrien_XIX_PSD_06_Mx00_XIX_E3V_EVCANFD: start 33, 3 bit, little-endian, data-type-policy=OVERRIDE, i-signal-type=PRIMITIVE, init-value=0, base-type=BT_PSD_Sys_Quali_Geometrien, compu {phys=raw for raw 0..7; unit Unit_None}, range phys 0..7 Unit_None, raw 0..7, unit=Unit_None, transfer-property=TRIGGERED, to Klima(timeout 1.5 s)  # Qualität der Geometrien in dieser Region
    signal PSD_Sys_Quali_Ortsinfo_XIX_PSD_06_Mx00_XIX_E3V_EVCANFD: start 36, 2 bit, little-endian, data-type-policy=OVERRIDE, i-signal-type=PRIMITIVE, init-value=0, base-type=BT_PSD_Sys_Quali_Ortsinfo, compu {phys=raw for raw 0..3; unit Unit_None}, range phys 0..3 Unit_None, raw 0..3, unit=Unit_None, transfer-property=TRIGGERED, to Klima(timeout 1.5 s)  # Qualität Ortsinformationen (Bebauung, Ortsschild) dieser Region
    signal PSD_Sys_Quali_verfuegbar_XIX_PSD_06_Mx00_XIX_E3V_EVCANFD: start 38, 1 bit, little-endian, data-type-policy=OVERRIDE, i-signal-type=PRIMITIVE, init-value=0, base-type=BT_PSD_Sys_Quali_verfuegbar, compu {0=Cx0_Qualitaetskriterien_nicht_verfuegbar (CM_PSD_Sys_Quali_verfuegbar_Cx0_Qualitaetskriterien_nicht_verfuegbar), 1=Cx1_Qualitaetskriterien_verfuegbar (CM_PSD_Sys_Quali_verfuegbar_Cx1_Qualitaetskriterien_verfuegbar)}, range raw 0..1, transfer-property=TRIGGERED, to Klima(timeout 1.5 s)  # Karte enthält gültige Qualitätskriterien
    signal PSD_Sys_Zielfuehrung_geaendert_XIX_PSD_06_Mx00_XIX_E3V_EVCANFD: start 39, 1 bit, little-endian, data-type-policy=OVERRIDE, i-signal-type=PRIMITIVE, init-value=0, base-type=BT_PSD_Sys_Zielfuehrung_geaendert, compu {0=Cx0_Zielfuehrung_nicht_geaendert (CM_PSD_Sys_Zielfuehrung_geaendert_Cx0_Zielfuehrung_nicht_geaendert), 1=Cx1_Zielfuehrung_geaendert (CM_PSD_Sys_Zielfuehrung_geaendert_Cx1_Zielfuehrung_geaendert)}, range raw 0..1, transfer-property=TRIGGERED, to Klima(timeout 1.5 s)  # Die Zielführung (Route) hat sich geändert hat ohne dass der Fahrer eine neue Zielführung gestartet hat
    signal PSD_Sys_Geometrieguete_erweitert_XIX_PSD_06_Mx00_XIX_E3V_EVCANFD: start 40, 8 bit, little-endian, data-type-policy=OVERRIDE, i-signal-type=PRIMITIVE, init-value=0, base-type=BT_PSD_Sys_Geometrieguete_erweitert, compu {0=Cx0_Init (CM_PSD_Sys_Geometrieguete_erweitert_Cx0_Init)}, range raw 0, transfer-property=TRIGGERED, to Klima(timeout 1.5 s)  # Güte der Kurvenrepräsentation der Klothoiden
    signal PSD_Sys_Quali_sonstige_Attribute_XIX_PSD_06_Mx00_XIX_E3V_EVCANFD: start 48, 3 bit, little-endian, data-type-policy=OVERRIDE, i-signal-type=PRIMITIVE, init-value=0, base-type=BT_PSD_Sys_Quali_sonstige_Attribute, compu {phys=raw for raw 0..7; unit Unit_None}, range phys 0..7 Unit_None, raw 0..7, unit=Unit_None, transfer-property=TRIGGERED, to Klima(timeout 1.5 s)  # Qualität sonstiger Attribute dieser Region
    signal PSD_Sys_Quali_Steigungen_XIX_PSD_06_Mx00_XIX_E3V_EVCANFD: start 51, 3 bit, little-endian, data-type-policy=OVERRIDE, i-signal-type=PRIMITIVE, init-value=0, base-type=BT_PSD_Sys_Quali_Steigungen, compu {phys=raw for raw 0..7}, range phys 0..7, raw 0..7, transfer-property=TRIGGERED, to Klima(timeout 1.5 s)  # Qualität der Steigungen dieser Region
    signal PSD_Sys_Quali_Strassenkennz_XIX_PSD_06_Mx00_XIX_E3V_EVCANFD: start 54, 3 bit, little-endian, data-type-policy=OVERRIDE, i-signal-type=PRIMITIVE, init-value=0, base-type=BT_PSD_Sys_Quali_Strassenkennz, compu {phys=raw for raw 0..7; unit Unit_None}, range phys 0..7 Unit_None, raw 0..7, unit=Unit_None, transfer-property=TRIGGERED, to Klima(timeout 1.5 s)  # Qualität Straßenkennzeichnungen dieser Region
    signal PSD_Sys_Quali_Tempolimits_XIX_PSD_06_Mx00_XIX_E3V_EVCANFD: start 57, 3 bit, little-endian, data-type-policy=OVERRIDE, i-signal-type=PRIMITIVE, init-value=0, base-type=BT_PSD_Sys_Quali_Tempolimits, compu {phys=raw for raw 0..7; unit Unit_None}, range phys 0..7 Unit_None, raw 0..7, unit=Unit_None, transfer-property=TRIGGERED, to Klima(timeout 1.5 s)  # Qualität Tempolimits dieser Region
    signal PSD_Sys_Quali_Vorfahrtsregelung_XIX_PSD_06_Mx00_XIX_E3V_EVCANFD: start 60, 3 bit, little-endian, data-type-policy=OVERRIDE, i-signal-type=PRIMITIVE, init-value=0, base-type=BT_PSD_Sys_Quali_Vorfahrtsregelung, compu {phys=raw for raw 0..7; unit Unit_None}, range phys 0..7 Unit_None, raw 0..7, unit=Unit_None, transfer-property=TRIGGERED, to Klima(timeout 1.5 s)  # Qualität Vorfahrtsregelungen dieser Region
  pdu PSD_06_Mx01_XIX_E3V_EVCANFD: length=8, transmission-mode-true-timing={cyclic-timing={time-offset=0, time-period=0.15}, event-controlled-timing={number-of-repetitions=0, repetition-period=0.0}}, unused-bit-pattern=0
    signal PSD_06_Mux_XIX_PSD_06_Mx01_XIX_E3V_EVCANFD: start 0, 3 bit, little-endian, data-type-policy=OVERRIDE, i-signal-type=PRIMITIVE, init-value=1, base-type=BT_PSD_06_Mux, compu {0=Cx0_Init (CM_PSD_06_Mux_Cx0_Init)}, range raw 0, to Klima(timeout 1.5 s)  # Multiplex Zähler für die PSD_06-Botschaft. Die unterschiedlichen Muxe folgen keiner festen Reihenfolge. Je nach Inhalt des PSD-Protokolls an der aktuellen Position werden jeweils die notwendigen PSD6-Botschaften gesendet.
    signal PSD_Attribut_Segment_ID_XIX_PSD_06_Mx01_XIX_E3V_EVCANFD: start 3, 6 bit, little-endian, data-type-policy=OVERRIDE, i-signal-type=PRIMITIVE, init-value=0, base-type=BT_PSD_Attribut_Segment_ID, invalid-value=Invalid_PSD_Attribut_Segment_ID_XIX_PSD_06_XIX_E3V_EVCANFD:1, compu {0=Cx0_keine_Segment_Information_vorhanden (CM_PSD_Attribut_Segment_ID_Cx0_keine_Segment_Information_vorhanden), 1=Cx1_Fehler (CM_PSD_Attribut_Segment_ID_Cx1_Fehler), phys=raw for raw 2..63}, range phys 2..63, raw 0..63, transfer-property=TRIGGERED, to Klima(timeout 1.5 s)  # Identifier des Streckensegments,für das die weiteren Attribute in der Botschaft gültig sind
    signal PSD_Attribut_3_ID_XIX_PSD_06_Mx01_XIX_E3V_EVCANFD: start 9, 5 bit, little-endian, data-type-policy=OVERRIDE, i-signal-type=PRIMITIVE, init-value=0, base-type=BT_PSD_Attribut_3_ID, compu {0=Cx0_keine_Information (CM_PSD_Attribut_3_ID_Cx0_keine_Information), phys=raw for raw 1..31}, range phys 1..31, raw 0..31, transfer-property=TRIGGERED, to Klima(timeout 1.5 s)  # Identifier des dritten Attributes
    signal PSD_Attribut_3_Offset_XIX_PSD_06_Mx01_XIX_E3V_EVCANFD: start 14, 7 bit, little-endian, data-type-policy=OVERRIDE, i-signal-type=PRIMITIVE, init-value=0, base-type=BT_PSD_Attribut_3_Offset, compu {phys=raw*2 for raw 0..127; unit Unit_Meter}, range phys 0..254 Unit_Meter, raw 0..127, unit=Unit_Meter, transfer-property=TRIGGERED, to Klima(timeout 1.5 s)  # Positionsoffset im Segment für die Position des Attributs
    signal PSD_Attribut_3_Wert_XIX_PSD_06_Mx01_XIX_E3V_EVCANFD: start 21, 4 bit, little-endian, data-type-policy=OVERRIDE, i-signal-type=PRIMITIVE, init-value=0, base-type=BT_PSD_Attribut_3_Wert, compu {phys=raw for raw 0..15; unit Unit_None}, range phys 0..15 Unit_None, raw 0..15, unit=Unit_None, transfer-property=TRIGGERED, to Klima(timeout 1.5 s)  # Wert des dritten Attributes
    signal PSD_Attribut_4_ID_XIX_PSD_06_Mx01_XIX_E3V_EVCANFD: start 25, 5 bit, little-endian, data-type-policy=OVERRIDE, i-signal-type=PRIMITIVE, init-value=0, base-type=BT_PSD_Attribut_4_ID, compu {0=Cx0_keine_Information (CM_PSD_Attribut_4_ID_Cx0_keine_Information), phys=raw for raw 1..31}, range phys 1..31, raw 0..31, transfer-property=TRIGGERED, to Klima(timeout 1.5 s)  # Typ von Attribut 4
    signal PSD_Attribut_4_Wert_XIX_PSD_06_Mx01_XIX_E3V_EVCANFD: start 30, 4 bit, little-endian, data-type-policy=OVERRIDE, i-signal-type=PRIMITIVE, init-value=0, base-type=BT_PSD_Attribut_4_Wert, compu {phys=raw for raw 0..15}, range phys 0..15, raw 0..15, transfer-property=TRIGGERED, to Klima(timeout 1.5 s)  # Wert von Attribut 4
    signal PSD_Attribut_4_Offset_XIX_PSD_06_Mx01_XIX_E3V_EVCANFD: start 34, 7 bit, little-endian, data-type-policy=OVERRIDE, i-signal-type=PRIMITIVE, init-value=0, base-type=BT_PSD_Attribut_4_Offset, compu {phys=raw*2 for raw 0..127; unit Unit_Meter}, range phys 0..254 Unit_Meter, raw 0..127, unit=Unit_Meter, transfer-property=TRIGGERED, to Klima(timeout 1.5 s)  # Offset von Attribut 4
    signal PSD_Attribut_5_ID_XIX_PSD_06_Mx01_XIX_E3V_EVCANFD: start 41, 5 bit, little-endian, data-type-policy=OVERRIDE, i-signal-type=PRIMITIVE, init-value=0, base-type=BT_PSD_Attribut_5_ID, compu {0=Cx0_keine_Information (CM_PSD_Attribut_5_ID_Cx0_keine_Information), phys=raw for raw 1..31}, range phys 1..31, raw 0..31, transfer-property=TRIGGERED, to Klima(timeout 1.5 s)  # Typ von Attribut 5
    signal PSD_Attribut_5_Offset_XIX_PSD_06_Mx01_XIX_E3V_EVCANFD: start 46, 7 bit, little-endian, data-type-policy=OVERRIDE, i-signal-type=PRIMITIVE, init-value=0, base-type=BT_PSD_Attribut_5_Offset, compu {phys=raw*2 for raw 0..127; unit Unit_Meter}, range phys 0..254 Unit_Meter, raw 0..127, unit=Unit_Meter, transfer-property=TRIGGERED, to Klima(timeout 1.5 s)  # Offset von Attribut 5
    signal PSD_Attribut_5_Wert_XIX_PSD_06_Mx01_XIX_E3V_EVCANFD: start 53, 4 bit, little-endian, data-type-policy=OVERRIDE, i-signal-type=PRIMITIVE, init-value=0, base-type=BT_PSD_Attribut_5_Wert, compu {phys=raw for raw 0..15}, range phys 0..15, raw 0..15, transfer-property=TRIGGERED, to Klima(timeout 1.5 s)  # Wert von Attribut 5
    signal PSD_Attribute_Komplett_06_XIX_PSD_06_Mx01_XIX_E3V_EVCANFD: start 57, 1 bit, little-endian, data-type-policy=OVERRIDE, i-signal-type=PRIMITIVE, init-value=0, base-type=BT_PSD_Attribute_Komplett_06, compu {0=Cx0_Attribute_nicht_komplett (CM_PSD_Attribute_Komplett_06_Cx0_Attribute_nicht_komplett), 1=Cx1_Attribute_komplett (CM_PSD_Attribute_Komplett_06_Cx1_Attribute_komplett)}, range raw 0..1, transfer-property=TRIGGERED, to Klima(timeout 1.5 s)  # Zeigt, ob alle Attribute für das Segment übertragen worden sind
  pdu PSD_06_Mx02_XIX_E3V_EVCANFD: length=8, transmission-mode-true-timing={cyclic-timing={time-offset=0, time-period=0.15}, event-controlled-timing={number-of-repetitions=0, repetition-period=0.0}}, unused-bit-pattern=0
    signal PSD_06_Mux_XIX_PSD_06_Mx02_XIX_E3V_EVCANFD: start 0, 3 bit, little-endian, data-type-policy=OVERRIDE, i-signal-type=PRIMITIVE, init-value=2, base-type=BT_PSD_06_Mux, compu {0=Cx0_Init (CM_PSD_06_Mux_Cx0_Init)}, range raw 0, to Klima(timeout 1.5 s)  # Multiplex Zähler für die PSD_06-Botschaft. Die unterschiedlichen Muxe folgen keiner festen Reihenfolge. Je nach Inhalt des PSD-Protokolls an der aktuellen Position werden jeweils die notwendigen PSD6-Botschaften gesendet.
    signal PSD_Ges_Segment_ID_XIX_PSD_06_Mx02_XIX_E3V_EVCANFD: start 3, 6 bit, little-endian, data-type-policy=OVERRIDE, i-signal-type=PRIMITIVE, init-value=0, base-type=BT_PSD_Ges_Segment_ID, compu {0=Cx0_keine_Segmentinformationen_vorhanden (CM_PSD_Ges_Segment_ID_Cx0_keine_Segmentinformationen_vorhanden) (keine Segmentinformationen vorhanden), 1=Cx1_nicht_zulaessig (CM_PSD_Ges_Segment_ID_Cx1_nicht_zulaessig) (nicht zulaessig), phys=raw for raw 2..63}, range phys 2..63, raw 0..63, transfer-property=TRIGGERED, to Klima(timeout 1.5 s)  # Identifier des prädiktiven Streckensegments ab dem die Geschwindigkeitsbegrenzungen und mögliche Einschränkungen gelten.
    signal PSD_Ges_Offset_XIX_PSD_06_Mx02_XIX_E3V_EVCANFD: start 9, 7 bit, little-endian, data-type-policy=OVERRIDE, i-signal-type=PRIMITIVE, init-value=0, base-type=BT_PSD_Ges_Offset, compu {phys=raw*2 for raw 0..127; unit Unit_Meter}, range phys 0..254 Unit_Meter, raw 0..127, unit=Unit_Meter, transfer-property=TRIGGERED, to Klima(timeout 1.5 s)  # Positionsoffset im Segment für die Position des Attributs
    signal PSD_Ges_Geschwindigkeit_XIX_PSD_06_Mx02_XIX_E3V_EVCANFD: start 16, 5 bit, little-endian, data-type-policy=OVERRIDE, i-signal-type=PRIMITIVE, init-value=0, base-type=BT_PSD_Ges_Geschwindigkeit, compu {0=Cx0_Kein_Geschwindigkeitsgebot (CM_PSD_Ges_Geschwindigkeit_Cx0_Kein_Geschwindigkeitsgebot) (Kein Geschwindigkeitsgebot), 1=Cx1_0_km_h_v_max_5_km_h (CM_PSD_Ges_Geschwindigkeit_Cx1_0_km_h_v_max_5_km_h) (0 km/h < v_max < 5 km/h), 2=Cx2_5_km_h_v_max_10km_h (CM_PSD_Ges_Geschwindigkeit_Cx2_5_km_h_v_max_10km_h) (5 km/h < v_max < 10km/h), 3=Cx3_10_km_h_v_max_15_km_h (CM_PSD_Ges_Geschwindigkeit_Cx3_10_km_h_v_max_15_km_h) (10 km/h < v_max < 15 km/h), 4=Cx4_15_km_h_v_max_20_km_h (CM_PSD_Ges_Geschwindigkeit_Cx4_15_km_h_v_max_20_km_h) (15 km/h < v_max < 20 km/h), 5=Cx5_20_km_h_v_max_25_km_h (CM_PSD_Ges_Geschwindigkeit_Cx5_20_km_h_v_max_25_km_h) (20 km/h < v_max < 25 km/h), 6=Cx6_25_km_h_v_max_30_km_h (CM_PSD_Ges_Geschwindigkeit_Cx6_25_km_h_v_max_30_km_h) (25 km/h < v_max < 30 km/h), 7=Cx7_30_km_h_v_max_35_km_h (CM_PSD_Ges_Geschwindigkeit_Cx7_30_km_h_v_max_35_km_h) (30 km/h < v_max < 35 km/h), 8=Cx8_35_km_h_v_max_40_km_h (CM_PSD_Ges_Geschwindigkeit_Cx8_35_km_h_v_max_40_km_h) (35 km/h < v_max < 40 km/h), 9=Cx9_40_km_h_v_max_45_km_h (CM_PSD_Ges_Geschwindigkeit_Cx9_40_km_h_v_max_45_km_h) (40 km/h < v_max < 45 km/h), 10=Cxa_45_km_h_v_max_50_km_h (CM_PSD_Ges_Geschwindigkeit_Cxa_45_km_h_v_max_50_km_h) (45 km/h < v_max < 50 km/h), 11=Cxb_50_km_h_v_max_60_km_h (CM_PSD_Ges_Geschwindigkeit_Cxb_50_km_h_v_max_60_km_h) (50 km/h < v_max < 60 km/h), 12=Cxc_60_km_h_v_max_70_km_h (CM_PSD_Ges_Geschwindigkeit_Cxc_60_km_h_v_max_70_km_h) (60 km/h < v_max < 70 km/h), 13=Cxd_70_km_h_v_max_80_km_h (CM_PSD_Ges_Geschwindigkeit_Cxd_70_km_h_v_max_80_km_h) (70 km/h < v_max < 80 km/h), 14=Cxe_80_km_h_v_max_90_km_h (CM_PSD_Ges_Geschwindigkeit_Cxe_80_km_h_v_max_90_km_h) (80 km/h < v_max < 90 km/h), 15=Cxf_90_km_h_v_max_100_km_h (CM_PSD_Ges_Geschwindigkeit_Cxf_90_km_h_v_max_100_km_h) (90 km/h < v_max < 100 km/h), 16=Cx10_100_km_h_v_max_110_km_h (CM_PSD_Ges_Geschwindigkeit_Cx10_100_km_h_v_max_110_km_h) (100 km/h < v_max < 110 km/h), 17=Cx11_110_km_h_v_max_120_km_h (CM_PSD_Ges_Geschwindigkeit_Cx11_110_km_h_v_max_120_km_h) (110 km/h < v_max < 120 km/h), 18=Cx12_120_km_h_v_max_130_km_h (CM_PSD_Ges_Geschwindigkeit_Cx12_120_km_h_v_max_130_km_h) (120 km/h < v_max < 130 km/h), 19=Cx13_130_km_h_v_max_140_km_h (CM_PSD_Ges_Geschwindigkeit_Cx13_130_km_h_v_max_140_km_h) (130 km/h < v_max < 140 km/h), 20=Cx14_140_km_h_v_max_150_km_h (CM_PSD_Ges_Geschwindigkeit_Cx14_140_km_h_v_max_150_km_h) (140 km/h < v_max < 150 km/h), 21=Cx15_150_km_h_v_max_160_km_h (CM_PSD_Ges_Geschwindigkeit_Cx15_150_km_h_v_max_160_km_h) (150 km/h < v_max < 160 km/h), 22=Cx16_160_km_h_v_max (CM_PSD_Ges_Geschwindigkeit_Cx16_160_km_h_v_max) (160 km/h < v_max), 23=Cx17_Geschwindigkeitsgebot_aufgehoben (CM_PSD_Ges_Geschwindigkeit_Cx17_Geschwindigkeitsgebot_aufgehoben) (Geschwindigkeitsgebot aufgehoben), 24=Cx18_0x1F_ungueltig (CM_PSD_Ges_Geschwindigkeit_Cx18_0x1F_ungueltig) (..0x1F ungültig)}, range raw 0..24, transfer-property=TRIGGERED, to Klima(timeout 1.5 s)
    signal PSD_Ges_Typ_XIX_PSD_06_Mx02_XIX_E3V_EVCANFD: start 21, 2 bit, little-endian, data-type-policy=OVERRIDE, i-signal-type=PRIMITIVE, init-value=3, base-type=BT_PSD_Ges_Typ, compu {0=Cx0_Geschw_Klasse_des_Kartendatensuppliers (CM_PSD_Ges_Typ_Cx0_Geschw_Klasse_des_Kartendatensuppliers), 1=Cx1_Explizit_abgeleiteten_Begrenzung (CM_PSD_Ges_Typ_Cx1_Explizit_abgeleiteten_Begrenzung), 2=Cx2_Durch_Gesetzg_vorgeg_allgem_Gebot_fuer_uebertr_Rahmenbed (CM_PSD_Ges_Typ_Cx2_Durch_Gesetzg_vorgeg_allgem_Gebot_fuer_uebertr_Rahmenbed), 3=Cx3_Init (CM_PSD_Ges_Typ_Cx3_Init)}, range raw 0..3, transfer-property=TRIGGERED, to Klima(timeout 1.5 s)  # Typ der Geschwindigkeitsbegrenzung
    signal PSD_Ges_Spur_Geschw_Begrenzung_XIX_PSD_06_Mx02_XIX_E3V_EVCANFD: start 23, 6 bit, little-endian, data-type-policy=OVERRIDE, i-signal-type=PRIMITIVE, init-value=0, base-type=BT_PSD_Ges_Spur_Geschw_Begrenzung, compu {0=Cx0_Gebot_fuer_alle_spuren_gueltig (CM_PSD_Ges_Spur_Geschw_Begrenzung_Cx0_Gebot_fuer_alle_spuren_gueltig)}, range raw 0, transfer-property=TRIGGERED, to Klima(timeout 1.5 s)  # Definition der Spuren, für die das übertragene Gebot gilt
    signal PSD_Ges_Geschwindigkeit_Gespann_XIX_PSD_06_Mx02_XIX_E3V_EVCANFD: start 29, 2 bit, little-endian, data-type-policy=OVERRIDE, i-signal-type=PRIMITIVE, init-value=0, base-type=BT_PSD_Ges_Geschwindigkeit_Gespann, compu {0=Cx0_alle_Fahrzeuge (CM_PSD_Ges_Geschwindigkeit_Gespann_Cx0_alle_Fahrzeuge) (alle Fahrzeuge), 1=Cx1_PKW_mit_Gespann (CM_PSD_Ges_Geschwindigkeit_Gespann_Cx1_PKW_mit_Gespann) (PKW mit Gespann), 2=Cx2_LKW_Busse_etc (CM_PSD_Ges_Geschwindigkeit_Gespann_Cx2_LKW_Busse_etc) (LKW, Busse, etc.)}, range raw 0..2, transfer-property=TRIGGERED, to Klima(timeout 1.5 s)  # Gilt diese Einschränkung der Geschwindigkeit für alle Fahrzeuge oder ausschließlich für PKW mit Gespann oder für LKW, Buss, etc.
    signal PSD_Ges_Geschwindigkeit_Witter_XIX_PSD_06_Mx02_XIX_E3V_EVCANFD: start 31, 2 bit, little-endian, data-type-policy=OVERRIDE, i-signal-type=PRIMITIVE, init-value=0, base-type=BT_PSD_Ges_Geschwindigkeit_Witter, compu {0=Cx0_Witterungsunabhaengig (CM_PSD_Ges_Geschwindigkeit_Witter_Cx0_Witterungsunabhaengig) (Witterungsunabhängig), 1=Cx1_Naesse_Regen_Niederschlag (CM_PSD_Ges_Geschwindigkeit_Witter_Cx1_Naesse_Regen_Niederschlag) (Nässe, Regen, Niederschlag), 2=Cx2_Glaette (CM_PSD_Ges_Geschwindigkeit_Witter_Cx2_Glaette) (Glätte), 3=Cx3_Nebel (CM_PSD_Ges_Geschwindigkeit_Witter_Cx3_Nebel)}, range raw 0..3, transfer-property=TRIGGERED, to Klima(timeout 1.5 s)  # Witterungsabhängigkeit der Geschwindigkeitsbegrenzung
    signal PSD_Ges_Geschwindigkeit_Tag_Anf_XIX_PSD_06_Mx02_XIX_E3V_EVCANFD: start 33, 3 bit, little-endian, data-type-policy=OVERRIDE, i-signal-type=PRIMITIVE, init-value=0, base-type=BT_PSD_Ges_Geschwindigkeit_Tag_Anf, compu {0=Cx0_kein_Beginn_definiert (CM_PSD_Ges_Geschwindigkeit_Tag_Anf_Cx0_kein_Beginn_definiert) (kein Beginn definiert), 1=Cx1_Montag (CM_PSD_Ges_Geschwindigkeit_Tag_Anf_Cx1_Montag), 2=Cx2_Dienstag (CM_PSD_Ges_Geschwindigkeit_Tag_Anf_Cx2_Dienstag), 3=Cx3_Mittwoch (CM_PSD_Ges_Geschwindigkeit_Tag_Anf_Cx3_Mittwoch), 4=Cx4_Donnerstag (CM_PSD_Ges_Geschwindigkeit_Tag_Anf_Cx4_Donnerstag), 5=Cx5_Freitag (CM_PSD_Ges_Geschwindigkeit_Tag_Anf_Cx5_Freitag), 6=Cx6_Samstag (CM_PSD_Ges_Geschwindigkeit_Tag_Anf_Cx6_Samstag), 7=Cx7_Sonntag (CM_PSD_Ges_Geschwindigkeit_Tag_Anf_Cx7_Sonntag)}, range raw 0..7, transfer-property=TRIGGERED, to Klima(timeout 1.5 s)  # Wochentag, an dem die tägliche Geschwindigkeitsbegrenzung beginnt
    signal PSD_Ges_Geschwindigkeit_Tag_Ende_XIX_PSD_06_Mx02_XIX_E3V_EVCANFD: start 36, 3 bit, little-endian, data-type-policy=OVERRIDE, i-signal-type=PRIMITIVE, init-value=0, base-type=BT_PSD_Ges_Geschwindigkeit_Tag_Ende, compu {0=Cx0_kein_Ende_definiert (CM_PSD_Ges_Geschwindigkeit_Tag_Ende_Cx0_kein_Ende_definiert) (kein Ende definiert), 1=Cx1_Montag (CM_PSD_Ges_Geschwindigkeit_Tag_Ende_Cx1_Montag), 2=Cx2_Dienstag (CM_PSD_Ges_Geschwindigkeit_Tag_Ende_Cx2_Dienstag), 3=Cx3_Mittwoch (CM_PSD_Ges_Geschwindigkeit_Tag_Ende_Cx3_Mittwoch), 4=Cx4_Donnerstag (CM_PSD_Ges_Geschwindigkeit_Tag_Ende_Cx4_Donnerstag), 5=Cx5_Freitag (CM_PSD_Ges_Geschwindigkeit_Tag_Ende_Cx5_Freitag), 6=Cx6_Samstag (CM_PSD_Ges_Geschwindigkeit_Tag_Ende_Cx6_Samstag), 7=Cx7_Sonntag (CM_PSD_Ges_Geschwindigkeit_Tag_Ende_Cx7_Sonntag)}, range raw 0..7, transfer-property=TRIGGERED, to Klima(timeout 1.5 s)  # Wochentag, an dem die tägliche Geschwindigkeitsbegrenzung endet
    signal PSD_Ges_Geschwindigkeit_Std_Anf_XIX_PSD_06_Mx02_XIX_E3V_EVCANFD: start 39, 5 bit, little-endian, data-type-policy=OVERRIDE, i-signal-type=PRIMITIVE, init-value=0, base-type=BT_PSD_Ges_Geschwindigkeit_Std_Anf, compu {phys=raw for raw 0..24, 25=Cx19_kein_Beginn_fuer_stundenweise_Einschraenkungen (CM_PSD_Ges_Geschwindigkeit_Std_Anf_Cx19_kein_Beginn_fuer_stundenweise_Einschraenkungen) (kein Beginn für stundenweise Einschränkungen); unit Unit_Hours}, range phys 0..24 Unit_Hours, raw 0..25, unit=Unit_Hours, transfer-property=TRIGGERED, to Klima(timeout 1.5 s)  # Stunde, zu der die stündliche Geschwindigkeitsbegrenzung beginnt 0h.. 24h
    signal PSD_Ges_Geschwindigkeit_Std_Ende_XIX_PSD_06_Mx02_XIX_E3V_EVCANFD: start 44, 5 bit, little-endian, data-type-policy=OVERRIDE, i-signal-type=PRIMITIVE, init-value=0, base-type=BT_PSD_Ges_Geschwindigkeit_Std_Ende, compu {phys=raw for raw 0..24, 25=Cx19_kein_Ende_fuer_stundenweise_Einschraenkungen (CM_PSD_Ges_Geschwindigkeit_Std_Ende_Cx19_kein_Ende_fuer_stundenweise_Einschraenkungen) (kein Ende für stundenweise Einschränkungen); unit Unit_Hours}, range phys 0..24 Unit_Hours, raw 0..25, unit=Unit_Hours, transfer-property=TRIGGERED, to Klima(timeout 1.5 s)  # Stunde, an der die stündliche Geschwindigkeitsbegrenzung endet 0h.. 24h
    signal PSD_Ges_Ueberholverbot_XIX_PSD_06_Mx02_XIX_E3V_EVCANFD: start 49, 2 bit, little-endian, data-type-policy=OVERRIDE, i-signal-type=PRIMITIVE, init-value=0, base-type=BT_PSD_Ges_Ueberholverbot, compu {0=Cx0_kein_ueberholverbot (CM_PSD_Ges_Ueberholverbot_Cx0_kein_ueberholverbot) (kein Überholverbot), 1=Cx1_alle_Fahrzeuge (CM_PSD_Ges_Ueberholverbot_Cx1_alle_Fahrzeuge) (alle Fahrzeuge), 2=Cx2_ueberholverbot_fuer_PKW_mit_Gespann (CM_PSD_Ges_Ueberholverbot_Cx2_ueberholverbot_fuer_PKW_mit_Gespann) (Überholverbot für PKW mit Gespann), 3=Cx3_ueberholverbot_fuer_LKW_Busse_etc (CM_PSD_Ges_Ueberholverbot_Cx3_ueberholverbot_fuer_LKW_Busse_etc) (Überholverbot für LKW, Busse, etc.)}, range raw 0..3, transfer-property=TRIGGERED, to Klima(timeout 1.5 s)
    signal PSD_Ges_Wechselverkehrszeichen_XIX_PSD_06_Mx02_XIX_E3V_EVCANFD: start 51, 3 bit, little-endian, data-type-policy=OVERRIDE, i-signal-type=PRIMITIVE, init-value=0, base-type=BT_PSD_Ges_Wechselverkehrszeichen, compu {0=Cx0_Kein_Wechselverkehrszeichen (CM_PSD_Ges_Wechselverkehrszeichen_Cx0_Kein_Wechselverkehrszeichen) (Kein Wechselverkehrszeichen), 1=Cx1_Wechselverkehrszeichen_links (CM_PSD_Ges_Wechselverkehrszeichen_Cx1_Wechselverkehrszeichen_links) (Wechselverkehrszeichen links), 2=Cx2_Wechselverkehrszeichen_rechts (CM_PSD_Ges_Wechselverkehrszeichen_Cx2_Wechselverkehrszeichen_rechts) (Wechselverkehrszeichen rechts), 3=Cx3_Wechselverkehrszeichen_links_und_rechts (CM_PSD_Ges_Wechselverkehrszeichen_Cx3_Wechselverkehrszeichen_links_und_rechts) (Wechselverkehrszeichen links und rechts), 4=Cx4_Wechselverkerhszeichen_ueber_der_Fahrbahn (CM_PSD_Ges_Wechselverkehrszeichen_Cx4_Wechselverkerhszeichen_ueber_der_Fahrbahn) (Wechselverkerhszeichen über der Fahrbahn)}, range raw 0..4, transfer-property=TRIGGERED, to Klima(timeout 1.5 s)  # Am Beginn des Segments ist ein Wechselverkehrszeichen angebracht.
    signal PSD_Wechselverkehrszeichen_Typ_XIX_PSD_06_Mx02_XIX_E3V_EVCANFD: start 54, 2 bit, little-endian, data-type-policy=OVERRIDE, i-signal-type=PRIMITIVE, init-value=0, base-type=BT_PSD_Wechselverkehrszeichen_Typ, compu {0=Cx0_kein_Wechselverkehrszeichen (CM_PSD_Wechselverkehrszeichen_Typ_Cx0_kein_Wechselverkehrszeichen), 1=Cx1_LED_Wechselverkehrszeichen (CM_PSD_Wechselverkehrszeichen_Typ_Cx1_LED_Wechselverkehrszeichen), 2=Cx2_nicht_LED_Wechselverkehrszeichen (CM_PSD_Wechselverkehrszeichen_Typ_Cx2_nicht_LED_Wechselverkehrszeichen)}, range raw 0..2, transfer-property=TRIGGERED, to Klima(timeout 1.5 s)  # Typ des Wechselverkehrszeichen
    signal PSD_Ges_Gesetzlich_Kategorie_XIX_PSD_06_Mx02_XIX_E3V_EVCANFD: start 56, 3 bit, little-endian, data-type-policy=OVERRIDE, i-signal-type=PRIMITIVE, init-value=0, base-type=BT_PSD_Ges_Gesetzlich_Kategorie, compu {0=Cx0_kein_legales_Verbot (CM_PSD_Ges_Gesetzlich_Kategorie_Cx0_kein_legales_Verbot), 1=Cx1_innerorts (CM_PSD_Ges_Gesetzlich_Kategorie_Cx1_innerorts), 2=Cx2_ausserorts (CM_PSD_Ges_Gesetzlich_Kategorie_Cx2_ausserorts), 3=Cx3_Autobahn (CM_PSD_Ges_Gesetzlich_Kategorie_Cx3_Autobahn)}, range raw 0..3, transfer-property=TRIGGERED, to Klima(timeout 1.5 s)  # Kategorie für das legale Gebot
    signal PSD_Ges_Gesetzlich_Zusatz_XIX_PSD_06_Mx02_XIX_E3V_EVCANFD: start 59, 2 bit, little-endian, data-type-policy=OVERRIDE, i-signal-type=PRIMITIVE, init-value=0, base-type=BT_PSD_Ges_Gesetzlich_Zusatz, compu {0=Cx0_kein_Zusatz_zu_legalem_Gebot (CM_PSD_Ges_Gesetzlich_Zusatz_Cx0_kein_Zusatz_zu_legalem_Gebot), 1=Cx1_Anhaenger_Klasse_1 (CM_PSD_Ges_Gesetzlich_Zusatz_Cx1_Anhaenger_Klasse_1), 2=Cx2_Anhaenger_Klasse_2 (CM_PSD_Ges_Gesetzlich_Zusatz_Cx2_Anhaenger_Klasse_2)}, range raw 0..2, transfer-property=TRIGGERED, to Klima(timeout 1.5 s)  # Zusatz für das legale Gebot
    signal PSD_Ges_Verkehrszeichen_Quelle_XIX_PSD_06_Mx02_XIX_E3V_EVCANFD: start 61, 2 bit, little-endian, data-type-policy=OVERRIDE, i-signal-type=PRIMITIVE, init-value=0, base-type=BT_PSD_Ges_Verkehrszeichen_Quelle, compu {0=Cx0_VZA_kein_Onlinedienst (CM_PSD_Ges_Verkehrszeichen_Quelle_Cx0_VZA_kein_Onlinedienst), 1=Cx1_nur_VZA (CM_PSD_Ges_Verkehrszeichen_Quelle_Cx1_nur_VZA), 2=Cx2_nur_VZO (CM_PSD_Ges_Verkehrszeichen_Quelle_Cx2_nur_VZO), 3=Cx3_VZA_und_VZO (CM_PSD_Ges_Verkehrszeichen_Quelle_Cx3_VZA_und_VZO)}, range raw 0..3, transfer-property=TRIGGERED, to Klima(timeout 1.5 s)  # Quelle der Verkehrszeicheninformation
    signal PSD_Ges_Attribute_Komplett_XIX_PSD_06_Mx02_XIX_E3V_EVCANFD: start 63, 1 bit, little-endian, data-type-policy=OVERRIDE, i-signal-type=PRIMITIVE, init-value=0, base-type=BT_PSD_Ges_Attribute_Komplett, compu {0=Cx0_Attribute_nicht_komplett (CM_PSD_Ges_Attribute_Komplett_Cx0_Attribute_nicht_komplett), 1=Cx1_Attribute_komplett (CM_PSD_Ges_Attribute_Komplett_Cx1_Attribute_komplett)}, range raw 0..1, transfer-property=TRIGGERED, to Klima(timeout 1.5 s)  # Zeigt, ob alle Attribute für das Segment übertragen worden sind
  pdu PSD_06_Mx03_XIX_E3V_EVCANFD: length=8, transmission-mode-true-timing={cyclic-timing={time-offset=0, time-period=0.15}, event-controlled-timing={number-of-repetitions=0, repetition-period=0.0}}, unused-bit-pattern=0
    signal PSD_06_Mux_XIX_PSD_06_Mx03_XIX_E3V_EVCANFD: start 0, 3 bit, little-endian, data-type-policy=OVERRIDE, i-signal-type=PRIMITIVE, init-value=3, base-type=BT_PSD_06_Mux, compu {0=Cx0_Init (CM_PSD_06_Mux_Cx0_Init)}, range raw 0, to Klima(timeout 1.5 s)  # Multiplex Zähler für die PSD_06-Botschaft. Die unterschiedlichen Muxe folgen keiner festen Reihenfolge. Je nach Inhalt des PSD-Protokolls an der aktuellen Position werden jeweils die notwendigen PSD6-Botschaften gesendet.
    signal PSD_Baum_Laenge_VZ_XIX_PSD_06_Mx03_XIX_E3V_EVCANFD: start 3, 1 bit, little-endian, data-type-policy=OVERRIDE, i-signal-type=PRIMITIVE, init-value=0, base-type=BT_PSD_Baum_Laenge_VZ, compu {0=Cx0_Ost (CM_PSD_Baum_Laenge_VZ_Cx0_Ost), 1=Cx1_West (CM_PSD_Baum_Laenge_VZ_Cx1_West)}, range raw 0..1, transfer-property=TRIGGERED, to Klima(timeout 1.5 s)  # Vorzeichen WGS84 Laenge des Fahrzeugsegments
    signal PSD_Baum_Laenge_XIX_PSD_06_Mx03_XIX_E3V_EVCANFD: start 4, 25 bit, little-endian, data-type-policy=OVERRIDE, i-signal-type=PRIMITIVE, init-value=0, base-type=BT_PSD_Baum_Laenge, compu {phys=raw*1e-05 for raw 0..18000000, 33554431=Cx1ffffff_keine_GPS_Information (CM_PSD_Baum_Laenge_Cx1ffffff_keine_GPS_Information); unit Unit_DegreOfArc}, range phys 0..180 Unit_DegreOfArc, raw 0..33554431, unit=Unit_DegreOfArc, transfer-property=TRIGGERED, to Klima(timeout 1.5 s)  # WGS84 Laenge des Fahrzeugsegments
    signal PSD_Baum_Breite_VZ_XIX_PSD_06_Mx03_XIX_E3V_EVCANFD: start 29, 1 bit, little-endian, data-type-policy=OVERRIDE, i-signal-type=PRIMITIVE, init-value=0, base-type=BT_PSD_Baum_Breite_VZ, compu {0=Cx0_Nord (CM_PSD_Baum_Breite_VZ_Cx0_Nord), 1=Cx1_Sued (CM_PSD_Baum_Breite_VZ_Cx1_Sued)}, range raw 0..1, transfer-property=TRIGGERED, to Klima(timeout 1.5 s)  # Vorzeichen WGS84 Breite des Fahrzeugsegments
    signal PSD_Baum_Breite_XIX_PSD_06_Mx03_XIX_E3V_EVCANFD: start 30, 24 bit, little-endian, data-type-policy=OVERRIDE, i-signal-type=PRIMITIVE, init-value=0, base-type=BT_PSD_Baum_Breite, compu {phys=raw*1e-05 for raw 0..9000000; unit Unit_DegreOfArc}, range phys 0..90 Unit_DegreOfArc, raw 0..9000000, unit=Unit_DegreOfArc, transfer-property=TRIGGERED  # WGS84 Breite des Fahrzeugsegments
    signal PSD_Baum_Ausrichtung_XIX_PSD_06_Mx03_XIX_E3V_EVCANFD: start 54, 10 bit, little-endian, data-type-policy=OVERRIDE, i-signal-type=PRIMITIVE, init-value=0, base-type=BT_PSD_Baum_Ausrichtung, compu {phys=raw*0.3515625 for raw 0..1023; unit Unit_DegreOfArc}, range phys 0..359.6484375 Unit_DegreOfArc, raw 0..1023, unit=Unit_DegreOfArc, transfer-property=TRIGGERED, to Klima(timeout 1.5 s)  # Ausrichtung des Fahrzeugsegments zu Nord
  pdu PSD_06_Mx04_XIX_E3V_EVCANFD: length=8, transmission-mode-true-timing={cyclic-timing={time-offset=0, time-period=0.15}, event-controlled-timing={number-of-repetitions=0, repetition-period=0.0}}, unused-bit-pattern=0
    signal PSD_06_Mux_XIX_PSD_06_Mx04_XIX_E3V_EVCANFD: start 0, 3 bit, little-endian, data-type-policy=OVERRIDE, i-signal-type=PRIMITIVE, init-value=4, base-type=BT_PSD_06_Mux, compu {0=Cx0_Init (CM_PSD_06_Mux_Cx0_Init)}, range raw 0, to Klima(timeout 1.5 s)  # Multiplex Zähler für die PSD_06-Botschaft. Die unterschiedlichen Muxe folgen keiner festen Reihenfolge. Je nach Inhalt des PSD-Protokolls an der aktuellen Position werden jeweils die notwendigen PSD6-Botschaften gesendet.
    signal PSD_Steigung_1_Segment_ID_XIX_PSD_06_Mx04_XIX_E3V_EVCANFD: start 3, 6 bit, little-endian, data-type-policy=OVERRIDE, i-signal-type=PRIMITIVE, init-value=0, base-type=BT_PSD_Steigung_1_Segment_ID, invalid-value=Invalid_PSD_Steigung_1_Segment_ID_XIX_PSD_06_XIX_E3V_EVCANFD:1, compu {0=Cx0_keine_Segment_Information_vorhanden (CM_PSD_Steigung_1_Segment_ID_Cx0_keine_Segment_Information_vorhanden), 1=Cx1_Fehler (CM_PSD_Steigung_1_Segment_ID_Cx1_Fehler), phys=raw for raw 2..63}, range phys 2..63, raw 0..63, transfer-property=TRIGGERED, to Klima(timeout 1.5 s)  # Identifier des prädiktiven Streckensegments, zu dem die ersten beiden Steigungswerte dieser Botschaft gehören
    signal PSD_Steigung_1_A_Steigung_XIX_PSD_06_Mx04_XIX_E3V_EVCANFD: start 9, 7 bit, little-endian, data-type-policy=OVERRIDE, i-signal-type=PRIMITIVE, init-value=0, base-type=BT_PSD_Steigung_1_A_Steigung, compu {phys=raw*0.12 for raw 0..125, 126=Cx7e_mehr_als_15_Prozent (CM_PSD_Steigung_1_A_Steigung_Cx7e_mehr_als_15_Prozent), 127=Cx7f_Steigung_unbekannt (CM_PSD_Steigung_1_A_Steigung_Cx7f_Steigung_unbekannt); unit Unit_PerCent}, range phys 0..15 Unit_PerCent, raw 0..127, unit=Unit_PerCent, transfer-property=TRIGGERED, to Klima(timeout 1.5 s)  # Steigung des Segments ab Offset 1A
    signal PSD_Steigung_1_A_Vorz_XIX_PSD_06_Mx04_XIX_E3V_EVCANFD: start 16, 1 bit, little-endian, data-type-policy=OVERRIDE, i-signal-type=PRIMITIVE, init-value=0, base-type=BT_PSD_Steigung_1_A_Vorz, compu {0=Cx0_Gefaelle (CM_PSD_Steigung_1_A_Vorz_Cx0_Gefaelle), 1=Cx1_Steigung (CM_PSD_Steigung_1_A_Vorz_Cx1_Steigung)}, range raw 0..1, transfer-property=TRIGGERED, to Klima(timeout 1.5 s)  # Vorzeichen für Steigung 1 A
    signal PSD_Steigung_1_A_Offset_XIX_PSD_06_Mx04_XIX_E3V_EVCANFD: start 17, 7 bit, little-endian, data-type-policy=OVERRIDE, i-signal-type=PRIMITIVE, init-value=0, base-type=BT_PSD_Steigung_1_A_Offset, compu {phys=raw*2 for raw 0..127; unit Unit_Meter}, range phys 0..254 Unit_Meter, raw 0..127, unit=Unit_Meter, transfer-property=TRIGGERED, to Klima(timeout 1.5 s)  # Positionsoffset im Segment für die Position der Steigung 1 A
    signal PSD_Steigung_1_B_Steigung_XIX_PSD_06_Mx04_XIX_E3V_EVCANFD: start 24, 7 bit, little-endian, data-type-policy=OVERRIDE, i-signal-type=PRIMITIVE, init-value=0, base-type=BT_PSD_Steigung_1_B_Steigung, compu {phys=raw*0.12 for raw 0..125, 126=Cx7e_mehr_als_15_Prozent (CM_PSD_Steigung_1_B_Steigung_Cx7e_mehr_als_15_Prozent), 127=Cx7f_Steigung_unbekannt (CM_PSD_Steigung_1_B_Steigung_Cx7f_Steigung_unbekannt); unit Unit_PerCent}, range phys 0..15 Unit_PerCent, raw 0..127, unit=Unit_PerCent, transfer-property=TRIGGERED, to Klima(timeout 1.5 s)  # Steigung des Segments ab Offset 1B
    signal PSD_Steigung_1_B_Vorz_XIX_PSD_06_Mx04_XIX_E3V_EVCANFD: start 31, 1 bit, little-endian, data-type-policy=OVERRIDE, i-signal-type=PRIMITIVE, init-value=0, base-type=BT_PSD_Steigung_1_B_Vorz, compu {0=Cx0_Gefaelle (CM_PSD_Steigung_1_B_Vorz_Cx0_Gefaelle), 1=Cx1_Steigung (CM_PSD_Steigung_1_B_Vorz_Cx1_Steigung)}, range raw 0..1, transfer-property=TRIGGERED, to Klima(timeout 1.5 s)  # Vorzeichen für Steigung 1 B
    signal PSD_Steigung_1_B_Offset_XIX_PSD_06_Mx04_XIX_E3V_EVCANFD: start 32, 7 bit, little-endian, data-type-policy=OVERRIDE, i-signal-type=PRIMITIVE, init-value=0, base-type=BT_PSD_Steigung_1_B_Offset, compu {phys=raw*2 for raw 0..127; unit Unit_Meter}, range phys 0..254 Unit_Meter, raw 0..127, unit=Unit_Meter, transfer-property=TRIGGERED, to Klima(timeout 1.5 s)  # Positionsoffset im Segment für die Position der Steigung 1 B
    signal PSD_Steigung_1_Attribute_kompl_XIX_PSD_06_Mx04_XIX_E3V_EVCANFD: start 39, 1 bit, little-endian, data-type-policy=OVERRIDE, i-signal-type=PRIMITIVE, init-value=0, base-type=BT_PSD_Steigung_1_Attribute_kompl, compu {0=Cx0_Steigungen_nicht_komplett (CM_PSD_Steigung_1_Attribute_kompl_Cx0_Steigungen_nicht_komplett), 1=Cx1_Steigungen_komplett (CM_PSD_Steigung_1_Attribute_kompl_Cx1_Steigungen_komplett)}, range raw 0..1, transfer-property=TRIGGERED, to Klima(timeout 1.5 s)  # Alle Steigungsdaten für dieses Segment gesendet
    signal PSD_Steigung_2_Segment_ID_XIX_PSD_06_Mx04_XIX_E3V_EVCANFD: start 40, 6 bit, little-endian, data-type-policy=OVERRIDE, i-signal-type=PRIMITIVE, init-value=0, base-type=BT_PSD_Steigung_2_Segment_ID, invalid-value=Invalid_PSD_Steigung_2_Segment_ID_XIX_PSD_06_XIX_E3V_EVCANFD:1, compu {0=Cx0_keine_Segment_Information_vorhanden (CM_PSD_Steigung_2_Segment_ID_Cx0_keine_Segment_Information_vorhanden), 1=Cx1_Fehler (CM_PSD_Steigung_2_Segment_ID_Cx1_Fehler), phys=raw for raw 2..63}, range phys 2..63, raw 0..63, transfer-property=TRIGGERED, to Klima(timeout 1.5 s)  # Identifier des prädiktiven Streckensegments, zu dem der dritte Steigungswert dieser Botschaft gehört
    signal PSD_Steigung_2_Steigung_XIX_PSD_06_Mx04_XIX_E3V_EVCANFD: start 46, 7 bit, little-endian, data-type-policy=OVERRIDE, i-signal-type=PRIMITIVE, init-value=0, base-type=BT_PSD_Steigung_2_Steigung, compu {phys=raw*0.12 for raw 0..125, 126=Cx7e_mehr_als_15_Prozent (CM_PSD_Steigung_2_Steigung_Cx7e_mehr_als_15_Prozent), 127=Cx7f_Steigung_unbekannt (CM_PSD_Steigung_2_Steigung_Cx7f_Steigung_unbekannt); unit Unit_PerCent}, range phys 0..15 Unit_PerCent, raw 0..127, unit=Unit_PerCent, transfer-property=TRIGGERED, to Klima(timeout 1.5 s)  # Steigung des Segments ab Offset 2
    signal PSD_Steigung_2_Vorz_XIX_PSD_06_Mx04_XIX_E3V_EVCANFD: start 53, 1 bit, little-endian, data-type-policy=OVERRIDE, i-signal-type=PRIMITIVE, init-value=0, base-type=BT_PSD_Steigung_2_Vorz, compu {0=Cx0_Gefaelle (CM_PSD_Steigung_2_Vorz_Cx0_Gefaelle), 1=Cx1_Steigung (CM_PSD_Steigung_2_Vorz_Cx1_Steigung)}, range raw 0..1, transfer-property=TRIGGERED, to Klima(timeout 1.5 s)  # Vorzeichen für Steigung 2
    signal PSD_Steigung_2_Offset_XIX_PSD_06_Mx04_XIX_E3V_EVCANFD: start 54, 7 bit, little-endian, data-type-policy=OVERRIDE, i-signal-type=PRIMITIVE, init-value=0, base-type=BT_PSD_Steigung_2_Offset, compu {phys=raw*2 for raw 0..127; unit Unit_Meter}, range phys 0..254 Unit_Meter, raw 0..127, unit=Unit_Meter, transfer-property=TRIGGERED, to Klima(timeout 1.5 s)  # Positionsoffset im Segment für die Position der Steigung 2
    signal PSD_Steigung_2_Attribute_kompl_XIX_PSD_06_Mx04_XIX_E3V_EVCANFD: start 61, 1 bit, little-endian, data-type-policy=OVERRIDE, i-signal-type=PRIMITIVE, init-value=0, base-type=BT_PSD_Steigung_2_Attribute_kompl, compu {0=Cx0_Steigungen_nicht_komplett (CM_PSD_Steigung_2_Attribute_kompl_Cx0_Steigungen_nicht_komplett), 1=Cx1_Steigungen_komplett (CM_PSD_Steigung_2_Attribute_kompl_Cx1_Steigungen_komplett)}, range raw 0..1, transfer-property=TRIGGERED, to Klima(timeout 1.5 s)  # Alle Steigungsdaten für dieses Segment gesendet
  pdu PSD_LR_01_Mx00_XIX_E3V_EVCANFD: length=8, transmission-mode-true-timing={cyclic-timing={time-offset=0, time-period=1.80}, event-controlled-timing={number-of-repetitions=0, repetition-period=0.0}}, unused-bit-pattern=0
    signal PSD_LR_01_MUX_XIX_PSD_LR_01_Mx00_XIX_E3V_EVCANFD: start 2, 2 bit, little-endian, data-type-policy=OVERRIDE, i-signal-type=PRIMITIVE, init-value=0, base-type=BT_PSD_LR_01_MUX, compu {0=Cx0_Init (CM_PSD_LR_01_MUX_Cx0_Init)}, range raw 0, to Klima(timeout 4.5 s)  # Fehlende Beschreibung (Import)
    signal PSD_LR_Profil_Laenge_XIX_PSD_LR_01_Mx00_XIX_E3V_EVCANFD: start 4, 14 bit, little-endian, data-type-policy=OVERRIDE, i-signal-type=PRIMITIVE, base-type=BT_PSD_LR_Profil_Laenge, compu {phys=raw*0.25 for raw 0..16383; unit Unit_KiloMeter}, range phys 0..4095.75 Unit_KiloMeter, raw 0..16383, unit=Unit_KiloMeter, transfer-property=TRIGGERED, to Klima(timeout 4.5 s)  # Gesamtlänge des übertragenen Profils. Signal wird nur bei aktiver PSD-Funktion zyklisch gesendet.
    signal PSD_LR_Fahrzeug_Pos_XIX_PSD_LR_01_Mx00_XIX_E3V_EVCANFD: start 18, 14 bit, little-endian, data-type-policy=OVERRIDE, i-signal-type=PRIMITIVE, base-type=BT_PSD_LR_Fahrzeug_Pos, compu {phys=raw*0.006103888 for raw 0..16383; unit Unit_PerCent}, range phys 0..99.999997104 Unit_PerCent, raw 0..16383, unit=Unit_PerCent, transfer-property=TRIGGERED, to Klima(timeout 4.5 s)  # Position des Fahrzeug in % relativ zur Gesamtlaenge des Profils. Signal wird nur bei aktiver PSD-Funktion zyklisch gesendet.
    signal PSD_LR_Globale_Steigung_Vorz_XIX_PSD_LR_01_Mx00_XIX_E3V_EVCANFD: start 32, 1 bit, little-endian, data-type-policy=OVERRIDE, i-signal-type=PRIMITIVE, init-value=0, base-type=BT_PSD_LR_Globale_Steigung_Vorz, compu {0=Cx0_Gefaelle (CM_PSD_LR_Globale_Steigung_Vorz_Cx0_Gefaelle), 1=Cx1_Steigung (CM_PSD_LR_Globale_Steigung_Vorz_Cx1_Steigung)}, range raw 0..1, transfer-property=TRIGGERED, to Klima(timeout 4.5 s)  # Vorzeichen für globale Steigung des Profils. Signal wird nur bei aktiver PSD-Funktion zyklisch gesendet.
    signal PSD_LR_Globale_Steigung_XIX_PSD_LR_01_Mx00_XIX_E3V_EVCANFD: start 33, 19 bit, little-endian, data-type-policy=OVERRIDE, i-signal-type=PRIMITIVE, base-type=BT_PSD_LR_Globale_Steigung, compu {phys=raw*2.861028406e-05 for raw 0..524287; unit Unit_PerCent}, range phys 0..14.999999999998066 Unit_PerCent, raw 0..524287, unit=Unit_PerCent, transfer-property=TRIGGERED, to Klima(timeout 4.5 s)  # Gesamtsteigung der in diesem Profil übertragenen Strecke. Signal wird nur bei aktiver PSD-Funktion zyklisch gesendet.
    signal PSD_LR_Max_Koeff_Amp_XIX_PSD_LR_01_Mx00_XIX_E3V_EVCANFD: start 52, 11 bit, little-endian, data-type-policy=OVERRIDE, i-signal-type=PRIMITIVE, base-type=BT_PSD_LR_Max_Koeff_Amp, compu {phys=raw*2 for raw 0..2047; unit Unit_Meter}, range phys 0..4094 Unit_Meter, raw 0..2047, unit=Unit_Meter, transfer-property=TRIGGERED  # Maximale Höhe der übertragenen Amplitudenwerte. Signal wird nur bei aktiver PSD-Funktion zyklisch gesendet.
    signal PSD_LR_Reset_XIX_PSD_LR_01_Mx00_XIX_E3V_EVCANFD: start 63, 1 bit, little-endian, data-type-policy=OVERRIDE, i-signal-type=PRIMITIVE, base-type=BT_PSD_LR_Reset, compu {0=Cx0_kein_Reset (CM_PSD_LR_Reset_Cx0_kein_Reset) (kein Reset), 1=Cx1_Reset (CM_PSD_LR_Reset_Cx1_Reset)}, range raw 0..1, transfer-property=TRIGGERED, to Klima(timeout 4.5 s)  # Reset-Signal, wenn der PSD-LR-Baum ungültig wird. Signal wird nur bei aktiver PSD-Funktion zyklisch gesendet.
  pdu PSD_LR_01_Mx01_XIX_E3V_EVCANFD: length=8, transmission-mode-true-timing={cyclic-timing={time-offset=0.45, time-period=1.80}, event-controlled-timing={number-of-repetitions=0, repetition-period=0.0}}, unused-bit-pattern=0
    signal PSD_LR_01_MUX_XIX_PSD_LR_01_Mx01_XIX_E3V_EVCANFD: start 2, 2 bit, little-endian, data-type-policy=OVERRIDE, i-signal-type=PRIMITIVE, init-value=1, base-type=BT_PSD_LR_01_MUX, compu {0=Cx0_Init (CM_PSD_LR_01_MUX_Cx0_Init)}, range raw 0, to Klima(timeout 4.5 s)  # Fehlende Beschreibung (Import)
    signal PSD_LR_Koeffizientensatz_Nr_XIX_PSD_LR_01_Mx01_XIX_E3V_EVCANFD: start 4, 6 bit, little-endian, data-type-policy=OVERRIDE, i-signal-type=PRIMITIVE, base-type=BT_PSD_LR_Koeffizientensatz_Nr, compu {phys=raw for raw 0..63}, range phys 0..63, raw 0..63, transfer-property=TRIGGERED  # Nummer des aktuell übertragenen Koeffizientansatzes. Signal wird nur bei aktiver PSD-Funktion zyklisch gesendet.
    signal PSD_LR_Koeff_1_Amp_XIX_PSD_LR_01_Mx01_XIX_E3V_EVCANFD: start 10, 9 bit, little-endian, data-type-policy=OVERRIDE, i-signal-type=PRIMITIVE, base-type=BT_PSD_LR_Koeff_1_Amp, compu {phys=raw*0.01956947162 for raw 0..511; unit Unit_PerCent}, range phys 0..9.99999999782 Unit_PerCent, raw 0..511, unit=Unit_PerCent, transfer-property=TRIGGERED  # Fehlende Beschreibung (Import)
    signal PSD_LR_Koeff_1_Phase_XIX_PSD_LR_01_Mx01_XIX_E3V_EVCANFD: start 19, 9 bit, little-endian, data-type-policy=OVERRIDE, i-signal-type=PRIMITIVE, base-type=BT_PSD_LR_Koeff_1_Phase, compu {phys=raw*0.0122958616 for raw 0..511; unit Unit_DegreOfArc}, range phys 0..6.2831852776 Unit_DegreOfArc, raw 0..511, unit=Unit_DegreOfArc, transfer-property=TRIGGERED  # Phasenwert des ersten FFT-Koeffizienten. Signal wird nur bei aktiver PSD-Funktion zyklisch gesendet.
    signal PSD_LR_Koeff_2_Amp_XIX_PSD_LR_01_Mx01_XIX_E3V_EVCANFD: start 28, 9 bit, little-endian, data-type-policy=OVERRIDE, i-signal-type=PRIMITIVE, base-type=BT_PSD_LR_Koeff_2_Amp, compu {phys=raw*0.01956947162 for raw 0..511; unit Unit_PerCent}, range phys 0..9.99999999782 Unit_PerCent, raw 0..511, unit=Unit_PerCent, transfer-property=TRIGGERED  # Fehlende Beschreibung (Import)
    signal PSD_LR_Koeff_2_Phase_XIX_PSD_LR_01_Mx01_XIX_E3V_EVCANFD: start 37, 9 bit, little-endian, data-type-policy=OVERRIDE, i-signal-type=PRIMITIVE, base-type=BT_PSD_LR_Koeff_2_Phase, compu {phys=raw*0.0122958616 for raw 0..511; unit Unit_DegreOfArc}, range phys 0..6.2831852776 Unit_DegreOfArc, raw 0..511, unit=Unit_DegreOfArc, transfer-property=TRIGGERED  # Phasenwert des zweiten FFT-Koeffizienten. Signal wird nur bei aktiver PSD-Funktion zyklisch gesendet.
    signal PSD_LR_Koeff_3_Amp_XIX_PSD_LR_01_Mx01_XIX_E3V_EVCANFD: start 46, 9 bit, little-endian, data-type-policy=OVERRIDE, i-signal-type=PRIMITIVE, base-type=BT_PSD_LR_Koeff_3_Amp, compu {phys=raw*0.01956947162 for raw 0..511; unit Unit_PerCent}, range phys 0..9.99999999782 Unit_PerCent, raw 0..511, unit=Unit_PerCent, transfer-property=TRIGGERED  # Fehlende Beschreibung (Import)
    signal PSD_LR_Koeff_3_Phase_XIX_PSD_LR_01_Mx01_XIX_E3V_EVCANFD: start 55, 9 bit, little-endian, data-type-policy=OVERRIDE, i-signal-type=PRIMITIVE, base-type=BT_PSD_LR_Koeff_3_Phase, compu {phys=raw*0.0122958616 for raw 0..511; unit Unit_DegreOfArc}, range phys 0..6.2831852776 Unit_DegreOfArc, raw 0..511, unit=Unit_DegreOfArc, transfer-property=TRIGGERED  # Phasenwert des dritten FFT-Koeffizienten. Signal wird nur bei aktiver PSD-Funktion zyklisch gesendet.
  pdu PSD_LR_01_Mx02_XIX_E3V_EVCANFD: length=8, transmission-mode-true-timing={cyclic-timing={time-offset=0.90, time-period=1.80}, event-controlled-timing={number-of-repetitions=0, repetition-period=0.0}}, unused-bit-pattern=0
    signal PSD_LR_01_MUX_XIX_PSD_LR_01_Mx02_XIX_E3V_EVCANFD: start 2, 2 bit, little-endian, data-type-policy=OVERRIDE, i-signal-type=PRIMITIVE, init-value=2, base-type=BT_PSD_LR_01_MUX, compu {0=Cx0_Init (CM_PSD_LR_01_MUX_Cx0_Init)}, range raw 0, to Klima(timeout 4.5 s)  # Fehlende Beschreibung (Import)
    signal PSD_LR_Attribut_1_Offset_XIX_PSD_LR_01_Mx02_XIX_E3V_EVCANFD: start 4, 12 bit, little-endian, data-type-policy=OVERRIDE, i-signal-type=PRIMITIVE, base-type=BT_PSD_LR_Attribut_1_Offset, compu {phys=raw*0.0244140625 for raw 0..4095; unit Unit_PerCent}, range phys 0..99.9755859375 Unit_PerCent, raw 0..4095, unit=Unit_PerCent, transfer-property=TRIGGERED, to Klima(timeout 4.5 s)  # Relative Position für Attribut 1 im Profil. Signal wird nur bei aktiver PSD-Funktion zyklisch gesendet.
    signal PSD_LR_Attribut_1_Wert_XIX_PSD_LR_01_Mx02_XIX_E3V_EVCANFD: start 16, 8 bit, little-endian, data-type-policy=OVERRIDE, i-signal-type=PRIMITIVE, init-value=0, base-type=BT_PSD_LR_Attribut_1_Wert, compu {0=Cx0_Init (CM_PSD_LR_Attribut_1_Wert_Cx0_Init)}, range raw 0, transfer-property=TRIGGERED, to Klima(timeout 4.5 s)  # Wert von Attribut 1 (Definition siehe PSD Spec) Signal wird nur bei aktiver PSD-Funktion zyklisch gesendet.
    signal PSD_LR_Attribut_2_Offset_XIX_PSD_LR_01_Mx02_XIX_E3V_EVCANFD: start 24, 12 bit, little-endian, data-type-policy=OVERRIDE, i-signal-type=PRIMITIVE, base-type=BT_PSD_LR_Attribut_2_Offset, compu {phys=raw*0.0244140625 for raw 0..4095; unit Unit_PerCent}, range phys 0..99.9755859375 Unit_PerCent, raw 0..4095, unit=Unit_PerCent, transfer-property=TRIGGERED, to Klima(timeout 4.5 s)  # Relative Position für Attribut 2 im Profil Signal wird nur bei aktiver PSD-Funktion zyklisch gesendet.
    signal PSD_LR_Attribut_2_Wert_XIX_PSD_LR_01_Mx02_XIX_E3V_EVCANFD: start 36, 8 bit, little-endian, data-type-policy=OVERRIDE, i-signal-type=PRIMITIVE, init-value=0, base-type=BT_PSD_LR_Attribut_2_Wert, compu {0=Cx0_Init (CM_PSD_LR_Attribut_2_Wert_Cx0_Init)}, range raw 0, transfer-property=TRIGGERED, to Klima(timeout 4.5 s)  # Wert von Attribut 2 (Definition siehe PSD Spec) Signal wird nur bei aktiver PSD-Funktion zyklisch gesendet.
    signal PSD_LR_Attribut_3_Offset_XIX_PSD_LR_01_Mx02_XIX_E3V_EVCANFD: start 44, 12 bit, little-endian, data-type-policy=OVERRIDE, i-signal-type=PRIMITIVE, base-type=BT_PSD_LR_Attribut_3_Offset, compu {phys=raw*0.0244140625 for raw 0..4095; unit Unit_PerCent}, range phys 0..99.9755859375 Unit_PerCent, raw 0..4095, unit=Unit_PerCent, transfer-property=TRIGGERED, to Klima(timeout 4.5 s)  # Relative Position für Attribut 3 im Profil Signal wird nur bei aktiver PSD-Funktion zyklisch gesendet.
    signal PSD_LR_Attribut_3_Wert_XIX_PSD_LR_01_Mx02_XIX_E3V_EVCANFD: start 56, 8 bit, little-endian, data-type-policy=OVERRIDE, i-signal-type=PRIMITIVE, init-value=0, base-type=BT_PSD_LR_Attribut_3_Wert, compu {0=Cx0_Init (CM_PSD_LR_Attribut_3_Wert_Cx0_Init)}, range raw 0, transfer-property=TRIGGERED, to Klima(timeout 4.5 s)  # Wert von Attribut 3 (Definition siehe PSD Spec) Signal wird nur bei aktiver PSD-Funktion zyklisch gesendet.
  pdu PSD_LR_01_Mx03_XIX_E3V_EVCANFD: length=8, transmission-mode-true-timing={cyclic-timing={time-offset=1.35, time-period=1.80}, event-controlled-timing={number-of-repetitions=0, repetition-period=0.0}}, unused-bit-pattern=0
    signal PSD_LR_01_MUX_XIX_PSD_LR_01_Mx03_XIX_E3V_EVCANFD: start 2, 2 bit, little-endian, data-type-policy=OVERRIDE, i-signal-type=PRIMITIVE, init-value=3, base-type=BT_PSD_LR_01_MUX, compu {0=Cx0_Init (CM_PSD_LR_01_MUX_Cx0_Init)}, range raw 0, to Klima(timeout 4.5 s)  # Fehlende Beschreibung (Import)
    signal PSD_LR_Steigung_1_Offset_XIX_PSD_LR_01_Mx03_XIX_E3V_EVCANFD: start 4, 12 bit, little-endian, data-type-policy=OVERRIDE, i-signal-type=PRIMITIVE, base-type=BT_PSD_LR_Steigung_1_Offset, compu {phys=raw*0.0244140625 for raw 0..4095; unit Unit_PerCent}, range phys 0..99.9755859375 Unit_PerCent, raw 0..4095, unit=Unit_PerCent, transfer-property=TRIGGERED, to Klima(timeout 4.5 s)  # Relative Position für die Steigung 1 im Profil. Signal wird nur bei aktiver PSD-Funktion zyklisch gesendet.
    signal PSD_LR_Steigung_1_Vorz_XIX_PSD_LR_01_Mx03_XIX_E3V_EVCANFD: start 16, 1 bit, little-endian, data-type-policy=OVERRIDE, i-signal-type=PRIMITIVE, init-value=0, base-type=BT_PSD_LR_Steigung_1_Vorz, compu {0=Cx0_Gefaelle (CM_PSD_LR_Steigung_1_Vorz_Cx0_Gefaelle), 1=Cx1_Steigung (CM_PSD_LR_Steigung_1_Vorz_Cx1_Steigung)}, range raw 0..1, transfer-property=TRIGGERED, to Klima(timeout 4.5 s)  # Vorzeichen für Steigung 1. Signal wird nur bei aktiver PSD-Funktion zyklisch gesendet.
    signal PSD_LR_Steigung_1_Wert_XIX_PSD_LR_01_Mx03_XIX_E3V_EVCANFD: start 17, 7 bit, little-endian, data-type-policy=OVERRIDE, i-signal-type=PRIMITIVE, base-type=BT_PSD_LR_Steigung_1_Wert, compu {phys=raw*0.12 for raw 0..127; unit Unit_PerCent}, range phys 0..15.24 Unit_PerCent, raw 0..127, unit=Unit_PerCent, transfer-property=TRIGGERED, to Klima(timeout 4.5 s)  # Mittlere Steigung zwischen dem Offset 1 und dem letzten Steigungswert. Signal wird nur bei aktiver PSD-Funktion zyklisch gesendet.
    signal PSD_LR_Steigung_2_Offset_XIX_PSD_LR_01_Mx03_XIX_E3V_EVCANFD: start 24, 12 bit, little-endian, data-type-policy=OVERRIDE, i-signal-type=PRIMITIVE, base-type=BT_PSD_LR_Steigung_2_Offset, compu {phys=raw*0.0244140625 for raw 0..4095; unit Unit_PerCent}, range phys 0..99.9755859375 Unit_PerCent, raw 0..4095, unit=Unit_PerCent, transfer-property=TRIGGERED, to Klima(timeout 4.5 s)  # Relative Position für die Steigung 2 im Profil. Signal wird nur bei aktiver PSD-Funktion zyklisch gesendet.
    signal PSD_LR_Steigung_2_Vorz_XIX_PSD_LR_01_Mx03_XIX_E3V_EVCANFD: start 36, 1 bit, little-endian, data-type-policy=OVERRIDE, i-signal-type=PRIMITIVE, init-value=0, base-type=BT_PSD_LR_Steigung_2_Vorz, compu {0=Cx0_Gefaelle (CM_PSD_LR_Steigung_2_Vorz_Cx0_Gefaelle), 1=Cx1_Steigung (CM_PSD_LR_Steigung_2_Vorz_Cx1_Steigung)}, range raw 0..1, transfer-property=TRIGGERED, to Klima(timeout 4.5 s)  # Vorzeichen für Steigung 2. Signal wird nur bei aktiver PSD-Funktion zyklisch gesendet.
    signal PSD_LR_Steigung_2_Wert_XIX_PSD_LR_01_Mx03_XIX_E3V_EVCANFD: start 37, 7 bit, little-endian, data-type-policy=OVERRIDE, i-signal-type=PRIMITIVE, base-type=BT_PSD_LR_Steigung_2_Wert, compu {phys=raw*0.12 for raw 0..127; unit Unit_PerCent}, range phys 0..15.24 Unit_PerCent, raw 0..127, unit=Unit_PerCent, transfer-property=TRIGGERED, to Klima(timeout 4.5 s)  # Mittlere Steigung zwischen dem Offset 2 und dem letzten Steigungswert. Signal wird nur bei aktiver PSD-Funktion zyklisch gesendet.
    signal PSD_LR_Steigung_3_Offset_XIX_PSD_LR_01_Mx03_XIX_E3V_EVCANFD: start 44, 12 bit, little-endian, data-type-policy=OVERRIDE, i-signal-type=PRIMITIVE, base-type=BT_PSD_LR_Steigung_3_Offset, compu {phys=raw*0.0244140625 for raw 0..4095; unit Unit_PerCent}, range phys 0..99.9755859375 Unit_PerCent, raw 0..4095, unit=Unit_PerCent, transfer-property=TRIGGERED, to Klima(timeout 4.5 s)  # Relative Position für die Steigung 3 im Profil. Signal wird nur bei aktiver PSD-Funktion zyklisch gesendet.
    signal PSD_LR_Steigung_3_Vorz_XIX_PSD_LR_01_Mx03_XIX_E3V_EVCANFD: start 56, 1 bit, little-endian, data-type-policy=OVERRIDE, i-signal-type=PRIMITIVE, init-value=0, base-type=BT_PSD_LR_Steigung_3_Vorz, compu {0=Cx0_Gefaelle (CM_PSD_LR_Steigung_3_Vorz_Cx0_Gefaelle), 1=Cx1_Steigung (CM_PSD_LR_Steigung_3_Vorz_Cx1_Steigung)}, range raw 0..1, transfer-property=TRIGGERED, to Klima(timeout 4.5 s)  # Vorzeichen für Steigung 3. Signal wird nur bei aktiver PSD-Funktion zyklisch gesendet.
    signal PSD_LR_Steigung_3_Wert_XIX_PSD_LR_01_Mx03_XIX_E3V_EVCANFD: start 57, 7 bit, little-endian, data-type-policy=OVERRIDE, i-signal-type=PRIMITIVE, base-type=BT_PSD_LR_Steigung_3_Wert, compu {phys=raw*0.12 for raw 0..127; unit Unit_PerCent}, range phys 0..15.24 Unit_PerCent, raw 0..127, unit=Unit_PerCent, transfer-property=TRIGGERED, to Klima(timeout 4.5 s)  # Mittlere Steigung zwischen dem Offset 3 und dem letzten Steigungswert. Signal wird nur bei aktiver PSD-Funktion zyklisch gesendet.
  pdu PSD_LR_01_MxStatic_XIX_E3V_EVCANFD: length=8, transmission-mode-true-timing=cyclic-timing={time-offset=0.0, time-period=0.45}, unused-bit-pattern=0
    signal PSD_LR_Profil_Nummer_XIX_PSD_LR_01_MxStatic_XIX_E3V_EVCANFD: start 0, 2 bit, little-endian, data-type-policy=OVERRIDE, i-signal-type=PRIMITIVE, base-type=BT_PSD_LR_Profil_Nummer, compu {phys=raw for raw 0..3}, range phys 0..3, raw 0..3, transfer-property=PENDING, to Klima(timeout 4.5 s)  # Nummer des aktuell übertragenen Profils
  pdu VIN_01_Mx00_XIX_E3V_EVCANFD: length=8, transmission-mode-true-timing={cyclic-timing={time-offset=0, time-period=0.4}, event-controlled-timing={number-of-repetitions=0, repetition-period=0.0}}, unused-bit-pattern=0  # 200ms bei D4 und folgende
    signal VIN_01_MUX_XIX_VIN_01_Mx00_XIX_E3V_EVCANFD: start 0, 2 bit, little-endian, data-type-policy=OVERRIDE, i-signal-type=PRIMITIVE, init-value=0, base-type=BT_VIN_01_MUX, compu {phys=raw for raw 0..3}, range phys 0..3, raw 0..3, to Klima(timeout 2 s)  # Achtung: Die Botschaft ist nicht linear gemultiplext!!! Sondern 0,1,0,2,0, usw.
    signal KS_Geheimnis_1_XIX_VIN_01_Mx00_XIX_E3V_EVCANFD: start 8, 8 bit, little-endian, data-type-policy=OVERRIDE, i-signal-type=PRIMITIVE, init-value=0, base-type=BT_KS_Geheimnis_1, compu {phys=raw for raw 0..255}, range phys 0..255, raw 0..255, transfer-property=TRIGGERED
    signal KS_Geheimnis_2_XIX_VIN_01_Mx00_XIX_E3V_EVCANFD: start 16, 8 bit, little-endian, data-type-policy=OVERRIDE, i-signal-type=PRIMITIVE, init-value=0, base-type=BT_KS_Geheimnis_2, compu {phys=raw for raw 0..255}, range phys 0..255, raw 0..255, transfer-property=TRIGGERED
    signal KS_Geheimnis_3_XIX_VIN_01_Mx00_XIX_E3V_EVCANFD: start 24, 8 bit, little-endian, data-type-policy=OVERRIDE, i-signal-type=PRIMITIVE, init-value=0, base-type=BT_KS_Geheimnis_3, compu {phys=raw for raw 0..255}, range phys 0..255, raw 0..255, transfer-property=TRIGGERED
    signal KS_Geheimnis_4_XIX_VIN_01_Mx00_XIX_E3V_EVCANFD: start 32, 8 bit, little-endian, data-type-policy=OVERRIDE, i-signal-type=PRIMITIVE, init-value=0, base-type=BT_KS_Geheimnis_4, compu {phys=raw for raw 0..255}, range phys 0..255, raw 0..255, transfer-property=TRIGGERED
    signal VIN_1_XIX_VIN_01_Mx00_XIX_E3V_EVCANFD: start 40, 8 bit, little-endian, data-type-policy=OVERRIDE, i-signal-type=PRIMITIVE, init-value=45, base-type=BT_VIN_1, compu {phys=raw for raw 0..255}, range phys 0..255, raw 0..255, transfer-property=TRIGGERED, to Klima(timeout 2 s)  # Initwert: 0x2D bei Fahrzeugen mit Wegfahrsperrengeneration >= 5 0x58 bei Fahrzeugen mit Wegfahrsperrengeneration < 5 (z.B. WFS-4)
    signal VIN_2_XIX_VIN_01_Mx00_XIX_E3V_EVCANFD: start 48, 8 bit, little-endian, data-type-policy=OVERRIDE, i-signal-type=PRIMITIVE, init-value=45, base-type=BT_VIN_2, compu {phys=raw for raw 0..255}, range phys 0..255, raw 0..255, transfer-property=TRIGGERED, to Klima(timeout 2 s)  # Initwert: 0x2D bei Fahrzeugen mit Wegfahrsperrengeneration >= 5 0x58 bei Fahrzeugen mit Wegfahrsperrengeneration < 5 (z.B. WFS-4)
    signal VIN_3_XIX_VIN_01_Mx00_XIX_E3V_EVCANFD: start 56, 8 bit, little-endian, data-type-policy=OVERRIDE, i-signal-type=PRIMITIVE, init-value=45, base-type=BT_VIN_3, compu {phys=raw for raw 0..255}, range phys 0..255, raw 0..255, transfer-property=TRIGGERED, to Klima(timeout 2 s)  # Initwert: 0x2D bei Fahrzeugen mit Wegfahrsperrengeneration >= 5 0x58 bei Fahrzeugen mit Wegfahrsperrengeneration < 5 (z.B. WFS-4)
  pdu VIN_01_Mx01_XIX_E3V_EVCANFD: length=8, transmission-mode-true-timing={cyclic-timing={time-offset=0.2, time-period=0.8}, event-controlled-timing={number-of-repetitions=0, repetition-period=0.0}}, unused-bit-pattern=0  # 200ms bei D4 und folgende
    signal VIN_01_MUX_XIX_VIN_01_Mx01_XIX_E3V_EVCANFD: start 0, 2 bit, little-endian, data-type-policy=OVERRIDE, i-signal-type=PRIMITIVE, init-value=1, base-type=BT_VIN_01_MUX, compu {phys=raw for raw 0..3}, range phys 0..3, raw 0..3, to Klima(timeout 2 s)  # Achtung: Die Botschaft ist nicht linear gemultiplext!!! Sondern 0,1,0,2,0, usw.
    signal VIN_4_XIX_VIN_01_Mx01_XIX_E3V_EVCANFD: start 8, 8 bit, little-endian, data-type-policy=OVERRIDE, i-signal-type=PRIMITIVE, init-value=45, base-type=BT_VIN_4, compu {phys=raw for raw 0..255}, range phys 0..255, raw 0..255, transfer-property=TRIGGERED, to Klima(timeout 2 s)  # Initwert: 0x2D bei Fahrzeugen mit Wegfahrsperrengeneration >= 5 0x58 bei Fahrzeugen mit Wegfahrsperrengeneration < 5 (z.B. WFS-4)
    signal VIN_5_XIX_VIN_01_Mx01_XIX_E3V_EVCANFD: start 16, 8 bit, little-endian, data-type-policy=OVERRIDE, i-signal-type=PRIMITIVE, init-value=45, base-type=BT_VIN_5, compu {phys=raw for raw 0..255}, range phys 0..255, raw 0..255, transfer-property=TRIGGERED, to Klima(timeout 2 s)  # Initwert: 0x2D bei Fahrzeugen mit Wegfahrsperrengeneration >= 5 0x58 bei Fahrzeugen mit Wegfahrsperrengeneration < 5 (z.B. WFS-4)
    signal VIN_6_XIX_VIN_01_Mx01_XIX_E3V_EVCANFD: start 24, 8 bit, little-endian, data-type-policy=OVERRIDE, i-signal-type=PRIMITIVE, init-value=45, base-type=BT_VIN_6, compu {phys=raw for raw 0..255}, range phys 0..255, raw 0..255, transfer-property=TRIGGERED, to Klima(timeout 2 s)  # Initwert: 0x2D bei Fahrzeugen mit Wegfahrsperrengeneration >= 5 0x58 bei Fahrzeugen mit Wegfahrsperrengeneration < 5 (z.B. WFS-4)
    signal VIN_7_XIX_VIN_01_Mx01_XIX_E3V_EVCANFD: start 32, 8 bit, little-endian, data-type-policy=OVERRIDE, i-signal-type=PRIMITIVE, init-value=45, base-type=BT_VIN_7, compu {phys=raw for raw 0..255}, range phys 0..255, raw 0..255, transfer-property=TRIGGERED, to Klima(timeout 2 s)  # Initwert: 0x2D bei Fahrzeugen mit Wegfahrsperrengeneration >= 5 0x58 bei Fahrzeugen mit Wegfahrsperrengeneration < 5 (z.B. WFS-4)
    signal VIN_8_XIX_VIN_01_Mx01_XIX_E3V_EVCANFD: start 40, 8 bit, little-endian, data-type-policy=OVERRIDE, i-signal-type=PRIMITIVE, init-value=45, base-type=BT_VIN_8, compu {phys=raw for raw 0..255}, range phys 0..255, raw 0..255, transfer-property=TRIGGERED, to Klima(timeout 2 s)  # Initwert: 0x2D bei Fahrzeugen mit Wegfahrsperrengeneration >= 5 0x58 bei Fahrzeugen mit Wegfahrsperrengeneration < 5 (z.B. WFS-4)
    signal VIN_9_XIX_VIN_01_Mx01_XIX_E3V_EVCANFD: start 48, 8 bit, little-endian, data-type-policy=OVERRIDE, i-signal-type=PRIMITIVE, init-value=45, base-type=BT_VIN_9, compu {phys=raw for raw 0..255}, range phys 0..255, raw 0..255, transfer-property=TRIGGERED, to Klima(timeout 2 s)  # Initwert: 0x2D bei Fahrzeugen mit Wegfahrsperrengeneration >= 5 0x58 bei Fahrzeugen mit Wegfahrsperrengeneration < 5 (z.B. WFS-4)
    signal VIN_10_XIX_VIN_01_Mx01_XIX_E3V_EVCANFD: start 56, 8 bit, little-endian, data-type-policy=OVERRIDE, i-signal-type=PRIMITIVE, init-value=45, base-type=BT_VIN_10, compu {phys=raw for raw 0..255}, range phys 0..255, raw 0..255, transfer-property=TRIGGERED, to Klima(timeout 2 s)  # Initwert: 0x2D bei Fahrzeugen mit Wegfahrsperrengeneration >= 5 0x58 bei Fahrzeugen mit Wegfahrsperrengeneration < 5 (z.B. WFS-4)
  pdu VIN_01_Mx02_XIX_E3V_EVCANFD: length=8, transmission-mode-true-timing={cyclic-timing={time-offset=0.6, time-period=0.8}, event-controlled-timing={number-of-repetitions=0, repetition-period=0.0}}, unused-bit-pattern=0  # 200ms bei D4 und folgende
    signal VIN_01_MUX_XIX_VIN_01_Mx02_XIX_E3V_EVCANFD: start 0, 2 bit, little-endian, data-type-policy=OVERRIDE, i-signal-type=PRIMITIVE, init-value=2, base-type=BT_VIN_01_MUX, compu {phys=raw for raw 0..3}, range phys 0..3, raw 0..3, to Klima(timeout 2 s)  # Achtung: Die Botschaft ist nicht linear gemultiplext!!! Sondern 0,1,0,2,0, usw.
    signal VIN_11_XIX_VIN_01_Mx02_XIX_E3V_EVCANFD: start 8, 8 bit, little-endian, data-type-policy=OVERRIDE, i-signal-type=PRIMITIVE, init-value=45, base-type=BT_VIN_11, compu {phys=raw for raw 0..255}, range phys 0..255, raw 0..255, transfer-property=TRIGGERED, to Klima(timeout 2 s)  # Initwert: 0x2D bei Fahrzeugen mit Wegfahrsperrengeneration >= 5 0x58 bei Fahrzeugen mit Wegfahrsperrengeneration < 5 (z.B. WFS-4)
    signal VIN_12_XIX_VIN_01_Mx02_XIX_E3V_EVCANFD: start 16, 8 bit, little-endian, data-type-policy=OVERRIDE, i-signal-type=PRIMITIVE, init-value=45, base-type=BT_VIN_12, compu {phys=raw for raw 0..255}, range phys 0..255, raw 0..255, transfer-property=TRIGGERED, to Klima(timeout 2 s)  # Initwert: 0x2D bei Fahrzeugen mit Wegfahrsperrengeneration >= 5 0x58 bei Fahrzeugen mit Wegfahrsperrengeneration < 5 (z.B. WFS-4)
    signal VIN_13_XIX_VIN_01_Mx02_XIX_E3V_EVCANFD: start 24, 8 bit, little-endian, data-type-policy=OVERRIDE, i-signal-type=PRIMITIVE, init-value=45, base-type=BT_VIN_13, compu {phys=raw for raw 0..255}, range phys 0..255, raw 0..255, transfer-property=TRIGGERED, to Klima(timeout 2 s)  # Initwert: 0x2D bei Fahrzeugen mit Wegfahrsperrengeneration >= 5 0x58 bei Fahrzeugen mit Wegfahrsperrengeneration < 5 (z.B. WFS-4)
    signal VIN_14_XIX_VIN_01_Mx02_XIX_E3V_EVCANFD: start 32, 8 bit, little-endian, data-type-policy=OVERRIDE, i-signal-type=PRIMITIVE, init-value=45, base-type=BT_VIN_14, compu {phys=raw for raw 0..255}, range phys 0..255, raw 0..255, transfer-property=TRIGGERED, to Klima(timeout 2 s)  # Initwert: 0x2D bei Fahrzeugen mit Wegfahrsperrengeneration >= 5 0x58 bei Fahrzeugen mit Wegfahrsperrengeneration < 5 (z.B. WFS-4)
    signal VIN_15_XIX_VIN_01_Mx02_XIX_E3V_EVCANFD: start 40, 8 bit, little-endian, data-type-policy=OVERRIDE, i-signal-type=PRIMITIVE, init-value=45, base-type=BT_VIN_15, compu {phys=raw for raw 0..255}, range phys 0..255, raw 0..255, transfer-property=TRIGGERED, to Klima(timeout 2 s)  # Initwert: 0x2D bei Fahrzeugen mit Wegfahrsperrengeneration >= 5 0x58 bei Fahrzeugen mit Wegfahrsperrengeneration < 5 (z.B. WFS-4)
    signal VIN_16_XIX_VIN_01_Mx02_XIX_E3V_EVCANFD: start 48, 8 bit, little-endian, data-type-policy=OVERRIDE, i-signal-type=PRIMITIVE, init-value=45, base-type=BT_VIN_16, compu {phys=raw for raw 0..255}, range phys 0..255, raw 0..255, transfer-property=TRIGGERED, to Klima(timeout 2 s)  # Initwert: 0x2D bei Fahrzeugen mit Wegfahrsperrengeneration >= 5 0x58 bei Fahrzeugen mit Wegfahrsperrengeneration < 5 (z.B. WFS-4)
    signal VIN_17_XIX_VIN_01_Mx02_XIX_E3V_EVCANFD: start 56, 8 bit, little-endian, data-type-policy=OVERRIDE, i-signal-type=PRIMITIVE, init-value=45, base-type=BT_VIN_17, compu {phys=raw for raw 0..255}, range phys 0..255, raw 0..255, transfer-property=TRIGGERED, to Klima(timeout 2 s)  # Initwert: 0x2D bei Fahrzeugen mit Wegfahrsperrengeneration >= 5 0x58 bei Fahrzeugen mit Wegfahrsperrengeneration < 5 (z.B. WFS-4)
  secured i pdu SOK_E3V_EVCANFD_XIX_TPCHType_CANHS_FoD_Master_XIX_0x17FC0346_XIX_0x17FE0346_XIX_Physical:
    length=520
    authentication-props=SecureCommunicationAuthenticationProps_XIX_64
    freshness-props=SecureCommunicationFreshnessProps
    payload=PT_E3V_EVCANFD_XIX_TPCHType_CANHS_FoD_Master_XIX_0x17FC0346_XIX_0x17FE0346_XIX_Physical
    secure-communication-props={auth-data-freshness-length=0, auth-data-freshness-start-position=0, auth-info-tx-length=64, authentication-build-attempts=1, authentication-retries=1, data-id=40, freshness-value-id=0, freshness-value-length=64, freshness-value-tx-length=0}
    use-as-cryptographic-i-pdu=false
  secured i pdu SOK_E3V_EVCANFD_XIX_TPCHType_CANHS_FoD_Master_XIX_0x17FE0346_XIX_0x17FC0346_XIX_Physical:
    length=520
    authentication-props=SecureCommunicationAuthenticationProps_XIX_64
    freshness-props=SecureCommunicationFreshnessProps
    payload=PT_E3V_EVCANFD_XIX_TPCHType_CANHS_FoD_Master_XIX_0x17FE0346_XIX_0x17FC0346_XIX_Physical
    secure-communication-props={auth-data-freshness-length=0, auth-data-freshness-start-position=0, auth-info-tx-length=64, authentication-build-attempts=1, authentication-retries=1, data-id=41, freshness-value-id=0, freshness-value-length=64, freshness-value-tx-length=0}
    use-as-cryptographic-i-pdu=false
  user defined i pdu CDD_E3V_EVCANFD_XIX_TPCHType_CANHS_FoD_Master_XIX_0x17FC0346_XIX_0x17FE0346_XIX_Physical: length=512, cdd-type=TPCHType_CANHS_FoD_Master
  user defined i pdu CDD_E3V_EVCANFD_XIX_TPCHType_CANHS_FoD_Master_XIX_0x17FE0346_XIX_0x17FC0346_XIX_Physical: length=512, cdd-type=TPCHType_CANHS_FoD_Master
package /IPDUGroup
  16 x i signal i pdu group:
    Klima_XIX_E3V_EVCANFD_Rx: communication-direction=IN, communication-mode=CAN_Receive_All
      i-signal-i-pdus:
        Airbag_01_XIX_E3V_EVCANFD
        Airbag_02_XIX_E3V_EVCANFD
        Airbag_04_XIX_E3V_EVCANFD
        Airbag_06_XIX_E3V_EVCANFD
        BCM_01_XIX_E3V_EVCANFD
        BCM_05_XIX_E3V_EVCANFD
        BEM_02_XIX_E3V_EVCANFD
        BEM_06_XIX_E3V_EVCANFD
        BMS_07_XIX_E3V_EVCANFD
        BMS_20_XIX_E3V_EVCANFD
        BMS_22_XIX_E3V_EVCANFD
        BMS_23_XIX_E3V_EVCANFD
        BMS_25_XIX_E3V_EVCANFD
        BMS_26_XIX_E3V_EVCANFD
        BMS_31_XIX_E3V_EVCANFD
        BMS_34_XIX_E3V_EVCANFD
        Charisma_03_XIX_E3V_EVCANFD
        Diagnose_01_XIX_E3V_EVCANFD
        DiETa_01_XIX_E3V_EVCANFD
        Dimmung_01_XIX_E3V_EVCANFD
        Einheiten_01_XIX_E3V_EVCANFD
        EM1_01_XIX_E3V_EVCANFD
        ESC_51_Auth_XIX_E3V_EVCANFD
        ESP_21_XIX_E3V_EVCANFD
        ESP_30_XIX_E3V_EVCANFD
        eTM_{01..03}_XIX_E3V_EVCANFD
        FoD_01_XIX_E3V_EVCANFD
        GNSS_01_XIX_E3V_EVCANFD
        GNSS_02_XIX_E3V_EVCANFD
        GNSS_04_XIX_E3V_EVCANFD
        GNSS_05_XIX_E3V_EVCANFD
        GNSS_DR_01_XIX_E3V_EVCANFD
        GNSS_DR_02_XIX_E3V_EVCANFD
        GNSS_DR_05_XIX_E3V_EVCANFD
        HDSG_01_XIX_E3V_EVCANFD
        HLR_02_XIX_E3V_EVCANFD
        HVEM_02_XIX_E3V_EVCANFD
        HVEM_04_XIX_E3V_EVCANFD
        HVK_01_XIX_E3V_EVCANFD
        HVLM_17_XIX_E3V_EVCANFD
        Klemmen_Status_01_XIX_E3V_EVCANFD
        Klemmen_Status_02_XIX_E3V_EVCANFD
        Klima_Sensor_01_XIX_E3V_EVCANFD
        Klima_Sensor_02_XIX_E3V_EVCANFD
        LiSi_01_XIX_E3V_EVCANFD
        LR_HZG_01_XIX_E3V_EVCANFD
        MFL_Tasten_Kon_01_XIX_E3V_EVCANFD
        MIK_01_XIX_E3V_EVCANFD
        Motor_14_XIX_E3V_EVCANFD
        Motor_16_XIX_E3V_EVCANFD
        Motor_26_Mx00_XIX_E3V_EVCANFD
        Motor_26_Mx01_XIX_E3V_EVCANFD
        Motor_26_MxStatic_XIX_E3V_EVCANFD
        Motor_52_XIX_E3V_EVCANFD
        Motor_54_XIX_E3V_EVCANFD
        Motor_Code_01_XIX_E3V_EVCANFD
        MSG_HYB_30_XIX_E3V_EVCANFD
        NavData_04_XIX_E3V_EVCANFD
        ORU_01_XIX_E3V_EVCANFD
        ORU_03_XIX_E3V_EVCANFD
        Personalisierung_01_XIX_E3V_EVCANFD
        POS_GNSS_DR_01_XIX_E3V_EVCANFD
        PSD_04_XIX_E3V_EVCANFD
        PSD_05_XIX_E3V_EVCANFD
        PSD_06_Mx{00..04}_XIX_E3V_EVCANFD
        PSD_LR_01_Mx{00..03}_XIX_E3V_EVCANFD
        PSD_LR_01_MxStatic_XIX_E3V_EVCANFD
        RLS_01_XIX_E3V_EVCANFD
        SAD_01_XIX_E3V_EVCANFD
        SMLS_01_XIX_E3V_EVCANFD
        SOK_FoD_Klima_Resp_Chal_02_XIX_E3V_EVCANFD
        SoSe_01_XIX_E3V_EVCANFD
        Standklima_01_XIX_E3V_EVCANFD
        Systeminfo_01_XIX_E3V_EVCANFD
        Temperaturen_01_XIX_E3V_EVCANFD
        TM_01_XIX_E3V_EVCANFD
        TSG_BT_01_XIX_E3V_EVCANFD
        TSG_FT_01_XIX_E3V_EVCANFD
        TSG_HBFS_01_XIX_E3V_EVCANFD
        TSG_HFS_01_XIX_E3V_EVCANFD
        UserStateServer_01_XIX_E3V_EVCANFD
        VIN_01_Mx{00..02}_XIX_E3V_EVCANFD
        Wischer_01_XIX_E3V_EVCANFD
        ZeitMaster_01_XIX_E3V_EVCANFD
        ZV_02_XIX_E3V_EVCANFD
    Klima_XIX_E3V_EVCANFD_Tx: communication-direction=OUT, communication-mode=CAN_Transmit_All
      i-signal-i-pdus:
        Klima_03_XIX_E3V_EVCANFD
        Klima_06_XIX_E3V_EVCANFD
        Klima_11_XIX_E3V_EVCANFD
        Klima_12_XIX_E3V_EVCANFD
        Klima_16_XIX_E3V_EVCANFD
        Klima_21_XIX_E3V_EVCANFD
        Klima_EV_03_XIX_E3V_EVCANFD
        Klima_EV_04_XIX_E3V_EVCANFD
        Klima_EV_{06..10}_XIX_E3V_EVCANFD
        Klima_hinten_04_XIX_E3V_EVCANFD
        Klima_SDA_01_XIX_E3V_EVCANFD
        Klima_Sensor_03_XIX_E3V_EVCANFD
        Klima_Sensor_04_XIX_E3V_EVCANFD
        KN_Klima_XIX_E3V_EVCANFD
        PTC_01_XIX_E3V_EVCANFD
        SOK_FoD_Klima_Req_Chal_02_XIX_E3V_EVCANFD
        Thermo_Verbrauch_01_XIX_E3V_EVCANFD
        Thermo_Verbrauch_02_XIX_E3V_EVCANFD
    Klima_XIX_Klima_LIN1_Rx: communication-direction=IN, communication-mode=CAN_Receive_All
      i-signal-i-pdus:
        AQSs_01_XIX_Klima_LIN1
        BLOWER1_STATUS_XIX_Klima_LIN1
        BLOWER2_STATUS_XIX_Klima_LIN1
        FSAs_01_XIX_Klima_LIN1
        ICO2bs_01_XIX_Klima_LIN1
        KBFs_01_XIX_Klima_LIN1
        KBFs_02_XIX_Klima_LIN1
        KPVs_01_XIX_Klima_LIN1
        KPVs_02_XIX_Klima_LIN1
        PMS1s_01_XIX_Klima_LIN1
        PTCs_01_XIX_Klima_LIN1
        UIFs_01_XIX_Klima_LIN1
    Klima_XIX_Klima_LIN1_Tx: communication-direction=OUT, communication-mode=CAN_Transmit_All
      i-signal-i-pdus:
        AQSe_01_XIX_Klima_LIN1
        BLOWER1_SET_XIX_Klima_LIN1
        BLOWER2_SET_XIX_Klima_LIN1
        FSAe_01_XIX_Klima_LIN1
        ICO2be_01_XIX_Klima_LIN1
        KBFe_01_XIX_Klima_LIN1
        KBFe_02_XIX_Klima_LIN1
        KPVe_01_XIX_Klima_LIN1
        KPVe_02_XIX_Klima_LIN1
        PMSe_01_XIX_Klima_LIN1
        PTCe_01_XIX_Klima_LIN1
        UIFe_01_XIX_Klima_LIN1
    Klima_XIX_Klima_LIN2_Rx: communication-direction=IN, communication-mode=CAN_Receive_All
      i-signal-i-pdus:
        DSs_01_XIX_Klima_LIN2
        DTS2bs_R744_01_XIX_Klima_LIN2
        DTS3bs_R744_01_XIX_Klima_LIN2
        EXV{1..3}s_01_XIX_Klima_LIN2
        IONs_01_XIX_Klima_LIN2
        LLRs_LL_01_XIX_Klima_LIN2
        LLRs_LS_01_XIX_Klima_LIN2
        LLRs_LS_02_XIX_Klima_LIN2
        LLRs_RL_01_XIX_Klima_LIN2
        LLRs_RS_01_XIX_Klima_LIN2
        LLRs_RS_02_XIX_Klima_LIN2
    Klima_XIX_Klima_LIN2_Tx: communication-direction=OUT, communication-mode=CAN_Transmit_All, i-signal-i-pdus=[EVe_01_Control_XIX_Klima_LIN2, IONe_01_XIX_Klima_LIN2, LLRe_L_01_XIX_Klima_LIN2, LLRe_R_01_XIX_Klima_LIN2]
    Klima_XIX_Klima_LIN3_Rx: communication-direction=IN, communication-mode=CAN_Receive_All
      i-signal-i-pdus:
        BLOWERs_01_XIX_Klima_LIN3
        BLOWERs_02_XIX_Klima_LIN3
        DTSs_{01..03}_XIX_Klima_LIN3
        EKK4s_01_XIX_Klima_LIN3
        EKK4s_02_XIX_Klima_LIN3
        EXV1s_01_XIX_Klima_LIN3
        HV_H2s_01_XIX_Klima_LIN3
        HV_H3s_01_XIX_Klima_LIN3
        HV_H6s_01_XIX_Klima_LIN3
        HV_Hs_01_XIX_Klima_LIN3
        HV_Hs_02_XIX_Klima_LIN3
        PCUs_01_XIX_Klima_LIN3
    Klima_XIX_Klima_LIN3_Tx: communication-direction=OUT, communication-mode=CAN_Transmit_All
      i-signal-i-pdus:
        BLOWERe_01_XIX_Klima_LIN3
        EKKe_01_XIX_Klima_LIN3
        EVe_01_Control_XIX_Klima_LIN3
        HV_H3e_01_XIX_Klima_LIN3
        HV_H6e_01_XIX_Klima_LIN3
        HV_He_01_XIX_Klima_LIN3
        ISO_Funktionaler_Req_All_XIX_Klima_LIN3
        PCUe_01_XIX_Klima_LIN3
    Klima_XIX_Klima_LIN4_Rx: communication-direction=IN, communication-mode=CAN_Receive_All
      i-signal-i-pdus:
        FRSs_01_XIX_Klima_LIN4
        HV_Hbs_01_XIX_Klima_LIN4
        HV_Hbs_02_XIX_Klima_LIN4
        KLhs_01_XIX_Klima_LIN4
        KLhs_02_XIX_Klima_LIN4
        LHR_01s_01_XIX_Klima_LIN4
        LLRs_LL_01_XIX_Klima_LIN4
        LLRs_LS_01_XIX_Klima_LIN4
        LLRs_RL_01_XIX_Klima_LIN4
        LLRs_RS_01_XIX_Klima_LIN4
        SMod_SRHs_01_XIX_Klima_LIN4
    Klima_XIX_Klima_LIN4_Tx: communication-direction=OUT, communication-mode=CAN_Transmit_All
      i-signal-i-pdus:
        FRSe_01_XIX_Klima_LIN4
        HV_Hbe_01_XIX_Klima_LIN4
        KLhe_01_XIX_Klima_LIN4
        KLhe_02_XIX_Klima_LIN4
        LHR_0102e_01_XIX_Klima_LIN4
        LLRe_L_01_XIX_Klima_LIN4
        LLRe_R_01_XIX_Klima_LIN4
        SMod_SRHe_01_XIX_Klima_LIN4
    Klima_XIX_Klima_LIN5_Rx: communication-direction=IN, communication-mode=CAN_Receive_All
      i-signal-i-pdus:
        ACTs_{401..412}_Status_XIX_Klima_LIN5
    Klima_XIX_Klima_LIN5_Tx: communication-direction=OUT, communication-mode=CAN_Transmit_All, i-signal-i-pdus=ACTe_400_Control_XIX_Klima_LIN5
    Klima_XIX_Klima_LIN6_Rx: communication-direction=IN, communication-mode=CAN_Receive_All
      i-signal-i-pdus:
        BLOWER1c_STATUS_XIX_Klima_LIN6
        BLOWER2b_STATUS_XIX_Klima_LIN6
        DTS{1..3}s_R744_01_XIX_Klima_LIN6
        EASV{1..5}s_01_Status_XIX_Klima_LIN6
        ICO2s_01_XIX_Klima_LIN6
    Klima_XIX_Klima_LIN6_Tx: communication-direction=OUT, communication-mode=CAN_Transmit_All
      i-signal-i-pdus:
        BLOWER1c_SET_XIX_Klima_LIN6
        BLOWER2b_SET_XIX_Klima_LIN6
        EVe_01_Control_XIX_Klima_LIN6
        ICO2e_01_XIX_Klima_LIN6
    Klima_XIX_Klima_LIN7_Rx: communication-direction=IN, communication-mode=CAN_Receive_All
      i-signal-i-pdus:
        BLOWER1b_STATUS_XIX_Klima_LIN7
        DTS2cs_R744_01_XIX_Klima_LIN7
        EXV4s_01_XIX_Klima_LIN7
        HV_H3bs_01_XIX_Klima_LIN7
        KLhs_01_XIX_Klima_LIN7
        KLhs_02_XIX_Klima_LIN7
        LHR_01s_01_XIX_Klima_LIN7
    Klima_XIX_Klima_LIN7_Tx: communication-direction=OUT, communication-mode=CAN_Transmit_All
      i-signal-i-pdus:
        BLOWER1b_SET_XIX_Klima_LIN7
        EVe_01_Control_XIX_Klima_LIN7
        HV_H3be_01_XIX_Klima_LIN7
        KLhe_01_XIX_Klima_LIN7
        KLhe_02_XIX_Klima_LIN7
        LHR_0102e_01_XIX_Klima_LIN7
package /Gateway
  gateway Klima: ecu=Klima
    signal-mappings:
      source-signal=ST_DI_KL_58xd_XIX_Dimmung_01, target-signal=ST_DI_KL_58xd_XIX_KBFe_01
      source-signal=ST_DI_KL_58xs_XIX_Dimmung_01, target-signal=ST_DI_KL_58xs_XIX_KBFe_01
      source-signal=ST_DI_KL_58xd_XIX_Dimmung_01, target-signal=ST_DI_KL_58xd_XIX_KPVe_02
      source-signal=ST_DI_KL_58xs_XIX_Dimmung_01, target-signal=ST_DI_KL_58xs_XIX_KPVe_02
      source-signal=ST_DI_KL_58xt_XIX_Dimmung_01, target-signal=ST_DI_KL_58xt_XIX_KPVe_02
      source-signal=ST_ZAS_Kl_15_XIX_Klemmen_Status_01, target-signal=ST_ZAS_Kl_15_XIX_KPVe_02
      source-signal=ST_FS_Taupunkt_XIX_Klima_Sensor_01, target-signal=ST_FS_Taupunkt_XIX_PMSe_01
      source-signal=ST_MD1_Lage_XIX_SAD_01, target-signal=ST_MD1_Lage_XIX_UIFe_01
      source-signal=ST_MRollo_Lage_XIX_SAD_01, target-signal=ST_MRollo_Lage_XIX_UIFe_01
      source-signal=ST_KBI_Aussen_Temp_gef_XIX_Temperaturen_01, target-signal=ST_KBI_Aussen_Temp_gef_XIX_PMSe_01
      source-signal=ST_FT_Kisi_li_aktiv_XIX_TSG_FT_01, target-signal=ST_FT_Kisi_li_aktiv_XIX_KBFe_01
      source-signal=ST_ZV_BT_offen_XIX_ZV_02, target-signal=ST_ZV_BT_offen_XIX_UIFe_01
      source-signal=ST_ZV_FT_offen_XIX_ZV_02, target-signal=ST_ZV_FT_offen_XIX_UIFe_01
      source-signal=ST_ZV_HBFS_offen_XIX_ZV_02, target-signal=ST_ZV_HBFS_offen_XIX_UIFe_01
      source-signal=ST_ZV_HFS_offen_XIX_ZV_02, target-signal=ST_ZV_HFS_offen_XIX_UIFe_01
      source-signal=ST_DI_KL_58xd_XIX_Dimmung_01, target-signal=ST_DI_KL_58xd_XIX_IONe_01
      source-signal=ST_UH_Minute_XIX_Diagnose_01, target-signal=CHNL/ST_UH_Minute_XIX_KLhe_02
      source-signal=ST_UH_Stunde_XIX_Diagnose_01, target-signal=CHNL/ST_UH_Stunde_XIX_KLhe_02
      source-signal=ST_DI_KL_58xd_XIX_Dimmung_01, target-signal=CHNL/ST_DI_KL_58xd_XIX_KLhe_02
      source-signal=ST_DI_KL_58xs_XIX_Dimmung_01, target-signal=CHNL/ST_DI_KL_58xs_XIX_KLhe_02
      source-signal=ST_KBI_Einheit_Uhrzeit_XIX_Einheiten_01, target-signal=CHNL/ST_KBI_Einheit_Uhrzeit_XIX_KLhe_02
      source-signal=ST_ZAS_Kl_15_XIX_Klemmen_Status_01, target-signal=CHNL/ST_ZAS_Kl_15_XIX_KLhe_02
      source-signal=ST_ZAS_Kl_S_XIX_Klemmen_Status_01, target-signal=CHNL/ST_ZAS_Kl_S_XIX_KLhe_02
      source-signal=ST_SI_T_Mode_XIX_Systeminfo_01, target-signal=CHNL/ST_SI_T_Mode_XIX_KLhe_02
      source-signal=ST_SI_T_Schutz_XIX_Systeminfo_01, target-signal=CHNL/ST_SI_T_Schutz_XIX_KLhe_02
      source-signal=ST_UH_Minute_XIX_Diagnose_01, target-signal=CHNL/ST_UH_Minute_XIX_KLhe_02
      source-signal=ST_UH_Stunde_XIX_Diagnose_01, target-signal=CHNL/ST_UH_Stunde_XIX_KLhe_02
      source-signal=ST_DI_KL_58xd_XIX_Dimmung_01, target-signal=CHNL/ST_DI_KL_58xd_XIX_KLhe_02
      source-signal=ST_DI_KL_58xs_XIX_Dimmung_01, target-signal=CHNL/ST_DI_KL_58xs_XIX_KLhe_02
      source-signal=ST_KBI_Einheit_Uhrzeit_XIX_Einheiten_01, target-signal=CHNL/ST_KBI_Einheit_Uhrzeit_XIX_KLhe_02
      source-signal=ST_ZAS_Kl_15_XIX_Klemmen_Status_01, target-signal=CHNL/ST_ZAS_Kl_15_XIX_KLhe_02
      source-signal=ST_ZAS_Kl_S_XIX_Klemmen_Status_01, target-signal=CHNL/ST_ZAS_Kl_S_XIX_KLhe_02
      source-signal=ST_SI_T_Mode_XIX_Systeminfo_01, target-signal=CHNL/ST_SI_T_Mode_XIX_KLhe_02
      source-signal=ST_SI_T_Schutz_XIX_Systeminfo_01, target-signal=CHNL/ST_SI_T_Schutz_XIX_KLhe_02
      source-signal=ST_FSA_HW_XIX_FSAs_01, target-signal=ST_FSA_HW_XIX_Klima_Sensor_03
      source-signal=ST_FSA_Luftfeuchte_rel_XIX_FSAs_01, target-signal=ST_FSA_Luftfeuchte_rel_XIX_Klima_Sensor_03
      source-signal=ST_FSA_ResponseError_XIX_FSAs_01, target-signal=ST_FSA_ResponseError_XIX_Klima_Sensor_03
      source-signal=ST_FSA_Sensorheizung_Status_XIX_FSAs_01, target-signal=ST_FSA_Sensorheizung_Status_XIX_Klima_Sensor_03
      source-signal=ST_FSA_SW_XIX_FSAs_01, target-signal=ST_FSA_SW_XIX_Klima_Sensor_03
      source-signal=ST_FSA_Taupunkt_XIX_FSAs_01, target-signal=ST_FSA_Taupunkt_XIX_Klima_Sensor_03
      source-signal=ST_FSA_Temp_Luft_XIX_FSAs_01, target-signal=ST_FSA_Temp_Luft_XIX_Klima_Sensor_03
      source-signal=ST_FSA_Temp_Sensor_XIX_FSAs_01, target-signal=ST_FSA_Temp_Sensor_XIX_Klima_Sensor_03
