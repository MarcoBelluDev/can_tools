[part 18 of 23: packages /TPConfig to /DiagnosticServices]
AUTOSAR XML (schema 4-3-0)
package /TPConfig
  can tp config CanTPConfig_E3V_EVCANFD: communication-cluster=E3V_EVCANFD, can-tp-ecu=Klima
    94 x can tp address:
      TA_0x17FC007B: tp-address=402391163
      TA_0x17FC0084: tp-address=402391172
      TA_0x17FC0087: tp-address=402391175
      TA_0x17FC0088: tp-address=402391176
      TA_0x17FC0096: tp-address=402391190
      TA_0x17FC0097: tp-address=402391191
      TA_0x17FC00A5: tp-address=402391205
      TA_0x17FC00B9: tp-address=402391225
      TA_0x17FC0346: tp-address=402391878
      TA_0x17FE007B: tp-address=402522235
      TA_0x17FE0084: tp-address=402522244
      TA_0x17FE0087: tp-address=402522247
      TA_0x17FE0088: tp-address=402522248
      TA_0x17FE0096: tp-address=402522262
      TA_0x17FE0097: tp-address=402522263
      TA_0x17FE00A5: tp-address=402522277
      TA_0x17FE00B9: tp-address=402522297
      TA_0x17FE0346: tp-address=402522950
      TA_0x18040001: tp-address=402915329
      TA_0x18040002: tp-address=402915330
      TA_0x18040003: tp-address=402915331
      TA_0x18040004: tp-address=402915332
      TA_0x18040005: tp-address=402915333
      TA_0x1804002A: tp-address=402915370
      TA_0x18060001: tp-address=403046401
      TA_0x18060002: tp-address=403046402
      TA_0x18060003: tp-address=403046403
      TA_0x18060004: tp-address=403046404
      TA_0x18060005: tp-address=403046405
      TA_0x1806002A: tp-address=403046442
      TA_0x18DA05F1: tp-address=416941553
      TA_0x18DA0AF1: tp-address=416942833
      TA_0x18DA0BF1: tp-address=416943089
      TA_0x18DA0CF1: tp-address=416943345
      TA_0x18DAF105: tp-address=417001733
      TA_0x18DAF10A: tp-address=417001738
      TA_0x18DAF10B: tp-address=417001739
      TA_0x18DAF10C: tp-address=417001740
      TA_0x18DB33F1: tp-address=417018865
      TA_0x1C400044: tp-address=473956420
      TA_0x1C400046: tp-address=473956422
      TA_0x1C40007B: tp-address=473956475
      TA_0x1C4000B9: tp-address=473956537
      TA_0x1C400244: tp-address=473956932
      TA_0x1C400246: tp-address=473956934
      TA_0x1C40027B: tp-address=473956987
      TA_0x1C4002B9: tp-address=473957049
      TA_0x1C410000: tp-address=474021888
      TA_0x1C410200: tp-address=474022400
      TA_0x1C420044: tp-address=474087492
      TA_0x1C420046: tp-address=474087494
      TA_0x1C42007B: tp-address=474087547
      TA_0x1C4200B9: tp-address=474087609
      TA_0x1C420244: tp-address=474088004
      TA_0x1C420246: tp-address=474088006
      TA_0x1C42027B: tp-address=474088059
      TA_0x1C4202B9: tp-address=474088121
      TA_0x1C440258: tp-address=474219096
      TA_0x1C460258: tp-address=474350168
      TA_0x700: tp-address=1792
      TA_0x70C: tp-address=1804
      TA_0x71C: tp-address=1820
      TA_0x723: tp-address=1827
      TA_0x732: tp-address=1842
      TA_0x733: tp-address=1843
      TA_0x734: tp-address=1844
      TA_0x73E: tp-address=1854
      TA_0x73F: tp-address=1855
      TA_0x744: tp-address=1860
      TA_0x746: tp-address=1862
      TA_0x747: tp-address=1863
      TA_0x74A: tp-address=1866
      TA_0x74B: tp-address=1867
      TA_0x74C: tp-address=1868
      TA_0x74D: tp-address=1869
      TA_0x764: tp-address=1892
      TA_0x767: tp-address=1895
      TA_0x776: tp-address=1910
      TA_0x786: tp-address=1926
      TA_0x78D: tp-address=1933
      TA_0x79C: tp-address=1948
      TA_0x79D: tp-address=1949
      TA_0x79E: tp-address=1950
      TA_0x7A8: tp-address=1960
      TA_0x7A9: tp-address=1961
      TA_0x7AE: tp-address=1966
      TA_0x7B0: tp-address=1968
      TA_0x7B1: tp-address=1969
      TA_0x7B4: tp-address=1972
      TA_0x7B5: tp-address=1973
      TA_0x7B6: tp-address=1974
      TA_0x7B7: tp-address=1975
      TA_0x7CE: tp-address=1998
      TA_0x7D1: tp-address=2001
    9 x can tp channel, all with channel-mode=HALF-DUPLEX-MODE:
      TPC_E3V_EVCANFD_XIX_TPCHType_CANFD_ISO_Diagnose_XIX_0x1C400046_XIX_0x1C420046_XIX_Physical: channel-id=703784648
      TPC_E3V_EVCANFD_XIX_TPCHType_CANFD_ISO_Diagnose_XIX_0x1C410000_XIX_Functional: channel-id=171904464
      TPC_E3V_EVCANFD_XIX_TPCHType_CANFD_OBDC_Diagnose_XIX_0x1C400246_XIX_0x1C420246_XIX_Physical: channel-id=986604787
      TPC_E3V_EVCANFD_XIX_TPCHType_CANFD_OBDC_Diagnose_XIX_0x1C410200_XIX_Functional: channel-id=1823983081
      TPC_E3V_EVCANFD_XIX_TPCHType_CANHS_FoD_Master_XIX_0x17FC0346_XIX_0x17FE0346_XIX_Physical: channel-id=804969401
      TPC_E3V_EVCANFD_XIX_TPCHType_CANHS_ISO_Diagnose_XIX_0x700_XIX_Functional: channel-id=940544939
      TPC_E3V_EVCANFD_XIX_TPCHType_CANHS_ISO_Diagnose_XIX_0x746_XIX_0x7B0_XIX_Physical: channel-id=770587415
      TPC_E3V_EVCANFD_XIX_TPCHType_CANHS_OBDx_XIX_0x18DA0AF1_XIX_0x18DAF10A_XIX_Physical: channel-id=1756180648
      TPC_E3V_EVCANFD_XIX_TPCHType_CANHS_OBDx_XIX_0x18DB33F1_XIX_Functional: channel-id=1812154513
    can-tp-connection addressing-format=STANDARD, can-tp-channel=TPC_E3V_EVCANFD_XIX_TPCHType_CANFD_ISO_Diagnose_XIX_0x1C400046_XIX_0x1C420046_XIX_Physical, cancellation=true, data-pdu=ISOx_Klima_Req_FD_XIX_E3V_EVCANFD, flow-control-pdu=ISOx_Klima_Resp_FD_XIX_E3V_EVCANFD, max-block-size=15, padding-activation=true, receiver=TPN_Klima_XIX_E3V_EVCANFD_XIX_474087494, ta-type=PHYSICAL, timeout-br=0.1, timeout-bs=1.0, timeout-cr=1.0, timeout-cs=0.2, tp-sdu=DCM_E3V_EVCANFD_XIX_TPCHType_CANFD_ISO_Diagnose_XIX_0x1C400046_XIX_0x1C420046_XIX_Physical, transmitter=TPN_Gateway_XIX_E3V_EVCANFD_XIX_473956422:
      ident TPCN_E3V_EVCANFD_XIX_TPCHType_CANFD_ISO_Diagnose_XIX_0x1C400046_Gateway_XIX_0x1C420046_Klima_XIX_Physical
    can-tp-connection addressing-format=STANDARD, can-tp-channel=TPC_E3V_EVCANFD_XIX_TPCHType_CANFD_ISO_Diagnose_XIX_0x1C410000_XIX_Functional, cancellation=true, data-pdu=ISOx_Funkt_Req_All_FD_XIX_E3V_EVCANFD, max-block-size=15, multicast=TA_0x1C410000, padding-activation=true, receiver=[TPN_Hybrid_01_XIX_E3V_EVCANFD_XIX_474087547, TPN_DCDC_NV_XIX_E3V_EVCANFD_XIX_474087609, TPN_Klima_XIX_E3V_EVCANFD_XIX_474087494, TPN_Ladegeraet_XIX_E3V_EVCANFD_XIX_474087492], ta-type=FUNCTIONAL, timeout-br=0.1, timeout-bs=1.0, timeout-cr=1.0, timeout-cs=0.2, tp-sdu=DCM_E3V_EVCANFD_XIX_TPCHType_CANFD_ISO_Diagnose_XIX_0x1C410000_XIX_Functional, transmitter=TPN_Gateway_XIX_E3V_EVCANFD_XIX_473956537:
      ident TPCN_E3V_EVCANFD_XIX_TPCHType_CANFD_ISO_Diagnose_XIX_0x1C410000_Gateway_XIX_Functional
    can-tp-connection addressing-format=STANDARD, can-tp-channel=TPC_E3V_EVCANFD_XIX_TPCHType_CANFD_ISO_Diagnose_XIX_0x1C400046_XIX_0x1C420046_XIX_Physical, cancellation=true, data-pdu=ISOx_Klima_Resp_FD_XIX_E3V_EVCANFD, flow-control-pdu=ISOx_Klima_Req_FD_XIX_E3V_EVCANFD, max-block-size=15, padding-activation=true, receiver=TPN_Gateway_XIX_E3V_EVCANFD_XIX_473956422, ta-type=PHYSICAL, timeout-br=0.1, timeout-bs=1.0, timeout-cr=1.0, timeout-cs=0.2, tp-sdu=DCM_E3V_EVCANFD_XIX_TPCHType_CANFD_ISO_Diagnose_XIX_0x1C420046_XIX_0x1C400046_XIX_Physical, transmitter=TPN_Klima_XIX_E3V_EVCANFD_XIX_474087494:
      ident TPCN_E3V_EVCANFD_XIX_TPCHType_CANFD_ISO_Diagnose_XIX_0x1C420046_Klima_XIX_0x1C400046_Gateway_XIX_Physical
    can-tp-connection addressing-format=STANDARD, can-tp-channel=TPC_E3V_EVCANFD_XIX_TPCHType_CANFD_OBDC_Diagnose_XIX_0x1C400246_XIX_0x1C420246_XIX_Physical, cancellation=true, data-pdu=OBDC_Klima_Req_FD_XIX_E3V_EVCANFD, flow-control-pdu=OBDC_Klima_Resp_FD_XIX_E3V_EVCANFD, max-block-size=15, padding-activation=true, receiver=TPN_Klima_XIX_E3V_EVCANFD_XIX_474088006, ta-type=PHYSICAL, timeout-br=0.1, timeout-bs=1.0, timeout-cr=1.0, timeout-cs=0.2, tp-sdu=DCM_E3V_EVCANFD_XIX_TPCHType_CANFD_OBDC_Diagnose_XIX_0x1C400246_XIX_0x1C420246_XIX_Physical, transmitter=TPN_Gateway_XIX_E3V_EVCANFD_XIX_473956934:
      ident TPCN_E3V_EVCANFD_XIX_TPCHType_CANFD_OBDC_Diagnose_XIX_0x1C400246_Gateway_XIX_0x1C420246_Klima_XIX_Physical
    can-tp-connection addressing-format=STANDARD, can-tp-channel=TPC_E3V_EVCANFD_XIX_TPCHType_CANFD_OBDC_Diagnose_XIX_0x1C410200_XIX_Functional, cancellation=true, data-pdu=OBDC_Funktionaler_Req_All_FD_XIX_E3V_EVCANFD, max-block-size=15, multicast=TA_0x1C410200, padding-activation=true, receiver=[TPN_Hybrid_01_XIX_E3V_EVCANFD_XIX_474088059, TPN_DCDC_NV_XIX_E3V_EVCANFD_XIX_474088121, TPN_Blade_Dr1_XIX_E3V_EVCANFD_XIX_474350168, TPN_Klima_XIX_E3V_EVCANFD_XIX_474088006, TPN_Ladegeraet_XIX_E3V_EVCANFD_XIX_474088004], ta-type=FUNCTIONAL, timeout-br=0.1, timeout-bs=1.0, timeout-cr=1.0, timeout-cs=0.2, tp-sdu=DCM_E3V_EVCANFD_XIX_TPCHType_CANFD_OBDC_Diagnose_XIX_0x1C410200_XIX_Functional, transmitter=TPN_Gateway_XIX_E3V_EVCANFD_XIX_474219096:
      ident TPCN_E3V_EVCANFD_XIX_TPCHType_CANFD_OBDC_Diagnose_XIX_0x1C410200_Gateway_XIX_Functional
    can-tp-connection addressing-format=STANDARD, can-tp-channel=TPC_E3V_EVCANFD_XIX_TPCHType_CANFD_OBDC_Diagnose_XIX_0x1C400246_XIX_0x1C420246_XIX_Physical, cancellation=true, data-pdu=OBDC_Klima_Resp_FD_XIX_E3V_EVCANFD, flow-control-pdu=OBDC_Klima_Req_FD_XIX_E3V_EVCANFD, max-block-size=15, padding-activation=true, receiver=TPN_Gateway_XIX_E3V_EVCANFD_XIX_473956934, ta-type=PHYSICAL, timeout-br=0.1, timeout-bs=1.0, timeout-cr=1.0, timeout-cs=0.2, tp-sdu=DCM_E3V_EVCANFD_XIX_TPCHType_CANFD_OBDC_Diagnose_XIX_0x1C420246_XIX_0x1C400246_XIX_Physical, transmitter=TPN_Klima_XIX_E3V_EVCANFD_XIX_474088006:
      ident TPCN_E3V_EVCANFD_XIX_TPCHType_CANFD_OBDC_Diagnose_XIX_0x1C420246_Klima_XIX_0x1C400246_Gateway_XIX_Physical
    can-tp-connection addressing-format=STANDARD, can-tp-channel=TPC_E3V_EVCANFD_XIX_TPCHType_CANHS_FoD_Master_XIX_0x17FC0346_XIX_0x17FE0346_XIX_Physical, cancellation=true, data-pdu=FoD_Klima_Req_XIX_E3V_EVCANFD, flow-control-pdu=FoD_Klima_Resp_XIX_E3V_EVCANFD, max-block-size=15, padding-activation=true, receiver=TPN_Klima_XIX_E3V_EVCANFD_XIX_402522950, ta-type=PHYSICAL, timeout-br=0.1, timeout-bs=1.0, timeout-cr=1.0, timeout-cs=0.2, tp-sdu=SOK_E3V_EVCANFD_XIX_TPCHType_CANHS_FoD_Master_XIX_0x17FC0346_XIX_0x17FE0346_XIX_Physical, transmitter=TPN_Gateway_XIX_E3V_EVCANFD_XIX_402391878:
      ident TPCN_E3V_EVCANFD_XIX_TPCHType_CANHS_FoD_Master_XIX_0x17FC0346_Gateway_XIX_0x17FE0346_Klima_XIX_Physical
    can-tp-connection addressing-format=STANDARD, can-tp-channel=TPC_E3V_EVCANFD_XIX_TPCHType_CANHS_FoD_Master_XIX_0x17FC0346_XIX_0x17FE0346_XIX_Physical, cancellation=true, data-pdu=FoD_Klima_Resp_XIX_E3V_EVCANFD, flow-control-pdu=FoD_Klima_Req_XIX_E3V_EVCANFD, max-block-size=15, padding-activation=true, receiver=TPN_Gateway_XIX_E3V_EVCANFD_XIX_402391878, ta-type=PHYSICAL, timeout-br=0.1, timeout-bs=1.0, timeout-cr=1.0, timeout-cs=0.2, tp-sdu=SOK_E3V_EVCANFD_XIX_TPCHType_CANHS_FoD_Master_XIX_0x17FE0346_XIX_0x17FC0346_XIX_Physical, transmitter=TPN_Klima_XIX_E3V_EVCANFD_XIX_402522950:
      ident TPCN_E3V_EVCANFD_XIX_TPCHType_CANHS_FoD_Master_XIX_0x17FE0346_Klima_XIX_0x17FC0346_Gateway_XIX_Physical
    can-tp-connection addressing-format=STANDARD, can-tp-channel=TPC_E3V_EVCANFD_XIX_TPCHType_CANHS_ISO_Diagnose_XIX_0x700_XIX_Functional, cancellation=true, data-pdu=ISO_Funktionaler_Req_All_XIX_E3V_EVCANFD, max-block-size=15, multicast=TA_0x700, padding-activation=true, receiver=[TPN_Hybrid_01_XIX_E3V_EVCANFD_XIX_402522235, TPN_DCDC_NV_XIX_E3V_EVCANFD_XIX_402522297, TPN_Blade_Dr1_XIX_E3V_EVCANFD_XIX_1910, TPN_Blade_Dr1_XIX_E3V_EVCANFD_XIX_1926, TPN_Blade_Dr1_XIX_E3V_EVCANFD_XIX_1933, TPN_Blade_Dr1_XIX_E3V_EVCANFD_XIX_1948, TPN_Blade_Dr1_XIX_E3V_EVCANFD_XIX_1949, TPN_Blade_Dr1_XIX_E3V_EVCANFD_XIX_1950, TPN_Blade_Dr1_XIX_E3V_EVCANFD_XIX_1960, TPN_Blade_Dr1_XIX_E3V_EVCANFD_XIX_1961, TPN_Blade_Dr1_XIX_E3V_EVCANFD_XIX_1969, TPN_Blade_Dr1_XIX_E3V_EVCANFD_XIX_1972, TPN_Blade_Dr1_XIX_E3V_EVCANFD_XIX_1973, TPN_Blade_Dr1_XIX_E3V_EVCANFD_XIX_1974, TPN_Blade_Dr1_XIX_E3V_EVCANFD_XIX_1975, TPN_Blade_Dr1_XIX_E3V_EVCANFD_XIX_1998, TPN_Blade_Dr1_XIX_E3V_EVCANFD_XIX_2001, TPN_Blade_Dr1_XIX_E3V_EVCANFD_XIX_402522244, TPN_Blade_Dr1_XIX_E3V_EVCANFD_XIX_402522247, TPN_Blade_Dr1_XIX_E3V_EVCANFD_XIX_402522248, TPN_Blade_Dr1_XIX_E3V_EVCANFD_XIX_402522262, TPN_Blade_Dr1_XIX_E3V_EVCANFD_XIX_402522263, TPN_Blade_Dr1_XIX_E3V_EVCANFD_XIX_402522277, TPN_Blade_Dr1_XIX_E3V_EVCANFD_XIX_403046401, TPN_Blade_Dr1_XIX_E3V_EVCANFD_XIX_403046402, TPN_Blade_Dr1_XIX_E3V_EVCANFD_XIX_403046403, TPN_Blade_Dr1_XIX_E3V_EVCANFD_XIX_403046404, TPN_Blade_Dr1_XIX_E3V_EVCANFD_XIX_403046405, TPN_Blade_Dr1_XIX_E3V_EVCANFD_XIX_403046442, TPN_Klima_XIX_E3V_EVCANFD_XIX_1968, TPN_Ladegeraet_XIX_E3V_EVCANFD_XIX_1966], ta-type=FUNCTIONAL, timeout-br=0.1, timeout-bs=1.0, timeout-cr=1.0, timeout-cs=0.2, tp-sdu=DCM_E3V_EVCANFD_XIX_TPCHType_CANHS_ISO_Diagnose_XIX_0x700_XIX_Functional, transmitter=TPN_Gateway_XIX_E3V_EVCANFD_XIX_1863:
      ident TPCN_E3V_EVCANFD_XIX_TPCHType_CANHS_ISO_Diagnose_XIX_0x700_Gateway_XIX_Functional
    can-tp-connection addressing-format=STANDARD, can-tp-channel=TPC_E3V_EVCANFD_XIX_TPCHType_CANHS_ISO_Diagnose_XIX_0x746_XIX_0x7B0_XIX_Physical, cancellation=true, data-pdu=ISO_Klima_Req_XIX_E3V_EVCANFD, flow-control-pdu=ISO_Klima_Resp_XIX_E3V_EVCANFD, max-block-size=15, padding-activation=true, receiver=TPN_Klima_XIX_E3V_EVCANFD_XIX_1968, ta-type=PHYSICAL, timeout-br=0.1, timeout-bs=1.0, timeout-cr=1.0, timeout-cs=0.2, tp-sdu=DCM_E3V_EVCANFD_XIX_TPCHType_CANHS_ISO_Diagnose_XIX_0x746_XIX_0x7B0_XIX_Physical, transmitter=TPN_Gateway_XIX_E3V_EVCANFD_XIX_1862:
      ident TPCN_E3V_EVCANFD_XIX_TPCHType_CANHS_ISO_Diagnose_XIX_0x746_Gateway_XIX_0x7B0_Klima_XIX_Physical
    can-tp-connection addressing-format=STANDARD, can-tp-channel=TPC_E3V_EVCANFD_XIX_TPCHType_CANHS_ISO_Diagnose_XIX_0x746_XIX_0x7B0_XIX_Physical, cancellation=true, data-pdu=ISO_Klima_Resp_XIX_E3V_EVCANFD, flow-control-pdu=ISO_Klima_Req_XIX_E3V_EVCANFD, max-block-size=15, padding-activation=true, receiver=TPN_Gateway_XIX_E3V_EVCANFD_XIX_1862, ta-type=PHYSICAL, timeout-br=0.1, timeout-bs=1.0, timeout-cr=1.0, timeout-cs=0.2, tp-sdu=DCM_E3V_EVCANFD_XIX_TPCHType_CANHS_ISO_Diagnose_XIX_0x7B0_XIX_0x746_XIX_Physical, transmitter=TPN_Klima_XIX_E3V_EVCANFD_XIX_1968:
      ident TPCN_E3V_EVCANFD_XIX_TPCHType_CANHS_ISO_Diagnose_XIX_0x7B0_Klima_XIX_0x746_Gateway_XIX_Physical
    can-tp-connection addressing-format=STANDARD, can-tp-channel=TPC_E3V_EVCANFD_XIX_TPCHType_CANHS_OBDx_XIX_0x18DA0AF1_XIX_0x18DAF10A_XIX_Physical, cancellation=true, data-pdu=OBDx_Klima_Req_XIX_E3V_EVCANFD, flow-control-pdu=OBDx_Klima_Resp_XIX_E3V_EVCANFD, max-block-size=15, padding-activation=true, receiver=TPN_Klima_XIX_E3V_EVCANFD_XIX_417001738, ta-type=PHYSICAL, timeout-br=0.001, timeout-bs=0.075, timeout-cr=0.15, timeout-cs=0.025, tp-sdu=DCM_E3V_EVCANFD_XIX_TPCHType_CANHS_OBDx_XIX_0x18DA0AF1_XIX_0x18DAF10A_XIX_Physical, transmitter=TPN_Gateway_XIX_E3V_EVCANFD_XIX_416942833:
      ident TPCN_E3V_EVCANFD_XIX_TPCHType_CANHS_OBDx_XIX_0x18DA0AF1_Gateway_XIX_0x18DAF10A_Klima_XIX_Physical
    can-tp-connection addressing-format=STANDARD, can-tp-channel=TPC_E3V_EVCANFD_XIX_TPCHType_CANHS_OBDx_XIX_0x18DA0AF1_XIX_0x18DAF10A_XIX_Physical, cancellation=true, data-pdu=OBDx_Klima_Resp_XIX_E3V_EVCANFD, flow-control-pdu=OBDx_Klima_Req_XIX_E3V_EVCANFD, max-block-size=15, padding-activation=true, receiver=TPN_Gateway_XIX_E3V_EVCANFD_XIX_416942833, ta-type=PHYSICAL, timeout-br=0.001, timeout-bs=0.075, timeout-cr=0.15, timeout-cs=0.025, tp-sdu=DCM_E3V_EVCANFD_XIX_TPCHType_CANHS_OBDx_XIX_0x18DAF10A_XIX_0x18DA0AF1_XIX_Physical, transmitter=TPN_Klima_XIX_E3V_EVCANFD_XIX_417001738:
      ident TPCN_E3V_EVCANFD_XIX_TPCHType_CANHS_OBDx_XIX_0x18DAF10A_Klima_XIX_0x18DA0AF1_Gateway_XIX_Physical
    can-tp-connection addressing-format=STANDARD, can-tp-channel=TPC_E3V_EVCANFD_XIX_TPCHType_CANHS_OBDx_XIX_0x18DB33F1_XIX_Functional, cancellation=true, data-pdu=OBDx_allOBD_Req_XIX_E3V_EVCANFD, max-block-size=15, multicast=TA_0x18DB33F1, padding-activation=true, receiver=[TPN_Hybrid_01_XIX_E3V_EVCANFD_XIX_417001733, TPN_DCDC_NV_XIX_E3V_EVCANFD_XIX_417001739, TPN_Klima_XIX_E3V_EVCANFD_XIX_417001738, TPN_Ladegeraet_XIX_E3V_EVCANFD_XIX_417001740], ta-type=FUNCTIONAL, timeout-br=0.001, timeout-bs=0.075, timeout-cr=0.15, timeout-cs=0.025, tp-sdu=DCM_E3V_EVCANFD_XIX_TPCHType_CANHS_OBDx_XIX_0x18DB33F1_XIX_Functional, transmitter=TPN_Gateway_XIX_E3V_EVCANFD_XIX_416943089:
      ident TPCN_E3V_EVCANFD_XIX_TPCHType_CANHS_OBDx_XIX_0x18DB33F1_Gateway_XIX_Functional
    90 x can tp node, all with st-min=0.005:
      TPN_Hybrid_01_XIX_E3V_EVCANFD_XIX_402522235: max-fc-wait=15, timeout-ar=1.0, timeout-as=1.0, tp-address=TA_0x17FE007B
      TPN_Hybrid_01_XIX_E3V_EVCANFD_XIX_417001733: max-fc-wait=0, timeout-ar=0.025, timeout-as=0.025, tp-address=TA_0x18DAF105
      TPN_Hybrid_01_XIX_E3V_EVCANFD_XIX_474087547: max-fc-wait=15, timeout-ar=1.0, timeout-as=1.0, tp-address=TA_0x1C42007B
      TPN_Hybrid_01_XIX_E3V_EVCANFD_XIX_474088059: max-fc-wait=15, timeout-ar=1.0, timeout-as=1.0, tp-address=TA_0x1C42027B
      TPN_DCDC_NV_XIX_E3V_EVCANFD_XIX_402522297: max-fc-wait=15, timeout-ar=1.0, timeout-as=1.0, tp-address=TA_0x17FE00B9
      TPN_DCDC_NV_XIX_E3V_EVCANFD_XIX_417001739: max-fc-wait=0, timeout-ar=0.025, timeout-as=0.025, tp-address=TA_0x18DAF10B
      TPN_DCDC_NV_XIX_E3V_EVCANFD_XIX_474087609: max-fc-wait=15, timeout-ar=1.0, timeout-as=1.0, tp-address=TA_0x1C4200B9
      TPN_DCDC_NV_XIX_E3V_EVCANFD_XIX_474088121: max-fc-wait=15, timeout-ar=1.0, timeout-as=1.0, tp-address=TA_0x1C4202B9
      TPN_Blade_Dr1_XIX_E3V_EVCANFD_XIX_1910: max-fc-wait=15, timeout-ar=1.0, timeout-as=1.0, tp-address=TA_0x776
      TPN_Blade_Dr1_XIX_E3V_EVCANFD_XIX_1926: max-fc-wait=15, timeout-ar=1.0, timeout-as=1.0, tp-address=TA_0x786
      TPN_Blade_Dr1_XIX_E3V_EVCANFD_XIX_1933: max-fc-wait=15, timeout-ar=1.0, timeout-as=1.0, tp-address=TA_0x78D
      TPN_Blade_Dr1_XIX_E3V_EVCANFD_XIX_1948: max-fc-wait=15, timeout-ar=1.0, timeout-as=1.0, tp-address=TA_0x79C
      TPN_Blade_Dr1_XIX_E3V_EVCANFD_XIX_1949: max-fc-wait=15, timeout-ar=1.0, timeout-as=1.0, tp-address=TA_0x79D
      TPN_Blade_Dr1_XIX_E3V_EVCANFD_XIX_1950: max-fc-wait=15, timeout-ar=1.0, timeout-as=1.0, tp-address=TA_0x79E
      TPN_Blade_Dr1_XIX_E3V_EVCANFD_XIX_1960: max-fc-wait=15, timeout-ar=1.0, timeout-as=1.0, tp-address=TA_0x7A8
      TPN_Blade_Dr1_XIX_E3V_EVCANFD_XIX_1961: max-fc-wait=15, timeout-ar=1.0, timeout-as=1.0, tp-address=TA_0x7A9
      TPN_Blade_Dr1_XIX_E3V_EVCANFD_XIX_1969: max-fc-wait=15, timeout-ar=1.0, timeout-as=1.0, tp-address=TA_0x7B1
      TPN_Blade_Dr1_XIX_E3V_EVCANFD_XIX_1972: max-fc-wait=15, timeout-ar=1.0, timeout-as=1.0, tp-address=TA_0x7B4
      TPN_Blade_Dr1_XIX_E3V_EVCANFD_XIX_1973: max-fc-wait=15, timeout-ar=1.0, timeout-as=1.0, tp-address=TA_0x7B5
      TPN_Blade_Dr1_XIX_E3V_EVCANFD_XIX_1974: max-fc-wait=15, timeout-ar=1.0, timeout-as=1.0, tp-address=TA_0x7B6
      TPN_Blade_Dr1_XIX_E3V_EVCANFD_XIX_1975: max-fc-wait=15, timeout-ar=1.0, timeout-as=1.0, tp-address=TA_0x7B7
      TPN_Blade_Dr1_XIX_E3V_EVCANFD_XIX_1998: max-fc-wait=15, timeout-ar=1.0, timeout-as=1.0, tp-address=TA_0x7CE
      TPN_Blade_Dr1_XIX_E3V_EVCANFD_XIX_2001: max-fc-wait=15, timeout-ar=1.0, timeout-as=1.0, tp-address=TA_0x7D1
      TPN_Blade_Dr1_XIX_E3V_EVCANFD_XIX_402522244: max-fc-wait=15, timeout-ar=1.0, timeout-as=1.0, tp-address=TA_0x17FE0084
      TPN_Blade_Dr1_XIX_E3V_EVCANFD_XIX_402522247: max-fc-wait=15, timeout-ar=1.0, timeout-as=1.0, tp-address=TA_0x17FE0087
      TPN_Blade_Dr1_XIX_E3V_EVCANFD_XIX_402522248: max-fc-wait=15, timeout-ar=1.0, timeout-as=1.0, tp-address=TA_0x17FE0088
      TPN_Blade_Dr1_XIX_E3V_EVCANFD_XIX_402522262: max-fc-wait=15, timeout-ar=1.0, timeout-as=1.0, tp-address=TA_0x17FE0096
      TPN_Blade_Dr1_XIX_E3V_EVCANFD_XIX_402522263: max-fc-wait=15, timeout-ar=1.0, timeout-as=1.0, tp-address=TA_0x17FE0097
      TPN_Blade_Dr1_XIX_E3V_EVCANFD_XIX_402522277: max-fc-wait=15, timeout-ar=1.0, timeout-as=1.0, tp-address=TA_0x17FE00A5
      TPN_Blade_Dr1_XIX_E3V_EVCANFD_XIX_403046401: max-fc-wait=15, timeout-ar=1.0, timeout-as=1.0, tp-address=TA_0x18060001
      TPN_Blade_Dr1_XIX_E3V_EVCANFD_XIX_403046402: max-fc-wait=15, timeout-ar=1.0, timeout-as=1.0, tp-address=TA_0x18060002
      TPN_Blade_Dr1_XIX_E3V_EVCANFD_XIX_403046403: max-fc-wait=15, timeout-ar=1.0, timeout-as=1.0, tp-address=TA_0x18060003
      TPN_Blade_Dr1_XIX_E3V_EVCANFD_XIX_403046404: max-fc-wait=15, timeout-ar=1.0, timeout-as=1.0, tp-address=TA_0x18060004
      TPN_Blade_Dr1_XIX_E3V_EVCANFD_XIX_403046405: max-fc-wait=15, timeout-ar=1.0, timeout-as=1.0, tp-address=TA_0x18060005
      TPN_Blade_Dr1_XIX_E3V_EVCANFD_XIX_403046442: max-fc-wait=15, timeout-ar=1.0, timeout-as=1.0, tp-address=TA_0x1806002A
      TPN_Blade_Dr1_XIX_E3V_EVCANFD_XIX_474350168: max-fc-wait=15, timeout-ar=1.0, timeout-as=1.0, tp-address=TA_0x1C460258
      TPN_Gateway_XIX_E3V_EVCANFD_XIX_1804: max-fc-wait=15, timeout-ar=1.0, timeout-as=1.0, tp-address=TA_0x70C
      TPN_Gateway_XIX_E3V_EVCANFD_XIX_1820: max-fc-wait=15, timeout-ar=1.0, timeout-as=1.0, tp-address=TA_0x71C
      TPN_Gateway_XIX_E3V_EVCANFD_XIX_1827: max-fc-wait=15, timeout-ar=1.0, timeout-as=1.0, tp-address=TA_0x723
      TPN_Gateway_XIX_E3V_EVCANFD_XIX_1842: max-fc-wait=15, timeout-ar=1.0, timeout-as=1.0, tp-address=TA_0x732
      TPN_Gateway_XIX_E3V_EVCANFD_XIX_1843: max-fc-wait=15, timeout-ar=1.0, timeout-as=1.0, tp-address=TA_0x733
      TPN_Gateway_XIX_E3V_EVCANFD_XIX_1844: max-fc-wait=15, timeout-ar=1.0, timeout-as=1.0, tp-address=TA_0x734
      TPN_Gateway_XIX_E3V_EVCANFD_XIX_1854: max-fc-wait=15, timeout-ar=1.0, timeout-as=1.0, tp-address=TA_0x73E
      TPN_Gateway_XIX_E3V_EVCANFD_XIX_1855: max-fc-wait=15, timeout-ar=1.0, timeout-as=1.0, tp-address=TA_0x73F
      TPN_Gateway_XIX_E3V_EVCANFD_XIX_1860: max-fc-wait=15, timeout-ar=1.0, timeout-as=1.0, tp-address=TA_0x744
      TPN_Gateway_XIX_E3V_EVCANFD_XIX_1862: max-fc-wait=15, timeout-ar=1.0, timeout-as=1.0, tp-address=TA_0x746
      TPN_Gateway_XIX_E3V_EVCANFD_XIX_1863: max-fc-wait=15, timeout-ar=1.0, timeout-as=1.0, tp-address=TA_0x747
      TPN_Gateway_XIX_E3V_EVCANFD_XIX_1866: max-fc-wait=15, timeout-ar=1.0, timeout-as=1.0, tp-address=TA_0x74A
      TPN_Gateway_XIX_E3V_EVCANFD_XIX_1867: max-fc-wait=15, timeout-ar=1.0, timeout-as=1.0, tp-address=TA_0x74B
      TPN_Gateway_XIX_E3V_EVCANFD_XIX_1868: max-fc-wait=15, timeout-ar=1.0, timeout-as=1.0, tp-address=TA_0x74C
      TPN_Gateway_XIX_E3V_EVCANFD_XIX_1869: max-fc-wait=15, timeout-ar=1.0, timeout-as=1.0, tp-address=TA_0x74D
      TPN_Gateway_XIX_E3V_EVCANFD_XIX_1892: max-fc-wait=15, timeout-ar=1.0, timeout-as=1.0, tp-address=TA_0x764
      TPN_Gateway_XIX_E3V_EVCANFD_XIX_1895: max-fc-wait=15, timeout-ar=1.0, timeout-as=1.0, tp-address=TA_0x767
      TPN_Gateway_XIX_E3V_EVCANFD_XIX_402391163: max-fc-wait=15, timeout-ar=1.0, timeout-as=1.0, tp-address=TA_0x17FC007B
      TPN_Gateway_XIX_E3V_EVCANFD_XIX_402391172: max-fc-wait=15, timeout-ar=1.0, timeout-as=1.0, tp-address=TA_0x17FC0084
      TPN_Gateway_XIX_E3V_EVCANFD_XIX_402391175: max-fc-wait=15, timeout-ar=1.0, timeout-as=1.0, tp-address=TA_0x17FC0087
      TPN_Gateway_XIX_E3V_EVCANFD_XIX_402391176: max-fc-wait=15, timeout-ar=1.0, timeout-as=1.0, tp-address=TA_0x17FC0088
      TPN_Gateway_XIX_E3V_EVCANFD_XIX_402391190: max-fc-wait=15, timeout-ar=1.0, timeout-as=1.0, tp-address=TA_0x17FC0096
      TPN_Gateway_XIX_E3V_EVCANFD_XIX_402391191: max-fc-wait=15, timeout-ar=1.0, timeout-as=1.0, tp-address=TA_0x17FC0097
      TPN_Gateway_XIX_E3V_EVCANFD_XIX_402391205: max-fc-wait=15, timeout-ar=1.0, timeout-as=1.0, tp-address=TA_0x17FC00A5
      TPN_Gateway_XIX_E3V_EVCANFD_XIX_402391225: max-fc-wait=15, timeout-ar=1.0, timeout-as=1.0, tp-address=TA_0x17FC00B9
      TPN_Gateway_XIX_E3V_EVCANFD_XIX_402391878: max-fc-wait=15, timeout-ar=1.0, timeout-as=1.0, tp-address=TA_0x17FC0346
      TPN_Gateway_XIX_E3V_EVCANFD_XIX_402915329: max-fc-wait=15, timeout-ar=1.0, timeout-as=1.0, tp-address=TA_0x18040001
      TPN_Gateway_XIX_E3V_EVCANFD_XIX_402915330: max-fc-wait=15, timeout-ar=1.0, timeout-as=1.0, tp-address=TA_0x18040002
      TPN_Gateway_XIX_E3V_EVCANFD_XIX_402915331: max-fc-wait=15, timeout-ar=1.0, timeout-as=1.0, tp-address=TA_0x18040003
      TPN_Gateway_XIX_E3V_EVCANFD_XIX_402915332: max-fc-wait=15, timeout-ar=1.0, timeout-as=1.0, tp-address=TA_0x18040004
      TPN_Gateway_XIX_E3V_EVCANFD_XIX_402915333: max-fc-wait=15, timeout-ar=1.0, timeout-as=1.0, tp-address=TA_0x18040005
      TPN_Gateway_XIX_E3V_EVCANFD_XIX_402915370: max-fc-wait=15, timeout-ar=1.0, timeout-as=1.0, tp-address=TA_0x1804002A
      TPN_Gateway_XIX_E3V_EVCANFD_XIX_416941553: max-fc-wait=0, timeout-ar=0.025, timeout-as=0.025, tp-address=TA_0x18DA05F1
      TPN_Gateway_XIX_E3V_EVCANFD_XIX_416942833: max-fc-wait=0, timeout-ar=0.025, timeout-as=0.025, tp-address=TA_0x18DA0AF1
      TPN_Gateway_XIX_E3V_EVCANFD_XIX_416943089: max-fc-wait=0, timeout-ar=0.025, timeout-as=0.025, tp-address=TA_0x18DA0BF1
      TPN_Gateway_XIX_E3V_EVCANFD_XIX_416943345: max-fc-wait=0, timeout-ar=0.025, timeout-as=0.025, tp-address=TA_0x18DA0CF1
      TPN_Gateway_XIX_E3V_EVCANFD_XIX_473956420: max-fc-wait=15, timeout-ar=1.0, timeout-as=1.0, tp-address=TA_0x1C400044
      TPN_Gateway_XIX_E3V_EVCANFD_XIX_473956422: max-fc-wait=15, timeout-ar=1.0, timeout-as=1.0, tp-address=TA_0x1C400046
      TPN_Gateway_XIX_E3V_EVCANFD_XIX_473956475: max-fc-wait=15, timeout-ar=1.0, timeout-as=1.0, tp-address=TA_0x1C40007B
      TPN_Gateway_XIX_E3V_EVCANFD_XIX_473956537: max-fc-wait=15, timeout-ar=1.0, timeout-as=1.0, tp-address=TA_0x1C4000B9
      TPN_Gateway_XIX_E3V_EVCANFD_XIX_473956932: max-fc-wait=15, timeout-ar=1.0, timeout-as=1.0, tp-address=TA_0x1C400244
      TPN_Gateway_XIX_E3V_EVCANFD_XIX_473956934: max-fc-wait=15, timeout-ar=1.0, timeout-as=1.0, tp-address=TA_0x1C400246
      TPN_Gateway_XIX_E3V_EVCANFD_XIX_473956987: max-fc-wait=15, timeout-ar=1.0, timeout-as=1.0, tp-address=TA_0x1C40027B
      TPN_Gateway_XIX_E3V_EVCANFD_XIX_473957049: max-fc-wait=15, timeout-ar=1.0, timeout-as=1.0, tp-address=TA_0x1C4002B9
      TPN_Gateway_XIX_E3V_EVCANFD_XIX_474219096: max-fc-wait=15, timeout-ar=1.0, timeout-as=1.0, tp-address=TA_0x1C440258
      TPN_Klima_XIX_E3V_EVCANFD_XIX_1968: connector=CN_E3V_EVCANFD, max-fc-wait=15, timeout-ar=1.0, timeout-as=1.0, tp-address=TA_0x7B0
      TPN_Klima_XIX_E3V_EVCANFD_XIX_402522950: connector=CN_E3V_EVCANFD, max-fc-wait=15, timeout-ar=1.0, timeout-as=1.0, tp-address=TA_0x17FE0346
      TPN_Klima_XIX_E3V_EVCANFD_XIX_417001738: connector=CN_E3V_EVCANFD, max-fc-wait=0, timeout-ar=0.025, timeout-as=0.025, tp-address=TA_0x18DAF10A
      TPN_Klima_XIX_E3V_EVCANFD_XIX_474087494: connector=CN_E3V_EVCANFD, max-fc-wait=15, timeout-ar=1.0, timeout-as=1.0, tp-address=TA_0x1C420046
      TPN_Klima_XIX_E3V_EVCANFD_XIX_474088006: connector=CN_E3V_EVCANFD, max-fc-wait=15, timeout-ar=1.0, timeout-as=1.0, tp-address=TA_0x1C420246
      TPN_Ladegeraet_XIX_E3V_EVCANFD_XIX_1966: max-fc-wait=15, timeout-ar=1.0, timeout-as=1.0, tp-address=TA_0x7AE
      TPN_Ladegeraet_XIX_E3V_EVCANFD_XIX_417001740: max-fc-wait=0, timeout-ar=0.025, timeout-as=0.025, tp-address=TA_0x18DAF10C
      TPN_Ladegeraet_XIX_E3V_EVCANFD_XIX_474087492: max-fc-wait=15, timeout-ar=1.0, timeout-as=1.0, tp-address=TA_0x1C420044
      TPN_Ladegeraet_XIX_E3V_EVCANFD_XIX_474088004: max-fc-wait=15, timeout-ar=1.0, timeout-as=1.0, tp-address=TA_0x1C420244
  7 x lin tp config:
    LinTPConfig_Klima_LIN2: communication-cluster=Klima_LIN2
      12 x tp address:
        TA_0x0: tp-address=0
        TA_0x19: tp-address=25
        TA_0x20: tp-address=32
        TA_0x21: tp-address=33
        TA_0x22: tp-address=34
        TA_0x6D: tp-address=109
        TA_0x15: tp-address=21
        TA_0x17: tp-address=23
        TA_0x18: tp-address=24
        TA_0xD: tp-address=13
        TA_0xF: tp-address=15
        TA_0x10: tp-address=16
      lin-tp-connection data-pdu=MasterReq_XIX_Klima_LIN2, flow-control=SlaveResp_XIX_Klima_LIN2, lin-tp-n-sdu=DCM_Klima_LIN2_XIX_TPCHType_LIN_Diagnose_XIX_0x0_XIX_0x19_XIX_Physical, receiver=TPN_DS_XIX_Klima_LIN2_XIX_25, timeout-as=1.0, timeout-cr=1.0, transmitter=TPN_Klima_XIX_Klima_LIN2_XIX_0:
        ident TPCN_Klima_LIN2_XIX_TPCHType_LIN_Diagnose_XIX_0x0_Klima_XIX_0x19_DS_XIX_Physical
      lin-tp-connection data-pdu=SlaveResp_XIX_Klima_LIN2, flow-control=MasterReq_XIX_Klima_LIN2, lin-tp-n-sdu=DCM_Klima_LIN2_XIX_TPCHType_LIN_Diagnose_XIX_0x19_XIX_0x0_XIX_Physical, receiver=TPN_Klima_XIX_Klima_LIN2_XIX_0, timeout-as=1.0, timeout-cr=1.0, transmitter=TPN_DS_XIX_Klima_LIN2_XIX_25:
        ident TPCN_Klima_LIN2_XIX_TPCHType_LIN_Diagnose_XIX_0x19_DS_XIX_0x0_Klima_XIX_Physical
      lin-tp-connection data-pdu=MasterReq_XIX_Klima_LIN2, flow-control=SlaveResp_XIX_Klima_LIN2, lin-tp-n-sdu=DCM_Klima_LIN2_XIX_TPCHType_LIN_Diagnose_XIX_0x0_XIX_0x20_XIX_Physical, receiver=TPN_EXV1_XIX_Klima_LIN2_XIX_32, timeout-as=1.0, timeout-cr=1.0, transmitter=TPN_Klima_XIX_Klima_LIN2_XIX_0:
        ident TPCN_Klima_LIN2_XIX_TPCHType_LIN_Diagnose_XIX_0x0_Klima_XIX_0x20_EXV1_XIX_Physical
      lin-tp-connection data-pdu=SlaveResp_XIX_Klima_LIN2, flow-control=MasterReq_XIX_Klima_LIN2, lin-tp-n-sdu=DCM_Klima_LIN2_XIX_TPCHType_LIN_Diagnose_XIX_0x20_XIX_0x0_XIX_Physical, receiver=TPN_Klima_XIX_Klima_LIN2_XIX_0, timeout-as=1.0, timeout-cr=1.0, transmitter=TPN_EXV1_XIX_Klima_LIN2_XIX_32:
        ident TPCN_Klima_LIN2_XIX_TPCHType_LIN_Diagnose_XIX_0x20_EXV1_XIX_0x0_Klima_XIX_Physical
      lin-tp-connection data-pdu=MasterReq_XIX_Klima_LIN2, flow-control=SlaveResp_XIX_Klima_LIN2, lin-tp-n-sdu=DCM_Klima_LIN2_XIX_TPCHType_LIN_Diagnose_XIX_0x0_XIX_0x21_XIX_Physical, receiver=TPN_EXV2_XIX_Klima_LIN2_XIX_33, timeout-as=1.0, timeout-cr=1.0, transmitter=TPN_Klima_XIX_Klima_LIN2_XIX_0:
        ident TPCN_Klima_LIN2_XIX_TPCHType_LIN_Diagnose_XIX_0x0_Klima_XIX_0x21_EXV2_XIX_Physical
      lin-tp-connection data-pdu=SlaveResp_XIX_Klima_LIN2, flow-control=MasterReq_XIX_Klima_LIN2, lin-tp-n-sdu=DCM_Klima_LIN2_XIX_TPCHType_LIN_Diagnose_XIX_0x21_XIX_0x0_XIX_Physical, receiver=TPN_Klima_XIX_Klima_LIN2_XIX_0, timeout-as=1.0, timeout-cr=1.0, transmitter=TPN_EXV2_XIX_Klima_LIN2_XIX_33:
        ident TPCN_Klima_LIN2_XIX_TPCHType_LIN_Diagnose_XIX_0x21_EXV2_XIX_0x0_Klima_XIX_Physical
      lin-tp-connection data-pdu=MasterReq_XIX_Klima_LIN2, flow-control=SlaveResp_XIX_Klima_LIN2, lin-tp-n-sdu=DCM_Klima_LIN2_XIX_TPCHType_LIN_Diagnose_XIX_0x0_XIX_0x22_XIX_Physical, receiver=TPN_EXV3_XIX_Klima_LIN2_XIX_34, timeout-as=1.0, timeout-cr=1.0, transmitter=TPN_Klima_XIX_Klima_LIN2_XIX_0:
        ident TPCN_Klima_LIN2_XIX_TPCHType_LIN_Diagnose_XIX_0x0_Klima_XIX_0x22_EXV3_XIX_Physical
      lin-tp-connection data-pdu=SlaveResp_XIX_Klima_LIN2, flow-control=MasterReq_XIX_Klima_LIN2, lin-tp-n-sdu=DCM_Klima_LIN2_XIX_TPCHType_LIN_Diagnose_XIX_0x22_XIX_0x0_XIX_Physical, receiver=TPN_Klima_XIX_Klima_LIN2_XIX_0, timeout-as=1.0, timeout-cr=1.0, transmitter=TPN_EXV3_XIX_Klima_LIN2_XIX_34:
        ident TPCN_Klima_LIN2_XIX_TPCHType_LIN_Diagnose_XIX_0x22_EXV3_XIX_0x0_Klima_XIX_Physical
      lin-tp-connection data-pdu=MasterReq_XIX_Klima_LIN2, flow-control=SlaveResp_XIX_Klima_LIN2, lin-tp-n-sdu=DCM_Klima_LIN2_XIX_TPCHType_LIN_Diagnose_XIX_0x0_XIX_0x6D_XIX_Physical, receiver=TPN_ION_Front_XIX_Klima_LIN2_XIX_109, timeout-as=1.0, timeout-cr=1.0, transmitter=TPN_Klima_XIX_Klima_LIN2_XIX_0:
        ident TPCN_Klima_LIN2_XIX_TPCHType_LIN_Diagnose_XIX_0x0_Klima_XIX_0x6D_ION_Front_XIX_Physical
      lin-tp-connection data-pdu=SlaveResp_XIX_Klima_LIN2, flow-control=MasterReq_XIX_Klima_LIN2, lin-tp-n-sdu=DCM_Klima_LIN2_XIX_TPCHType_LIN_Diagnose_XIX_0x6D_XIX_0x0_XIX_Physical, receiver=TPN_Klima_XIX_Klima_LIN2_XIX_0, timeout-as=1.0, timeout-cr=1.0, transmitter=TPN_ION_Front_XIX_Klima_LIN2_XIX_109:
        ident TPCN_Klima_LIN2_XIX_TPCHType_LIN_Diagnose_XIX_0x6D_ION_Front_XIX_0x0_Klima_XIX_Physical
      lin-tp-connection data-pdu=MasterReq_XIX_Klima_LIN2, flow-control=SlaveResp_XIX_Klima_LIN2, lin-tp-n-sdu=DCM_Klima_LIN2_XIX_TPCHType_LIN_Diagnose_XIX_0x0_XIX_0x15_XIX_Physical, receiver=TPN_LLR_VLL_XIX_Klima_LIN2_XIX_21, timeout-as=1.0, timeout-cr=1.0, transmitter=TPN_Klima_XIX_Klima_LIN2_XIX_0:
        ident TPCN_Klima_LIN2_XIX_TPCHType_LIN_Diagnose_XIX_0x0_Klima_XIX_0x15_LLR_LL1_XIX_Physical
      lin-tp-connection data-pdu=SlaveResp_XIX_Klima_LIN2, flow-control=MasterReq_XIX_Klima_LIN2, lin-tp-n-sdu=DCM_Klima_LIN2_XIX_TPCHType_LIN_Diagnose_XIX_0x15_XIX_0x0_XIX_Physical, receiver=TPN_Klima_XIX_Klima_LIN2_XIX_0, timeout-as=1.0, timeout-cr=1.0, transmitter=TPN_LLR_VLL_XIX_Klima_LIN2_XIX_21:
        ident TPCN_Klima_LIN2_XIX_TPCHType_LIN_Diagnose_XIX_0x15_LLR_LL1_XIX_0x0_Klima_XIX_Physical
      lin-tp-connection data-pdu=MasterReq_XIX_Klima_LIN2, flow-control=SlaveResp_XIX_Klima_LIN2, lin-tp-n-sdu=DCM_Klima_LIN2_XIX_TPCHType_LIN_Diagnose_XIX_0x0_XIX_0x17_XIX_Physical, receiver=TPN_LLR_VLS_XIX_Klima_LIN2_XIX_23, timeout-as=1.0, timeout-cr=1.0, transmitter=TPN_Klima_XIX_Klima_LIN2_XIX_0:
        ident TPCN_Klima_LIN2_XIX_TPCHType_LIN_Diagnose_XIX_0x0_Klima_XIX_0x17_LLR_LS1_XIX_Physical
      lin-tp-connection data-pdu=SlaveResp_XIX_Klima_LIN2, flow-control=MasterReq_XIX_Klima_LIN2, lin-tp-n-sdu=DCM_Klima_LIN2_XIX_TPCHType_LIN_Diagnose_XIX_0x17_XIX_0x0_XIX_Physical, receiver=TPN_Klima_XIX_Klima_LIN2_XIX_0, timeout-as=1.0, timeout-cr=1.0, transmitter=TPN_LLR_VLS_XIX_Klima_LIN2_XIX_23:
        ident TPCN_Klima_LIN2_XIX_TPCHType_LIN_Diagnose_XIX_0x17_LLR_LS1_XIX_0x0_Klima_XIX_Physical
      lin-tp-connection data-pdu=MasterReq_XIX_Klima_LIN2, flow-control=SlaveResp_XIX_Klima_LIN2, lin-tp-n-sdu=DCM_Klima_LIN2_XIX_TPCHType_LIN_Diagnose_XIX_0x0_XIX_0x18_XIX_Physical, receiver=TPN_LLR_VLS2_XIX_Klima_LIN2_XIX_24, timeout-as=1.0, timeout-cr=1.0, transmitter=TPN_Klima_XIX_Klima_LIN2_XIX_0:
        ident TPCN_Klima_LIN2_XIX_TPCHType_LIN_Diagnose_XIX_0x0_Klima_XIX_0x18_LLR_LS2_XIX_Physical
      lin-tp-connection data-pdu=SlaveResp_XIX_Klima_LIN2, flow-control=MasterReq_XIX_Klima_LIN2, lin-tp-n-sdu=DCM_Klima_LIN2_XIX_TPCHType_LIN_Diagnose_XIX_0x18_XIX_0x0_XIX_Physical, receiver=TPN_Klima_XIX_Klima_LIN2_XIX_0, timeout-as=1.0, timeout-cr=1.0, transmitter=TPN_LLR_VLS2_XIX_Klima_LIN2_XIX_24:
        ident TPCN_Klima_LIN2_XIX_TPCHType_LIN_Diagnose_XIX_0x18_LLR_LS2_XIX_0x0_Klima_XIX_Physical
      lin-tp-connection data-pdu=MasterReq_XIX_Klima_LIN2, flow-control=SlaveResp_XIX_Klima_LIN2, lin-tp-n-sdu=DCM_Klima_LIN2_XIX_TPCHType_LIN_Diagnose_XIX_0x0_XIX_0xD_XIX_Physical, receiver=TPN_LLR_VRL_XIX_Klima_LIN2_XIX_13, timeout-as=1.0, timeout-cr=1.0, transmitter=TPN_Klima_XIX_Klima_LIN2_XIX_0:
        ident TPCN_Klima_LIN2_XIX_TPCHType_LIN_Diagnose_XIX_0x0_Klima_XIX_0xD_LLR_RL1_XIX_Physical
      lin-tp-connection data-pdu=SlaveResp_XIX_Klima_LIN2, flow-control=MasterReq_XIX_Klima_LIN2, lin-tp-n-sdu=DCM_Klima_LIN2_XIX_TPCHType_LIN_Diagnose_XIX_0xD_XIX_0x0_XIX_Physical, receiver=TPN_Klima_XIX_Klima_LIN2_XIX_0, timeout-as=1.0, timeout-cr=1.0, transmitter=TPN_LLR_VRL_XIX_Klima_LIN2_XIX_13:
        ident TPCN_Klima_LIN2_XIX_TPCHType_LIN_Diagnose_XIX_0xD_LLR_RL1_XIX_0x0_Klima_XIX_Physical
      lin-tp-connection data-pdu=MasterReq_XIX_Klima_LIN2, flow-control=SlaveResp_XIX_Klima_LIN2, lin-tp-n-sdu=DCM_Klima_LIN2_XIX_TPCHType_LIN_Diagnose_XIX_0x0_XIX_0xF_XIX_Physical, receiver=TPN_LLR_VRS_XIX_Klima_LIN2_XIX_15, timeout-as=1.0, timeout-cr=1.0, transmitter=TPN_Klima_XIX_Klima_LIN2_XIX_0:
        ident TPCN_Klima_LIN2_XIX_TPCHType_LIN_Diagnose_XIX_0x0_Klima_XIX_0xF_LLR_RS1_XIX_Physical
      lin-tp-connection data-pdu=SlaveResp_XIX_Klima_LIN2, flow-control=MasterReq_XIX_Klima_LIN2, lin-tp-n-sdu=DCM_Klima_LIN2_XIX_TPCHType_LIN_Diagnose_XIX_0xF_XIX_0x0_XIX_Physical, receiver=TPN_Klima_XIX_Klima_LIN2_XIX_0, timeout-as=1.0, timeout-cr=1.0, transmitter=TPN_LLR_VRS_XIX_Klima_LIN2_XIX_15:
        ident TPCN_Klima_LIN2_XIX_TPCHType_LIN_Diagnose_XIX_0xF_LLR_RS1_XIX_0x0_Klima_XIX_Physical
      lin-tp-connection data-pdu=MasterReq_XIX_Klima_LIN2, flow-control=SlaveResp_XIX_Klima_LIN2, lin-tp-n-sdu=DCM_Klima_LIN2_XIX_TPCHType_LIN_Diagnose_XIX_0x0_XIX_0x10_XIX_Physical, receiver=TPN_LLR_VRS2_XIX_Klima_LIN2_XIX_16, timeout-as=1.0, timeout-cr=1.0, transmitter=TPN_Klima_XIX_Klima_LIN2_XIX_0:
        ident TPCN_Klima_LIN2_XIX_TPCHType_LIN_Diagnose_XIX_0x0_Klima_XIX_0x10_LLR_RS2_XIX_Physical
      lin-tp-connection data-pdu=SlaveResp_XIX_Klima_LIN2, flow-control=MasterReq_XIX_Klima_LIN2, lin-tp-n-sdu=DCM_Klima_LIN2_XIX_TPCHType_LIN_Diagnose_XIX_0x10_XIX_0x0_XIX_Physical, receiver=TPN_Klima_XIX_Klima_LIN2_XIX_0, timeout-as=1.0, timeout-cr=1.0, transmitter=TPN_LLR_VRS2_XIX_Klima_LIN2_XIX_16:
        ident TPCN_Klima_LIN2_XIX_TPCHType_LIN_Diagnose_XIX_0x10_LLR_RS2_XIX_0x0_Klima_XIX_Physical
      12 x lin tp node, all with p-2-max=2.0, p-2-timing=0.5:
        TPN_Klima_XIX_Klima_LIN2_XIX_0: connector=CN_Klima_LIN2, tp-address=LinTPConfig_Klima_LIN2/TA_0x0
        TPN_DS_XIX_Klima_LIN2_XIX_25: tp-address=TA_0x19
        TPN_EXV1_XIX_Klima_LIN2_XIX_32: tp-address=LinTPConfig_Klima_LIN2/TA_0x20
        TPN_EXV2_XIX_Klima_LIN2_XIX_33: tp-address=LinTPConfig_Klima_LIN2/TA_0x21
        TPN_EXV3_XIX_Klima_LIN2_XIX_34: tp-address=LinTPConfig_Klima_LIN2/TA_0x22
        TPN_ION_Front_XIX_Klima_LIN2_XIX_109: tp-address=TA_0x6D
        TPN_LLR_VLL_XIX_Klima_LIN2_XIX_21: tp-address=LinTPConfig_Klima_LIN2/TA_0x15
        TPN_LLR_VLS_XIX_Klima_LIN2_XIX_23: tp-address=LinTPConfig_Klima_LIN2/TA_0x17
        TPN_LLR_VLS2_XIX_Klima_LIN2_XIX_24: tp-address=TA_0x18
        TPN_LLR_VRL_XIX_Klima_LIN2_XIX_13: tp-address=LinTPConfig_Klima_LIN2/TA_0xD
        TPN_LLR_VRS_XIX_Klima_LIN2_XIX_15: tp-address=LinTPConfig_Klima_LIN2/TA_0xF
        TPN_LLR_VRS2_XIX_Klima_LIN2_XIX_16: tp-address=TA_0x10
    LinTPConfig_Klima_LIN1: communication-cluster=Klima_LIN1
      7 x tp address:
        TA_0x0: tp-address=0
        TA_0x1A: tp-address=26
        TA_0x50: tp-address=80
        TA_0x43: tp-address=67
        TA_0xA: tp-address=10
        TA_0x40: tp-address=64
        TA_0x64: tp-address=100
      lin-tp-connection data-pdu=MasterReq_XIX_Klima_LIN1, flow-control=SlaveResp_XIX_Klima_LIN1, lin-tp-n-sdu=DCM_Klima_LIN1_XIX_TPCHType_LIN_Diagnose_XIX_0x0_XIX_0x1A_XIX_Physical, receiver=TPN_AQS_XIX_Klima_LIN1_XIX_26, timeout-as=1.0, timeout-cr=1.0, transmitter=TPN_Klima_XIX_Klima_LIN1_XIX_0:
        ident TPCN_Klima_LIN1_XIX_TPCHType_LIN_Diagnose_XIX_0x0_Klima_XIX_0x1A_AQS_XIX_Physical
      lin-tp-connection data-pdu=SlaveResp_XIX_Klima_LIN1, flow-control=MasterReq_XIX_Klima_LIN1, lin-tp-n-sdu=DCM_Klima_LIN1_XIX_TPCHType_LIN_Diagnose_XIX_0x1A_XIX_0x0_XIX_Physical, receiver=TPN_Klima_XIX_Klima_LIN1_XIX_0, timeout-as=1.0, timeout-cr=1.0, transmitter=TPN_AQS_XIX_Klima_LIN1_XIX_26:
        ident TPCN_Klima_LIN1_XIX_TPCHType_LIN_Diagnose_XIX_0x1A_AQS_XIX_0x0_Klima_XIX_Physical
      lin-tp-connection data-pdu=MasterReq_XIX_Klima_LIN1, flow-control=SlaveResp_XIX_Klima_LIN1, lin-tp-n-sdu=DCM_Klima_LIN1_XIX_TPCHType_LIN_Diagnose_XIX_0x0_XIX_0x50_XIX_Physical, receiver=TPN_FSA_XIX_Klima_LIN1_XIX_80, timeout-as=1.0, timeout-cr=1.0, transmitter=TPN_Klima_XIX_Klima_LIN1_XIX_0:
        ident TPCN_Klima_LIN1_XIX_TPCHType_LIN_Diagnose_XIX_0x0_Klima_XIX_0x50_FSA_XIX_Physical
      lin-tp-connection data-pdu=SlaveResp_XIX_Klima_LIN1, flow-control=MasterReq_XIX_Klima_LIN1, lin-tp-n-sdu=DCM_Klima_LIN1_XIX_TPCHType_LIN_Diagnose_XIX_0x50_XIX_0x0_XIX_Physical, receiver=TPN_Klima_XIX_Klima_LIN1_XIX_0, timeout-as=1.0, timeout-cr=1.0, transmitter=TPN_FSA_XIX_Klima_LIN1_XIX_80:
        ident TPCN_Klima_LIN1_XIX_TPCHType_LIN_Diagnose_XIX_0x50_FSA_XIX_0x0_Klima_XIX_Physical
      lin-tp-connection data-pdu=MasterReq_XIX_Klima_LIN1, flow-control=SlaveResp_XIX_Klima_LIN1, lin-tp-n-sdu=DCM_Klima_LIN1_XIX_TPCHType_LIN_Diagnose_XIX_0x0_XIX_0x43_XIX_Physical, receiver=TPN_ICO2b_XIX_Klima_LIN1_XIX_67, timeout-as=1.0, timeout-cr=1.0, transmitter=TPN_Klima_XIX_Klima_LIN1_XIX_0:
        ident TPCN_Klima_LIN1_XIX_TPCHType_LIN_Diagnose_XIX_0x0_Klima_XIX_0x43_ICO2b_XIX_Physical
      lin-tp-connection data-pdu=SlaveResp_XIX_Klima_LIN1, flow-control=MasterReq_XIX_Klima_LIN1, lin-tp-n-sdu=DCM_Klima_LIN1_XIX_TPCHType_LIN_Diagnose_XIX_0x43_XIX_0x0_XIX_Physical, receiver=TPN_Klima_XIX_Klima_LIN1_XIX_0, timeout-as=1.0, timeout-cr=1.0, transmitter=TPN_ICO2b_XIX_Klima_LIN1_XIX_67:
        ident TPCN_Klima_LIN1_XIX_TPCHType_LIN_Diagnose_XIX_0x43_ICO2b_XIX_0x0_Klima_XIX_Physical
      lin-tp-connection data-pdu=MasterReq_XIX_Klima_LIN1, flow-control=SlaveResp_XIX_Klima_LIN1, lin-tp-n-sdu=DCM_Klima_LIN1_XIX_TPCHType_LIN_Diagnose_XIX_0x0_XIX_0xA_XIX_Physical, receiver=TPN_KPV_XIX_Klima_LIN1_XIX_10, timeout-as=1.0, timeout-cr=1.0, transmitter=TPN_Klima_XIX_Klima_LIN1_XIX_0:
        ident TPCN_Klima_LIN1_XIX_TPCHType_LIN_Diagnose_XIX_0x0_Klima_XIX_0xA_KPV_XIX_Physical
      lin-tp-connection data-pdu=SlaveResp_XIX_Klima_LIN1, flow-control=MasterReq_XIX_Klima_LIN1, lin-tp-n-sdu=DCM_Klima_LIN1_XIX_TPCHType_LIN_Diagnose_XIX_0xA_XIX_0x0_XIX_Physical, receiver=TPN_Klima_XIX_Klima_LIN1_XIX_0, timeout-as=1.0, timeout-cr=1.0, transmitter=TPN_KPV_XIX_Klima_LIN1_XIX_10:
        ident TPCN_Klima_LIN1_XIX_TPCHType_LIN_Diagnose_XIX_0xA_KPV_XIX_0x0_Klima_XIX_Physical
      lin-tp-connection data-pdu=MasterReq_XIX_Klima_LIN1, flow-control=SlaveResp_XIX_Klima_LIN1, lin-tp-n-sdu=DCM_Klima_LIN1_XIX_TPCHType_LIN_Diagnose_XIX_0x0_XIX_0x40_XIX_Physical, receiver=TPN_PMS_innen_XIX_Klima_LIN1_XIX_64, timeout-as=1.0, timeout-cr=1.0, transmitter=TPN_Klima_XIX_Klima_LIN1_XIX_0:
        ident TPCN_Klima_LIN1_XIX_TPCHType_LIN_Diagnose_XIX_0x0_Klima_XIX_0x40_PMS_XIX_Physical
      lin-tp-connection data-pdu=SlaveResp_XIX_Klima_LIN1, flow-control=MasterReq_XIX_Klima_LIN1, lin-tp-n-sdu=DCM_Klima_LIN1_XIX_TPCHType_LIN_Diagnose_XIX_0x40_XIX_0x0_XIX_Physical, receiver=TPN_Klima_XIX_Klima_LIN1_XIX_0, timeout-as=1.0, timeout-cr=1.0, transmitter=TPN_PMS_innen_XIX_Klima_LIN1_XIX_64:
        ident TPCN_Klima_LIN1_XIX_TPCHType_LIN_Diagnose_XIX_0x40_PMS_XIX_0x0_Klima_XIX_Physical
      lin-tp-connection data-pdu=MasterReq_XIX_Klima_LIN1, flow-control=SlaveResp_XIX_Klima_LIN1, lin-tp-n-sdu=DCM_Klima_LIN1_XIX_TPCHType_LIN_Diagnose_XIX_0x0_XIX_0x64_XIX_Physical, receiver=TPN_UIF_XIX_Klima_LIN1_XIX_100, timeout-as=1.0, timeout-cr=1.0, transmitter=TPN_Klima_XIX_Klima_LIN1_XIX_0:
        ident TPCN_Klima_LIN1_XIX_TPCHType_LIN_Diagnose_XIX_0x0_Klima_XIX_0x64_UIF_XIX_Physical
      lin-tp-connection data-pdu=SlaveResp_XIX_Klima_LIN1, flow-control=MasterReq_XIX_Klima_LIN1, lin-tp-n-sdu=DCM_Klima_LIN1_XIX_TPCHType_LIN_Diagnose_XIX_0x64_XIX_0x0_XIX_Physical, receiver=TPN_Klima_XIX_Klima_LIN1_XIX_0, timeout-as=1.0, timeout-cr=1.0, transmitter=TPN_UIF_XIX_Klima_LIN1_XIX_100:
        ident TPCN_Klima_LIN1_XIX_TPCHType_LIN_Diagnose_XIX_0x64_UIF_XIX_0x0_Klima_XIX_Physical
      7 x lin tp node, all with p-2-max=2.0, p-2-timing=0.5:
        TPN_Klima_XIX_Klima_LIN1_XIX_0: connector=CN_Klima_LIN1, tp-address=LinTPConfig_Klima_LIN1/TA_0x0
        TPN_AQS_XIX_Klima_LIN1_XIX_26: tp-address=TA_0x1A
        TPN_FSA_XIX_Klima_LIN1_XIX_80: tp-address=LinTPConfig_Klima_LIN1/TA_0x50
        TPN_ICO2b_XIX_Klima_LIN1_XIX_67: tp-address=LinTPConfig_Klima_LIN1/TA_0x43
        TPN_KPV_XIX_Klima_LIN1_XIX_10: tp-address=TA_0xA
        TPN_PMS_innen_XIX_Klima_LIN1_XIX_64: tp-address=TA_0x40
        TPN_UIF_XIX_Klima_LIN1_XIX_100: tp-address=TA_0x64
    LinTPConfig_Klima_LIN3: communication-cluster=Klima_LIN3
      10 x tp address:
        TA_0x0: tp-address=0
        TA_0x14: tp-address=20
        TA_0x15: tp-address=21
        TA_0x16: tp-address=22
        TA_0x39: tp-address=57
        TA_0x20: tp-address=32
        TA_0x61: tp-address=97
        TA_0x63: tp-address=99
        TA_0x5F: tp-address=95
        TA_0x5E: tp-address=94
      lin-tp-connection data-pdu=MasterReq_XIX_Klima_LIN3, flow-control=SlaveResp_XIX_Klima_LIN3, lin-tp-n-sdu=DCM_Klima_LIN3_XIX_TPCHType_LIN_Diagnose_XIX_0x0_XIX_0x14_XIX_Physical, receiver=TPN_pT_Sensor1_XIX_Klima_LIN3_XIX_20, timeout-as=1.0, timeout-cr=1.0, transmitter=TPN_Klima_XIX_Klima_LIN3_XIX_0:
        ident TPCN_Klima_LIN3_XIX_TPCHType_LIN_Diagnose_XIX_0x0_Klima_XIX_0x14_DTS1_XIX_Physical
      lin-tp-connection data-pdu=SlaveResp_XIX_Klima_LIN3, flow-control=MasterReq_XIX_Klima_LIN3, lin-tp-n-sdu=DCM_Klima_LIN3_XIX_TPCHType_LIN_Diagnose_XIX_0x14_XIX_0x0_XIX_Physical, receiver=TPN_Klima_XIX_Klima_LIN3_XIX_0, timeout-as=1.0, timeout-cr=1.0, transmitter=TPN_pT_Sensor1_XIX_Klima_LIN3_XIX_20:
        ident TPCN_Klima_LIN3_XIX_TPCHType_LIN_Diagnose_XIX_0x14_DTS1_XIX_0x0_Klima_XIX_Physical
      lin-tp-connection data-pdu=MasterReq_XIX_Klima_LIN3, flow-control=SlaveResp_XIX_Klima_LIN3, lin-tp-n-sdu=DCM_Klima_LIN3_XIX_TPCHType_LIN_Diagnose_XIX_0x0_XIX_0x15_XIX_Physical, receiver=TPN_pT_Sensor2_XIX_Klima_LIN3_XIX_21, timeout-as=1.0, timeout-cr=1.0, transmitter=TPN_Klima_XIX_Klima_LIN3_XIX_0:
        ident TPCN_Klima_LIN3_XIX_TPCHType_LIN_Diagnose_XIX_0x0_Klima_XIX_0x15_DTS3_XIX_Physical
      lin-tp-connection data-pdu=SlaveResp_XIX_Klima_LIN3, flow-control=MasterReq_XIX_Klima_LIN3, lin-tp-n-sdu=DCM_Klima_LIN3_XIX_TPCHType_LIN_Diagnose_XIX_0x15_XIX_0x0_XIX_Physical, receiver=TPN_Klima_XIX_Klima_LIN3_XIX_0, timeout-as=1.0, timeout-cr=1.0, transmitter=TPN_pT_Sensor2_XIX_Klima_LIN3_XIX_21:
        ident TPCN_Klima_LIN3_XIX_TPCHType_LIN_Diagnose_XIX_0x15_DTS3_XIX_0x0_Klima_XIX_Physical
      lin-tp-connection data-pdu=MasterReq_XIX_Klima_LIN3, flow-control=SlaveResp_XIX_Klima_LIN3, lin-tp-n-sdu=DCM_Klima_LIN3_XIX_TPCHType_LIN_Diagnose_XIX_0x0_XIX_0x16_XIX_Physical, receiver=TPN_pT_Sensor3_XIX_Klima_LIN3_XIX_22, timeout-as=1.0, timeout-cr=1.0, transmitter=TPN_Klima_XIX_Klima_LIN3_XIX_0:
        ident TPCN_Klima_LIN3_XIX_TPCHType_LIN_Diagnose_XIX_0x0_Klima_XIX_0x16_DTS4_XIX_Physical
      lin-tp-connection data-pdu=SlaveResp_XIX_Klima_LIN3, flow-control=MasterReq_XIX_Klima_LIN3, lin-tp-n-sdu=DCM_Klima_LIN3_XIX_TPCHType_LIN_Diagnose_XIX_0x16_XIX_0x0_XIX_Physical, receiver=TPN_Klima_XIX_Klima_LIN3_XIX_0, timeout-as=1.0, timeout-cr=1.0, transmitter=TPN_pT_Sensor3_XIX_Klima_LIN3_XIX_22:
        ident TPCN_Klima_LIN3_XIX_TPCHType_LIN_Diagnose_XIX_0x16_DTS4_XIX_0x0_Klima_XIX_Physical
      lin-tp-connection data-pdu=MasterReq_XIX_Klima_LIN3, flow-control=SlaveResp_XIX_Klima_LIN3, lin-tp-n-sdu=DCM_Klima_LIN3_XIX_TPCHType_LIN_Diagnose_XIX_0x0_XIX_0x39_XIX_Physical, receiver=TPN_EKK4_XIX_Klima_LIN3_XIX_57, timeout-as=1.0, timeout-cr=1.0, transmitter=TPN_Klima_XIX_Klima_LIN3_XIX_0:
        ident TPCN_Klima_LIN3_XIX_TPCHType_LIN_Diagnose_XIX_0x0_Klima_XIX_0x39_EKK_XIX_Physical
      lin-tp-connection data-pdu=SlaveResp_XIX_Klima_LIN3, flow-control=MasterReq_XIX_Klima_LIN3, lin-tp-n-sdu=DCM_Klima_LIN3_XIX_TPCHType_LIN_Diagnose_XIX_0x39_XIX_0x0_XIX_Physical, receiver=TPN_Klima_XIX_Klima_LIN3_XIX_0, timeout-as=1.0, timeout-cr=1.0, transmitter=TPN_EKK4_XIX_Klima_LIN3_XIX_57:
        ident TPCN_Klima_LIN3_XIX_TPCHType_LIN_Diagnose_XIX_0x39_EKK_XIX_0x0_Klima_XIX_Physical
      lin-tp-connection data-pdu=MasterReq_XIX_Klima_LIN3, flow-control=SlaveResp_XIX_Klima_LIN3, lin-tp-n-sdu=DCM_Klima_LIN3_XIX_TPCHType_LIN_Diagnose_XIX_0x0_XIX_0x20_XIX_Physical, receiver=TPN_EXV1_XIX_Klima_LIN3_XIX_32, timeout-as=1.0, timeout-cr=1.0, transmitter=TPN_Klima_XIX_Klima_LIN3_XIX_0:
        ident TPCN_Klima_LIN3_XIX_TPCHType_LIN_Diagnose_XIX_0x0_Klima_XIX_0x20_EXV1_XIX_Physical
      lin-tp-connection data-pdu=SlaveResp_XIX_Klima_LIN3, flow-control=MasterReq_XIX_Klima_LIN3, lin-tp-n-sdu=DCM_Klima_LIN3_XIX_TPCHType_LIN_Diagnose_XIX_0x20_XIX_0x0_XIX_Physical, receiver=TPN_Klima_XIX_Klima_LIN3_XIX_0, timeout-as=1.0, timeout-cr=1.0, transmitter=TPN_EXV1_XIX_Klima_LIN3_XIX_32:
        ident TPCN_Klima_LIN3_XIX_TPCHType_LIN_Diagnose_XIX_0x20_EXV1_XIX_0x0_Klima_XIX_Physical
      lin-tp-connection data-pdu=MasterReq_XIX_Klima_LIN3, flow-control=SlaveResp_XIX_Klima_LIN3, lin-tp-n-sdu=DCM_Klima_LIN3_XIX_TPCHType_LIN_Diagnose_XIX_0x0_XIX_0x61_XIX_Physical, receiver=TPN_BLOWER_XIX_Klima_LIN3_XIX_97, timeout-as=1.0, timeout-cr=1.0, transmitter=TPN_Klima_XIX_Klima_LIN3_XIX_0:
        ident TPCN_Klima_LIN3_XIX_TPCHType_LIN_Diagnose_XIX_0x0_Klima_XIX_0x61_Geblaese_XIX_Physical
      lin-tp-connection data-pdu=SlaveResp_XIX_Klima_LIN3, flow-control=MasterReq_XIX_Klima_LIN3, lin-tp-n-sdu=DCM_Klima_LIN3_XIX_TPCHType_LIN_Diagnose_XIX_0x61_XIX_0x0_XIX_Physical, receiver=TPN_Klima_XIX_Klima_LIN3_XIX_0, timeout-as=1.0, timeout-cr=1.0, transmitter=TPN_BLOWER_XIX_Klima_LIN3_XIX_97:
        ident TPCN_Klima_LIN3_XIX_TPCHType_LIN_Diagnose_XIX_0x61_Geblaese_XIX_0x0_Klima_XIX_Physical
      lin-tp-connection data-pdu=MasterReq_XIX_Klima_LIN3, flow-control=SlaveResp_XIX_Klima_LIN3, lin-tp-n-sdu=DCM_Klima_LIN3_XIX_TPCHType_LIN_Diagnose_XIX_0x0_XIX_0x63_XIX_Physical, receiver=TPN_HV_H3_XIX_Klima_LIN3_XIX_99, timeout-as=1.0, timeout-cr=1.0, transmitter=TPN_Klima_XIX_Klima_LIN3_XIX_0:
        ident TPCN_Klima_LIN3_XIX_TPCHType_LIN_Diagnose_XIX_0x0_Klima_XIX_0x63_PTC_2_XIX_Physical
      lin-tp-connection data-pdu=SlaveResp_XIX_Klima_LIN3, flow-control=MasterReq_XIX_Klima_LIN3, lin-tp-n-sdu=DCM_Klima_LIN3_XIX_TPCHType_LIN_Diagnose_XIX_0x63_XIX_0x0_XIX_Physical, receiver=TPN_Klima_XIX_Klima_LIN3_XIX_0, timeout-as=1.0, timeout-cr=1.0, transmitter=TPN_HV_H3_XIX_Klima_LIN3_XIX_99:
        ident TPCN_Klima_LIN3_XIX_TPCHType_LIN_Diagnose_XIX_0x63_PTC_2_XIX_0x0_Klima_XIX_Physical
      lin-tp-connection data-pdu=MasterReq_XIX_Klima_LIN3, flow-control=SlaveResp_XIX_Klima_LIN3, lin-tp-n-sdu=DCM_Klima_LIN3_XIX_TPCHType_LIN_Diagnose_XIX_0x0_XIX_0x5F_XIX_Physical, receiver=TPN_HV_H_XIX_Klima_LIN3_XIX_95, timeout-as=1.0, timeout-cr=1.0, transmitter=TPN_Klima_XIX_Klima_LIN3_XIX_0:
        ident TPCN_Klima_LIN3_XIX_TPCHType_LIN_Diagnose_XIX_0x0_Klima_XIX_0x5F_PTC_XIX_Physical
      lin-tp-connection data-pdu=SlaveResp_XIX_Klima_LIN3, flow-control=MasterReq_XIX_Klima_LIN3, lin-tp-n-sdu=DCM_Klima_LIN3_XIX_TPCHType_LIN_Diagnose_XIX_0x5F_XIX_0x0_XIX_Physical, receiver=TPN_Klima_XIX_Klima_LIN3_XIX_0, timeout-as=1.0, timeout-cr=1.0, transmitter=TPN_HV_H_XIX_Klima_LIN3_XIX_95:
        ident TPCN_Klima_LIN3_XIX_TPCHType_LIN_Diagnose_XIX_0x5F_PTC_XIX_0x0_Klima_XIX_Physical
      lin-tp-connection data-pdu=MasterReq_XIX_Klima_LIN3, flow-control=SlaveResp_XIX_Klima_LIN3, lin-tp-n-sdu=DCM_Klima_LIN3_XIX_TPCHType_LIN_Diagnose_XIX_0x0_XIX_0x5E_XIX_Physical, receiver=TPN_HV_H6_XIX_Klima_LIN3_XIX_94, timeout-as=1.0, timeout-cr=1.0, transmitter=TPN_Klima_XIX_Klima_LIN3_XIX_0:
        ident TPCN_Klima_LIN3_XIX_TPCHType_LIN_Diagnose_XIX_0x0_Klima_XIX_0x5E_PTC_XIX_Physical
      lin-tp-connection data-pdu=SlaveResp_XIX_Klima_LIN3, flow-control=MasterReq_XIX_Klima_LIN3, lin-tp-n-sdu=DCM_Klima_LIN3_XIX_TPCHType_LIN_Diagnose_XIX_0x5E_XIX_0x0_XIX_Physical, receiver=TPN_Klima_XIX_Klima_LIN3_XIX_0, timeout-as=1.0, timeout-cr=1.0, transmitter=TPN_HV_H6_XIX_Klima_LIN3_XIX_94:
        ident TPCN_Klima_LIN3_XIX_TPCHType_LIN_Diagnose_XIX_0x5E_PTC_XIX_0x0_Klima_XIX_Physical
      10 x lin tp node, all with p-2-max=2.0, p-2-timing=0.5:
        TPN_Klima_XIX_Klima_LIN3_XIX_0: connector=CN_Klima_LIN3, tp-address=LinTPConfig_Klima_LIN3/TA_0x0
        TPN_pT_Sensor1_XIX_Klima_LIN3_XIX_20: tp-address=TA_0x14
        TPN_pT_Sensor2_XIX_Klima_LIN3_XIX_21: tp-address=LinTPConfig_Klima_LIN3/TA_0x15
        TPN_pT_Sensor3_XIX_Klima_LIN3_XIX_22: tp-address=TA_0x16
        TPN_EKK4_XIX_Klima_LIN3_XIX_57: tp-address=TA_0x39
        TPN_EXV1_XIX_Klima_LIN3_XIX_32: tp-address=LinTPConfig_Klima_LIN3/TA_0x20
        TPN_BLOWER_XIX_Klima_LIN3_XIX_97: tp-address=TA_0x61
        TPN_HV_H3_XIX_Klima_LIN3_XIX_99: tp-address=LinTPConfig_Klima_LIN3/TA_0x63
        TPN_HV_H_XIX_Klima_LIN3_XIX_95: tp-address=TA_0x5F
        TPN_HV_H6_XIX_Klima_LIN3_XIX_94: tp-address=TA_0x5E
    LinTPConfig_Klima_LIN4: communication-cluster=Klima_LIN4
      7 x tp address:
        TA_0x0: tp-address=0
        TA_0x4E: tp-address=78
        TA_0x50: tp-address=80
        TA_0x15: tp-address=21
        TA_0x17: tp-address=23
        TA_0xD: tp-address=13
        TA_0xF: tp-address=15
      lin-tp-connection data-pdu=MasterReq_XIX_Klima_LIN4, flow-control=SlaveResp_XIX_Klima_LIN4, lin-tp-n-sdu=DCM_Klima_LIN4_XIX_TPCHType_LIN_Diagnose_XIX_0x0_XIX_0x4E_XIX_Physical, receiver=TPN_KLh_XIX_Klima_LIN4_XIX_78, timeout-as=1.0, timeout-cr=1.0, transmitter=TPN_Klima_XIX_Klima_LIN4_XIX_0:
        ident TPCN_Klima_LIN4_XIX_TPCHType_LIN_Diagnose_XIX_0x0_Klima_XIX_0x4E_KBF_XIX_Physical
      lin-tp-connection data-pdu=SlaveResp_XIX_Klima_LIN4, flow-control=MasterReq_XIX_Klima_LIN4, lin-tp-n-sdu=DCM_Klima_LIN4_XIX_TPCHType_LIN_Diagnose_XIX_0x4E_XIX_0x0_XIX_Physical, receiver=TPN_Klima_XIX_Klima_LIN4_XIX_0, timeout-as=1.0, timeout-cr=1.0, transmitter=TPN_KLh_XIX_Klima_LIN4_XIX_78:
        ident TPCN_Klima_LIN4_XIX_TPCHType_LIN_Diagnose_XIX_0x4E_KBF_XIX_0x0_Klima_XIX_Physical
      lin-tp-connection data-pdu=MasterReq_XIX_Klima_LIN4, flow-control=SlaveResp_XIX_Klima_LIN4, lin-tp-n-sdu=DCM_Klima_LIN4_XIX_TPCHType_LIN_Diagnose_XIX_0x0_XIX_0x50_XIX_Physical, receiver=TPN_LHR_01_XIX_Klima_LIN4_XIX_80, timeout-as=1.0, timeout-cr=1.0, transmitter=TPN_Klima_XIX_Klima_LIN4_XIX_0:
        ident TPCN_Klima_LIN4_XIX_TPCHType_LIN_Diagnose_XIX_0x0_Klima_XIX_0x50_LHR_01_XIX_Physical
      lin-tp-connection data-pdu=SlaveResp_XIX_Klima_LIN4, flow-control=MasterReq_XIX_Klima_LIN4, lin-tp-n-sdu=DCM_Klima_LIN4_XIX_TPCHType_LIN_Diagnose_XIX_0x50_XIX_0x0_XIX_Physical, receiver=TPN_Klima_XIX_Klima_LIN4_XIX_0, timeout-as=1.0, timeout-cr=1.0, transmitter=TPN_LHR_01_XIX_Klima_LIN4_XIX_80:
        ident TPCN_Klima_LIN4_XIX_TPCHType_LIN_Diagnose_XIX_0x50_LHR_01_XIX_0x0_Klima_XIX_Physical
      lin-tp-connection data-pdu=MasterReq_XIX_Klima_LIN4, flow-control=SlaveResp_XIX_Klima_LIN4, lin-tp-n-sdu=DCM_Klima_LIN4_XIX_TPCHType_LIN_Diagnose_XIX_0x0_XIX_0x15_XIX_Physical, receiver=TPN_LLR_HLL_XIX_Klima_LIN4_XIX_21, timeout-as=1.0, timeout-cr=1.0, transmitter=TPN_Klima_XIX_Klima_LIN4_XIX_0:
        ident TPCN_Klima_LIN4_XIX_TPCHType_LIN_Diagnose_XIX_0x0_Klima_XIX_0x15_LLR_H_LL1_XIX_Physical
      lin-tp-connection data-pdu=SlaveResp_XIX_Klima_LIN4, flow-control=MasterReq_XIX_Klima_LIN4, lin-tp-n-sdu=DCM_Klima_LIN4_XIX_TPCHType_LIN_Diagnose_XIX_0x15_XIX_0x0_XIX_Physical, receiver=TPN_Klima_XIX_Klima_LIN4_XIX_0, timeout-as=1.0, timeout-cr=1.0, transmitter=TPN_LLR_HLL_XIX_Klima_LIN4_XIX_21:
        ident TPCN_Klima_LIN4_XIX_TPCHType_LIN_Diagnose_XIX_0x15_LLR_H_LL1_XIX_0x0_Klima_XIX_Physical
      lin-tp-connection data-pdu=MasterReq_XIX_Klima_LIN4, flow-control=SlaveResp_XIX_Klima_LIN4, lin-tp-n-sdu=DCM_Klima_LIN4_XIX_TPCHType_LIN_Diagnose_XIX_0x0_XIX_0x17_XIX_Physical, receiver=TPN_LLR_HLS_XIX_Klima_LIN4_XIX_23, timeout-as=1.0, timeout-cr=1.0, transmitter=TPN_Klima_XIX_Klima_LIN4_XIX_0:
        ident TPCN_Klima_LIN4_XIX_TPCHType_LIN_Diagnose_XIX_0x0_Klima_XIX_0x17_LLR_H_LS1_XIX_Physical
      lin-tp-connection data-pdu=SlaveResp_XIX_Klima_LIN4, flow-control=MasterReq_XIX_Klima_LIN4, lin-tp-n-sdu=DCM_Klima_LIN4_XIX_TPCHType_LIN_Diagnose_XIX_0x17_XIX_0x0_XIX_Physical, receiver=TPN_Klima_XIX_Klima_LIN4_XIX_0, timeout-as=1.0, timeout-cr=1.0, transmitter=TPN_LLR_HLS_XIX_Klima_LIN4_XIX_23:
        ident TPCN_Klima_LIN4_XIX_TPCHType_LIN_Diagnose_XIX_0x17_LLR_H_LS1_XIX_0x0_Klima_XIX_Physical
      lin-tp-connection data-pdu=MasterReq_XIX_Klima_LIN4, flow-control=SlaveResp_XIX_Klima_LIN4, lin-tp-n-sdu=DCM_Klima_LIN4_XIX_TPCHType_LIN_Diagnose_XIX_0x0_XIX_0xD_XIX_Physical, receiver=TPN_LLR_HRL_XIX_Klima_LIN4_XIX_13, timeout-as=1.0, timeout-cr=1.0, transmitter=TPN_Klima_XIX_Klima_LIN4_XIX_0:
        ident TPCN_Klima_LIN4_XIX_TPCHType_LIN_Diagnose_XIX_0x0_Klima_XIX_0xD_LLR_H_RL1_XIX_Physical
      lin-tp-connection data-pdu=SlaveResp_XIX_Klima_LIN4, flow-control=MasterReq_XIX_Klima_LIN4, lin-tp-n-sdu=DCM_Klima_LIN4_XIX_TPCHType_LIN_Diagnose_XIX_0xD_XIX_0x0_XIX_Physical, receiver=TPN_Klima_XIX_Klima_LIN4_XIX_0, timeout-as=1.0, timeout-cr=1.0, transmitter=TPN_LLR_HRL_XIX_Klima_LIN4_XIX_13:
        ident TPCN_Klima_LIN4_XIX_TPCHType_LIN_Diagnose_XIX_0xD_LLR_H_RL1_XIX_0x0_Klima_XIX_Physical
      lin-tp-connection data-pdu=MasterReq_XIX_Klima_LIN4, flow-control=SlaveResp_XIX_Klima_LIN4, lin-tp-n-sdu=DCM_Klima_LIN4_XIX_TPCHType_LIN_Diagnose_XIX_0x0_XIX_0xF_XIX_Physical, receiver=TPN_LLR_HRS_XIX_Klima_LIN4_XIX_15, timeout-as=1.0, timeout-cr=1.0, transmitter=TPN_Klima_XIX_Klima_LIN4_XIX_0:
        ident TPCN_Klima_LIN4_XIX_TPCHType_LIN_Diagnose_XIX_0x0_Klima_XIX_0xF_LLR_H_RS1_XIX_Physical
      lin-tp-connection data-pdu=SlaveResp_XIX_Klima_LIN4, flow-control=MasterReq_XIX_Klima_LIN4, lin-tp-n-sdu=DCM_Klima_LIN4_XIX_TPCHType_LIN_Diagnose_XIX_0xF_XIX_0x0_XIX_Physical, receiver=TPN_Klima_XIX_Klima_LIN4_XIX_0, timeout-as=1.0, timeout-cr=1.0, transmitter=TPN_LLR_HRS_XIX_Klima_LIN4_XIX_15:
        ident TPCN_Klima_LIN4_XIX_TPCHType_LIN_Diagnose_XIX_0xF_LLR_H_RS1_XIX_0x0_Klima_XIX_Physical
      7 x lin tp node, all with p-2-max=2.0, p-2-timing=0.5:
        TPN_Klima_XIX_Klima_LIN4_XIX_0: connector=CN_Klima_LIN4, tp-address=LinTPConfig_Klima_LIN4/TA_0x0
        TPN_KLh_XIX_Klima_LIN4_XIX_78: tp-address=LinTPConfig_Klima_LIN4/TA_0x4E
        TPN_LHR_01_XIX_Klima_LIN4_XIX_80: tp-address=LinTPConfig_Klima_LIN4/TA_0x50
        TPN_LLR_HLL_XIX_Klima_LIN4_XIX_21: tp-address=LinTPConfig_Klima_LIN4/TA_0x15
        TPN_LLR_HLS_XIX_Klima_LIN4_XIX_23: tp-address=LinTPConfig_Klima_LIN4/TA_0x17
        TPN_LLR_HRL_XIX_Klima_LIN4_XIX_13: tp-address=LinTPConfig_Klima_LIN4/TA_0xD
        TPN_LLR_HRS_XIX_Klima_LIN4_XIX_15: tp-address=LinTPConfig_Klima_LIN4/TA_0xF
    LinTPConfig_Klima_LIN7: communication-cluster=Klima_LIN7
      6 x tp address:
        TA_0x0: tp-address=0
        TA_0x2: tp-address=2
        TA_0x37: tp-address=55
        TA_0x4E: tp-address=78
        TA_0x50: tp-address=80
        TA_0x63: tp-address=99
      lin-tp-connection data-pdu=MasterReq_XIX_Klima_LIN7, flow-control=SlaveResp_XIX_Klima_LIN7, lin-tp-n-sdu=DCM_Klima_LIN7_XIX_TPCHType_LIN_Diagnose_XIX_0x0_XIX_0x2_XIX_Physical, receiver=TPN_pT_Sensor2c_R744_XIX_Klima_LIN7_XIX_2, timeout-as=1.0, timeout-cr=1.0, transmitter=TPN_Klima_XIX_Klima_LIN7_XIX_0:
        ident TPCN_Klima_LIN7_XIX_TPCHType_LIN_Diagnose_XIX_0x0_Klima_XIX_0x2_DTS6_XIX_Physical
      lin-tp-connection data-pdu=SlaveResp_XIX_Klima_LIN7, flow-control=MasterReq_XIX_Klima_LIN7, lin-tp-n-sdu=DCM_Klima_LIN7_XIX_TPCHType_LIN_Diagnose_XIX_0x2_XIX_0x0_XIX_Physical, receiver=TPN_Klima_XIX_Klima_LIN7_XIX_0, timeout-as=1.0, timeout-cr=1.0, transmitter=TPN_pT_Sensor2c_R744_XIX_Klima_LIN7_XIX_2:
        ident TPCN_Klima_LIN7_XIX_TPCHType_LIN_Diagnose_XIX_0x2_DTS6_XIX_0x0_Klima_XIX_Physical
      lin-tp-connection data-pdu=MasterReq_XIX_Klima_LIN7, flow-control=SlaveResp_XIX_Klima_LIN7, lin-tp-n-sdu=DCM_Klima_LIN7_XIX_TPCHType_LIN_Diagnose_XIX_0x0_XIX_0x37_XIX_Physical, receiver=TPN_EXV4_XIX_Klima_LIN7_XIX_55, timeout-as=1.0, timeout-cr=1.0, transmitter=TPN_Klima_XIX_Klima_LIN7_XIX_0:
        ident TPCN_Klima_LIN7_XIX_TPCHType_LIN_Diagnose_XIX_0x0_Klima_XIX_0x37_EXV4_XIX_Physical
      lin-tp-connection data-pdu=SlaveResp_XIX_Klima_LIN7, flow-control=MasterReq_XIX_Klima_LIN7, lin-tp-n-sdu=DCM_Klima_LIN7_XIX_TPCHType_LIN_Diagnose_XIX_0x37_XIX_0x0_XIX_Physical, receiver=TPN_Klima_XIX_Klima_LIN7_XIX_0, timeout-as=1.0, timeout-cr=1.0, transmitter=TPN_EXV4_XIX_Klima_LIN7_XIX_55:
        ident TPCN_Klima_LIN7_XIX_TPCHType_LIN_Diagnose_XIX_0x37_EXV4_XIX_0x0_Klima_XIX_Physical
      lin-tp-connection data-pdu=MasterReq_XIX_Klima_LIN7, flow-control=SlaveResp_XIX_Klima_LIN7, lin-tp-n-sdu=DCM_Klima_LIN7_XIX_TPCHType_LIN_Diagnose_XIX_0x0_XIX_0x4E_XIX_Physical, receiver=TPN_KLhb_XIX_Klima_LIN7_XIX_78, timeout-as=1.0, timeout-cr=1.0, transmitter=TPN_Klima_XIX_Klima_LIN7_XIX_0:
        ident TPCN_Klima_LIN7_XIX_TPCHType_LIN_Diagnose_XIX_0x0_Klima_XIX_0x4E_KBF_2_XIX_Physical
      lin-tp-connection data-pdu=SlaveResp_XIX_Klima_LIN7, flow-control=MasterReq_XIX_Klima_LIN7, lin-tp-n-sdu=DCM_Klima_LIN7_XIX_TPCHType_LIN_Diagnose_XIX_0x4E_XIX_0x0_XIX_Physical, receiver=TPN_Klima_XIX_Klima_LIN7_XIX_0, timeout-as=1.0, timeout-cr=1.0, transmitter=TPN_KLhb_XIX_Klima_LIN7_XIX_78:
        ident TPCN_Klima_LIN7_XIX_TPCHType_LIN_Diagnose_XIX_0x4E_KBF_2_XIX_0x0_Klima_XIX_Physical
      lin-tp-connection data-pdu=MasterReq_XIX_Klima_LIN7, flow-control=SlaveResp_XIX_Klima_LIN7, lin-tp-n-sdu=DCM_Klima_LIN7_XIX_TPCHType_LIN_Diagnose_XIX_0x0_XIX_0x50_XIX_Physical, receiver=TPN_LHR_01b_XIX_Klima_LIN7_XIX_80, timeout-as=1.0, timeout-cr=1.0, transmitter=TPN_Klima_XIX_Klima_LIN7_XIX_0:
        ident TPCN_Klima_LIN7_XIX_TPCHType_LIN_Diagnose_XIX_0x0_Klima_XIX_0x50_LHR_02_XIX_Physical
      lin-tp-connection data-pdu=SlaveResp_XIX_Klima_LIN7, flow-control=MasterReq_XIX_Klima_LIN7, lin-tp-n-sdu=DCM_Klima_LIN7_XIX_TPCHType_LIN_Diagnose_XIX_0x50_XIX_0x0_XIX_Physical, receiver=TPN_Klima_XIX_Klima_LIN7_XIX_0, timeout-as=1.0, timeout-cr=1.0, transmitter=TPN_LHR_01b_XIX_Klima_LIN7_XIX_80:
        ident TPCN_Klima_LIN7_XIX_TPCHType_LIN_Diagnose_XIX_0x50_LHR_02_XIX_0x0_Klima_XIX_Physical
      lin-tp-connection data-pdu=MasterReq_XIX_Klima_LIN7, flow-control=SlaveResp_XIX_Klima_LIN7, lin-tp-n-sdu=DCM_Klima_LIN7_XIX_TPCHType_LIN_Diagnose_XIX_0x0_XIX_0x63_XIX_Physical, receiver=TPN_HV_H3b_XIX_Klima_LIN7_XIX_99, timeout-as=1.0, timeout-cr=1.0, transmitter=TPN_Klima_XIX_Klima_LIN7_XIX_0:
        ident TPCN_Klima_LIN7_XIX_TPCHType_LIN_Diagnose_XIX_0x0_Klima_XIX_0x63_PTC_3_XIX_Physical
      lin-tp-connection data-pdu=SlaveResp_XIX_Klima_LIN7, flow-control=MasterReq_XIX_Klima_LIN7, lin-tp-n-sdu=DCM_Klima_LIN7_XIX_TPCHType_LIN_Diagnose_XIX_0x63_XIX_0x0_XIX_Physical, receiver=TPN_Klima_XIX_Klima_LIN7_XIX_0, timeout-as=1.0, timeout-cr=1.0, transmitter=TPN_HV_H3b_XIX_Klima_LIN7_XIX_99:
        ident TPCN_Klima_LIN7_XIX_TPCHType_LIN_Diagnose_XIX_0x63_PTC_3_XIX_0x0_Klima_XIX_Physical
      6 x lin tp node, all with p-2-max=2.0, p-2-timing=0.5:
        TPN_Klima_XIX_Klima_LIN7_XIX_0: connector=CN_Klima_LIN7, tp-address=LinTPConfig_Klima_LIN7/TA_0x0
        TPN_pT_Sensor2c_R744_XIX_Klima_LIN7_XIX_2: tp-address=LinTPConfig_Klima_LIN7/TA_0x2
        TPN_EXV4_XIX_Klima_LIN7_XIX_55: tp-address=TA_0x37
        TPN_KLhb_XIX_Klima_LIN7_XIX_78: tp-address=LinTPConfig_Klima_LIN7/TA_0x4E
        TPN_LHR_01b_XIX_Klima_LIN7_XIX_80: tp-address=LinTPConfig_Klima_LIN7/TA_0x50
        TPN_HV_H3b_XIX_Klima_LIN7_XIX_99: tp-address=LinTPConfig_Klima_LIN7/TA_0x63
    LinTPConfig_Klima_LIN6: communication-cluster=Klima_LIN6
      10 x tp address:
        TA_0x{0..3}: tp-address={0..3}
        TA_0x23: tp-address=35
        TA_0x25: tp-address=37
        TA_0x26: tp-address=38
        TA_0x27: tp-address=39
        TA_0x28: tp-address=40
        TA_0x43: tp-address=67
      lin-tp-connection data-pdu=MasterReq_XIX_Klima_LIN6, flow-control=SlaveResp_XIX_Klima_LIN6, lin-tp-n-sdu=DCM_Klima_LIN6_XIX_TPCHType_LIN_Diagnose_XIX_0x0_XIX_0x1_XIX_Physical, receiver=TPN_pT_Sensor1_R744_XIX_Klima_LIN6_XIX_1, timeout-as=1.0, timeout-cr=1.0, transmitter=TPN_Klima_XIX_Klima_LIN6_XIX_0:
        ident TPCN_Klima_LIN6_XIX_TPCHType_LIN_Diagnose_XIX_0x0_Klima_XIX_0x1_DTS1_XIX_Physical
      lin-tp-connection data-pdu=SlaveResp_XIX_Klima_LIN6, flow-control=MasterReq_XIX_Klima_LIN6, lin-tp-n-sdu=DCM_Klima_LIN6_XIX_TPCHType_LIN_Diagnose_XIX_0x1_XIX_0x0_XIX_Physical, receiver=TPN_Klima_XIX_Klima_LIN6_XIX_0, timeout-as=1.0, timeout-cr=1.0, transmitter=TPN_pT_Sensor1_R744_XIX_Klima_LIN6_XIX_1:
        ident TPCN_Klima_LIN6_XIX_TPCHType_LIN_Diagnose_XIX_0x1_DTS1_XIX_0x0_Klima_XIX_Physical
      lin-tp-connection data-pdu=MasterReq_XIX_Klima_LIN6, flow-control=SlaveResp_XIX_Klima_LIN6, lin-tp-n-sdu=DCM_Klima_LIN6_XIX_TPCHType_LIN_Diagnose_XIX_0x0_XIX_0x2_XIX_Physical, receiver=TPN_pT_Sensor2_R744_XIX_Klima_LIN6_XIX_2, timeout-as=1.0, timeout-cr=1.0, transmitter=TPN_Klima_XIX_Klima_LIN6_XIX_0:
        ident TPCN_Klima_LIN6_XIX_TPCHType_LIN_Diagnose_XIX_0x0_Klima_XIX_0x2_DTS2_XIX_Physical
      lin-tp-connection data-pdu=SlaveResp_XIX_Klima_LIN6, flow-control=MasterReq_XIX_Klima_LIN6, lin-tp-n-sdu=DCM_Klima_LIN6_XIX_TPCHType_LIN_Diagnose_XIX_0x2_XIX_0x0_XIX_Physical, receiver=TPN_Klima_XIX_Klima_LIN6_XIX_0, timeout-as=1.0, timeout-cr=1.0, transmitter=TPN_pT_Sensor2_R744_XIX_Klima_LIN6_XIX_2:
        ident TPCN_Klima_LIN6_XIX_TPCHType_LIN_Diagnose_XIX_0x2_DTS2_XIX_0x0_Klima_XIX_Physical
      lin-tp-connection data-pdu=MasterReq_XIX_Klima_LIN6, flow-control=SlaveResp_XIX_Klima_LIN6, lin-tp-n-sdu=DCM_Klima_LIN6_XIX_TPCHType_LIN_Diagnose_XIX_0x0_XIX_0x3_XIX_Physical, receiver=TPN_pT_Sensor3_R744_XIX_Klima_LIN6_XIX_3, timeout-as=1.0, timeout-cr=1.0, transmitter=TPN_Klima_XIX_Klima_LIN6_XIX_0:
        ident TPCN_Klima_LIN6_XIX_TPCHType_LIN_Diagnose_XIX_0x0_Klima_XIX_0x3_DTS3_XIX_Physical
      lin-tp-connection data-pdu=SlaveResp_XIX_Klima_LIN6, flow-control=MasterReq_XIX_Klima_LIN6, lin-tp-n-sdu=DCM_Klima_LIN6_XIX_TPCHType_LIN_Diagnose_XIX_0x3_XIX_0x0_XIX_Physical, receiver=TPN_Klima_XIX_Klima_LIN6_XIX_0, timeout-as=1.0, timeout-cr=1.0, transmitter=TPN_pT_Sensor3_R744_XIX_Klima_LIN6_XIX_3:
        ident TPCN_Klima_LIN6_XIX_TPCHType_LIN_Diagnose_XIX_0x3_DTS3_XIX_0x0_Klima_XIX_Physical
      lin-tp-connection data-pdu=MasterReq_XIX_Klima_LIN6, flow-control=SlaveResp_XIX_Klima_LIN6, lin-tp-n-sdu=DCM_Klima_LIN6_XIX_TPCHType_LIN_Diagnose_XIX_0x0_XIX_0x23_XIX_Physical, receiver=TPN_EASV1_XIX_Klima_LIN6_XIX_35, timeout-as=1.0, timeout-cr=1.0, transmitter=TPN_Klima_XIX_Klima_LIN6_XIX_0:
        ident TPCN_Klima_LIN6_XIX_TPCHType_LIN_Diagnose_XIX_0x0_Klima_XIX_0x23_EASV1_XIX_Physical
      lin-tp-connection data-pdu=SlaveResp_XIX_Klima_LIN6, flow-control=MasterReq_XIX_Klima_LIN6, lin-tp-n-sdu=DCM_Klima_LIN6_XIX_TPCHType_LIN_Diagnose_XIX_0x23_XIX_0x0_XIX_Physical, receiver=TPN_Klima_XIX_Klima_LIN6_XIX_0, timeout-as=1.0, timeout-cr=1.0, transmitter=TPN_EASV1_XIX_Klima_LIN6_XIX_35:
        ident TPCN_Klima_LIN6_XIX_TPCHType_LIN_Diagnose_XIX_0x23_EASV1_XIX_0x0_Klima_XIX_Physical
      lin-tp-connection data-pdu=MasterReq_XIX_Klima_LIN6, flow-control=SlaveResp_XIX_Klima_LIN6, lin-tp-n-sdu=DCM_Klima_LIN6_XIX_TPCHType_LIN_Diagnose_XIX_0x0_XIX_0x25_XIX_Physical, receiver=TPN_EASV2_XIX_Klima_LIN6_XIX_37, timeout-as=1.0, timeout-cr=1.0, transmitter=TPN_Klima_XIX_Klima_LIN6_XIX_0:
        ident TPCN_Klima_LIN6_XIX_TPCHType_LIN_Diagnose_XIX_0x0_Klima_XIX_0x25_EASV2_XIX_Physical
      lin-tp-connection data-pdu=SlaveResp_XIX_Klima_LIN6, flow-control=MasterReq_XIX_Klima_LIN6, lin-tp-n-sdu=DCM_Klima_LIN6_XIX_TPCHType_LIN_Diagnose_XIX_0x25_XIX_0x0_XIX_Physical, receiver=TPN_Klima_XIX_Klima_LIN6_XIX_0, timeout-as=1.0, timeout-cr=1.0, transmitter=TPN_EASV2_XIX_Klima_LIN6_XIX_37:
        ident TPCN_Klima_LIN6_XIX_TPCHType_LIN_Diagnose_XIX_0x25_EASV2_XIX_0x0_Klima_XIX_Physical
      lin-tp-connection data-pdu=MasterReq_XIX_Klima_LIN6, flow-control=SlaveResp_XIX_Klima_LIN6, lin-tp-n-sdu=DCM_Klima_LIN6_XIX_TPCHType_LIN_Diagnose_XIX_0x0_XIX_0x26_XIX_Physical, receiver=TPN_EASV3_XIX_Klima_LIN6_XIX_38, timeout-as=1.0, timeout-cr=1.0, transmitter=TPN_Klima_XIX_Klima_LIN6_XIX_0:
        ident TPCN_Klima_LIN6_XIX_TPCHType_LIN_Diagnose_XIX_0x0_Klima_XIX_0x26_EASV3_XIX_Physical
      lin-tp-connection data-pdu=SlaveResp_XIX_Klima_LIN6, flow-control=MasterReq_XIX_Klima_LIN6, lin-tp-n-sdu=DCM_Klima_LIN6_XIX_TPCHType_LIN_Diagnose_XIX_0x26_XIX_0x0_XIX_Physical, receiver=TPN_Klima_XIX_Klima_LIN6_XIX_0, timeout-as=1.0, timeout-cr=1.0, transmitter=TPN_EASV3_XIX_Klima_LIN6_XIX_38:
        ident TPCN_Klima_LIN6_XIX_TPCHType_LIN_Diagnose_XIX_0x26_EASV3_XIX_0x0_Klima_XIX_Physical
      lin-tp-connection data-pdu=MasterReq_XIX_Klima_LIN6, flow-control=SlaveResp_XIX_Klima_LIN6, lin-tp-n-sdu=DCM_Klima_LIN6_XIX_TPCHType_LIN_Diagnose_XIX_0x0_XIX_0x27_XIX_Physical, receiver=TPN_EASV4_XIX_Klima_LIN6_XIX_39, timeout-as=1.0, timeout-cr=1.0, transmitter=TPN_Klima_XIX_Klima_LIN6_XIX_0:
        ident TPCN_Klima_LIN6_XIX_TPCHType_LIN_Diagnose_XIX_0x0_Klima_XIX_0x27_EASV4_XIX_Physical
      lin-tp-connection data-pdu=SlaveResp_XIX_Klima_LIN6, flow-control=MasterReq_XIX_Klima_LIN6, lin-tp-n-sdu=DCM_Klima_LIN6_XIX_TPCHType_LIN_Diagnose_XIX_0x27_XIX_0x0_XIX_Physical, receiver=TPN_Klima_XIX_Klima_LIN6_XIX_0, timeout-as=1.0, timeout-cr=1.0, transmitter=TPN_EASV4_XIX_Klima_LIN6_XIX_39:
        ident TPCN_Klima_LIN6_XIX_TPCHType_LIN_Diagnose_XIX_0x27_EASV4_XIX_0x0_Klima_XIX_Physical
      lin-tp-connection data-pdu=MasterReq_XIX_Klima_LIN6, flow-control=SlaveResp_XIX_Klima_LIN6, lin-tp-n-sdu=DCM_Klima_LIN6_XIX_TPCHType_LIN_Diagnose_XIX_0x0_XIX_0x28_XIX_Physical, receiver=TPN_EASV5_XIX_Klima_LIN6_XIX_40, timeout-as=1.0, timeout-cr=1.0, transmitter=TPN_Klima_XIX_Klima_LIN6_XIX_0:
        ident TPCN_Klima_LIN6_XIX_TPCHType_LIN_Diagnose_XIX_0x0_Klima_XIX_0x28_EASV5_XIX_Physical
      lin-tp-connection data-pdu=SlaveResp_XIX_Klima_LIN6, flow-control=MasterReq_XIX_Klima_LIN6, lin-tp-n-sdu=DCM_Klima_LIN6_XIX_TPCHType_LIN_Diagnose_XIX_0x28_XIX_0x0_XIX_Physical, receiver=TPN_Klima_XIX_Klima_LIN6_XIX_0, timeout-as=1.0, timeout-cr=1.0, transmitter=TPN_EASV5_XIX_Klima_LIN6_XIX_40:
        ident TPCN_Klima_LIN6_XIX_TPCHType_LIN_Diagnose_XIX_0x28_EASV5_XIX_0x0_Klima_XIX_Physical
      lin-tp-connection data-pdu=MasterReq_XIX_Klima_LIN6, flow-control=SlaveResp_XIX_Klima_LIN6, lin-tp-n-sdu=DCM_Klima_LIN6_XIX_TPCHType_LIN_Diagnose_XIX_0x0_XIX_0x43_XIX_Physical, receiver=TPN_ICO2_XIX_Klima_LIN6_XIX_67, timeout-as=1.0, timeout-cr=1.0, transmitter=TPN_Klima_XIX_Klima_LIN6_XIX_0:
        ident TPCN_Klima_LIN6_XIX_TPCHType_LIN_Diagnose_XIX_0x0_Klima_XIX_0x43_ICO2_XIX_Physical
      lin-tp-connection data-pdu=SlaveResp_XIX_Klima_LIN6, flow-control=MasterReq_XIX_Klima_LIN6, lin-tp-n-sdu=DCM_Klima_LIN6_XIX_TPCHType_LIN_Diagnose_XIX_0x43_XIX_0x0_XIX_Physical, receiver=TPN_Klima_XIX_Klima_LIN6_XIX_0, timeout-as=1.0, timeout-cr=1.0, transmitter=TPN_ICO2_XIX_Klima_LIN6_XIX_67:
        ident TPCN_Klima_LIN6_XIX_TPCHType_LIN_Diagnose_XIX_0x43_ICO2_XIX_0x0_Klima_XIX_Physical
      10 x lin tp node, all with p-2-max=2.0, p-2-timing=0.5:
        TPN_Klima_XIX_Klima_LIN6_XIX_0: connector=CN_Klima_LIN6, tp-address=LinTPConfig_Klima_LIN6/TA_0x0
        TPN_pT_Sensor1_R744_XIX_Klima_LIN6_XIX_1: tp-address=TA_0x1
        TPN_pT_Sensor2_R744_XIX_Klima_LIN6_XIX_2: tp-address=LinTPConfig_Klima_LIN6/TA_0x2
        TPN_pT_Sensor3_R744_XIX_Klima_LIN6_XIX_3: tp-address=TA_0x3
        TPN_EASV1_XIX_Klima_LIN6_XIX_35: tp-address=LinTPConfig_Klima_LIN6/TA_0x23
        TPN_EASV2_XIX_Klima_LIN6_XIX_37: tp-address=LinTPConfig_Klima_LIN6/TA_0x25
        TPN_EASV3_XIX_Klima_LIN6_XIX_38: tp-address=LinTPConfig_Klima_LIN6/TA_0x26
        TPN_EASV4_XIX_Klima_LIN6_XIX_39: tp-address=LinTPConfig_Klima_LIN6/TA_0x27
        TPN_EASV5_XIX_Klima_LIN6_XIX_40: tp-address=TA_0x28
        TPN_ICO2_XIX_Klima_LIN6_XIX_67: tp-address=LinTPConfig_Klima_LIN6/TA_0x43
    LinTPConfig_Klima_LIN5: communication-cluster=Klima_LIN5
      9 x tp address:
        TA_0x0: tp-address=0
        TA_0x20: tp-address=32
        TA_0x21: tp-address=33
        TA_0x22: tp-address=34
        TA_0x23: tp-address=35
        TA_0x24: tp-address=36
        TA_0x25: tp-address=37
        TA_0x26: tp-address=38
        TA_0x27: tp-address=39
      lin-tp-connection data-pdu=MasterReq_XIX_Klima_LIN5, flow-control=SlaveResp_XIX_Klima_LIN5, lin-tp-n-sdu=DCM_Klima_LIN5_XIX_TPCHType_LIN_Diagnose_XIX_0x0_XIX_0x20_XIX_Physical, receiver=TPN_ACT401_XIX_Klima_LIN5_XIX_32, timeout-as=1.0, timeout-cr=1.0, transmitter=TPN_Klima_XIX_Klima_LIN5_XIX_0:
        ident TPCN_Klima_LIN5_XIX_TPCHType_LIN_Diagnose_XIX_0x0_Klima_XIX_0x20_ACT401_XIX_Physical
      lin-tp-connection data-pdu=SlaveResp_XIX_Klima_LIN5, flow-control=MasterReq_XIX_Klima_LIN5, lin-tp-n-sdu=DCM_Klima_LIN5_XIX_TPCHType_LIN_Diagnose_XIX_0x20_XIX_0x0_XIX_Physical, receiver=TPN_Klima_XIX_Klima_LIN5_XIX_0, timeout-as=1.0, timeout-cr=1.0, transmitter=TPN_ACT401_XIX_Klima_LIN5_XIX_32:
        ident TPCN_Klima_LIN5_XIX_TPCHType_LIN_Diagnose_XIX_0x20_ACT401_XIX_0x0_Klima_XIX_Physical
      lin-tp-connection data-pdu=MasterReq_XIX_Klima_LIN5, flow-control=SlaveResp_XIX_Klima_LIN5, lin-tp-n-sdu=DCM_Klima_LIN5_XIX_TPCHType_LIN_Diagnose_XIX_0x0_XIX_0x21_XIX_Physical, receiver=TPN_ACT402_XIX_Klima_LIN5_XIX_33, timeout-as=1.0, timeout-cr=1.0, transmitter=TPN_Klima_XIX_Klima_LIN5_XIX_0:
        ident TPCN_Klima_LIN5_XIX_TPCHType_LIN_Diagnose_XIX_0x0_Klima_XIX_0x21_ACT402_XIX_Physical
      lin-tp-connection data-pdu=SlaveResp_XIX_Klima_LIN5, flow-control=MasterReq_XIX_Klima_LIN5, lin-tp-n-sdu=DCM_Klima_LIN5_XIX_TPCHType_LIN_Diagnose_XIX_0x21_XIX_0x0_XIX_Physical, receiver=TPN_Klima_XIX_Klima_LIN5_XIX_0, timeout-as=1.0, timeout-cr=1.0, transmitter=TPN_ACT402_XIX_Klima_LIN5_XIX_33:
        ident TPCN_Klima_LIN5_XIX_TPCHType_LIN_Diagnose_XIX_0x21_ACT402_XIX_0x0_Klima_XIX_Physical
      lin-tp-connection data-pdu=MasterReq_XIX_Klima_LIN5, flow-control=SlaveResp_XIX_Klima_LIN5, lin-tp-n-sdu=DCM_Klima_LIN5_XIX_TPCHType_LIN_Diagnose_XIX_0x0_XIX_0x22_XIX_Physical, receiver=TPN_ACT403_XIX_Klima_LIN5_XIX_34, timeout-as=1.0, timeout-cr=1.0, transmitter=TPN_Klima_XIX_Klima_LIN5_XIX_0:
        ident TPCN_Klima_LIN5_XIX_TPCHType_LIN_Diagnose_XIX_0x0_Klima_XIX_0x22_ACT403_XIX_Physical
      lin-tp-connection data-pdu=SlaveResp_XIX_Klima_LIN5, flow-control=MasterReq_XIX_Klima_LIN5, lin-tp-n-sdu=DCM_Klima_LIN5_XIX_TPCHType_LIN_Diagnose_XIX_0x22_XIX_0x0_XIX_Physical, receiver=TPN_Klima_XIX_Klima_LIN5_XIX_0, timeout-as=1.0, timeout-cr=1.0, transmitter=TPN_ACT403_XIX_Klima_LIN5_XIX_34:
        ident TPCN_Klima_LIN5_XIX_TPCHType_LIN_Diagnose_XIX_0x22_ACT403_XIX_0x0_Klima_XIX_Physical
      lin-tp-connection data-pdu=MasterReq_XIX_Klima_LIN5, flow-control=SlaveResp_XIX_Klima_LIN5, lin-tp-n-sdu=DCM_Klima_LIN5_XIX_TPCHType_LIN_Diagnose_XIX_0x0_XIX_0x23_XIX_Physical, receiver=TPN_ACT404_XIX_Klima_LIN5_XIX_35, timeout-as=1.0, timeout-cr=1.0, transmitter=TPN_Klima_XIX_Klima_LIN5_XIX_0:
        ident TPCN_Klima_LIN5_XIX_TPCHType_LIN_Diagnose_XIX_0x0_Klima_XIX_0x23_ACT404_XIX_Physical
      lin-tp-connection data-pdu=SlaveResp_XIX_Klima_LIN5, flow-control=MasterReq_XIX_Klima_LIN5, lin-tp-n-sdu=DCM_Klima_LIN5_XIX_TPCHType_LIN_Diagnose_XIX_0x23_XIX_0x0_XIX_Physical, receiver=TPN_Klima_XIX_Klima_LIN5_XIX_0, timeout-as=1.0, timeout-cr=1.0, transmitter=TPN_ACT404_XIX_Klima_LIN5_XIX_35:
        ident TPCN_Klima_LIN5_XIX_TPCHType_LIN_Diagnose_XIX_0x23_ACT404_XIX_0x0_Klima_XIX_Physical
      lin-tp-connection data-pdu=MasterReq_XIX_Klima_LIN5, flow-control=SlaveResp_XIX_Klima_LIN5, lin-tp-n-sdu=DCM_Klima_LIN5_XIX_TPCHType_LIN_Diagnose_XIX_0x0_XIX_0x24_XIX_Physical, receiver=TPN_ACT405_XIX_Klima_LIN5_XIX_36, timeout-as=1.0, timeout-cr=1.0, transmitter=TPN_Klima_XIX_Klima_LIN5_XIX_0:
        ident TPCN_Klima_LIN5_XIX_TPCHType_LIN_Diagnose_XIX_0x0_Klima_XIX_0x24_ACT405_XIX_Physical
      lin-tp-connection data-pdu=SlaveResp_XIX_Klima_LIN5, flow-control=MasterReq_XIX_Klima_LIN5, lin-tp-n-sdu=DCM_Klima_LIN5_XIX_TPCHType_LIN_Diagnose_XIX_0x24_XIX_0x0_XIX_Physical, receiver=TPN_Klima_XIX_Klima_LIN5_XIX_0, timeout-as=1.0, timeout-cr=1.0, transmitter=TPN_ACT405_XIX_Klima_LIN5_XIX_36:
        ident TPCN_Klima_LIN5_XIX_TPCHType_LIN_Diagnose_XIX_0x24_ACT405_XIX_0x0_Klima_XIX_Physical
      lin-tp-connection data-pdu=MasterReq_XIX_Klima_LIN5, flow-control=SlaveResp_XIX_Klima_LIN5, lin-tp-n-sdu=DCM_Klima_LIN5_XIX_TPCHType_LIN_Diagnose_XIX_0x0_XIX_0x25_XIX_Physical, receiver=TPN_ACT406_XIX_Klima_LIN5_XIX_37, timeout-as=1.0, timeout-cr=1.0, transmitter=TPN_Klima_XIX_Klima_LIN5_XIX_0:
        ident TPCN_Klima_LIN5_XIX_TPCHType_LIN_Diagnose_XIX_0x0_Klima_XIX_0x25_ACT406_XIX_Physical
      lin-tp-connection data-pdu=SlaveResp_XIX_Klima_LIN5, flow-control=MasterReq_XIX_Klima_LIN5, lin-tp-n-sdu=DCM_Klima_LIN5_XIX_TPCHType_LIN_Diagnose_XIX_0x25_XIX_0x0_XIX_Physical, receiver=TPN_Klima_XIX_Klima_LIN5_XIX_0, timeout-as=1.0, timeout-cr=1.0, transmitter=TPN_ACT406_XIX_Klima_LIN5_XIX_37:
        ident TPCN_Klima_LIN5_XIX_TPCHType_LIN_Diagnose_XIX_0x25_ACT406_XIX_0x0_Klima_XIX_Physical
      lin-tp-connection data-pdu=MasterReq_XIX_Klima_LIN5, flow-control=SlaveResp_XIX_Klima_LIN5, lin-tp-n-sdu=DCM_Klima_LIN5_XIX_TPCHType_LIN_Diagnose_XIX_0x0_XIX_0x26_XIX_Physical, receiver=TPN_ACT407_XIX_Klima_LIN5_XIX_38, timeout-as=1.0, timeout-cr=1.0, transmitter=TPN_Klima_XIX_Klima_LIN5_XIX_0:
        ident TPCN_Klima_LIN5_XIX_TPCHType_LIN_Diagnose_XIX_0x0_Klima_XIX_0x26_ACT407_XIX_Physical
      lin-tp-connection data-pdu=SlaveResp_XIX_Klima_LIN5, flow-control=MasterReq_XIX_Klima_LIN5, lin-tp-n-sdu=DCM_Klima_LIN5_XIX_TPCHType_LIN_Diagnose_XIX_0x26_XIX_0x0_XIX_Physical, receiver=TPN_Klima_XIX_Klima_LIN5_XIX_0, timeout-as=1.0, timeout-cr=1.0, transmitter=TPN_ACT407_XIX_Klima_LIN5_XIX_38:
        ident TPCN_Klima_LIN5_XIX_TPCHType_LIN_Diagnose_XIX_0x26_ACT407_XIX_0x0_Klima_XIX_Physical
      lin-tp-connection data-pdu=MasterReq_XIX_Klima_LIN5, flow-control=SlaveResp_XIX_Klima_LIN5, lin-tp-n-sdu=DCM_Klima_LIN5_XIX_TPCHType_LIN_Diagnose_XIX_0x0_XIX_0x27_XIX_Physical, receiver=TPN_ACT408_XIX_Klima_LIN5_XIX_39, timeout-as=1.0, timeout-cr=1.0, transmitter=TPN_Klima_XIX_Klima_LIN5_XIX_0:
        ident TPCN_Klima_LIN5_XIX_TPCHType_LIN_Diagnose_XIX_0x0_Klima_XIX_0x27_ACT408_XIX_Physical
      lin-tp-connection data-pdu=SlaveResp_XIX_Klima_LIN5, flow-control=MasterReq_XIX_Klima_LIN5, lin-tp-n-sdu=DCM_Klima_LIN5_XIX_TPCHType_LIN_Diagnose_XIX_0x27_XIX_0x0_XIX_Physical, receiver=TPN_Klima_XIX_Klima_LIN5_XIX_0, timeout-as=1.0, timeout-cr=1.0, transmitter=TPN_ACT408_XIX_Klima_LIN5_XIX_39:
        ident TPCN_Klima_LIN5_XIX_TPCHType_LIN_Diagnose_XIX_0x27_ACT408_XIX_0x0_Klima_XIX_Physical
      9 x lin tp node, all with p-2-max=2.0, p-2-timing=0.5:
        TPN_Klima_XIX_Klima_LIN5_XIX_0: connector=CN_Klima_LIN5, tp-address=LinTPConfig_Klima_LIN5/TA_0x0
        TPN_ACT401_XIX_Klima_LIN5_XIX_32: tp-address=LinTPConfig_Klima_LIN5/TA_0x20
        TPN_ACT402_XIX_Klima_LIN5_XIX_33: tp-address=LinTPConfig_Klima_LIN5/TA_0x21
        TPN_ACT403_XIX_Klima_LIN5_XIX_34: tp-address=LinTPConfig_Klima_LIN5/TA_0x22
        TPN_ACT404_XIX_Klima_LIN5_XIX_35: tp-address=LinTPConfig_Klima_LIN5/TA_0x23
        TPN_ACT405_XIX_Klima_LIN5_XIX_36: tp-address=TA_0x24
        TPN_ACT406_XIX_Klima_LIN5_XIX_37: tp-address=LinTPConfig_Klima_LIN5/TA_0x25
        TPN_ACT407_XIX_Klima_LIN5_XIX_38: tp-address=LinTPConfig_Klima_LIN5/TA_0x26
        TPN_ACT408_XIX_Klima_LIN5_XIX_39: tp-address=LinTPConfig_Klima_LIN5/TA_0x27
package /SecureCommunication
  secure communication props set SecureCommunicationPropsSet
    secure communication authentication props SecureCommunicationAuthenticationProps_XIX_64: category=VW_PROFILE, auth-algorithm=SipHash24, auth-info-tx-length=64
    secure communication authentication props SecureCommunicationAuthenticationProps_XIX_32: category=VW_PROFILE, auth-algorithm=SipHash24, auth-info-tx-length=32
    secure communication authentication props SecureCommunicationAuthenticationProps_Aes128_XIX_32: category=VW_PROFILE, auth-algorithm=AES128, auth-info-tx-length=32
    secure communication freshness props SecureCommunicationFreshnessProps: category=VW_PROFILE, freshness-value-length=64, freshness-value-tx-length=0
package /DiagnosticServices
  5 x diagnostic connection:
    DC_Klima_XIX_TPCHType_CANFD_ISO_Diagnose: functional-request=TPCN_E3V_EVCANFD_XIX_TPCHType_CANFD_ISO_Diagnose_XIX_0x1C410000_Gateway_XIX_Functional, physical-request=TPCN_E3V_EVCANFD_XIX_TPCHType_CANFD_ISO_Diagnose_XIX_0x1C400046_Gateway_XIX_0x1C420046_Klima_XIX_Physical, response=TPCN_E3V_EVCANFD_XIX_TPCHType_CANFD_ISO_Diagnose_XIX_0x1C420046_Klima_XIX_0x1C400046_Gateway_XIX_Physical
    DC_Klima_XIX_TPCHType_CANFD_OBDC_Diagnose: functional-request=TPCN_E3V_EVCANFD_XIX_TPCHType_CANFD_OBDC_Diagnose_XIX_0x1C410200_Gateway_XIX_Functional, physical-request=TPCN_E3V_EVCANFD_XIX_TPCHType_CANFD_OBDC_Diagnose_XIX_0x1C400246_Gateway_XIX_0x1C420246_Klima_XIX_Physical, response=TPCN_E3V_EVCANFD_XIX_TPCHType_CANFD_OBDC_Diagnose_XIX_0x1C420246_Klima_XIX_0x1C400246_Gateway_XIX_Physical
    DC_Klima_XIX_TPCHType_CANHS_ISO_Diagnose: functional-request=TPCN_E3V_EVCANFD_XIX_TPCHType_CANHS_ISO_Diagnose_XIX_0x700_Gateway_XIX_Functional, physical-request=TPCN_E3V_EVCANFD_XIX_TPCHType_CANHS_ISO_Diagnose_XIX_0x746_Gateway_XIX_0x7B0_Klima_XIX_Physical, response=TPCN_E3V_EVCANFD_XIX_TPCHType_CANHS_ISO_Diagnose_XIX_0x7B0_Klima_XIX_0x746_Gateway_XIX_Physical
    DC_Klima_XIX_TPCHType_CANHS_OBDx: functional-request=TPCN_E3V_EVCANFD_XIX_TPCHType_CANHS_OBDx_XIX_0x18DB33F1_Gateway_XIX_Functional, physical-request=TPCN_E3V_EVCANFD_XIX_TPCHType_CANHS_OBDx_XIX_0x18DA0AF1_Gateway_XIX_0x18DAF10A_Klima_XIX_Physical, response=TPCN_E3V_EVCANFD_XIX_TPCHType_CANHS_OBDx_XIX_0x18DAF10A_Klima_XIX_0x18DA0AF1_Gateway_XIX_Physical
    DC_Klima_XIX_TPCHType_LIN_Diagnose: physical-request=TPCN_Klima_LIN1_XIX_TPCHType_LIN_Diagnose_XIX_0x0_Klima_XIX_0x1A_AQS_XIX_Physical, response=TPCN_Klima_LIN1_XIX_TPCHType_LIN_Diagnose_XIX_0x1A_AQS_XIX_0x0_Klima_XIX_Physical
  diagnostic service table DST_Klima: ecu-instance=Klima
    diagnostic-connections:
      DC_Klima_XIX_TPCHType_CANFD_ISO_Diagnose
      DC_Klima_XIX_TPCHType_CANFD_OBDC_Diagnose
      DC_Klima_XIX_TPCHType_CANHS_ISO_Diagnose
      DC_Klima_XIX_TPCHType_CANHS_OBDx
      DC_Klima_XIX_TPCHType_LIN_Diagnose
