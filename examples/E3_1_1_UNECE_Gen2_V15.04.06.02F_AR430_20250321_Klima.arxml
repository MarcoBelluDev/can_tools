[part 1 of 23: package /E3_1_1_UNECE_Gen2]
AUTOSAR XML (schema 4-3-0)
standard types defined: sint8, sint16, sint32, sint64, uint8, uint16, uint32, uint64, float32, float64, boolean
package /E3_1_1_UNECE_Gen2
  system System
    system mapping System_Mappings
      data-mappings:
        communication-direction=IN, data-element=Grundumfang_XIX_Klima.Geltungsbereich_E3_1_1_UNECE_Gen2.RP_IF_AB_Abschaltanf_SIH_BF_XIX_Grundumfang_XIX_Klima.DE_AB_Abschaltanf_SIH_BF, system-signal=AB_Abschaltanf_SIH_BF
        communication-direction=IN, data-element=Grundumfang_XIX_Klima.Geltungsbereich_E3_1_1_UNECE_Gen2.RP_IF_AB_Belegung_VB_XIX_Grundumfang_XIX_Klima.DE_AB_Belegung_VB, system-signal=AB_Belegung_VB
        communication-direction=IN, data-element=Grundumfang_XIX_Klima.Geltungsbereich_E3_1_1_UNECE_Gen2.RP_IF_AB_Belegung_VF_XIX_Grundumfang_XIX_Klima.DE_AB_Belegung_VF, system-signal=AB_Belegung_VF
        communication-direction=IN, data-element=Grundumfang_XIX_Klima.Geltungsbereich_E3_1_1_UNECE_Gen2.RP_IF_AB_Belegung_VF_ext_XIX_Grundumfang_XIX_Klima.DE_AB_Belegung_VF_ext, system-signal=AB_Belegung_VF_ext
        communication-direction=IN, data-element=Grundumfang_XIX_Klima.Geltungsbereich_E3_1_1_UNECE_Gen2.RP_IF_AB_Crash_Int_XIX_Grundumfang_XIX_Klima.DE_AB_Crash_Int, system-signal=AB_Crash_Int
        communication-direction=IN, data-element=Grundumfang_XIX_Klima.Geltungsbereich_E3_1_1_UNECE_Gen2.RP_IF_AB_Deaktivierung_HV_XIX_Grundumfang_XIX_Klima.DE_AB_Deaktivierung_HV, system-signal=AB_Deaktivierung_HV
        communication-direction=IN, data-element=Grundumfang_XIX_Klima.Geltungsbereich_E3_1_1_UNECE_Gen2.RP_IF_AB_Gurtschloss_BF_XIX_Grundumfang_XIX_Klima.DE_AB_Gurtschloss_BF, system-signal=AB_Gurtschloss_BF
        communication-direction=IN, data-element=Grundumfang_XIX_Klima.Geltungsbereich_E3_1_1_UNECE_Gen2.RP_IF_AB_Gurtschloss_FA_XIX_Grundumfang_XIX_Klima.DE_AB_Gurtschloss_FA, system-signal=AB_Gurtschloss_FA
        communication-direction=IN, data-element=Grundumfang_XIX_Klima.Geltungsbereich_E3_1_1_UNECE_Gen2.RP_IF_AB_Gurtschloss_MI_XIX_Grundumfang_XIX_Klima.DE_AB_Gurtschloss_MI, system-signal=AB_Gurtschloss_MI
        communication-direction=IN, data-element=Grundumfang_XIX_Klima.Geltungsbereich_E3_1_1_UNECE_Gen2.RP_IF_AB_Gurtschloss_Reihe2_BF_XIX_Grundumfang_XIX_Klima.DE_AB_Gurtschloss_Reihe2_BF, system-signal=AB_Gurtschloss_Reihe2_BF
        communication-direction=IN, data-element=Grundumfang_XIX_Klima.Geltungsbereich_E3_1_1_UNECE_Gen2.RP_IF_AB_Gurtschloss_Reihe2_FA_XIX_Grundumfang_XIX_Klima.DE_AB_Gurtschloss_Reihe2_FA, system-signal=AB_Gurtschloss_Reihe2_FA
        communication-direction=IN, data-element=Grundumfang_XIX_Klima.Geltungsbereich_E3_1_1_UNECE_Gen2.RP_IF_AB_Gurtschloss_Reihe2_MI_XIX_Grundumfang_XIX_Klima.DE_AB_Gurtschloss_Reihe2_MI, system-signal=AB_Gurtschloss_Reihe2_MI
        communication-direction=IN, data-element=Grundumfang_XIX_Klima.Geltungsbereich_E3_1_1_UNECE_Gen2.RP_IF_AB_Gurtschloss_Reihe3_BF_XIX_Grundumfang_XIX_Klima.DE_AB_Gurtschloss_Reihe3_BF, system-signal=AB_Gurtschloss_Reihe3_BF
        communication-direction=IN, data-element=Grundumfang_XIX_Klima.Geltungsbereich_E3_1_1_UNECE_Gen2.RP_IF_AB_Gurtschloss_Reihe3_FA_XIX_Grundumfang_XIX_Klima.DE_AB_Gurtschloss_Reihe3_FA, system-signal=AB_Gurtschloss_Reihe3_FA
        communication-direction=IN, data-element=Grundumfang_XIX_Klima.Geltungsbereich_E3_1_1_UNECE_Gen2.RP_IF_AB_Gurtschloss_Reihe3_MI_XIX_Grundumfang_XIX_Klima.DE_AB_Gurtschloss_Reihe3_MI, system-signal=AB_Gurtschloss_Reihe3_MI
        communication-direction=IN, data-element=Grundumfang_XIX_Klima.Geltungsbereich_E3_1_1_UNECE_Gen2.RP_IF_AB_Gurtwarn_Reihe2_BF_XIX_Grundumfang_XIX_Klima.DE_AB_Gurtwarn_Reihe2_BF, system-signal=AB_Gurtwarn_Reihe2_BF
        communication-direction=IN, data-element=Grundumfang_XIX_Klima.Geltungsbereich_E3_1_1_UNECE_Gen2.RP_IF_AB_Gurtwarn_Reihe2_FA_XIX_Grundumfang_XIX_Klima.DE_AB_Gurtwarn_Reihe2_FA, system-signal=AB_Gurtwarn_Reihe2_FA
        communication-direction=IN, data-element=Grundumfang_XIX_Klima.Geltungsbereich_E3_1_1_UNECE_Gen2.RP_IF_AB_Gurtwarn_Reihe2_MI_XIX_Grundumfang_XIX_Klima.DE_AB_Gurtwarn_Reihe2_MI, system-signal=AB_Gurtwarn_Reihe2_MI
        communication-direction=IN, data-element=Grundumfang_XIX_Klima.Geltungsbereich_E3_1_1_UNECE_Gen2.RP_IF_AB_Gurtwarn_Reihe3_BF_XIX_Grundumfang_XIX_Klima.DE_AB_Gurtwarn_Reihe3_BF, system-signal=AB_Gurtwarn_Reihe3_BF
        communication-direction=IN, data-element=Grundumfang_XIX_Klima.Geltungsbereich_E3_1_1_UNECE_Gen2.RP_IF_AB_Gurtwarn_Reihe3_FA_XIX_Grundumfang_XIX_Klima.DE_AB_Gurtwarn_Reihe3_FA, system-signal=AB_Gurtwarn_Reihe3_FA
        communication-direction=IN, data-element=Grundumfang_XIX_Klima.Geltungsbereich_E3_1_1_UNECE_Gen2.RP_IF_AB_Gurtwarn_Reihe3_MI_XIX_Grundumfang_XIX_Klima.DE_AB_Gurtwarn_Reihe3_MI, system-signal=AB_Gurtwarn_Reihe3_MI
        communication-direction=IN, data-element=Grundumfang_XIX_Klima.Geltungsbereich_E3_1_1_UNECE_Gen2.RP_IF_AB_Gurtwarn_VM_XIX_Grundumfang_XIX_Klima.DE_AB_Gurtwarn_VM, system-signal=AB_Gurtwarn_VM
        communication-direction=IN, data-element=Grundumfang_XIX_Klima.Geltungsbereich_E3_1_1_UNECE_Gen2.RP_IF_AB_SBR_hinten_verbau_XIX_Grundumfang_XIX_Klima.DE_AB_SBR_hinten_verbau, system-signal=AB_SBR_hinten_verbau
        communication-direction=IN, data-element=Grundumfang_XIX_Klima.Geltungsbereich_E3_1_1_UNECE_Gen2.RP_IF_AB_Stellgliedtest_XIX_Grundumfang_XIX_Klima.DE_AB_Stellgliedtest, system-signal=AB_Stellgliedtest
        communication-direction=IN, data-element=Grundumfang_XIX_Klima.Geltungsbereich_E3_1_1_UNECE_Gen2.RP_IF_ACT401_Adresse_Aktuator_XIX_Grundumfang_XIX_Klima.DE_ACT401_Adresse_Aktuator, system-signal=ACT401_Adresse_Aktuator
        communication-direction=IN, data-element=Grundumfang_XIX_Klima.Geltungsbereich_E3_1_1_UNECE_Gen2.RP_IF_ACT401_Blockierung_aufgetreten_XIX_Grundumfang_XIX_Klima.DE_ACT401_Blockierung_aufgetreten, system-signal=ACT401_Blockierung_aufgetreten
        communication-direction=IN, data-element=Grundumfang_XIX_Klima.Geltungsbereich_E3_1_1_UNECE_Gen2.RP_IF_ACT401_Drehrichtung_XIX_Grundumfang_XIX_Klima.DE_ACT401_Drehrichtung, system-signal=ACT401_Drehrichtung
        communication-direction=IN, data-element=Grundumfang_XIX_Klima.Geltungsbereich_E3_1_1_UNECE_Gen2.RP_IF_ACT401_Elektr_Defekt_XIX_Grundumfang_XIX_Klima.DE_ACT401_Elektr_Defekt, system-signal=ACT401_Elektr_Defekt
        communication-direction=IN, data-element=Grundumfang_XIX_Klima.Geltungsbereich_E3_1_1_UNECE_Gen2.RP_IF_ACT401_Freigabe_Blockiererkennung_XIX_Grundumfang_XIX_Klima.DE_ACT401_Freigabe_Blockiererkennung, system-signal=ACT401_Freigabe_Blockiererkennung
        communication-direction=IN, data-element=Grundumfang_XIX_Klima.Geltungsbereich_E3_1_1_UNECE_Gen2.RP_IF_ACT401_Geschwindigkeitsstatus_XIX_Grundumfang_XIX_Klima.DE_ACT401_Geschwindigkeitsstatus, system-signal=ACT401_Geschwindigkeitsstatus
        communication-direction=IN, data-element=Grundumfang_XIX_Klima.Geltungsbereich_E3_1_1_UNECE_Gen2.RP_IF_ACT401_Ist_Position_Aktuator_XIX_Grundumfang_XIX_Klima.DE_ACT401_Ist_Position_Aktuator, system-signal=ACT401_Ist_Position_Aktuator
        communication-direction=IN, data-element=Grundumfang_XIX_Klima.Geltungsbereich_E3_1_1_UNECE_Gen2.RP_IF_ACT401_Notlauf_aufgetreten_XIX_Grundumfang_XIX_Klima.DE_ACT401_Notlauf_aufgetreten, system-signal=ACT401_Notlauf_aufgetreten
        communication-direction=IN, data-element=Grundumfang_XIX_Klima.Geltungsbereich_E3_1_1_UNECE_Gen2.RP_IF_ACT401_Notlauffreigabe_XIX_Grundumfang_XIX_Klima.DE_ACT401_Notlauffreigabe, system-signal=ACT401_Notlauffreigabe
        communication-direction=IN, data-element=Grundumfang_XIX_Klima.Geltungsbereich_E3_1_1_UNECE_Gen2.RP_IF_ACT401_Notlaufposition_XIX_Grundumfang_XIX_Klima.DE_ACT401_Notlaufposition, system-signal=ACT401_Notlaufposition
        communication-direction=IN, data-element=Grundumfang_XIX_Klima.Geltungsbereich_E3_1_1_UNECE_Gen2.RP_IF_ACT401_Positionsvorgabe_Status_XIX_Grundumfang_XIX_Klima.DE_ACT401_Positionsvorgabe_Status, system-signal=ACT401_Positionsvorgabe_Status
        communication-direction=IN, data-element=Grundumfang_XIX_Klima.Geltungsbereich_E3_1_1_UNECE_Gen2.RP_IF_ACT401_Reset_XIX_Grundumfang_XIX_Klima.DE_ACT401_Reset, system-signal=ACT401_Reset
        communication-direction=IN, data-element=Grundumfang_XIX_Klima.Geltungsbereich_E3_1_1_UNECE_Gen2.RP_IF_ACT401_ResponseError_XIX_Grundumfang_XIX_Klima.DE_ACT401_ResponseError, system-signal=ACT401_ResponseError
        communication-direction=IN, data-element=Grundumfang_XIX_Klima.Geltungsbereich_E3_1_1_UNECE_Gen2.RP_IF_ACT401_Selbsthaltemoment_XIX_Grundumfang_XIX_Klima.DE_ACT401_Selbsthaltemoment, system-signal=ACT401_Selbsthaltemoment
        communication-direction=IN, data-element=Grundumfang_XIX_Klima.Geltungsbereich_E3_1_1_UNECE_Gen2.RP_IF_ACT401_Sonderfunktionen_XIX_Grundumfang_XIX_Klima.DE_ACT401_Sonderfunktionen, system-signal=ACT401_Sonderfunktionen
        communication-direction=IN, data-element=Grundumfang_XIX_Klima.Geltungsbereich_E3_1_1_UNECE_Gen2.RP_IF_ACT401_Spulenbestromung_XIX_Grundumfang_XIX_Klima.DE_ACT401_Spulenbestromung, system-signal=ACT401_Spulenbestromung
        communication-direction=IN, data-element=Grundumfang_XIX_Klima.Geltungsbereich_E3_1_1_UNECE_Gen2.RP_IF_ACT401_Stopmodus_XIX_Grundumfang_XIX_Klima.DE_ACT401_Stopmodus, system-signal=ACT401_Stopmodus
        communication-direction=IN, data-element=Grundumfang_XIX_Klima.Geltungsbereich_E3_1_1_UNECE_Gen2.RP_IF_ACT401_Uebertemperatur_XIX_Grundumfang_XIX_Klima.DE_ACT401_Uebertemperatur, system-signal=ACT401_Uebertemperatur
        communication-direction=IN, data-element=Grundumfang_XIX_Klima.Geltungsbereich_E3_1_1_UNECE_Gen2.RP_IF_ACT401_Variante_XIX_Grundumfang_XIX_Klima.DE_ACT401_Variante, system-signal=ACT401_Variante
        communication-direction=IN, data-element=Grundumfang_XIX_Klima.Geltungsbereich_E3_1_1_UNECE_Gen2.RP_IF_ACT401_Verfahrrichtung_XIX_Grundumfang_XIX_Klima.DE_ACT401_Verfahrrichtung, system-signal=ACT401_Verfahrrichtung
        communication-direction=IN, data-element=Grundumfang_XIX_Klima.Geltungsbereich_E3_1_1_UNECE_Gen2.RP_IF_ACT401_Versorgungsspannung_XIX_Grundumfang_XIX_Klima.DE_ACT401_Versorgungsspannung, system-signal=ACT401_Versorgungsspannung
        communication-direction=IN, data-element=Grundumfang_XIX_Klima.Geltungsbereich_E3_1_1_UNECE_Gen2.RP_IF_ACT402_Adresse_Aktuator_XIX_Grundumfang_XIX_Klima.DE_ACT402_Adresse_Aktuator, system-signal=ACT402_Adresse_Aktuator
        communication-direction=IN, data-element=Grundumfang_XIX_Klima.Geltungsbereich_E3_1_1_UNECE_Gen2.RP_IF_ACT402_Blockierung_aufgetreten_XIX_Grundumfang_XIX_Klima.DE_ACT402_Blockierung_aufgetreten, system-signal=ACT402_Blockierung_aufgetreten
        communication-direction=IN, data-element=Grundumfang_XIX_Klima.Geltungsbereich_E3_1_1_UNECE_Gen2.RP_IF_ACT402_Drehrichtung_XIX_Grundumfang_XIX_Klima.DE_ACT402_Drehrichtung, system-signal=ACT402_Drehrichtung
        communication-direction=IN, data-element=Grundumfang_XIX_Klima.Geltungsbereich_E3_1_1_UNECE_Gen2.RP_IF_ACT402_Elektr_Defekt_XIX_Grundumfang_XIX_Klima.DE_ACT402_Elektr_Defekt, system-signal=ACT402_Elektr_Defekt
        communication-direction=IN, data-element=Grundumfang_XIX_Klima.Geltungsbereich_E3_1_1_UNECE_Gen2.RP_IF_ACT402_Freigabe_Blockiererkennung_XIX_Grundumfang_XIX_Klima.DE_ACT402_Freigabe_Blockiererkennung, system-signal=ACT402_Freigabe_Blockiererkennung
        communication-direction=IN, data-element=Grundumfang_XIX_Klima.Geltungsbereich_E3_1_1_UNECE_Gen2.RP_IF_ACT402_Geschwindigkeitsstatus_XIX_Grundumfang_XIX_Klima.DE_ACT402_Geschwindigkeitsstatus, system-signal=ACT402_Geschwindigkeitsstatus
        communication-direction=IN, data-element=Grundumfang_XIX_Klima.Geltungsbereich_E3_1_1_UNECE_Gen2.RP_IF_ACT402_Ist_Position_Aktuator_XIX_Grundumfang_XIX_Klima.DE_ACT402_Ist_Position_Aktuator, system-signal=ACT402_Ist_Position_Aktuator
        communication-direction=IN, data-element=Grundumfang_XIX_Klima.Geltungsbereich_E3_1_1_UNECE_Gen2.RP_IF_ACT402_Notlauf_aufgetreten_XIX_Grundumfang_XIX_Klima.DE_ACT402_Notlauf_aufgetreten, system-signal=ACT402_Notlauf_aufgetreten
        communication-direction=IN, data-element=Grundumfang_XIX_Klima.Geltungsbereich_E3_1_1_UNECE_Gen2.RP_IF_ACT402_Notlauffreigabe_XIX_Grundumfang_XIX_Klima.DE_ACT402_Notlauffreigabe, system-signal=ACT402_Notlauffreigabe
        communication-direction=IN, data-element=Grundumfang_XIX_Klima.Geltungsbereich_E3_1_1_UNECE_Gen2.RP_IF_ACT402_Notlaufposition_XIX_Grundumfang_XIX_Klima.DE_ACT402_Notlaufposition, system-signal=ACT402_Notlaufposition
        communication-direction=IN, data-element=Grundumfang_XIX_Klima.Geltungsbereich_E3_1_1_UNECE_Gen2.RP_IF_ACT402_Positionsvorgabe_Status_XIX_Grundumfang_XIX_Klima.DE_ACT402_Positionsvorgabe_Status, system-signal=ACT402_Positionsvorgabe_Status
        communication-direction=IN, data-element=Grundumfang_XIX_Klima.Geltungsbereich_E3_1_1_UNECE_Gen2.RP_IF_ACT402_Reset_XIX_Grundumfang_XIX_Klima.DE_ACT402_Reset, system-signal=ACT402_Reset
        communication-direction=IN, data-element=Grundumfang_XIX_Klima.Geltungsbereich_E3_1_1_UNECE_Gen2.RP_IF_ACT402_ResponseError_XIX_Grundumfang_XIX_Klima.DE_ACT402_ResponseError, system-signal=ACT402_ResponseError
        communication-direction=IN, data-element=Grundumfang_XIX_Klima.Geltungsbereich_E3_1_1_UNECE_Gen2.RP_IF_ACT402_Selbsthaltemoment_XIX_Grundumfang_XIX_Klima.DE_ACT402_Selbsthaltemoment, system-signal=ACT402_Selbsthaltemoment
        communication-direction=IN, data-element=Grundumfang_XIX_Klima.Geltungsbereich_E3_1_1_UNECE_Gen2.RP_IF_ACT402_Sonderfunktionen_XIX_Grundumfang_XIX_Klima.DE_ACT402_Sonderfunktionen, system-signal=ACT402_Sonderfunktionen
        communication-direction=IN, data-element=Grundumfang_XIX_Klima.Geltungsbereich_E3_1_1_UNECE_Gen2.RP_IF_ACT402_Spulenbestromung_XIX_Grundumfang_XIX_Klima.DE_ACT402_Spulenbestromung, system-signal=ACT402_Spulenbestromung
        communication-direction=IN, data-element=Grundumfang_XIX_Klima.Geltungsbereich_E3_1_1_UNECE_Gen2.RP_IF_ACT402_Stopmodus_XIX_Grundumfang_XIX_Klima.DE_ACT402_Stopmodus, system-signal=ACT402_Stopmodus
        communication-direction=IN, data-element=Grundumfang_XIX_Klima.Geltungsbereich_E3_1_1_UNECE_Gen2.RP_IF_ACT402_Uebertemperatur_XIX_Grundumfang_XIX_Klima.DE_ACT402_Uebertemperatur, system-signal=ACT402_Uebertemperatur
        communication-direction=IN, data-element=Grundumfang_XIX_Klima.Geltungsbereich_E3_1_1_UNECE_Gen2.RP_IF_ACT402_Variante_XIX_Grundumfang_XIX_Klima.DE_ACT402_Variante, system-signal=ACT402_Variante
        communication-direction=IN, data-element=Grundumfang_XIX_Klima.Geltungsbereich_E3_1_1_UNECE_Gen2.RP_IF_ACT402_Verfahrrichtung_XIX_Grundumfang_XIX_Klima.DE_ACT402_Verfahrrichtung, system-signal=ACT402_Verfahrrichtung
        communication-direction=IN, data-element=Grundumfang_XIX_Klima.Geltungsbereich_E3_1_1_UNECE_Gen2.RP_IF_ACT402_Versorgungsspannung_XIX_Grundumfang_XIX_Klima.DE_ACT402_Versorgungsspannung, system-signal=ACT402_Versorgungsspannung
        communication-direction=IN, data-element=Grundumfang_XIX_Klima.Geltungsbereich_E3_1_1_UNECE_Gen2.RP_IF_ACT403_Adresse_Aktuator_XIX_Grundumfang_XIX_Klima.DE_ACT403_Adresse_Aktuator, system-signal=ACT403_Adresse_Aktuator
        communication-direction=IN, data-element=Grundumfang_XIX_Klima.Geltungsbereich_E3_1_1_UNECE_Gen2.RP_IF_ACT403_Blockierung_aufgetreten_XIX_Grundumfang_XIX_Klima.DE_ACT403_Blockierung_aufgetreten, system-signal=ACT403_Blockierung_aufgetreten
        communication-direction=IN, data-element=Grundumfang_XIX_Klima.Geltungsbereich_E3_1_1_UNECE_Gen2.RP_IF_ACT403_Drehrichtung_XIX_Grundumfang_XIX_Klima.DE_ACT403_Drehrichtung, system-signal=ACT403_Drehrichtung
        communication-direction=IN, data-element=Grundumfang_XIX_Klima.Geltungsbereich_E3_1_1_UNECE_Gen2.RP_IF_ACT403_Elektr_Defekt_XIX_Grundumfang_XIX_Klima.DE_ACT403_Elektr_Defekt, system-signal=ACT403_Elektr_Defekt
        communication-direction=IN, data-element=Grundumfang_XIX_Klima.Geltungsbereich_E3_1_1_UNECE_Gen2.RP_IF_ACT403_Freigabe_Blockiererkennung_XIX_Grundumfang_XIX_Klima.DE_ACT403_Freigabe_Blockiererkennung, system-signal=ACT403_Freigabe_Blockiererkennung
        communication-direction=IN, data-element=Grundumfang_XIX_Klima.Geltungsbereich_E3_1_1_UNECE_Gen2.RP_IF_ACT403_Geschwindigkeitsstatus_XIX_Grundumfang_XIX_Klima.DE_ACT403_Geschwindigkeitsstatus, system-signal=ACT403_Geschwindigkeitsstatus
        communication-direction=IN, data-element=Grundumfang_XIX_Klima.Geltungsbereich_E3_1_1_UNECE_Gen2.RP_IF_ACT403_Ist_Position_Aktuator_XIX_Grundumfang_XIX_Klima.DE_ACT403_Ist_Position_Aktuator, system-signal=ACT403_Ist_Position_Aktuator
        communication-direction=IN, data-element=Grundumfang_XIX_Klima.Geltungsbereich_E3_1_1_UNECE_Gen2.RP_IF_ACT403_Notlauf_aufgetreten_XIX_Grundumfang_XIX_Klima.DE_ACT403_Notlauf_aufgetreten, system-signal=ACT403_Notlauf_aufgetreten
        communication-direction=IN, data-element=Grundumfang_XIX_Klima.Geltungsbereich_E3_1_1_UNECE_Gen2.RP_IF_ACT403_Notlauffreigabe_XIX_Grundumfang_XIX_Klima.DE_ACT403_Notlauffreigabe, system-signal=ACT403_Notlauffreigabe
        communication-direction=IN, data-element=Grundumfang_XIX_Klima.Geltungsbereich_E3_1_1_UNECE_Gen2.RP_IF_ACT403_Notlaufposition_XIX_Grundumfang_XIX_Klima.DE_ACT403_Notlaufposition, system-signal=ACT403_Notlaufposition
        communication-direction=IN, data-element=Grundumfang_XIX_Klima.Geltungsbereich_E3_1_1_UNECE_Gen2.RP_IF_ACT403_Positionsvorgabe_Status_XIX_Grundumfang_XIX_Klima.DE_ACT403_Positionsvorgabe_Status, system-signal=ACT403_Positionsvorgabe_Status
        communication-direction=IN, data-element=Grundumfang_XIX_Klima.Geltungsbereich_E3_1_1_UNECE_Gen2.RP_IF_ACT403_Reset_XIX_Grundumfang_XIX_Klima.DE_ACT403_Reset, system-signal=ACT403_Reset
        communication-direction=IN, data-element=Grundumfang_XIX_Klima.Geltungsbereich_E3_1_1_UNECE_Gen2.RP_IF_ACT403_ResponseError_XIX_Grundumfang_XIX_Klima.DE_ACT403_ResponseError, system-signal=ACT403_ResponseError
        communication-direction=IN, data-element=Grundumfang_XIX_Klima.Geltungsbereich_E3_1_1_UNECE_Gen2.RP_IF_ACT403_Selbsthaltemoment_XIX_Grundumfang_XIX_Klima.DE_ACT403_Selbsthaltemoment, system-signal=ACT403_Selbsthaltemoment
        communication-direction=IN, data-element=Grundumfang_XIX_Klima.Geltungsbereich_E3_1_1_UNECE_Gen2.RP_IF_ACT403_Sonderfunktionen_XIX_Grundumfang_XIX_Klima.DE_ACT403_Sonderfunktionen, system-signal=ACT403_Sonderfunktionen
        communication-direction=IN, data-element=Grundumfang_XIX_Klima.Geltungsbereich_E3_1_1_UNECE_Gen2.RP_IF_ACT403_Spulenbestromung_XIX_Grundumfang_XIX_Klima.DE_ACT403_Spulenbestromung, system-signal=ACT403_Spulenbestromung
        communication-direction=IN, data-element=Grundumfang_XIX_Klima.Geltungsbereich_E3_1_1_UNECE_Gen2.RP_IF_ACT403_Stopmodus_XIX_Grundumfang_XIX_Klima.DE_ACT403_Stopmodus, system-signal=ACT403_Stopmodus
        communication-direction=IN, data-element=Grundumfang_XIX_Klima.Geltungsbereich_E3_1_1_UNECE_Gen2.RP_IF_ACT403_Uebertemperatur_XIX_Grundumfang_XIX_Klima.DE_ACT403_Uebertemperatur, system-signal=ACT403_Uebertemperatur
        communication-direction=IN, data-element=Grundumfang_XIX_Klima.Geltungsbereich_E3_1_1_UNECE_Gen2.RP_IF_ACT403_Variante_XIX_Grundumfang_XIX_Klima.DE_ACT403_Variante, system-signal=ACT403_Variante
        communication-direction=IN, data-element=Grundumfang_XIX_Klima.Geltungsbereich_E3_1_1_UNECE_Gen2.RP_IF_ACT403_Verfahrrichtung_XIX_Grundumfang_XIX_Klima.DE_ACT403_Verfahrrichtung, system-signal=ACT403_Verfahrrichtung
        communication-direction=IN, data-element=Grundumfang_XIX_Klima.Geltungsbereich_E3_1_1_UNECE_Gen2.RP_IF_ACT403_Versorgungsspannung_XIX_Grundumfang_XIX_Klima.DE_ACT403_Versorgungsspannung, system-signal=ACT403_Versorgungsspannung
        communication-direction=IN, data-element=Grundumfang_XIX_Klima.Geltungsbereich_E3_1_1_UNECE_Gen2.RP_IF_ACT404_Adresse_Aktuator_XIX_Grundumfang_XIX_Klima.DE_ACT404_Adresse_Aktuator, system-signal=ACT404_Adresse_Aktuator
        communication-direction=IN, data-element=Grundumfang_XIX_Klima.Geltungsbereich_E3_1_1_UNECE_Gen2.RP_IF_ACT404_Blockierung_aufgetreten_XIX_Grundumfang_XIX_Klima.DE_ACT404_Blockierung_aufgetreten, system-signal=ACT404_Blockierung_aufgetreten
        communication-direction=IN, data-element=Grundumfang_XIX_Klima.Geltungsbereich_E3_1_1_UNECE_Gen2.RP_IF_ACT404_Drehrichtung_XIX_Grundumfang_XIX_Klima.DE_ACT404_Drehrichtung, system-signal=ACT404_Drehrichtung
        communication-direction=IN, data-element=Grundumfang_XIX_Klima.Geltungsbereich_E3_1_1_UNECE_Gen2.RP_IF_ACT404_Elektr_Defekt_XIX_Grundumfang_XIX_Klima.DE_ACT404_Elektr_Defekt, system-signal=ACT404_Elektr_Defekt
        communication-direction=IN, data-element=Grundumfang_XIX_Klima.Geltungsbereich_E3_1_1_UNECE_Gen2.RP_IF_ACT404_Freigabe_Blockiererkennung_XIX_Grundumfang_XIX_Klima.DE_ACT404_Freigabe_Blockiererkennung, system-signal=ACT404_Freigabe_Blockiererkennung
        communication-direction=IN, data-element=Grundumfang_XIX_Klima.Geltungsbereich_E3_1_1_UNECE_Gen2.RP_IF_ACT404_Geschwindigkeitsstatus_XIX_Grundumfang_XIX_Klima.DE_ACT404_Geschwindigkeitsstatus, system-signal=ACT404_Geschwindigkeitsstatus
        communication-direction=IN, data-element=Grundumfang_XIX_Klima.Geltungsbereich_E3_1_1_UNECE_Gen2.RP_IF_ACT404_Ist_Position_Aktuator_XIX_Grundumfang_XIX_Klima.DE_ACT404_Ist_Position_Aktuator, system-signal=ACT404_Ist_Position_Aktuator
        communication-direction=IN, data-element=Grundumfang_XIX_Klima.Geltungsbereich_E3_1_1_UNECE_Gen2.RP_IF_ACT404_Notlauf_aufgetreten_XIX_Grundumfang_XIX_Klima.DE_ACT404_Notlauf_aufgetreten, system-signal=ACT404_Notlauf_aufgetreten
        communication-direction=IN, data-element=Grundumfang_XIX_Klima.Geltungsbereich_E3_1_1_UNECE_Gen2.RP_IF_ACT404_Notlauffreigabe_XIX_Grundumfang_XIX_Klima.DE_ACT404_Notlauffreigabe, system-signal=ACT404_Notlauffreigabe
        communication-direction=IN, data-element=Grundumfang_XIX_Klima.Geltungsbereich_E3_1_1_UNECE_Gen2.RP_IF_ACT404_Notlaufposition_XIX_Grundumfang_XIX_Klima.DE_ACT404_Notlaufposition, system-signal=ACT404_Notlaufposition
        communication-direction=IN, data-element=Grundumfang_XIX_Klima.Geltungsbereich_E3_1_1_UNECE_Gen2.RP_IF_ACT404_Positionsvorgabe_Status_XIX_Grundumfang_XIX_Klima.DE_ACT404_Positionsvorgabe_Status, system-signal=ACT404_Positionsvorgabe_Status
        communication-direction=IN, data-element=Grundumfang_XIX_Klima.Geltungsbereich_E3_1_1_UNECE_Gen2.RP_IF_ACT404_Reset_XIX_Grundumfang_XIX_Klima.DE_ACT404_Reset, system-signal=ACT404_Reset
        communication-direction=IN, data-element=Grundumfang_XIX_Klima.Geltungsbereich_E3_1_1_UNECE_Gen2.RP_IF_ACT404_ResponseError_XIX_Grundumfang_XIX_Klima.DE_ACT404_ResponseError, system-signal=ACT404_ResponseError
        communication-direction=IN, data-element=Grundumfang_XIX_Klima.Geltungsbereich_E3_1_1_UNECE_Gen2.RP_IF_ACT404_Selbsthaltemoment_XIX_Grundumfang_XIX_Klima.DE_ACT404_Selbsthaltemoment, system-signal=ACT404_Selbsthaltemoment
        communication-direction=IN, data-element=Grundumfang_XIX_Klima.Geltungsbereich_E3_1_1_UNECE_Gen2.RP_IF_ACT404_Sonderfunktionen_XIX_Grundumfang_XIX_Klima.DE_ACT404_Sonderfunktionen, system-signal=ACT404_Sonderfunktionen
        communication-direction=IN, data-element=Grundumfang_XIX_Klima.Geltungsbereich_E3_1_1_UNECE_Gen2.RP_IF_ACT404_Spulenbestromung_XIX_Grundumfang_XIX_Klima.DE_ACT404_Spulenbestromung, system-signal=ACT404_Spulenbestromung
        communication-direction=IN, data-element=Grundumfang_XIX_Klima.Geltungsbereich_E3_1_1_UNECE_Gen2.RP_IF_ACT404_Stopmodus_XIX_Grundumfang_XIX_Klima.DE_ACT404_Stopmodus, system-signal=ACT404_Stopmodus
        communication-direction=IN, data-element=Grundumfang_XIX_Klima.Geltungsbereich_E3_1_1_UNECE_Gen2.RP_IF_ACT404_Uebertemperatur_XIX_Grundumfang_XIX_Klima.DE_ACT404_Uebertemperatur, system-signal=ACT404_Uebertemperatur
        communication-direction=IN, data-element=Grundumfang_XIX_Klima.Geltungsbereich_E3_1_1_UNECE_Gen2.RP_IF_ACT404_Variante_XIX_Grundumfang_XIX_Klima.DE_ACT404_Variante, system-signal=ACT404_Variante
        communication-direction=IN, data-element=Grundumfang_XIX_Klima.Geltungsbereich_E3_1_1_UNECE_Gen2.RP_IF_ACT404_Verfahrrichtung_XIX_Grundumfang_XIX_Klima.DE_ACT404_Verfahrrichtung, system-signal=ACT404_Verfahrrichtung
        communication-direction=IN, data-element=Grundumfang_XIX_Klima.Geltungsbereich_E3_1_1_UNECE_Gen2.RP_IF_ACT404_Versorgungsspannung_XIX_Grundumfang_XIX_Klima.DE_ACT404_Versorgungsspannung, system-signal=ACT404_Versorgungsspannung
        communication-direction=IN, data-element=Grundumfang_XIX_Klima.Geltungsbereich_E3_1_1_UNECE_Gen2.RP_IF_ACT405_Adresse_Aktuator_XIX_Grundumfang_XIX_Klima.DE_ACT405_Adresse_Aktuator, system-signal=ACT405_Adresse_Aktuator
        communication-direction=IN, data-element=Grundumfang_XIX_Klima.Geltungsbereich_E3_1_1_UNECE_Gen2.RP_IF_ACT405_Blockierung_aufgetreten_XIX_Grundumfang_XIX_Klima.DE_ACT405_Blockierung_aufgetreten, system-signal=ACT405_Blockierung_aufgetreten
        communication-direction=IN, data-element=Grundumfang_XIX_Klima.Geltungsbereich_E3_1_1_UNECE_Gen2.RP_IF_ACT405_Drehrichtung_XIX_Grundumfang_XIX_Klima.DE_ACT405_Drehrichtung, system-signal=ACT405_Drehrichtung
        communication-direction=IN, data-element=Grundumfang_XIX_Klima.Geltungsbereich_E3_1_1_UNECE_Gen2.RP_IF_ACT405_Elektr_Defekt_XIX_Grundumfang_XIX_Klima.DE_ACT405_Elektr_Defekt, system-signal=ACT405_Elektr_Defekt
        communication-direction=IN, data-element=Grundumfang_XIX_Klima.Geltungsbereich_E3_1_1_UNECE_Gen2.RP_IF_ACT405_Freigabe_Blockiererkennung_XIX_Grundumfang_XIX_Klima.DE_ACT405_Freigabe_Blockiererkennung, system-signal=ACT405_Freigabe_Blockiererkennung
        communication-direction=IN, data-element=Grundumfang_XIX_Klima.Geltungsbereich_E3_1_1_UNECE_Gen2.RP_IF_ACT405_Geschwindigkeitsstatus_XIX_Grundumfang_XIX_Klima.DE_ACT405_Geschwindigkeitsstatus, system-signal=ACT405_Geschwindigkeitsstatus
        communication-direction=IN, data-element=Grundumfang_XIX_Klima.Geltungsbereich_E3_1_1_UNECE_Gen2.RP_IF_ACT405_Ist_Position_Aktuator_XIX_Grundumfang_XIX_Klima.DE_ACT405_Ist_Position_Aktuator, system-signal=ACT405_Ist_Position_Aktuator
        communication-direction=IN, data-element=Grundumfang_XIX_Klima.Geltungsbereich_E3_1_1_UNECE_Gen2.RP_IF_ACT405_Notlauf_aufgetreten_XIX_Grundumfang_XIX_Klima.DE_ACT405_Notlauf_aufgetreten, system-signal=ACT405_Notlauf_aufgetreten
        communication-direction=IN, data-element=Grundumfang_XIX_Klima.Geltungsbereich_E3_1_1_UNECE_Gen2.RP_IF_ACT405_Notlauffreigabe_XIX_Grundumfang_XIX_Klima.DE_ACT405_Notlauffreigabe, system-signal=ACT405_Notlauffreigabe
        communication-direction=IN, data-element=Grundumfang_XIX_Klima.Geltungsbereich_E3_1_1_UNECE_Gen2.RP_IF_ACT405_Notlaufposition_XIX_Grundumfang_XIX_Klima.DE_ACT405_Notlaufposition, system-signal=ACT405_Notlaufposition
        communication-direction=IN, data-element=Grundumfang_XIX_Klima.Geltungsbereich_E3_1_1_UNECE_Gen2.RP_IF_ACT405_Positionsvorgabe_Status_XIX_Grundumfang_XIX_Klima.DE_ACT405_Positionsvorgabe_Status, system-signal=ACT405_Positionsvorgabe_Status
        communication-direction=IN, data-element=Grundumfang_XIX_Klima.Geltungsbereich_E3_1_1_UNECE_Gen2.RP_IF_ACT405_Reset_XIX_Grundumfang_XIX_Klima.DE_ACT405_Reset, system-signal=ACT405_Reset
        communication-direction=IN, data-element=Grundumfang_XIX_Klima.Geltungsbereich_E3_1_1_UNECE_Gen2.RP_IF_ACT405_ResponseError_XIX_Grundumfang_XIX_Klima.DE_ACT405_ResponseError, system-signal=ACT405_ResponseError
        communication-direction=IN, data-element=Grundumfang_XIX_Klima.Geltungsbereich_E3_1_1_UNECE_Gen2.RP_IF_ACT405_Selbsthaltemoment_XIX_Grundumfang_XIX_Klima.DE_ACT405_Selbsthaltemoment, system-signal=ACT405_Selbsthaltemoment
        communication-direction=IN, data-element=Grundumfang_XIX_Klima.Geltungsbereich_E3_1_1_UNECE_Gen2.RP_IF_ACT405_Sonderfunktionen_XIX_Grundumfang_XIX_Klima.DE_ACT405_Sonderfunktionen, system-signal=ACT405_Sonderfunktionen
        communication-direction=IN, data-element=Grundumfang_XIX_Klima.Geltungsbereich_E3_1_1_UNECE_Gen2.RP_IF_ACT405_Spulenbestromung_XIX_Grundumfang_XIX_Klima.DE_ACT405_Spulenbestromung, system-signal=ACT405_Spulenbestromung
        communication-direction=IN, data-element=Grundumfang_XIX_Klima.Geltungsbereich_E3_1_1_UNECE_Gen2.RP_IF_ACT405_Stopmodus_XIX_Grundumfang_XIX_Klima.DE_ACT405_Stopmodus, system-signal=ACT405_Stopmodus
        communication-direction=IN, data-element=Grundumfang_XIX_Klima.Geltungsbereich_E3_1_1_UNECE_Gen2.RP_IF_ACT405_Uebertemperatur_XIX_Grundumfang_XIX_Klima.DE_ACT405_Uebertemperatur, system-signal=ACT405_Uebertemperatur
        communication-direction=IN, data-element=Grundumfang_XIX_Klima.Geltungsbereich_E3_1_1_UNECE_Gen2.RP_IF_ACT405_Variante_XIX_Grundumfang_XIX_Klima.DE_ACT405_Variante, system-signal=ACT405_Variante
        communication-direction=IN, data-element=Grundumfang_XIX_Klima.Geltungsbereich_E3_1_1_UNECE_Gen2.RP_IF_ACT405_Verfahrrichtung_XIX_Grundumfang_XIX_Klima.DE_ACT405_Verfahrrichtung, system-signal=ACT405_Verfahrrichtung
        communication-direction=IN, data-element=Grundumfang_XIX_Klima.Geltungsbereich_E3_1_1_UNECE_Gen2.RP_IF_ACT405_Versorgungsspannung_XIX_Grundumfang_XIX_Klima.DE_ACT405_Versorgungsspannung, system-signal=ACT405_Versorgungsspannung
        communication-direction=IN, data-element=Grundumfang_XIX_Klima.Geltungsbereich_E3_1_1_UNECE_Gen2.RP_IF_ACT406_Adresse_Aktuator_XIX_Grundumfang_XIX_Klima.DE_ACT406_Adresse_Aktuator, system-signal=ACT406_Adresse_Aktuator
        communication-direction=IN, data-element=Grundumfang_XIX_Klima.Geltungsbereich_E3_1_1_UNECE_Gen2.RP_IF_ACT406_Blockierung_aufgetreten_XIX_Grundumfang_XIX_Klima.DE_ACT406_Blockierung_aufgetreten, system-signal=ACT406_Blockierung_aufgetreten
        communication-direction=IN, data-element=Grundumfang_XIX_Klima.Geltungsbereich_E3_1_1_UNECE_Gen2.RP_IF_ACT406_Drehrichtung_XIX_Grundumfang_XIX_Klima.DE_ACT406_Drehrichtung, system-signal=ACT406_Drehrichtung
        communication-direction=IN, data-element=Grundumfang_XIX_Klima.Geltungsbereich_E3_1_1_UNECE_Gen2.RP_IF_ACT406_Elektr_Defekt_XIX_Grundumfang_XIX_Klima.DE_ACT406_Elektr_Defekt, system-signal=ACT406_Elektr_Defekt
        communication-direction=IN, data-element=Grundumfang_XIX_Klima.Geltungsbereich_E3_1_1_UNECE_Gen2.RP_IF_ACT406_Freigabe_Blockiererkennung_XIX_Grundumfang_XIX_Klima.DE_ACT406_Freigabe_Blockiererkennung, system-signal=ACT406_Freigabe_Blockiererkennung
        communication-direction=IN, data-element=Grundumfang_XIX_Klima.Geltungsbereich_E3_1_1_UNECE_Gen2.RP_IF_ACT406_Geschwindigkeitsstatus_XIX_Grundumfang_XIX_Klima.DE_ACT406_Geschwindigkeitsstatus, system-signal=ACT406_Geschwindigkeitsstatus
        communication-direction=IN, data-element=Grundumfang_XIX_Klima.Geltungsbereich_E3_1_1_UNECE_Gen2.RP_IF_ACT406_Ist_Position_Aktuator_XIX_Grundumfang_XIX_Klima.DE_ACT406_Ist_Position_Aktuator, system-signal=ACT406_Ist_Position_Aktuator
        communication-direction=IN, data-element=Grundumfang_XIX_Klima.Geltungsbereich_E3_1_1_UNECE_Gen2.RP_IF_ACT406_Notlauf_aufgetreten_XIX_Grundumfang_XIX_Klima.DE_ACT406_Notlauf_aufgetreten, system-signal=ACT406_Notlauf_aufgetreten
        communication-direction=IN, data-element=Grundumfang_XIX_Klima.Geltungsbereich_E3_1_1_UNECE_Gen2.RP_IF_ACT406_Notlauffreigabe_XIX_Grundumfang_XIX_Klima.DE_ACT406_Notlauffreigabe, system-signal=ACT406_Notlauffreigabe
        communication-direction=IN, data-element=Grundumfang_XIX_Klima.Geltungsbereich_E3_1_1_UNECE_Gen2.RP_IF_ACT406_Notlaufposition_XIX_Grundumfang_XIX_Klima.DE_ACT406_Notlaufposition, system-signal=ACT406_Notlaufposition
        communication-direction=IN, data-element=Grundumfang_XIX_Klima.Geltungsbereich_E3_1_1_UNECE_Gen2.RP_IF_ACT406_Positionsvorgabe_Status_XIX_Grundumfang_XIX_Klima.DE_ACT406_Positionsvorgabe_Status, system-signal=ACT406_Positionsvorgabe_Status
        communication-direction=IN, data-element=Grundumfang_XIX_Klima.Geltungsbereich_E3_1_1_UNECE_Gen2.RP_IF_ACT406_Reset_XIX_Grundumfang_XIX_Klima.DE_ACT406_Reset, system-signal=ACT406_Reset
        communication-direction=IN, data-element=Grundumfang_XIX_Klima.Geltungsbereich_E3_1_1_UNECE_Gen2.RP_IF_ACT406_ResponseError_XIX_Grundumfang_XIX_Klima.DE_ACT406_ResponseError, system-signal=ACT406_ResponseError
        communication-direction=IN, data-element=Grundumfang_XIX_Klima.Geltungsbereich_E3_1_1_UNECE_Gen2.RP_IF_ACT406_Selbsthaltemoment_XIX_Grundumfang_XIX_Klima.DE_ACT406_Selbsthaltemoment, system-signal=ACT406_Selbsthaltemoment
        communication-direction=IN, data-element=Grundumfang_XIX_Klima.Geltungsbereich_E3_1_1_UNECE_Gen2.RP_IF_ACT406_Sonderfunktionen_XIX_Grundumfang_XIX_Klima.DE_ACT406_Sonderfunktionen, system-signal=ACT406_Sonderfunktionen
        communication-direction=IN, data-element=Grundumfang_XIX_Klima.Geltungsbereich_E3_1_1_UNECE_Gen2.RP_IF_ACT406_Spulenbestromung_XIX_Grundumfang_XIX_Klima.DE_ACT406_Spulenbestromung, system-signal=ACT406_Spulenbestromung
        communication-direction=IN, data-element=Grundumfang_XIX_Klima.Geltungsbereich_E3_1_1_UNECE_Gen2.RP_IF_ACT406_Stopmodus_XIX_Grundumfang_XIX_Klima.DE_ACT406_Stopmodus, system-signal=ACT406_Stopmodus
        communication-direction=IN, data-element=Grundumfang_XIX_Klima.Geltungsbereich_E3_1_1_UNECE_Gen2.RP_IF_ACT406_Uebertemperatur_XIX_Grundumfang_XIX_Klima.DE_ACT406_Uebertemperatur, system-signal=ACT406_Uebertemperatur
        communication-direction=IN, data-element=Grundumfang_XIX_Klima.Geltungsbereich_E3_1_1_UNECE_Gen2.RP_IF_ACT406_Variante_XIX_Grundumfang_XIX_Klima.DE_ACT406_Variante, system-signal=ACT406_Variante
        communication-direction=IN, data-element=Grundumfang_XIX_Klima.Geltungsbereich_E3_1_1_UNECE_Gen2.RP_IF_ACT406_Verfahrrichtung_XIX_Grundumfang_XIX_Klima.DE_ACT406_Verfahrrichtung, system-signal=ACT406_Verfahrrichtung
        communication-direction=IN, data-element=Grundumfang_XIX_Klima.Geltungsbereich_E3_1_1_UNECE_Gen2.RP_IF_ACT406_Versorgungsspannung_XIX_Grundumfang_XIX_Klima.DE_ACT406_Versorgungsspannung, system-signal=ACT406_Versorgungsspannung
        communication-direction=IN, data-element=Grundumfang_XIX_Klima.Geltungsbereich_E3_1_1_UNECE_Gen2.RP_IF_ACT407_Adresse_Aktuator_XIX_Grundumfang_XIX_Klima.DE_ACT407_Adresse_Aktuator, system-signal=ACT407_Adresse_Aktuator
        communication-direction=IN, data-element=Grundumfang_XIX_Klima.Geltungsbereich_E3_1_1_UNECE_Gen2.RP_IF_ACT407_Blockierung_aufgetreten_XIX_Grundumfang_XIX_Klima.DE_ACT407_Blockierung_aufgetreten, system-signal=ACT407_Blockierung_aufgetreten
        communication-direction=IN, data-element=Grundumfang_XIX_Klima.Geltungsbereich_E3_1_1_UNECE_Gen2.RP_IF_ACT407_Drehrichtung_XIX_Grundumfang_XIX_Klima.DE_ACT407_Drehrichtung, system-signal=ACT407_Drehrichtung
        communication-direction=IN, data-element=Grundumfang_XIX_Klima.Geltungsbereich_E3_1_1_UNECE_Gen2.RP_IF_ACT407_Elektr_Defekt_XIX_Grundumfang_XIX_Klima.DE_ACT407_Elektr_Defekt, system-signal=ACT407_Elektr_Defekt
        communication-direction=IN, data-element=Grundumfang_XIX_Klima.Geltungsbereich_E3_1_1_UNECE_Gen2.RP_IF_ACT407_Freigabe_Blockiererkennung_XIX_Grundumfang_XIX_Klima.DE_ACT407_Freigabe_Blockiererkennung, system-signal=ACT407_Freigabe_Blockiererkennung
        communication-direction=IN, data-element=Grundumfang_XIX_Klima.Geltungsbereich_E3_1_1_UNECE_Gen2.RP_IF_ACT407_Geschwindigkeitsstatus_XIX_Grundumfang_XIX_Klima.DE_ACT407_Geschwindigkeitsstatus, system-signal=ACT407_Geschwindigkeitsstatus
        communication-direction=IN, data-element=Grundumfang_XIX_Klima.Geltungsbereich_E3_1_1_UNECE_Gen2.RP_IF_ACT407_Ist_Position_Aktuator_XIX_Grundumfang_XIX_Klima.DE_ACT407_Ist_Position_Aktuator, system-signal=ACT407_Ist_Position_Aktuator
        communication-direction=IN, data-element=Grundumfang_XIX_Klima.Geltungsbereich_E3_1_1_UNECE_Gen2.RP_IF_ACT407_Notlauf_aufgetreten_XIX_Grundumfang_XIX_Klima.DE_ACT407_Notlauf_aufgetreten, system-signal=ACT407_Notlauf_aufgetreten
        communication-direction=IN, data-element=Grundumfang_XIX_Klima.Geltungsbereich_E3_1_1_UNECE_Gen2.RP_IF_ACT407_Notlauffreigabe_XIX_Grundumfang_XIX_Klima.DE_ACT407_Notlauffreigabe, system-signal=ACT407_Notlauffreigabe
        communication-direction=IN, data-element=Grundumfang_XIX_Klima.Geltungsbereich_E3_1_1_UNECE_Gen2.RP_IF_ACT407_Notlaufposition_XIX_Grundumfang_XIX_Klima.DE_ACT407_Notlaufposition, system-signal=ACT407_Notlaufposition
        communication-direction=IN, data-element=Grundumfang_XIX_Klima.Geltungsbereich_E3_1_1_UNECE_Gen2.RP_IF_ACT407_Positionsvorgabe_Status_XIX_Grundumfang_XIX_Klima.DE_ACT407_Positionsvorgabe_Status, system-signal=ACT407_Positionsvorgabe_Status
        communication-direction=IN, data-element=Grundumfang_XIX_Klima.Geltungsbereich_E3_1_1_UNECE_Gen2.RP_IF_ACT407_Reset_XIX_Grundumfang_XIX_Klima.DE_ACT407_Reset, system-signal=ACT407_Reset
        communication-direction=IN, data-element=Grundumfang_XIX_Klima.Geltungsbereich_E3_1_1_UNECE_Gen2.RP_IF_ACT407_ResponseError_XIX_Grundumfang_XIX_Klima.DE_ACT407_ResponseError, system-signal=ACT407_ResponseError
        communication-direction=IN, data-element=Grundumfang_XIX_Klima.Geltungsbereich_E3_1_1_UNECE_Gen2.RP_IF_ACT407_Selbsthaltemoment_XIX_Grundumfang_XIX_Klima.DE_ACT407_Selbsthaltemoment, system-signal=ACT407_Selbsthaltemoment
        communication-direction=IN, data-element=Grundumfang_XIX_Klima.Geltungsbereich_E3_1_1_UNECE_Gen2.RP_IF_ACT407_Sonderfunktionen_XIX_Grundumfang_XIX_Klima.DE_ACT407_Sonderfunktionen, system-signal=ACT407_Sonderfunktionen
        communication-direction=IN, data-element=Grundumfang_XIX_Klima.Geltungsbereich_E3_1_1_UNECE_Gen2.RP_IF_ACT407_Spulenbestromung_XIX_Grundumfang_XIX_Klima.DE_ACT407_Spulenbestromung, system-signal=ACT407_Spulenbestromung
        communication-direction=IN, data-element=Grundumfang_XIX_Klima.Geltungsbereich_E3_1_1_UNECE_Gen2.RP_IF_ACT407_Stopmodus_XIX_Grundumfang_XIX_Klima.DE_ACT407_Stopmodus, system-signal=ACT407_Stopmodus
        communication-direction=IN, data-element=Grundumfang_XIX_Klima.Geltungsbereich_E3_1_1_UNECE_Gen2.RP_IF_ACT407_Uebertemperatur_XIX_Grundumfang_XIX_Klima.DE_ACT407_Uebertemperatur, system-signal=ACT407_Uebertemperatur
        communication-direction=IN, data-element=Grundumfang_XIX_Klima.Geltungsbereich_E3_1_1_UNECE_Gen2.RP_IF_ACT407_Variante_XIX_Grundumfang_XIX_Klima.DE_ACT407_Variante, system-signal=ACT407_Variante
        communication-direction=IN, data-element=Grundumfang_XIX_Klima.Geltungsbereich_E3_1_1_UNECE_Gen2.RP_IF_ACT407_Verfahrrichtung_XIX_Grundumfang_XIX_Klima.DE_ACT407_Verfahrrichtung, system-signal=ACT407_Verfahrrichtung
        communication-direction=IN, data-element=Grundumfang_XIX_Klima.Geltungsbereich_E3_1_1_UNECE_Gen2.RP_IF_ACT407_Versorgungsspannung_XIX_Grundumfang_XIX_Klima.DE_ACT407_Versorgungsspannung, system-signal=ACT407_Versorgungsspannung
        communication-direction=IN, data-element=Grundumfang_XIX_Klima.Geltungsbereich_E3_1_1_UNECE_Gen2.RP_IF_ACT408_Adresse_Aktuator_XIX_Grundumfang_XIX_Klima.DE_ACT408_Adresse_Aktuator, system-signal=ACT408_Adresse_Aktuator
        communication-direction=IN, data-element=Grundumfang_XIX_Klima.Geltungsbereich_E3_1_1_UNECE_Gen2.RP_IF_ACT408_Blockierung_aufgetreten_XIX_Grundumfang_XIX_Klima.DE_ACT408_Blockierung_aufgetreten, system-signal=ACT408_Blockierung_aufgetreten
        communication-direction=IN, data-element=Grundumfang_XIX_Klima.Geltungsbereich_E3_1_1_UNECE_Gen2.RP_IF_ACT408_Drehrichtung_XIX_Grundumfang_XIX_Klima.DE_ACT408_Drehrichtung, system-signal=ACT408_Drehrichtung
        communication-direction=IN, data-element=Grundumfang_XIX_Klima.Geltungsbereich_E3_1_1_UNECE_Gen2.RP_IF_ACT408_Elektr_Defekt_XIX_Grundumfang_XIX_Klima.DE_ACT408_Elektr_Defekt, system-signal=ACT408_Elektr_Defekt
        communication-direction=IN, data-element=Grundumfang_XIX_Klima.Geltungsbereich_E3_1_1_UNECE_Gen2.RP_IF_ACT408_Freigabe_Blockiererkennung_XIX_Grundumfang_XIX_Klima.DE_ACT408_Freigabe_Blockiererkennung, system-signal=ACT408_Freigabe_Blockiererkennung
        communication-direction=IN, data-element=Grundumfang_XIX_Klima.Geltungsbereich_E3_1_1_UNECE_Gen2.RP_IF_ACT408_Geschwindigkeitsstatus_XIX_Grundumfang_XIX_Klima.DE_ACT408_Geschwindigkeitsstatus, system-signal=ACT408_Geschwindigkeitsstatus
        communication-direction=IN, data-element=Grundumfang_XIX_Klima.Geltungsbereich_E3_1_1_UNECE_Gen2.RP_IF_ACT408_Ist_Position_Aktuator_XIX_Grundumfang_XIX_Klima.DE_ACT408_Ist_Position_Aktuator, system-signal=ACT408_Ist_Position_Aktuator
        communication-direction=IN, data-element=Grundumfang_XIX_Klima.Geltungsbereich_E3_1_1_UNECE_Gen2.RP_IF_ACT408_Notlauf_aufgetreten_XIX_Grundumfang_XIX_Klima.DE_ACT408_Notlauf_aufgetreten, system-signal=ACT408_Notlauf_aufgetreten
        communication-direction=IN, data-element=Grundumfang_XIX_Klima.Geltungsbereich_E3_1_1_UNECE_Gen2.RP_IF_ACT408_Notlauffreigabe_XIX_Grundumfang_XIX_Klima.DE_ACT408_Notlauffreigabe, system-signal=ACT408_Notlauffreigabe
        communication-direction=IN, data-element=Grundumfang_XIX_Klima.Geltungsbereich_E3_1_1_UNECE_Gen2.RP_IF_ACT408_Notlaufposition_XIX_Grundumfang_XIX_Klima.DE_ACT408_Notlaufposition, system-signal=ACT408_Notlaufposition
        communication-direction=IN, data-element=Grundumfang_XIX_Klima.Geltungsbereich_E3_1_1_UNECE_Gen2.RP_IF_ACT408_Positionsvorgabe_Status_XIX_Grundumfang_XIX_Klima.DE_ACT408_Positionsvorgabe_Status, system-signal=ACT408_Positionsvorgabe_Status
        communication-direction=IN, data-element=Grundumfang_XIX_Klima.Geltungsbereich_E3_1_1_UNECE_Gen2.RP_IF_ACT408_Reset_XIX_Grundumfang_XIX_Klima.DE_ACT408_Reset, system-signal=ACT408_Reset
        communication-direction=IN, data-element=Grundumfang_XIX_Klima.Geltungsbereich_E3_1_1_UNECE_Gen2.RP_IF_ACT408_ResponseError_XIX_Grundumfang_XIX_Klima.DE_ACT408_ResponseError, system-signal=ACT408_ResponseError
        communication-direction=IN, data-element=Grundumfang_XIX_Klima.Geltungsbereich_E3_1_1_UNECE_Gen2.RP_IF_ACT408_Selbsthaltemoment_XIX_Grundumfang_XIX_Klima.DE_ACT408_Selbsthaltemoment, system-signal=ACT408_Selbsthaltemoment
        communication-direction=IN, data-element=Grundumfang_XIX_Klima.Geltungsbereich_E3_1_1_UNECE_Gen2.RP_IF_ACT408_Sonderfunktionen_XIX_Grundumfang_XIX_Klima.DE_ACT408_Sonderfunktionen, system-signal=ACT408_Sonderfunktionen
        communication-direction=IN, data-element=Grundumfang_XIX_Klima.Geltungsbereich_E3_1_1_UNECE_Gen2.RP_IF_ACT408_Spulenbestromung_XIX_Grundumfang_XIX_Klima.DE_ACT408_Spulenbestromung, system-signal=ACT408_Spulenbestromung
        communication-direction=IN, data-element=Grundumfang_XIX_Klima.Geltungsbereich_E3_1_1_UNECE_Gen2.RP_IF_ACT408_Stopmodus_XIX_Grundumfang_XIX_Klima.DE_ACT408_Stopmodus, system-signal=ACT408_Stopmodus
        communication-direction=IN, data-element=Grundumfang_XIX_Klima.Geltungsbereich_E3_1_1_UNECE_Gen2.RP_IF_ACT408_Uebertemperatur_XIX_Grundumfang_XIX_Klima.DE_ACT408_Uebertemperatur, system-signal=ACT408_Uebertemperatur
        communication-direction=IN, data-element=Grundumfang_XIX_Klima.Geltungsbereich_E3_1_1_UNECE_Gen2.RP_IF_ACT408_Variante_XIX_Grundumfang_XIX_Klima.DE_ACT408_Variante, system-signal=ACT408_Variante
        communication-direction=IN, data-element=Grundumfang_XIX_Klima.Geltungsbereich_E3_1_1_UNECE_Gen2.RP_IF_ACT408_Verfahrrichtung_XIX_Grundumfang_XIX_Klima.DE_ACT408_Verfahrrichtung, system-signal=ACT408_Verfahrrichtung
        communication-direction=IN, data-element=Grundumfang_XIX_Klima.Geltungsbereich_E3_1_1_UNECE_Gen2.RP_IF_ACT408_Versorgungsspannung_XIX_Grundumfang_XIX_Klima.DE_ACT408_Versorgungsspannung, system-signal=ACT408_Versorgungsspannung
        communication-direction=IN, data-element=Grundumfang_XIX_Klima.Geltungsbereich_E3_1_1_UNECE_Gen2.RP_IF_ACT409_Adresse_Aktuator_XIX_Grundumfang_XIX_Klima.DE_ACT409_Adresse_Aktuator, system-signal=ACT409_Adresse_Aktuator
        communication-direction=IN, data-element=Grundumfang_XIX_Klima.Geltungsbereich_E3_1_1_UNECE_Gen2.RP_IF_ACT409_Blockierung_aufgetreten_XIX_Grundumfang_XIX_Klima.DE_ACT409_Blockierung_aufgetreten, system-signal=ACT409_Blockierung_aufgetreten
        communication-direction=IN, data-element=Grundumfang_XIX_Klima.Geltungsbereich_E3_1_1_UNECE_Gen2.RP_IF_ACT409_Drehrichtung_XIX_Grundumfang_XIX_Klima.DE_ACT409_Drehrichtung, system-signal=ACT409_Drehrichtung
        communication-direction=IN, data-element=Grundumfang_XIX_Klima.Geltungsbereich_E3_1_1_UNECE_Gen2.RP_IF_ACT409_Elektr_Defekt_XIX_Grundumfang_XIX_Klima.DE_ACT409_Elektr_Defekt, system-signal=ACT409_Elektr_Defekt
        communication-direction=IN, data-element=Grundumfang_XIX_Klima.Geltungsbereich_E3_1_1_UNECE_Gen2.RP_IF_ACT409_Freigabe_Blockiererkennung_XIX_Grundumfang_XIX_Klima.DE_ACT409_Freigabe_Blockiererkennung, system-signal=ACT409_Freigabe_Blockiererkennung
        communication-direction=IN, data-element=Grundumfang_XIX_Klima.Geltungsbereich_E3_1_1_UNECE_Gen2.RP_IF_ACT409_Geschwindigkeitsstatus_XIX_Grundumfang_XIX_Klima.DE_ACT409_Geschwindigkeitsstatus, system-signal=ACT409_Geschwindigkeitsstatus
        communication-direction=IN, data-element=Grundumfang_XIX_Klima.Geltungsbereich_E3_1_1_UNECE_Gen2.RP_IF_ACT409_Ist_Position_Aktuator_XIX_Grundumfang_XIX_Klima.DE_ACT409_Ist_Position_Aktuator, system-signal=ACT409_Ist_Position_Aktuator
        communication-direction=IN, data-element=Grundumfang_XIX_Klima.Geltungsbereich_E3_1_1_UNECE_Gen2.RP_IF_ACT409_Notlauf_aufgetreten_XIX_Grundumfang_XIX_Klima.DE_ACT409_Notlauf_aufgetreten, system-signal=ACT409_Notlauf_aufgetreten
        communication-direction=IN, data-element=Grundumfang_XIX_Klima.Geltungsbereich_E3_1_1_UNECE_Gen2.RP_IF_ACT409_Notlauffreigabe_XIX_Grundumfang_XIX_Klima.DE_ACT409_Notlauffreigabe, system-signal=ACT409_Notlauffreigabe
        communication-direction=IN, data-element=Grundumfang_XIX_Klima.Geltungsbereich_E3_1_1_UNECE_Gen2.RP_IF_ACT409_Notlaufposition_XIX_Grundumfang_XIX_Klima.DE_ACT409_Notlaufposition, system-signal=ACT409_Notlaufposition
        communication-direction=IN, data-element=Grundumfang_XIX_Klima.Geltungsbereich_E3_1_1_UNECE_Gen2.RP_IF_ACT409_Positionsvorgabe_Status_XIX_Grundumfang_XIX_Klima.DE_ACT409_Positionsvorgabe_Status, system-signal=ACT409_Positionsvorgabe_Status
        communication-direction=IN, data-element=Grundumfang_XIX_Klima.Geltungsbereich_E3_1_1_UNECE_Gen2.RP_IF_ACT409_Reset_XIX_Grundumfang_XIX_Klima.DE_ACT409_Reset, system-signal=ACT409_Reset
        communication-direction=IN, data-element=Grundumfang_XIX_Klima.Geltungsbereich_E3_1_1_UNECE_Gen2.RP_IF_ACT409_ResponseError_XIX_Grundumfang_XIX_Klima.DE_ACT409_ResponseError, system-signal=ACT409_ResponseError
        communication-direction=IN, data-element=Grundumfang_XIX_Klima.Geltungsbereich_E3_1_1_UNECE_Gen2.RP_IF_ACT409_Selbsthaltemoment_XIX_Grundumfang_XIX_Klima.DE_ACT409_Selbsthaltemoment, system-signal=ACT409_Selbsthaltemoment
        communication-direction=IN, data-element=Grundumfang_XIX_Klima.Geltungsbereich_E3_1_1_UNECE_Gen2.RP_IF_ACT409_Sonderfunktionen_XIX_Grundumfang_XIX_Klima.DE_ACT409_Sonderfunktionen, system-signal=ACT409_Sonderfunktionen
        communication-direction=IN, data-element=Grundumfang_XIX_Klima.Geltungsbereich_E3_1_1_UNECE_Gen2.RP_IF_ACT409_Spulenbestromung_XIX_Grundumfang_XIX_Klima.DE_ACT409_Spulenbestromung, system-signal=ACT409_Spulenbestromung
        communication-direction=IN, data-element=Grundumfang_XIX_Klima.Geltungsbereich_E3_1_1_UNECE_Gen2.RP_IF_ACT409_Stopmodus_XIX_Grundumfang_XIX_Klima.DE_ACT409_Stopmodus, system-signal=ACT409_Stopmodus
        communication-direction=IN, data-element=Grundumfang_XIX_Klima.Geltungsbereich_E3_1_1_UNECE_Gen2.RP_IF_ACT409_Uebertemperatur_XIX_Grundumfang_XIX_Klima.DE_ACT409_Uebertemperatur, system-signal=ACT409_Uebertemperatur
        communication-direction=IN, data-element=Grundumfang_XIX_Klima.Geltungsbereich_E3_1_1_UNECE_Gen2.RP_IF_ACT409_Variante_XIX_Grundumfang_XIX_Klima.DE_ACT409_Variante, system-signal=ACT409_Variante
        communication-direction=IN, data-element=Grundumfang_XIX_Klima.Geltungsbereich_E3_1_1_UNECE_Gen2.RP_IF_ACT409_Verfahrrichtung_XIX_Grundumfang_XIX_Klima.DE_ACT409_Verfahrrichtung, system-signal=ACT409_Verfahrrichtung
        communication-direction=IN, data-element=Grundumfang_XIX_Klima.Geltungsbereich_E3_1_1_UNECE_Gen2.RP_IF_ACT409_Versorgungsspannung_XIX_Grundumfang_XIX_Klima.DE_ACT409_Versorgungsspannung, system-signal=ACT409_Versorgungsspannung
        communication-direction=IN, data-element=Grundumfang_XIX_Klima.Geltungsbereich_E3_1_1_UNECE_Gen2.RP_IF_ACT410_Adresse_Aktuator_XIX_Grundumfang_XIX_Klima.DE_ACT410_Adresse_Aktuator, system-signal=ACT410_Adresse_Aktuator
        communication-direction=IN, data-element=Grundumfang_XIX_Klima.Geltungsbereich_E3_1_1_UNECE_Gen2.RP_IF_ACT410_Blockierung_aufgetreten_XIX_Grundumfang_XIX_Klima.DE_ACT410_Blockierung_aufgetreten, system-signal=ACT410_Blockierung_aufgetreten
        communication-direction=IN, data-element=Grundumfang_XIX_Klima.Geltungsbereich_E3_1_1_UNECE_Gen2.RP_IF_ACT410_Drehrichtung_XIX_Grundumfang_XIX_Klima.DE_ACT410_Drehrichtung, system-signal=ACT410_Drehrichtung
        communication-direction=IN, data-element=Grundumfang_XIX_Klima.Geltungsbereich_E3_1_1_UNECE_Gen2.RP_IF_ACT410_Elektr_Defekt_XIX_Grundumfang_XIX_Klima.DE_ACT410_Elektr_Defekt, system-signal=ACT410_Elektr_Defekt
        communication-direction=IN, data-element=Grundumfang_XIX_Klima.Geltungsbereich_E3_1_1_UNECE_Gen2.RP_IF_ACT410_Freigabe_Blockiererkennung_XIX_Grundumfang_XIX_Klima.DE_ACT410_Freigabe_Blockiererkennung, system-signal=ACT410_Freigabe_Blockiererkennung
        communication-direction=IN, data-element=Grundumfang_XIX_Klima.Geltungsbereich_E3_1_1_UNECE_Gen2.RP_IF_ACT410_Geschwindigkeitsstatus_XIX_Grundumfang_XIX_Klima.DE_ACT410_Geschwindigkeitsstatus, system-signal=ACT410_Geschwindigkeitsstatus
        communication-direction=IN, data-element=Grundumfang_XIX_Klima.Geltungsbereich_E3_1_1_UNECE_Gen2.RP_IF_ACT410_Ist_Position_Aktuator_XIX_Grundumfang_XIX_Klima.DE_ACT410_Ist_Position_Aktuator, system-signal=ACT410_Ist_Position_Aktuator
        communication-direction=IN, data-element=Grundumfang_XIX_Klima.Geltungsbereich_E3_1_1_UNECE_Gen2.RP_IF_ACT410_Notlauf_aufgetreten_XIX_Grundumfang_XIX_Klima.DE_ACT410_Notlauf_aufgetreten, system-signal=ACT410_Notlauf_aufgetreten
        communication-direction=IN, data-element=Grundumfang_XIX_Klima.Geltungsbereich_E3_1_1_UNECE_Gen2.RP_IF_ACT410_Notlauffreigabe_XIX_Grundumfang_XIX_Klima.DE_ACT410_Notlauffreigabe, system-signal=ACT410_Notlauffreigabe
        communication-direction=IN, data-element=Grundumfang_XIX_Klima.Geltungsbereich_E3_1_1_UNECE_Gen2.RP_IF_ACT410_Notlaufposition_XIX_Grundumfang_XIX_Klima.DE_ACT410_Notlaufposition, system-signal=ACT410_Notlaufposition
        communication-direction=IN, data-element=Grundumfang_XIX_Klima.Geltungsbereich_E3_1_1_UNECE_Gen2.RP_IF_ACT410_Positionsvorgabe_Status_XIX_Grundumfang_XIX_Klima.DE_ACT410_Positionsvorgabe_Status, system-signal=ACT410_Positionsvorgabe_Status
        communication-direction=IN, data-element=Grundumfang_XIX_Klima.Geltungsbereich_E3_1_1_UNECE_Gen2.RP_IF_ACT410_Reset_XIX_Grundumfang_XIX_Klima.DE_ACT410_Reset, system-signal=ACT410_Reset
        communication-direction=IN, data-element=Grundumfang_XIX_Klima.Geltungsbereich_E3_1_1_UNECE_Gen2.RP_IF_ACT410_ResponseError_XIX_Grundumfang_XIX_Klima.DE_ACT410_ResponseError, system-signal=ACT410_ResponseError
        communication-direction=IN, data-element=Grundumfang_XIX_Klima.Geltungsbereich_E3_1_1_UNECE_Gen2.RP_IF_ACT410_Selbsthaltemoment_XIX_Grundumfang_XIX_Klima.DE_ACT410_Selbsthaltemoment, system-signal=ACT410_Selbsthaltemoment
        communication-direction=IN, data-element=Grundumfang_XIX_Klima.Geltungsbereich_E3_1_1_UNECE_Gen2.RP_IF_ACT410_Sonderfunktionen_XIX_Grundumfang_XIX_Klima.DE_ACT410_Sonderfunktionen, system-signal=ACT410_Sonderfunktionen
        communication-direction=IN, data-element=Grundumfang_XIX_Klima.Geltungsbereich_E3_1_1_UNECE_Gen2.RP_IF_ACT410_Spulenbestromung_XIX_Grundumfang_XIX_Klima.DE_ACT410_Spulenbestromung, system-signal=ACT410_Spulenbestromung
        communication-direction=IN, data-element=Grundumfang_XIX_Klima.Geltungsbereich_E3_1_1_UNECE_Gen2.RP_IF_ACT410_Stopmodus_XIX_Grundumfang_XIX_Klima.DE_ACT410_Stopmodus, system-signal=ACT410_Stopmodus
        communication-direction=IN, data-element=Grundumfang_XIX_Klima.Geltungsbereich_E3_1_1_UNECE_Gen2.RP_IF_ACT410_Uebertemperatur_XIX_Grundumfang_XIX_Klima.DE_ACT410_Uebertemperatur, system-signal=ACT410_Uebertemperatur
        communication-direction=IN, data-element=Grundumfang_XIX_Klima.Geltungsbereich_E3_1_1_UNECE_Gen2.RP_IF_ACT410_Variante_XIX_Grundumfang_XIX_Klima.DE_ACT410_Variante, system-signal=ACT410_Variante
        communication-direction=IN, data-element=Grundumfang_XIX_Klima.Geltungsbereich_E3_1_1_UNECE_Gen2.RP_IF_ACT410_Verfahrrichtung_XIX_Grundumfang_XIX_Klima.DE_ACT410_Verfahrrichtung, system-signal=ACT410_Verfahrrichtung
        communication-direction=IN, data-element=Grundumfang_XIX_Klima.Geltungsbereich_E3_1_1_UNECE_Gen2.RP_IF_ACT410_Versorgungsspannung_XIX_Grundumfang_XIX_Klima.DE_ACT410_Versorgungsspannung, system-signal=ACT410_Versorgungsspannung
        communication-direction=IN, data-element=Grundumfang_XIX_Klima.Geltungsbereich_E3_1_1_UNECE_Gen2.RP_IF_ACT411_Adresse_Aktuator_XIX_Grundumfang_XIX_Klima.DE_ACT411_Adresse_Aktuator, system-signal=ACT411_Adresse_Aktuator
        communication-direction=IN, data-element=Grundumfang_XIX_Klima.Geltungsbereich_E3_1_1_UNECE_Gen2.RP_IF_ACT411_Blockierung_aufgetreten_XIX_Grundumfang_XIX_Klima.DE_ACT411_Blockierung_aufgetreten, system-signal=ACT411_Blockierung_aufgetreten
        communication-direction=IN, data-element=Grundumfang_XIX_Klima.Geltungsbereich_E3_1_1_UNECE_Gen2.RP_IF_ACT411_Drehrichtung_XIX_Grundumfang_XIX_Klima.DE_ACT411_Drehrichtung, system-signal=ACT411_Drehrichtung
        communication-direction=IN, data-element=Grundumfang_XIX_Klima.Geltungsbereich_E3_1_1_UNECE_Gen2.RP_IF_ACT411_Elektr_Defekt_XIX_Grundumfang_XIX_Klima.DE_ACT411_Elektr_Defekt, system-signal=ACT411_Elektr_Defekt
        communication-direction=IN, data-element=Grundumfang_XIX_Klima.Geltungsbereich_E3_1_1_UNECE_Gen2.RP_IF_ACT411_Freigabe_Blockiererkennung_XIX_Grundumfang_XIX_Klima.DE_ACT411_Freigabe_Blockiererkennung, system-signal=ACT411_Freigabe_Blockiererkennung
        communication-direction=IN, data-element=Grundumfang_XIX_Klima.Geltungsbereich_E3_1_1_UNECE_Gen2.RP_IF_ACT411_Geschwindigkeitsstatus_XIX_Grundumfang_XIX_Klima.DE_ACT411_Geschwindigkeitsstatus, system-signal=ACT411_Geschwindigkeitsstatus
        communication-direction=IN, data-element=Grundumfang_XIX_Klima.Geltungsbereich_E3_1_1_UNECE_Gen2.RP_IF_ACT411_Ist_Position_Aktuator_XIX_Grundumfang_XIX_Klima.DE_ACT411_Ist_Position_Aktuator, system-signal=ACT411_Ist_Position_Aktuator
        communication-direction=IN, data-element=Grundumfang_XIX_Klima.Geltungsbereich_E3_1_1_UNECE_Gen2.RP_IF_ACT411_Notlauf_aufgetreten_XIX_Grundumfang_XIX_Klima.DE_ACT411_Notlauf_aufgetreten, system-signal=ACT411_Notlauf_aufgetreten
        communication-direction=IN, data-element=Grundumfang_XIX_Klima.Geltungsbereich_E3_1_1_UNECE_Gen2.RP_IF_ACT411_Notlauffreigabe_XIX_Grundumfang_XIX_Klima.DE_ACT411_Notlauffreigabe, system-signal=ACT411_Notlauffreigabe
        communication-direction=IN, data-element=Grundumfang_XIX_Klima.Geltungsbereich_E3_1_1_UNECE_Gen2.RP_IF_ACT411_Notlaufposition_XIX_Grundumfang_XIX_Klima.DE_ACT411_Notlaufposition, system-signal=ACT411_Notlaufposition
        communication-direction=IN, data-element=Grundumfang_XIX_Klima.Geltungsbereich_E3_1_1_UNECE_Gen2.RP_IF_ACT411_Positionsvorgabe_Status_XIX_Grundumfang_XIX_Klima.DE_ACT411_Positionsvorgabe_Status, system-signal=ACT411_Positionsvorgabe_Status
        communication-direction=IN, data-element=Grundumfang_XIX_Klima.Geltungsbereich_E3_1_1_UNECE_Gen2.RP_IF_ACT411_Reset_XIX_Grundumfang_XIX_Klima.DE_ACT411_Reset, system-signal=ACT411_Reset
        communication-direction=IN, data-element=Grundumfang_XIX_Klima.Geltungsbereich_E3_1_1_UNECE_Gen2.RP_IF_ACT411_ResponseError_XIX_Grundumfang_XIX_Klima.DE_ACT411_ResponseError, system-signal=ACT411_ResponseError
        communication-direction=IN, data-element=Grundumfang_XIX_Klima.Geltungsbereich_E3_1_1_UNECE_Gen2.RP_IF_ACT411_Selbsthaltemoment_XIX_Grundumfang_XIX_Klima.DE_ACT411_Selbsthaltemoment, system-signal=ACT411_Selbsthaltemoment
        communication-direction=IN, data-element=Grundumfang_XIX_Klima.Geltungsbereich_E3_1_1_UNECE_Gen2.RP_IF_ACT411_Sonderfunktionen_XIX_Grundumfang_XIX_Klima.DE_ACT411_Sonderfunktionen, system-signal=ACT411_Sonderfunktionen
        communication-direction=IN, data-element=Grundumfang_XIX_Klima.Geltungsbereich_E3_1_1_UNECE_Gen2.RP_IF_ACT411_Spulenbestromung_XIX_Grundumfang_XIX_Klima.DE_ACT411_Spulenbestromung, system-signal=ACT411_Spulenbestromung
        communication-direction=IN, data-element=Grundumfang_XIX_Klima.Geltungsbereich_E3_1_1_UNECE_Gen2.RP_IF_ACT411_Stopmodus_XIX_Grundumfang_XIX_Klima.DE_ACT411_Stopmodus, system-signal=ACT411_Stopmodus
        communication-direction=IN, data-element=Grundumfang_XIX_Klima.Geltungsbereich_E3_1_1_UNECE_Gen2.RP_IF_ACT411_Uebertemperatur_XIX_Grundumfang_XIX_Klima.DE_ACT411_Uebertemperatur, system-signal=ACT411_Uebertemperatur
        communication-direction=IN, data-element=Grundumfang_XIX_Klima.Geltungsbereich_E3_1_1_UNECE_Gen2.RP_IF_ACT411_Variante_XIX_Grundumfang_XIX_Klima.DE_ACT411_Variante, system-signal=ACT411_Variante
        communication-direction=IN, data-element=Grundumfang_XIX_Klima.Geltungsbereich_E3_1_1_UNECE_Gen2.RP_IF_ACT411_Verfahrrichtung_XIX_Grundumfang_XIX_Klima.DE_ACT411_Verfahrrichtung, system-signal=ACT411_Verfahrrichtung
        communication-direction=IN, data-element=Grundumfang_XIX_Klima.Geltungsbereich_E3_1_1_UNECE_Gen2.RP_IF_ACT411_Versorgungsspannung_XIX_Grundumfang_XIX_Klima.DE_ACT411_Versorgungsspannung, system-signal=ACT411_Versorgungsspannung
        communication-direction=IN, data-element=Grundumfang_XIX_Klima.Geltungsbereich_E3_1_1_UNECE_Gen2.RP_IF_ACT412_Adresse_Aktuator_XIX_Grundumfang_XIX_Klima.DE_ACT412_Adresse_Aktuator, system-signal=ACT412_Adresse_Aktuator
        communication-direction=IN, data-element=Grundumfang_XIX_Klima.Geltungsbereich_E3_1_1_UNECE_Gen2.RP_IF_ACT412_Blockierung_aufgetreten_XIX_Grundumfang_XIX_Klima.DE_ACT412_Blockierung_aufgetreten, system-signal=ACT412_Blockierung_aufgetreten
        communication-direction=IN, data-element=Grundumfang_XIX_Klima.Geltungsbereich_E3_1_1_UNECE_Gen2.RP_IF_ACT412_Drehrichtung_XIX_Grundumfang_XIX_Klima.DE_ACT412_Drehrichtung, system-signal=ACT412_Drehrichtung
        communication-direction=IN, data-element=Grundumfang_XIX_Klima.Geltungsbereich_E3_1_1_UNECE_Gen2.RP_IF_ACT412_Elektr_Defekt_XIX_Grundumfang_XIX_Klima.DE_ACT412_Elektr_Defekt, system-signal=ACT412_Elektr_Defekt
        communication-direction=IN, data-element=Grundumfang_XIX_Klima.Geltungsbereich_E3_1_1_UNECE_Gen2.RP_IF_ACT412_Freigabe_Blockiererkennung_XIX_Grundumfang_XIX_Klima.DE_ACT412_Freigabe_Blockiererkennung, system-signal=ACT412_Freigabe_Blockiererkennung
        communication-direction=IN, data-element=Grundumfang_XIX_Klima.Geltungsbereich_E3_1_1_UNECE_Gen2.RP_IF_ACT412_Geschwindigkeitsstatus_XIX_Grundumfang_XIX_Klima.DE_ACT412_Geschwindigkeitsstatus, system-signal=ACT412_Geschwindigkeitsstatus
        communication-direction=IN, data-element=Grundumfang_XIX_Klima.Geltungsbereich_E3_1_1_UNECE_Gen2.RP_IF_ACT412_Ist_Position_Aktuator_XIX_Grundumfang_XIX_Klima.DE_ACT412_Ist_Position_Aktuator, system-signal=ACT412_Ist_Position_Aktuator
        communication-direction=IN, data-element=Grundumfang_XIX_Klima.Geltungsbereich_E3_1_1_UNECE_Gen2.RP_IF_ACT412_Notlauf_aufgetreten_XIX_Grundumfang_XIX_Klima.DE_ACT412_Notlauf_aufgetreten, system-signal=ACT412_Notlauf_aufgetreten
        communication-direction=IN, data-element=Grundumfang_XIX_Klima.Geltungsbereich_E3_1_1_UNECE_Gen2.RP_IF_ACT412_Notlauffreigabe_XIX_Grundumfang_XIX_Klima.DE_ACT412_Notlauffreigabe, system-signal=ACT412_Notlauffreigabe
        communication-direction=IN, data-element=Grundumfang_XIX_Klima.Geltungsbereich_E3_1_1_UNECE_Gen2.RP_IF_ACT412_Notlaufposition_XIX_Grundumfang_XIX_Klima.DE_ACT412_Notlaufposition, system-signal=ACT412_Notlaufposition
        communication-direction=IN, data-element=Grundumfang_XIX_Klima.Geltungsbereich_E3_1_1_UNECE_Gen2.RP_IF_ACT412_Positionsvorgabe_Status_XIX_Grundumfang_XIX_Klima.DE_ACT412_Positionsvorgabe_Status, system-signal=ACT412_Positionsvorgabe_Status
        communication-direction=IN, data-element=Grundumfang_XIX_Klima.Geltungsbereich_E3_1_1_UNECE_Gen2.RP_IF_ACT412_Reset_XIX_Grundumfang_XIX_Klima.DE_ACT412_Reset, system-signal=ACT412_Reset
        communication-direction=IN, data-element=Grundumfang_XIX_Klima.Geltungsbereich_E3_1_1_UNECE_Gen2.RP_IF_ACT412_ResponseError_XIX_Grundumfang_XIX_Klima.DE_ACT412_ResponseError, system-signal=ACT412_ResponseError
        communication-direction=IN, data-element=Grundumfang_XIX_Klima.Geltungsbereich_E3_1_1_UNECE_Gen2.RP_IF_ACT412_Selbsthaltemoment_XIX_Grundumfang_XIX_Klima.DE_ACT412_Selbsthaltemoment, system-signal=ACT412_Selbsthaltemoment
        communication-direction=IN, data-element=Grundumfang_XIX_Klima.Geltungsbereich_E3_1_1_UNECE_Gen2.RP_IF_ACT412_Sonderfunktionen_XIX_Grundumfang_XIX_Klima.DE_ACT412_Sonderfunktionen, system-signal=ACT412_Sonderfunktionen
        communication-direction=IN, data-element=Grundumfang_XIX_Klima.Geltungsbereich_E3_1_1_UNECE_Gen2.RP_IF_ACT412_Spulenbestromung_XIX_Grundumfang_XIX_Klima.DE_ACT412_Spulenbestromung, system-signal=ACT412_Spulenbestromung
        communication-direction=IN, data-element=Grundumfang_XIX_Klima.Geltungsbereich_E3_1_1_UNECE_Gen2.RP_IF_ACT412_Stopmodus_XIX_Grundumfang_XIX_Klima.DE_ACT412_Stopmodus, system-signal=ACT412_Stopmodus
        communication-direction=IN, data-element=Grundumfang_XIX_Klima.Geltungsbereich_E3_1_1_UNECE_Gen2.RP_IF_ACT412_Uebertemperatur_XIX_Grundumfang_XIX_Klima.DE_ACT412_Uebertemperatur, system-signal=ACT412_Uebertemperatur
        communication-direction=IN, data-element=Grundumfang_XIX_Klima.Geltungsbereich_E3_1_1_UNECE_Gen2.RP_IF_ACT412_Variante_XIX_Grundumfang_XIX_Klima.DE_ACT412_Variante, system-signal=ACT412_Variante
        communication-direction=IN, data-element=Grundumfang_XIX_Klima.Geltungsbereich_E3_1_1_UNECE_Gen2.RP_IF_ACT412_Verfahrrichtung_XIX_Grundumfang_XIX_Klima.DE_ACT412_Verfahrrichtung, system-signal=ACT412_Verfahrrichtung
        communication-direction=IN, data-element=Grundumfang_XIX_Klima.Geltungsbereich_E3_1_1_UNECE_Gen2.RP_IF_ACT412_Versorgungsspannung_XIX_Grundumfang_XIX_Klima.DE_ACT412_Versorgungsspannung, system-signal=ACT412_Versorgungsspannung
        communication-direction=OUT, data-element=Grundumfang_XIX_Klima.Geltungsbereich_E3_1_1_UNECE_Gen2.SP_IF_Adresse_ION_XIX_Grundumfang_XIX_Klima.DE_Adresse_ION, system-signal=Adresse_ION
        communication-direction=OUT, data-element=Grundumfang_XIX_Klima.Geltungsbereich_E3_1_1_UNECE_Gen2.SP_IF_Adresse_PCU_XIX_Grundumfang_XIX_Klima.DE_Adresse_PCU, system-signal=Adresse_PCU
        communication-direction=OUT, data-element=Grundumfang_XIX_Klima.Geltungsbereich_E3_1_1_UNECE_Gen2.SP_IF_Adressegment_ION_XIX_Grundumfang_XIX_Klima.DE_Adressegment_ION, system-signal=Adressegment_ION
        communication-direction=OUT, data-element=Grundumfang_XIX_Klima.Geltungsbereich_E3_1_1_UNECE_Gen2.SP_IF_Anlernen_LLR_li_XIX_Grundumfang_XIX_Klima.DE_Anlernen_LLR_li, system-signal=Anlernen_LLR_li
        communication-direction=OUT, data-element=Grundumfang_XIX_Klima.Geltungsbereich_E3_1_1_UNECE_Gen2.SP_IF_Anlernen_LLR_re_XIX_Grundumfang_XIX_Klima.DE_Anlernen_LLR_re, system-signal=Anlernen_LLR_re
        communication-direction=IN, data-element=Grundumfang_XIX_Klima.Geltungsbereich_E3_1_1_UNECE_Gen2.RP_IF_AQS_COBereich_XIX_Grundumfang_XIX_Klima.DE_AQS_COBereich, system-signal=AQS_COBereich
        communication-direction=IN, data-element=Grundumfang_XIX_Klima.Geltungsbereich_E3_1_1_UNECE_Gen2.RP_IF_AQS_COStatus_XIX_Grundumfang_XIX_Klima.DE_AQS_COStatus, system-signal=AQS_COStatus
        communication-direction=IN, data-element=Grundumfang_XIX_Klima.Geltungsbereich_E3_1_1_UNECE_Gen2.RP_IF_AQS_COWert_XIX_Grundumfang_XIX_Klima.DE_AQS_COWert, system-signal=AQS_COWert
        communication-direction=IN, data-element=Grundumfang_XIX_Klima.Geltungsbereich_E3_1_1_UNECE_Gen2.RP_IF_AQS_HW_XIX_Grundumfang_XIX_Klima.DE_AQS_HW, system-signal=AQS_HW
        communication-direction=IN, data-element=Grundumfang_XIX_Klima.Geltungsbereich_E3_1_1_UNECE_Gen2.RP_IF_AQS_Luftguete_XIX_Grundumfang_XIX_Klima.DE_AQS_Luftguete, system-signal=AQS_Luftguete
        communication-direction=IN, data-element=Grundumfang_XIX_Klima.Geltungsbereich_E3_1_1_UNECE_Gen2.RP_IF_AQS_NoxBereich_XIX_Grundumfang_XIX_Klima.DE_AQS_NoxBereich, system-signal=AQS_NoxBereich
        communication-direction=IN, data-element=Grundumfang_XIX_Klima.Geltungsbereich_E3_1_1_UNECE_Gen2.RP_IF_AQS_NoxStatus_XIX_Grundumfang_XIX_Klima.DE_AQS_NoxStatus, system-signal=AQS_NoxStatus
        communication-direction=IN, data-element=Grundumfang_XIX_Klima.Geltungsbereich_E3_1_1_UNECE_Gen2.RP_IF_AQS_NoxWert_XIX_Grundumfang_XIX_Klima.DE_AQS_NoxWert, system-signal=AQS_NoxWert
        communication-direction=IN, data-element=Grundumfang_XIX_Klima.Geltungsbereich_E3_1_1_UNECE_Gen2.RP_IF_AQS_Parameter_XIX_Grundumfang_XIX_Klima.DE_AQS_Parameter, system-signal=AQS_Parameter
        communication-direction=IN, data-element=Grundumfang_XIX_Klima.Geltungsbereich_E3_1_1_UNECE_Gen2.RP_IF_AQS_ResponseError_XIX_Grundumfang_XIX_Klima.DE_AQS_ResponseError, system-signal=AQS_ResponseError
        communication-direction=OUT, data-element=Grundumfang_XIX_Klima.Geltungsbereich_E3_1_1_UNECE_Gen2.SP_IF_AQS_Sensorheizung_XIX_Grundumfang_XIX_Klima.DE_AQS_Sensorheizung, system-signal=AQS_Sensorheizung
        communication-direction=IN, data-element=Grundumfang_XIX_Klima.Geltungsbereich_E3_1_1_UNECE_Gen2.RP_IF_AQS_Sensorheizung_Status_XIX_Grundumfang_XIX_Klima.DE_AQS_Sensorheizung_Status, system-signal=AQS_Sensorheizung_Status
        communication-direction=IN, data-element=Grundumfang_XIX_Klima.Geltungsbereich_E3_1_1_UNECE_Gen2.RP_IF_AQS_SW_XIX_Grundumfang_XIX_Klima.DE_AQS_SW, system-signal=AQS_SW
        communication-direction=IN, data-element=Grundumfang_XIX_Klima.Geltungsbereich_E3_1_1_UNECE_Gen2.RP_IF_AQS_Toggle_XIX_Grundumfang_XIX_Klima.DE_AQS_Toggle, system-signal=AQS_Toggle
        communication-direction=IN, data-element=Grundumfang_XIX_Klima.Geltungsbereich_E3_1_1_UNECE_Gen2.RP_IF_AQS_Traffic_XIX_Grundumfang_XIX_Klima.DE_AQS_Traffic, system-signal=AQS_Traffic
        communication-direction=OUT, data-element=Grundumfang_XIX_Klima.Geltungsbereich_E3_1_1_UNECE_Gen2.SP_IF_Aussentemp_ungef_XIX_Grundumfang_XIX_Klima.DE_Aussentemp_ungef, system-signal=Aussentemp_ungef
        communication-direction=IN, data-element=Grundumfang_XIX_Klima.Geltungsbereich_E3_1_1_UNECE_Gen2.RP_IF_BCM1_Aussen_Temp_ungef_XIX_Grundumfang_XIX_Klima.DE_BCM1_Aussen_Temp_ungef, system-signal=BCM1_Aussen_Temp_ungef
        communication-direction=IN, data-element=Grundumfang_XIX_Klima.Geltungsbereich_E3_1_1_UNECE_Gen2.RP_IF_BCM1_FStatus_Aussentemp_ungef_XIX_Grundumfang_XIX_Klima.DE_BCM1_FStatus_Aussentemp_ungef, system-signal=BCM1_FStatus_Aussentemp_ungef
        communication-direction=IN, data-element=Grundumfang_XIX_Klima.Geltungsbereich_E3_1_1_UNECE_Gen2.RP_IF_BCM1_OBD_FStatus_ATemp_XIX_Grundumfang_XIX_Klima.DE_BCM1_OBD_FStatus_ATemp, system-signal=BCM1_OBD_FStatus_ATemp
        communication-direction=IN, data-element=Grundumfang_XIX_Klima.Geltungsbereich_E3_1_1_UNECE_Gen2.RP_IF_BCM1_Rueckfahrlicht_Schalter_XIX_Grundumfang_XIX_Klima.DE_BCM1_Rueckfahrlicht_Schalter, system-signal=BCM1_Rueckfahrlicht_Schalter
        communication-direction=OUT, data-element=Grundumfang_XIX_Klima.Geltungsbereich_E3_1_1_UNECE_Gen2.SP_IF_BCM_Remotestart_Betrieb_XIX_Grundumfang_XIX_Klima.DE_BCM_Remotestart_Betrieb, system-signal=BCM_Remotestart_Betrieb
        communication-direction=IN, data-element=Grundumfang_XIX_Klima.Geltungsbereich_E3_1_1_UNECE_Gen2.RP_IF_BEM_Red_Innengeblaese_XIX_Grundumfang_XIX_Klima.DE_BEM_Red_Innengeblaese, system-signal=BEM_Red_Innengeblaese
        communication-direction=IN, data-element=Grundumfang_XIX_Klima.Geltungsbereich_E3_1_1_UNECE_Gen2.RP_IF_BLOWER1_HW_XIX_Grundumfang_XIX_Klima.DE_BLOWER1_HW, system-signal=BLOWER1_HW
        communication-direction=IN, data-element=Grundumfang_XIX_Klima.Geltungsbereich_E3_1_1_UNECE_Gen2.RP_IF_BLOWER1_IBATT_XIX_Grundumfang_XIX_Klima.DE_BLOWER1_IBATT, system-signal=BLOWER1_IBATT
        communication-direction=OUT, data-element=Grundumfang_XIX_Klima.Geltungsbereich_E3_1_1_UNECE_Gen2.SP_IF_BLOWER1_IMAX_MAX_XIX_Grundumfang_XIX_Klima.DE_BLOWER1_IMAX_MAX, system-signal=BLOWER1_IMAX_MAX
        communication-direction=OUT, data-element=Grundumfang_XIX_Klima.Geltungsbereich_E3_1_1_UNECE_Gen2.SP_IF_BLOWER1_IMAX_MIN_XIX_Grundumfang_XIX_Klima.DE_BLOWER1_IMAX_MIN, system-signal=BLOWER1_IMAX_MIN
        communication-direction=OUT, data-element=Grundumfang_XIX_Klima.Geltungsbereich_E3_1_1_UNECE_Gen2.SP_IF_BLOWER1_RAMP_XIX_Grundumfang_XIX_Klima.DE_BLOWER1_RAMP, system-signal=BLOWER1_RAMP
        communication-direction=IN, data-element=Grundumfang_XIX_Klima.Geltungsbereich_E3_1_1_UNECE_Gen2.RP_IF_BLOWER1_ResponseError_XIX_Grundumfang_XIX_Klima.DE_BLOWER1_ResponseError, system-signal=BLOWER1_ResponseError
        communication-direction=OUT, data-element=Grundumfang_XIX_Klima.Geltungsbereich_E3_1_1_UNECE_Gen2.SP_IF_BLOWER1_RX_FREQUENCY_XIX_Grundumfang_XIX_Klima.DE_BLOWER1_RX_FREQUENCY, system-signal=BLOWER1_RX_FREQUENCY
        communication-direction=OUT, data-element=Grundumfang_XIX_Klima.Geltungsbereich_E3_1_1_UNECE_Gen2.SP_IF_BLOWER1_SAFETY_SPEED_XIX_Grundumfang_XIX_Klima.DE_BLOWER1_SAFETY_SPEED, system-signal=BLOWER1_SAFETY_SPEED
        communication-direction=OUT, data-element=Grundumfang_XIX_Klima.Geltungsbereich_E3_1_1_UNECE_Gen2.SP_IF_BLOWER1_SAFETYRUN_THRESHOLD_XIX_Grundumfang_XIX_Klima.DE_BLOWER1_SAFETYRUN_THRESHOLD, system-signal=BLOWER1_SAFETYRUN_THRESHOLD
        communication-direction=OUT, data-element=Grundumfang_XIX_Klima.Geltungsbereich_E3_1_1_UNECE_Gen2.SP_IF_BLOWER1_SELECT_XIX_Grundumfang_XIX_Klima.DE_BLOWER1_SELECT, system-signal=BLOWER1_SELECT
        communication-direction=OUT, data-element=Grundumfang_XIX_Klima.Geltungsbereich_E3_1_1_UNECE_Gen2.SP_IF_BLOWER1_SPEED_XIX_Grundumfang_XIX_Klima.DE_BLOWER1_SPEED, system-signal=BLOWER1_SPEED
        communication-direction=IN, data-element=Grundumfang_XIX_Klima.Geltungsbereich_E3_1_1_UNECE_Gen2.RP_IF_BLOWER1_STATUS1_XIX_Grundumfang_XIX_Klima.DE_BLOWER1_STATUS1, system-signal=BLOWER1_STATUS1
        communication-direction=IN, data-element=Grundumfang_XIX_Klima.Geltungsbereich_E3_1_1_UNECE_Gen2.RP_IF_BLOWER1_STATUS2_XIX_Grundumfang_XIX_Klima.DE_BLOWER1_STATUS2, system-signal=BLOWER1_STATUS2
        communication-direction=IN, data-element=Grundumfang_XIX_Klima.Geltungsbereich_E3_1_1_UNECE_Gen2.RP_IF_BLOWER1_SUPPLIER_XIX_Grundumfang_XIX_Klima.DE_BLOWER1_SUPPLIER, system-signal=BLOWER1_SUPPLIER
        communication-direction=IN, data-element=Grundumfang_XIX_Klima.Geltungsbereich_E3_1_1_UNECE_Gen2.RP_IF_BLOWER1_SW_XIX_Grundumfang_XIX_Klima.DE_BLOWER1_SW, system-signal=BLOWER1_SW
        communication-direction=IN, data-element=Grundumfang_XIX_Klima.Geltungsbereich_E3_1_1_UNECE_Gen2.RP_IF_BLOWER1_TEMPERATURE_XIX_Grundumfang_XIX_Klima.DE_BLOWER1_TEMPERATURE, system-signal=BLOWER1_TEMPERATURE
        communication-direction=OUT, data-element=Grundumfang_XIX_Klima.Geltungsbereich_E3_1_1_UNECE_Gen2.SP_IF_BLOWER1_U_KNEE_XIX_Grundumfang_XIX_Klima.DE_BLOWER1_U_KNEE, system-signal=BLOWER1_U_KNEE
        communication-direction=IN, data-element=Grundumfang_XIX_Klima.Geltungsbereich_E3_1_1_UNECE_Gen2.RP_IF_BLOWER1_UBATT_XIX_Grundumfang_XIX_Klima.DE_BLOWER1_UBATT, system-signal=BLOWER1_UBATT
        communication-direction=IN, data-element=Grundumfang_XIX_Klima.Geltungsbereich_E3_1_1_UNECE_Gen2.RP_IF_BLOWER1_UMOTOR_XIX_Grundumfang_XIX_Klima.DE_BLOWER1_UMOTOR, system-signal=BLOWER1_UMOTOR
        communication-direction=IN, data-element=Grundumfang_XIX_Klima.Geltungsbereich_E3_1_1_UNECE_Gen2.RP_IF_BLOWER1b_HW_XIX_Grundumfang_XIX_Klima.DE_BLOWER1b_HW, system-signal=BLOWER1b_HW
        communication-direction=IN, data-element=Grundumfang_XIX_Klima.Geltungsbereich_E3_1_1_UNECE_Gen2.RP_IF_BLOWER1b_IBATT_XIX_Grundumfang_XIX_Klima.DE_BLOWER1b_IBATT, system-signal=BLOWER1b_IBATT
        communication-direction=OUT, data-element=Grundumfang_XIX_Klima.Geltungsbereich_E3_1_1_UNECE_Gen2.SP_IF_BLOWER1b_IMAX_MAX_XIX_Grundumfang_XIX_Klima.DE_BLOWER1b_IMAX_MAX, system-signal=BLOWER1b_IMAX_MAX
        communication-direction=OUT, data-element=Grundumfang_XIX_Klima.Geltungsbereich_E3_1_1_UNECE_Gen2.SP_IF_BLOWER1b_IMAX_MIN_XIX_Grundumfang_XIX_Klima.DE_BLOWER1b_IMAX_MIN, system-signal=BLOWER1b_IMAX_MIN
        communication-direction=OUT, data-element=Grundumfang_XIX_Klima.Geltungsbereich_E3_1_1_UNECE_Gen2.SP_IF_BLOWER1b_RAMP_XIX_Grundumfang_XIX_Klima.DE_BLOWER1b_RAMP, system-signal=BLOWER1b_RAMP
        communication-direction=IN, data-element=Grundumfang_XIX_Klima.Geltungsbereich_E3_1_1_UNECE_Gen2.RP_IF_BLOWER1b_ResponseError_XIX_Grundumfang_XIX_Klima.DE_BLOWER1b_ResponseError, system-signal=BLOWER1b_ResponseError
        communication-direction=OUT, data-element=Grundumfang_XIX_Klima.Geltungsbereich_E3_1_1_UNECE_Gen2.SP_IF_BLOWER1b_RX_FREQUENCY_XIX_Grundumfang_XIX_Klima.DE_BLOWER1b_RX_FREQUENCY, system-signal=BLOWER1b_RX_FREQUENCY
        communication-direction=OUT, data-element=Grundumfang_XIX_Klima.Geltungsbereich_E3_1_1_UNECE_Gen2.SP_IF_BLOWER1b_SAFETY_SPEED_XIX_Grundumfang_XIX_Klima.DE_BLOWER1b_SAFETY_SPEED, system-signal=BLOWER1b_SAFETY_SPEED
        communication-direction=OUT, data-element=Grundumfang_XIX_Klima.Geltungsbereich_E3_1_1_UNECE_Gen2.SP_IF_BLOWER1b_SAFETYRUN_THRESHOLD_XIX_Grundumfang_XIX_Klima.DE_BLOWER1b_SAFETYRUN_THRESHOLD, system-signal=BLOWER1b_SAFETYRUN_THRESHOLD
        communication-direction=OUT, data-element=Grundumfang_XIX_Klima.Geltungsbereich_E3_1_1_UNECE_Gen2.SP_IF_BLOWER1b_SELECT_XIX_Grundumfang_XIX_Klima.DE_BLOWER1b_SELECT, system-signal=BLOWER1b_SELECT
        communication-direction=OUT, data-element=Grundumfang_XIX_Klima.Geltungsbereich_E3_1_1_UNECE_Gen2.SP_IF_BLOWER1b_SPEED_XIX_Grundumfang_XIX_Klima.DE_BLOWER1b_SPEED, system-signal=BLOWER1b_SPEED
        communication-direction=IN, data-element=Grundumfang_XIX_Klima.Geltungsbereich_E3_1_1_UNECE_Gen2.RP_IF_BLOWER1b_STATUS1_XIX_Grundumfang_XIX_Klima.DE_BLOWER1b_STATUS1, system-signal=BLOWER1b_STATUS1
        communication-direction=IN, data-element=Grundumfang_XIX_Klima.Geltungsbereich_E3_1_1_UNECE_Gen2.RP_IF_BLOWER1b_STATUS2_XIX_Grundumfang_XIX_Klima.DE_BLOWER1b_STATUS2, system-signal=BLOWER1b_STATUS2
        communication-direction=IN, data-element=Grundumfang_XIX_Klima.Geltungsbereich_E3_1_1_UNECE_Gen2.RP_IF_BLOWER1b_SUPPLIER_XIX_Grundumfang_XIX_Klima.DE_BLOWER1b_SUPPLIER, system-signal=BLOWER1b_SUPPLIER
        communication-direction=IN, data-element=Grundumfang_XIX_Klima.Geltungsbereich_E3_1_1_UNECE_Gen2.RP_IF_BLOWER1b_SW_XIX_Grundumfang_XIX_Klima.DE_BLOWER1b_SW, system-signal=BLOWER1b_SW
        communication-direction=IN, data-element=Grundumfang_XIX_Klima.Geltungsbereich_E3_1_1_UNECE_Gen2.RP_IF_BLOWER1b_TEMPERATURE_XIX_Grundumfang_XIX_Klima.DE_BLOWER1b_TEMPERATURE, system-signal=BLOWER1b_TEMPERATURE
        communication-direction=OUT, data-element=Grundumfang_XIX_Klima.Geltungsbereich_E3_1_1_UNECE_Gen2.SP_IF_BLOWER1b_U_KNEE_XIX_Grundumfang_XIX_Klima.DE_BLOWER1b_U_KNEE, system-signal=BLOWER1b_U_KNEE
        communication-direction=IN, data-element=Grundumfang_XIX_Klima.Geltungsbereich_E3_1_1_UNECE_Gen2.RP_IF_BLOWER1b_UBATT_XIX_Grundumfang_XIX_Klima.DE_BLOWER1b_UBATT, system-signal=BLOWER1b_UBATT
        communication-direction=IN, data-element=Grundumfang_XIX_Klima.Geltungsbereich_E3_1_1_UNECE_Gen2.RP_IF_BLOWER1b_UMOTOR_XIX_Grundumfang_XIX_Klima.DE_BLOWER1b_UMOTOR, system-signal=BLOWER1b_UMOTOR
        communication-direction=IN, data-element=Grundumfang_XIX_Klima.Geltungsbereich_E3_1_1_UNECE_Gen2.RP_IF_BLOWER1c_HW_XIX_Grundumfang_XIX_Klima.DE_BLOWER1c_HW, system-signal=BLOWER1c_HW
        communication-direction=IN, data-element=Grundumfang_XIX_Klima.Geltungsbereich_E3_1_1_UNECE_Gen2.RP_IF_BLOWER1c_IBATT_XIX_Grundumfang_XIX_Klima.DE_BLOWER1c_IBATT, system-signal=BLOWER1c_IBATT
        communication-direction=OUT, data-element=Grundumfang_XIX_Klima.Geltungsbereich_E3_1_1_UNECE_Gen2.SP_IF_BLOWER1c_IMAX_MAX_XIX_Grundumfang_XIX_Klima.DE_BLOWER1c_IMAX_MAX, system-signal=BLOWER1c_IMAX_MAX
        communication-direction=OUT, data-element=Grundumfang_XIX_Klima.Geltungsbereich_E3_1_1_UNECE_Gen2.SP_IF_BLOWER1c_IMAX_MIN_XIX_Grundumfang_XIX_Klima.DE_BLOWER1c_IMAX_MIN, system-signal=BLOWER1c_IMAX_MIN
        communication-direction=OUT, data-element=Grundumfang_XIX_Klima.Geltungsbereich_E3_1_1_UNECE_Gen2.SP_IF_BLOWER1c_RAMP_XIX_Grundumfang_XIX_Klima.DE_BLOWER1c_RAMP, system-signal=BLOWER1c_RAMP
        communication-direction=IN, data-element=Grundumfang_XIX_Klima.Geltungsbereich_E3_1_1_UNECE_Gen2.RP_IF_BLOWER1c_ResponseError_XIX_Grundumfang_XIX_Klima.DE_BLOWER1c_ResponseError, system-signal=BLOWER1c_ResponseError
        communication-direction=OUT, data-element=Grundumfang_XIX_Klima.Geltungsbereich_E3_1_1_UNECE_Gen2.SP_IF_BLOWER1c_RX_FREQUENCY_XIX_Grundumfang_XIX_Klima.DE_BLOWER1c_RX_FREQUENCY, system-signal=BLOWER1c_RX_FREQUENCY
        communication-direction=OUT, data-element=Grundumfang_XIX_Klima.Geltungsbereich_E3_1_1_UNECE_Gen2.SP_IF_BLOWER1c_SAFETY_SPEED_XIX_Grundumfang_XIX_Klima.DE_BLOWER1c_SAFETY_SPEED, system-signal=BLOWER1c_SAFETY_SPEED
        communication-direction=OUT, data-element=Grundumfang_XIX_Klima.Geltungsbereich_E3_1_1_UNECE_Gen2.SP_IF_BLOWER1c_SAFETYRUN_THRESHOLD_XIX_Grundumfang_XIX_Klima.DE_BLOWER1c_SAFETYRUN_THRESHOLD, system-signal=BLOWER1c_SAFETYRUN_THRESHOLD
        communication-direction=OUT, data-element=Grundumfang_XIX_Klima.Geltungsbereich_E3_1_1_UNECE_Gen2.SP_IF_BLOWER1c_SELECT_XIX_Grundumfang_XIX_Klima.DE_BLOWER1c_SELECT, system-signal=BLOWER1c_SELECT
        communication-direction=OUT, data-element=Grundumfang_XIX_Klima.Geltungsbereich_E3_1_1_UNECE_Gen2.SP_IF_BLOWER1c_SPEED_XIX_Grundumfang_XIX_Klima.DE_BLOWER1c_SPEED, system-signal=BLOWER1c_SPEED
        communication-direction=IN, data-element=Grundumfang_XIX_Klima.Geltungsbereich_E3_1_1_UNECE_Gen2.RP_IF_BLOWER1c_STATUS1_XIX_Grundumfang_XIX_Klima.DE_BLOWER1c_STATUS1, system-signal=BLOWER1c_STATUS1
        communication-direction=IN, data-element=Grundumfang_XIX_Klima.Geltungsbereich_E3_1_1_UNECE_Gen2.RP_IF_BLOWER1c_STATUS2_XIX_Grundumfang_XIX_Klima.DE_BLOWER1c_STATUS2, system-signal=BLOWER1c_STATUS2
        communication-direction=IN, data-element=Grundumfang_XIX_Klima.Geltungsbereich_E3_1_1_UNECE_Gen2.RP_IF_BLOWER1c_SUPPLIER_XIX_Grundumfang_XIX_Klima.DE_BLOWER1c_SUPPLIER, system-signal=BLOWER1c_SUPPLIER
        communication-direction=IN, data-element=Grundumfang_XIX_Klima.Geltungsbereich_E3_1_1_UNECE_Gen2.RP_IF_BLOWER1c_SW_XIX_Grundumfang_XIX_Klima.DE_BLOWER1c_SW, system-signal=BLOWER1c_SW
        communication-direction=IN, data-element=Grundumfang_XIX_Klima.Geltungsbereich_E3_1_1_UNECE_Gen2.RP_IF_BLOWER1c_TEMPERATURE_XIX_Grundumfang_XIX_Klima.DE_BLOWER1c_TEMPERATURE, system-signal=BLOWER1c_TEMPERATURE
        communication-direction=OUT, data-element=Grundumfang_XIX_Klima.Geltungsbereich_E3_1_1_UNECE_Gen2.SP_IF_BLOWER1c_U_KNEE_XIX_Grundumfang_XIX_Klima.DE_BLOWER1c_U_KNEE, system-signal=BLOWER1c_U_KNEE
        communication-direction=IN, data-element=Grundumfang_XIX_Klima.Geltungsbereich_E3_1_1_UNECE_Gen2.RP_IF_BLOWER1c_UBATT_XIX_Grundumfang_XIX_Klima.DE_BLOWER1c_UBATT, system-signal=BLOWER1c_UBATT
        communication-direction=IN, data-element=Grundumfang_XIX_Klima.Geltungsbereich_E3_1_1_UNECE_Gen2.RP_IF_BLOWER1c_UMOTOR_XIX_Grundumfang_XIX_Klima.DE_BLOWER1c_UMOTOR, system-signal=BLOWER1c_UMOTOR
        communication-direction=IN, data-element=Grundumfang_XIX_Klima.Geltungsbereich_E3_1_1_UNECE_Gen2.RP_IF_BLOWER2_HW_XIX_Grundumfang_XIX_Klima.DE_BLOWER2_HW, system-signal=BLOWER2_HW
        communication-direction=IN, data-element=Grundumfang_XIX_Klima.Geltungsbereich_E3_1_1_UNECE_Gen2.RP_IF_BLOWER2_IBATT_XIX_Grundumfang_XIX_Klima.DE_BLOWER2_IBATT, system-signal=BLOWER2_IBATT
        communication-direction=IN, data-element=Grundumfang_XIX_Klima.Geltungsbereich_E3_1_1_UNECE_Gen2.RP_IF_BLOWER2_ResponseError_XIX_Grundumfang_XIX_Klima.DE_BLOWER2_ResponseError, system-signal=BLOWER2_ResponseError
        communication-direction=IN, data-element=Grundumfang_XIX_Klima.Geltungsbereich_E3_1_1_UNECE_Gen2.RP_IF_BLOWER2_STATUS1_XIX_Grundumfang_XIX_Klima.DE_BLOWER2_STATUS1, system-signal=BLOWER2_STATUS1
        communication-direction=IN, data-element=Grundumfang_XIX_Klima.Geltungsbereich_E3_1_1_UNECE_Gen2.RP_IF_BLOWER2_STATUS1_INVALID_XIX_Grundumfang_XIX_Klima.DE_BLOWER2_STATUS1_INVALID, system-signal=BLOWER2_STATUS1_INVALID
        communication-direction=IN, data-element=Grundumfang_XIX_Klima.Geltungsbereich_E3_1_1_UNECE_Gen2.RP_IF_BLOWER2_STATUS2_XIX_Grundumfang_XIX_Klima.DE_BLOWER2_STATUS2, system-signal=BLOWER2_STATUS2
        communication-direction=IN, data-element=Grundumfang_XIX_Klima.Geltungsbereich_E3_1_1_UNECE_Gen2.RP_IF_BLOWER2_SUPPLIER_XIX_Grundumfang_XIX_Klima.DE_BLOWER2_SUPPLIER, system-signal=BLOWER2_SUPPLIER
        communication-direction=IN, data-element=Grundumfang_XIX_Klima.Geltungsbereich_E3_1_1_UNECE_Gen2.RP_IF_BLOWER2_SW_XIX_Grundumfang_XIX_Klima.DE_BLOWER2_SW, system-signal=BLOWER2_SW
        communication-direction=IN, data-element=Grundumfang_XIX_Klima.Geltungsbereich_E3_1_1_UNECE_Gen2.RP_IF_BLOWER2_TEMPERATURE_XIX_Grundumfang_XIX_Klima.DE_BLOWER2_TEMPERATURE, system-signal=BLOWER2_TEMPERATURE
        communication-direction=IN, data-element=Grundumfang_XIX_Klima.Geltungsbereich_E3_1_1_UNECE_Gen2.RP_IF_BLOWER2_UBATT_XIX_Grundumfang_XIX_Klima.DE_BLOWER2_UBATT, system-signal=BLOWER2_UBATT
        communication-direction=IN, data-element=Grundumfang_XIX_Klima.Geltungsbereich_E3_1_1_UNECE_Gen2.RP_IF_BLOWER2_UMOTOR_XIX_Grundumfang_XIX_Klima.DE_BLOWER2_UMOTOR, system-signal=BLOWER2_UMOTOR
        communication-direction=IN, data-element=Grundumfang_XIX_Klima.Geltungsbereich_E3_1_1_UNECE_Gen2.RP_IF_BLOWER2b_HW_XIX_Grundumfang_XIX_Klima.DE_BLOWER2b_HW, system-signal=BLOWER2b_HW
        communication-direction=IN, data-element=Grundumfang_XIX_Klima.Geltungsbereich_E3_1_1_UNECE_Gen2.RP_IF_BLOWER2b_IBATT_XIX_Grundumfang_XIX_Klima.DE_BLOWER2b_IBATT, system-signal=BLOWER2b_IBATT
        communication-direction=IN, data-element=Grundumfang_XIX_Klima.Geltungsbereich_E3_1_1_UNECE_Gen2.RP_IF_BLOWER2b_ResponseError_XIX_Grundumfang_XIX_Klima.DE_BLOWER2b_ResponseError, system-signal=BLOWER2b_ResponseError
        communication-direction=IN, data-element=Grundumfang_XIX_Klima.Geltungsbereich_E3_1_1_UNECE_Gen2.RP_IF_BLOWER2b_STATUS1_XIX_Grundumfang_XIX_Klima.DE_BLOWER2b_STATUS1, system-signal=BLOWER2b_STATUS1
        communication-direction=IN, data-element=Grundumfang_XIX_Klima.Geltungsbereich_E3_1_1_UNECE_Gen2.RP_IF_BLOWER2b_STATUS1_INVALID_XIX_Grundumfang_XIX_Klima.DE_BLOWER2b_STATUS1_INVALID, system-signal=BLOWER2b_STATUS1_INVALID
        communication-direction=IN, data-element=Grundumfang_XIX_Klima.Geltungsbereich_E3_1_1_UNECE_Gen2.RP_IF_BLOWER2b_STATUS2_XIX_Grundumfang_XIX_Klima.DE_BLOWER2b_STATUS2, system-signal=BLOWER2b_STATUS2
        communication-direction=IN, data-element=Grundumfang_XIX_Klima.Geltungsbereich_E3_1_1_UNECE_Gen2.RP_IF_BLOWER2b_SUPPLIER_XIX_Grundumfang_XIX_Klima.DE_BLOWER2b_SUPPLIER, system-signal=BLOWER2b_SUPPLIER
        communication-direction=IN, data-element=Grundumfang_XIX_Klima.Geltungsbereich_E3_1_1_UNECE_Gen2.RP_IF_BLOWER2b_SW_XIX_Grundumfang_XIX_Klima.DE_BLOWER2b_SW, system-signal=BLOWER2b_SW
        communication-direction=IN, data-element=Grundumfang_XIX_Klima.Geltungsbereich_E3_1_1_UNECE_Gen2.RP_IF_BLOWER2b_TEMPERATURE_XIX_Grundumfang_XIX_Klima.DE_BLOWER2b_TEMPERATURE, system-signal=BLOWER2b_TEMPERATURE
        communication-direction=IN, data-element=Grundumfang_XIX_Klima.Geltungsbereich_E3_1_1_UNECE_Gen2.RP_IF_BLOWER2b_UBATT_XIX_Grundumfang_XIX_Klima.DE_BLOWER2b_UBATT, system-signal=BLOWER2b_UBATT
        communication-direction=IN, data-element=Grundumfang_XIX_Klima.Geltungsbereich_E3_1_1_UNECE_Gen2.RP_IF_BLOWER2b_UMOTOR_XIX_Grundumfang_XIX_Klima.DE_BLOWER2b_UMOTOR, system-signal=BLOWER2b_UMOTOR
        communication-direction=OUT, data-element=Grundumfang_XIX_Klima.Geltungsbereich_E3_1_1_UNECE_Gen2.SP_IF_BLOWER2be_IMAX_MAX_XIX_Grundumfang_XIX_Klima.DE_BLOWER2be_IMAX_MAX, system-signal=BLOWER2be_IMAX_MAX
        communication-direction=OUT, data-element=Grundumfang_XIX_Klima.Geltungsbereich_E3_1_1_UNECE_Gen2.SP_IF_BLOWER2be_IMAX_MIN_XIX_Grundumfang_XIX_Klima.DE_BLOWER2be_IMAX_MIN, system-signal=BLOWER2be_IMAX_MIN
        communication-direction=OUT, data-element=Grundumfang_XIX_Klima.Geltungsbereich_E3_1_1_UNECE_Gen2.SP_IF_BLOWER2be_RAMP_XIX_Grundumfang_XIX_Klima.DE_BLOWER2be_RAMP, system-signal=BLOWER2be_RAMP
        communication-direction=OUT, data-element=Grundumfang_XIX_Klima.Geltungsbereich_E3_1_1_UNECE_Gen2.SP_IF_BLOWER2be_RX_FREQUENCY_XIX_Grundumfang_XIX_Klima.DE_BLOWER2be_RX_FREQUENCY, system-signal=BLOWER2be_RX_FREQUENCY
        communication-direction=OUT, data-element=Grundumfang_XIX_Klima.Geltungsbereich_E3_1_1_UNECE_Gen2.SP_IF_BLOWER2be_SAFETY_SPEED_XIX_Grundumfang_XIX_Klima.DE_BLOWER2be_SAFETY_SPEED, system-signal=BLOWER2be_SAFETY_SPEED
        communication-direction=OUT, data-element=Grundumfang_XIX_Klima.Geltungsbereich_E3_1_1_UNECE_Gen2.SP_IF_BLOWER2be_SAFETYRUN_THRESHOLD_XIX_Grundumfang_XIX_Klima.DE_BLOWER2be_SAFETYRUN_THRESHOLD, system-signal=BLOWER2be_SAFETYRUN_THRESHOLD
        communication-direction=OUT, data-element=Grundumfang_XIX_Klima.Geltungsbereich_E3_1_1_UNECE_Gen2.SP_IF_BLOWER2be_SELECT_XIX_Grundumfang_XIX_Klima.DE_BLOWER2be_SELECT, system-signal=BLOWER2be_SELECT
        communication-direction=OUT, data-element=Grundumfang_XIX_Klima.Geltungsbereich_E3_1_1_UNECE_Gen2.SP_IF_BLOWER2be_SPEED_XIX_Grundumfang_XIX_Klima.DE_BLOWER2be_SPEED, system-signal=BLOWER2be_SPEED
        communication-direction=OUT, data-element=Grundumfang_XIX_Klima.Geltungsbereich_E3_1_1_UNECE_Gen2.SP_IF_BLOWER2be_U_KNEE_XIX_Grundumfang_XIX_Klima.DE_BLOWER2be_U_KNEE, system-signal=BLOWER2be_U_KNEE
        communication-direction=OUT, data-element=Grundumfang_XIX_Klima.Geltungsbereich_E3_1_1_UNECE_Gen2.SP_IF_BLOWER2e_IMAX_MAX_XIX_Grundumfang_XIX_Klima.DE_BLOWER2e_IMAX_MAX, system-signal=BLOWER2e_IMAX_MAX
        communication-direction=OUT, data-element=Grundumfang_XIX_Klima.Geltungsbereich_E3_1_1_UNECE_Gen2.SP_IF_BLOWER2e_IMAX_MIN_XIX_Grundumfang_XIX_Klima.DE_BLOWER2e_IMAX_MIN, system-signal=BLOWER2e_IMAX_MIN
        communication-direction=OUT, data-element=Grundumfang_XIX_Klima.Geltungsbereich_E3_1_1_UNECE_Gen2.SP_IF_BLOWER2e_RAMP_XIX_Grundumfang_XIX_Klima.DE_BLOWER2e_RAMP, system-signal=BLOWER2e_RAMP
        communication-direction=OUT, data-element=Grundumfang_XIX_Klima.Geltungsbereich_E3_1_1_UNECE_Gen2.SP_IF_BLOWER2e_RX_FREQUENCY_XIX_Grundumfang_XIX_Klima.DE_BLOWER2e_RX_FREQUENCY, system-signal=BLOWER2e_RX_FREQUENCY
        communication-direction=OUT, data-element=Grundumfang_XIX_Klima.Geltungsbereich_E3_1_1_UNECE_Gen2.SP_IF_BLOWER2e_SAFETY_SPEED_XIX_Grundumfang_XIX_Klima.DE_BLOWER2e_SAFETY_SPEED, system-signal=BLOWER2e_SAFETY_SPEED
        communication-direction=OUT, data-element=Grundumfang_XIX_Klima.Geltungsbereich_E3_1_1_UNECE_Gen2.SP_IF_BLOWER2e_SAFETYRUN_THRESHOLD_XIX_Grundumfang_XIX_Klima.DE_BLOWER2e_SAFETYRUN_THRESHOLD, system-signal=BLOWER2e_SAFETYRUN_THRESHOLD
        communication-direction=OUT, data-element=Grundumfang_XIX_Klima.Geltungsbereich_E3_1_1_UNECE_Gen2.SP_IF_BLOWER2e_SELECT_XIX_Grundumfang_XIX_Klima.DE_BLOWER2e_SELECT, system-signal=BLOWER2e_SELECT
        communication-direction=OUT, data-element=Grundumfang_XIX_Klima.Geltungsbereich_E3_1_1_UNECE_Gen2.SP_IF_BLOWER2e_SPEED_XIX_Grundumfang_XIX_Klima.DE_BLOWER2e_SPEED, system-signal=BLOWER2e_SPEED
        communication-direction=OUT, data-element=Grundumfang_XIX_Klima.Geltungsbereich_E3_1_1_UNECE_Gen2.SP_IF_BLOWER2e_U_KNEE_XIX_Grundumfang_XIX_Klima.DE_BLOWER2e_U_KNEE, system-signal=BLOWER2e_U_KNEE
        communication-direction=IN, data-element=Grundumfang_XIX_Klima.Geltungsbereich_E3_1_1_UNECE_Gen2.RP_IF_BLOWER_DIAG_FLAG1_XIX_Grundumfang_XIX_Klima.DE_BLOWER_DIAG_FLAG1, system-signal=BLOWER_DIAG_FLAG1
        communication-direction=IN, data-element=Grundumfang_XIX_Klima.Geltungsbereich_E3_1_1_UNECE_Gen2.RP_IF_BLOWER_DIAG_FLAG2_XIX_Grundumfang_XIX_Klima.DE_BLOWER_DIAG_FLAG2, system-signal=BLOWER_DIAG_FLAG2
        communication-direction=IN, data-element=Grundumfang_XIX_Klima.Geltungsbereich_E3_1_1_UNECE_Gen2.RP_IF_BLOWER_IBATT_XIX_Grundumfang_XIX_Klima.DE_BLOWER_IBATT, system-signal=BLOWER_IBATT
        communication-direction=IN, data-element=Grundumfang_XIX_Klima.Geltungsbereich_E3_1_1_UNECE_Gen2.RP_IF_BLOWER_ResponseError_XIX_Grundumfang_XIX_Klima.DE_BLOWER_ResponseError, system-signal=BLOWER_ResponseError
        communication-direction=IN, data-element=Grundumfang_XIX_Klima.Geltungsbereich_E3_1_1_UNECE_Gen2.RP_IF_BLOWER_ROTATION_SPEED_XIX_Grundumfang_XIX_Klima.DE_BLOWER_ROTATION_SPEED, system-signal=BLOWER_ROTATION_SPEED
        communication-direction=IN, data-element=Grundumfang_XIX_Klima.Geltungsbereich_E3_1_1_UNECE_Gen2.RP_IF_BLOWER_STATUS_MOTOR_XIX_Grundumfang_XIX_Klima.DE_BLOWER_STATUS_MOTOR, system-signal=BLOWER_STATUS_MOTOR
        communication-direction=IN, data-element=Grundumfang_XIX_Klima.Geltungsbereich_E3_1_1_UNECE_Gen2.RP_IF_BLOWER_SUPPLIER_XIX_Grundumfang_XIX_Klima.DE_BLOWER_SUPPLIER, system-signal=BLOWER_SUPPLIER
        communication-direction=IN, data-element=Grundumfang_XIX_Klima.Geltungsbereich_E3_1_1_UNECE_Gen2.RP_IF_BLOWER_TEMPERATURE_XIX_Grundumfang_XIX_Klima.DE_BLOWER_TEMPERATURE, system-signal=BLOWER_TEMPERATURE
        communication-direction=IN, data-element=Grundumfang_XIX_Klima.Geltungsbereich_E3_1_1_UNECE_Gen2.RP_IF_BLOWER_TORQUE_XIX_Grundumfang_XIX_Klima.DE_BLOWER_TORQUE, system-signal=BLOWER_TORQUE
        communication-direction=IN, data-element=Grundumfang_XIX_Klima.Geltungsbereich_E3_1_1_UNECE_Gen2.RP_IF_BLOWER_UBATT_XIX_Grundumfang_XIX_Klima.DE_BLOWER_UBATT, system-signal=BLOWER_UBATT
        communication-direction=IN, data-element=Grundumfang_XIX_Klima.Geltungsbereich_E3_1_1_UNECE_Gen2.RP_IF_BLOWER_UMOTOR_XIX_Grundumfang_XIX_Klima.DE_BLOWER_UMOTOR, system-signal=BLOWER_UMOTOR
        communication-direction=IN, data-element=Grundumfang_XIX_Klima.Geltungsbereich_E3_1_1_UNECE_Gen2.RP_IF_BMS_BattHeizung_Anf_XIX_Grundumfang_XIX_Klima.DE_BMS_BattHeizung_Anf, system-signal=BMS_BattHeizung_Anf
        communication-direction=IN, data-element=Grundumfang_XIX_Klima.Geltungsbereich_E3_1_1_UNECE_Gen2.RP_IF_BMS_DC_Ladeprofil_XIX_Grundumfang_XIX_Klima.DE_BMS_DC_Ladeprofil, system-signal=BMS_DC_Ladeprofil
        communication-direction=IN, data-element=Grundumfang_XIX_Klima.Geltungsbereich_E3_1_1_UNECE_Gen2.RP_IF_BMS_Fehler_NTKreis_XIX_Grundumfang_XIX_Klima.DE_BMS_Fehler_NTKreis, system-signal=BMS_Fehler_NTKreis
        communication-direction=IN, data-element=Grundumfang_XIX_Klima.Geltungsbereich_E3_1_1_UNECE_Gen2.RP_IF_BMS_Kuehlung_Anf_XIX_Grundumfang_XIX_Klima.DE_BMS_Kuehlung_Anf, system-signal=BMS_Kuehlung_Anf
        communication-direction=IN, data-element=HVEM_Auto_NL_XIX_Klima.Geltungsbereich_E3_1_1_UNECE_Gen2.RP_IF_BMS_Kuehlung_Anf_XIX_HVEM_Auto_NL_XIX_Klima.DE_BMS_Kuehlung_Anf, system-signal=BMS_Kuehlung_Anf
        communication-direction=IN, data-element=Grundumfang_XIX_Klima.Geltungsbereich_E3_1_1_UNECE_Gen2.RP_IF_BMS_KundenWarnung_XIX_Grundumfang_XIX_Klima.DE_BMS_KundenWarnung, system-signal=BMS_KundenWarnung
        communication-direction=IN, data-element=Grundumfang_XIX_Klima.Geltungsbereich_E3_1_1_UNECE_Gen2.RP_IF_BMS_Ladezustand_XIX_Grundumfang_XIX_Klima.DE_BMS_Ladezustand, system-signal=BMS_Ladezustand
        communication-direction=IN, data-element=Grundumfang_XIX_Klima.Geltungsbereich_E3_1_1_UNECE_Gen2.RP_IF_BMS_Pumpe1_Ansteuerung_XIX_Grundumfang_XIX_Klima.DE_BMS_Pumpe1_Ansteuerung, system-signal=BMS_Pumpe1_Ansteuerung
        communication-direction=IN, data-element=Grundumfang_XIX_Klima.Geltungsbereich_E3_1_1_UNECE_Gen2.RP_IF_BMS_Pumpe2_Ansteuerung_XIX_Grundumfang_XIX_Klima.DE_BMS_Pumpe2_Ansteuerung, system-signal=BMS_Pumpe2_Ansteuerung
        communication-direction=IN, data-element=Grundumfang_XIX_Klima.Geltungsbereich_E3_1_1_UNECE_Gen2.RP_IF_BMS_RuecklaufTemperatur_XIX_Grundumfang_XIX_Klima.DE_BMS_RuecklaufTemperatur, system-signal=BMS_RuecklaufTemperatur
        communication-direction=IN, data-element=Grundumfang_XIX_Klima.Geltungsbereich_E3_1_1_UNECE_Gen2.RP_IF_BMS_SollVorlauftemperatur_XIX_Grundumfang_XIX_Klima.DE_BMS_SollVorlauftemperatur, system-signal=BMS_SollVorlauftemperatur
        communication-direction=IN, data-element=Grundumfang_XIX_Klima.Geltungsbereich_E3_1_1_UNECE_Gen2.RP_IF_BMS_Spannung_XIX_Grundumfang_XIX_Klima.DE_BMS_Spannung, system-signal=BMS_Spannung
        communication-direction=IN, data-element=Grundumfang_XIX_Klima.Geltungsbereich_E3_1_1_UNECE_Gen2.RP_IF_BMS_Status_Ventil1_XIX_Grundumfang_XIX_Klima.DE_BMS_Status_Ventil1, system-signal=BMS_Status_Ventil1
        communication-direction=IN, data-element=Grundumfang_XIX_Klima.Geltungsbereich_E3_1_1_UNECE_Gen2.RP_IF_BMS_Status_Ventil2_XIX_Grundumfang_XIX_Klima.DE_BMS_Status_Ventil2, system-signal=BMS_Status_Ventil2
        communication-direction=IN, data-element=Grundumfang_XIX_Klima.Geltungsbereich_E3_1_1_UNECE_Gen2.RP_IF_BMS_Strom_XIX_Grundumfang_XIX_Klima.DE_BMS_Strom, system-signal=BMS_Strom
        communication-direction=IN, data-element=Grundumfang_XIX_Klima.Geltungsbereich_E3_1_1_UNECE_Gen2.RP_IF_BMS_Temperatur_XIX_Grundumfang_XIX_Klima.DE_BMS_Temperatur, system-signal=BMS_Temperatur
        communication-direction=IN, data-element=Grundumfang_XIX_Klima.Geltungsbereich_E3_1_1_UNECE_Gen2.RP_IF_BMS_Temperierung_Anf_XIX_Grundumfang_XIX_Klima.DE_BMS_Temperierung_Anf, system-signal=BMS_Temperierung_Anf
        communication-direction=IN, data-element=Grundumfang_XIX_Klima.Geltungsbereich_E3_1_1_UNECE_Gen2.RP_IF_BMS_TMA_Betriebsart_XIX_Grundumfang_XIX_Klima.DE_BMS_TMA_Betriebsart, system-signal=BMS_TMA_Betriebsart
        communication-direction=IN, data-element=Grundumfang_XIX_Klima.Geltungsbereich_E3_1_1_UNECE_Gen2.RP_IF_BMS_TMA_Kuehlkreis_Status_XIX_Grundumfang_XIX_Klima.DE_BMS_TMA_Kuehlkreis_Status, system-signal=BMS_TMA_Kuehlkreis_Status
        communication-direction=IN, data-element=HVEM_Auto_NL_XIX_Klima.Geltungsbereich_E3_1_1_UNECE_Gen2.RP_IF_BMS_UBE_T_XIX_HVEM_Auto_NL_XIX_Klima.DE_BMS_UBE_T, system-signal=BMS_UBE_T
        communication-direction=IN, data-element=Grundumfang_XIX_Klima.Geltungsbereich_E3_1_1_UNECE_Gen2.RP_IF_BMS_VorlaufTemperatur_XIX_Grundumfang_XIX_Klima.DE_BMS_VorlaufTemperatur, system-signal=BMS_VorlaufTemperatur
        communication-direction=IN, data-element=Grundumfang_XIX_Klima.Geltungsbereich_E3_1_1_UNECE_Gen2.RP_IF_BT_FH_Oeffnung_XIX_Grundumfang_XIX_Klima.DE_BT_FH_Oeffnung, system-signal=BT_FH_Oeffnung
        communication-direction=OUT, data-element=Grundumfang_XIX_Klima.Geltungsbereich_E3_1_1_UNECE_Gen2.SP_IF_BT_FH_Oeffnung_4Bit_XIX_Grundumfang_XIX_Klima.DE_BT_FH_Oeffnung_4Bit, system-signal=BT_FH_Oeffnung_4Bit
        communication-direction=IN, data-element=Grundumfang_XIX_Klima.Geltungsbereich_E3_1_1_UNECE_Gen2.RP_IF_BT_Tuer_geoeffnet_XIX_Grundumfang_XIX_Klima.DE_BT_Tuer_geoeffnet, system-signal=BT_Tuer_geoeffnet
        communication-direction=IN, data-element=Grundumfang_XIX_Klima.Geltungsbereich_E3_1_1_UNECE_Gen2.RP_IF_CHA_Fahrer_Umschaltung_XIX_Grundumfang_XIX_Klima.DE_CHA_Fahrer_Umschaltung, system-signal=CHA_Fahrer_Umschaltung
        communication-direction=IN, data-element=Grundumfang_XIX_Klima.Geltungsbereich_E3_1_1_UNECE_Gen2.RP_IF_CHA_Ziel_FahrPr_KL_XIX_Grundumfang_XIX_Klima.DE_CHA_Ziel_FahrPr_KL, system-signal=CHA_Ziel_FahrPr_KL
        communication-direction=IN, data-element=Grundumfang_XIX_Klima.Geltungsbereich_E3_1_1_UNECE_Gen2.RP_IF_DGN_Verlernzaehler_XIX_Grundumfang_XIX_Klima.DE_DGN_Verlernzaehler, system-signal=DGN_Verlernzaehler
        communication-direction=IN, data-element=Grundumfang_XIX_Klima.Geltungsbereich_E3_1_1_UNECE_Gen2.RP_IF_DI_KL_58xd_XIX_Grundumfang_XIX_Klima.DE_DI_KL_58xd, system-signal=DI_KL_58xd
        communication-direction=OUT, data-element=Grundumfang_XIX_Klima.Geltungsbereich_E3_1_1_UNECE_Gen2.SP_IF_DI_KL_58xd_XIX_Grundumfang_XIX_Klima.DE_DI_KL_58xd, system-signal=DI_KL_58xd
        communication-direction=IN, data-element=Grundumfang_XIX_Klima.Geltungsbereich_E3_1_1_UNECE_Gen2.RP_IF_DI_KL_58xs_XIX_Grundumfang_XIX_Klima.DE_DI_KL_58xs, system-signal=DI_KL_58xs
        communication-direction=OUT, data-element=Grundumfang_XIX_Klima.Geltungsbereich_E3_1_1_UNECE_Gen2.SP_IF_DI_KL_58xs_XIX_Grundumfang_XIX_Klima.DE_DI_KL_58xs, system-signal=DI_KL_58xs
        communication-direction=IN, data-element=Grundumfang_XIX_Klima.Geltungsbereich_E3_1_1_UNECE_Gen2.RP_IF_DiETa_Defrost_Taste_XIX_Grundumfang_XIX_Klima.DE_DiETa_Defrost_Taste, system-signal=DiETa_Defrost_Taste
        communication-direction=IN, data-element=Grundumfang_XIX_Klima.Geltungsbereich_E3_1_1_UNECE_Gen2.RP_IF_DiETa_FSH_Taste_XIX_Grundumfang_XIX_Klima.DE_DiETa_FSH_Taste, system-signal=DiETa_FSH_Taste
        communication-direction=IN, data-element=Grundumfang_XIX_Klima.Geltungsbereich_E3_1_1_UNECE_Gen2.RP_IF_DiETa_HSH_Taste_XIX_Grundumfang_XIX_Klima.DE_DiETa_HSH_Taste, system-signal=DiETa_HSH_Taste
        communication-direction=IN, data-element=Grundumfang_XIX_Klima.Geltungsbereich_E3_1_1_UNECE_Gen2.RP_IF_DiETa_Klima_XIX_Grundumfang_XIX_Klima.DE_DiETa_Klima, system-signal=DiETa_Klima
        communication-direction=IN, data-element=Grundumfang_XIX_Klima.Geltungsbereich_E3_1_1_UNECE_Gen2.RP_IF_DS_BitError_XIX_Grundumfang_XIX_Klima.DE_DS_BitError, system-signal=DS_BitError
        communication-direction=IN, data-element=Grundumfang_XIX_Klima.Geltungsbereich_E3_1_1_UNECE_Gen2.RP_IF_DS_ChecksumError_XIX_Grundumfang_XIX_Klima.DE_DS_ChecksumError, system-signal=DS_ChecksumError
        communication-direction=IN, data-element=Grundumfang_XIX_Klima.Geltungsbereich_E3_1_1_UNECE_Gen2.RP_IF_DS_DruckError_XIX_Grundumfang_XIX_Klima.DE_DS_DruckError, system-signal=DS_DruckError
        communication-direction=IN, data-element=Grundumfang_XIX_Klima.Geltungsbereich_E3_1_1_UNECE_Gen2.RP_IF_DS_HW_XIX_Grundumfang_XIX_Klima.DE_DS_HW, system-signal=DS_HW
        communication-direction=IN, data-element=Grundumfang_XIX_Klima.Geltungsbereich_E3_1_1_UNECE_Gen2.RP_IF_DS_Kaeltemittel_P_XIX_Grundumfang_XIX_Klima.DE_DS_Kaeltemittel_P, system-signal=DS_Kaeltemittel_P
        communication-direction=OUT, data-element=Grundumfang_XIX_Klima.Geltungsbereich_E3_1_1_UNECE_Gen2.SP_IF_DS_Kaeltemittel_P_XIX_Grundumfang_XIX_Klima.DE_DS_Kaeltemittel_P, system-signal=DS_Kaeltemittel_P
        communication-direction=OUT, data-element=Grundumfang_XIX_Klima.Geltungsbereich_E3_1_1_UNECE_Gen2.SP_IF_DS_Kaeltemittel_P_WP_XIX_Grundumfang_XIX_Klima.DE_DS_Kaeltemittel_P_WP, system-signal=DS_Kaeltemittel_P_WP
        communication-direction=OUT, data-element=Grundumfang_XIX_Klima.Geltungsbereich_E3_1_1_UNECE_Gen2.SP_IF_DS_Status_XIX_Grundumfang_XIX_Klima.DE_DS_Status, system-signal=DS_Status
        communication-direction=IN, data-element=Grundumfang_XIX_Klima.Geltungsbereich_E3_1_1_UNECE_Gen2.RP_IF_DS_SW_XIX_Grundumfang_XIX_Klima.DE_DS_SW, system-signal=DS_SW
        communication-direction=IN, data-element=Grundumfang_XIX_Klima.Geltungsbereich_E3_1_1_UNECE_Gen2.RP_IF_DS_TempError_XIX_Grundumfang_XIX_Klima.DE_DS_TempError, system-signal=DS_TempError
        communication-direction=IN, data-element=Grundumfang_XIX_Klima.Geltungsbereich_E3_1_1_UNECE_Gen2.RP_IF_DTS1_Fehler_XIX_Grundumfang_XIX_Klima.DE_DTS1_Fehler, system-signal=DTS1_Fehler
        communication-direction=IN, data-element=Grundumfang_XIX_Klima.Geltungsbereich_E3_1_1_UNECE_Gen2.RP_IF_DTS1_interne_Sensor_T_XIX_Grundumfang_XIX_Klima.DE_DTS1_interne_Sensor_T, system-signal=DTS1_interne_Sensor_T
        communication-direction=IN, data-element=Grundumfang_XIX_Klima.Geltungsbereich_E3_1_1_UNECE_Gen2.RP_IF_DTS1_Kaeltemittel_p_XIX_Grundumfang_XIX_Klima.DE_DTS1_Kaeltemittel_p, system-signal=DTS1_Kaeltemittel_p
        communication-direction=IN, data-element=Grundumfang_XIX_Klima.Geltungsbereich_E3_1_1_UNECE_Gen2.RP_IF_DTS1_Kaeltemittel_T_XIX_Grundumfang_XIX_Klima.DE_DTS1_Kaeltemittel_T, system-signal=DTS1_Kaeltemittel_T
        communication-direction=IN, data-element=Grundumfang_XIX_Klima.Geltungsbereich_E3_1_1_UNECE_Gen2.RP_IF_DTS1_Kommunikation_XIX_Grundumfang_XIX_Klima.DE_DTS1_Kommunikation, system-signal=DTS1_Kommunikation
        communication-direction=IN, data-element=Grundumfang_XIX_Klima.Geltungsbereich_E3_1_1_UNECE_Gen2.RP_IF_DTS1_R744_Fehler_XIX_Grundumfang_XIX_Klima.DE_DTS1_R744_Fehler, system-signal=DTS1_R744_Fehler
        communication-direction=IN, data-element=Grundumfang_XIX_Klima.Geltungsbereich_E3_1_1_UNECE_Gen2.RP_IF_DTS1_R744_interne_Sensor_T_XIX_Grundumfang_XIX_Klima.DE_DTS1_R744_interne_Sensor_T, system-signal=DTS1_R744_interne_Sensor_T
        communication-direction=IN, data-element=Grundumfang_XIX_Klima.Geltungsbereich_E3_1_1_UNECE_Gen2.RP_IF_DTS1_R744_Kaeltemittel_p_XIX_Grundumfang_XIX_Klima.DE_DTS1_R744_Kaeltemittel_p, system-signal=DTS1_R744_Kaeltemittel_p
        communication-direction=IN, data-element=Grundumfang_XIX_Klima.Geltungsbereich_E3_1_1_UNECE_Gen2.RP_IF_DTS1_R744_Kaeltemittel_t_XIX_Grundumfang_XIX_Klima.DE_DTS1_R744_Kaeltemittel_t, system-signal=DTS1_R744_Kaeltemittel_t
        communication-direction=IN, data-element=Grundumfang_XIX_Klima.Geltungsbereich_E3_1_1_UNECE_Gen2.RP_IF_DTS1_R744_Kommunikation_XIX_Grundumfang_XIX_Klima.DE_DTS1_R744_Kommunikation, system-signal=DTS1_R744_Kommunikation
        communication-direction=IN, data-element=Grundumfang_XIX_Klima.Geltungsbereich_E3_1_1_UNECE_Gen2.RP_IF_DTS1_R744_ResponseError_XIX_Grundumfang_XIX_Klima.DE_DTS1_R744_ResponseError, system-signal=DTS1_R744_ResponseError
        communication-direction=IN, data-element=Grundumfang_XIX_Klima.Geltungsbereich_E3_1_1_UNECE_Gen2.RP_IF_DTS1_R744_TNCTOC_XIX_Grundumfang_XIX_Klima.DE_DTS1_R744_TNCTOC, system-signal=DTS1_R744_TNCTOC
        communication-direction=IN, data-element=Grundumfang_XIX_Klima.Geltungsbereich_E3_1_1_UNECE_Gen2.RP_IF_DTS1_ResponseError_XIX_Grundumfang_XIX_Klima.DE_DTS1_ResponseError, system-signal=DTS1_ResponseError
        communication-direction=IN, data-element=Grundumfang_XIX_Klima.Geltungsbereich_E3_1_1_UNECE_Gen2.RP_IF_DTS1_TNCTOC_XIX_Grundumfang_XIX_Klima.DE_DTS1_TNCTOC, system-signal=DTS1_TNCTOC
        communication-direction=IN, data-element=Grundumfang_XIX_Klima.Geltungsbereich_E3_1_1_UNECE_Gen2.RP_IF_DTS2_Fehler_XIX_Grundumfang_XIX_Klima.DE_DTS2_Fehler, system-signal=DTS2_Fehler
        communication-direction=IN, data-element=Grundumfang_XIX_Klima.Geltungsbereich_E3_1_1_UNECE_Gen2.RP_IF_DTS2_interne_Sensor_T_XIX_Grundumfang_XIX_Klima.DE_DTS2_interne_Sensor_T, system-signal=DTS2_interne_Sensor_T
        communication-direction=IN, data-element=Grundumfang_XIX_Klima.Geltungsbereich_E3_1_1_UNECE_Gen2.RP_IF_DTS2_Kaeltemittel_p_XIX_Grundumfang_XIX_Klima.DE_DTS2_Kaeltemittel_p, system-signal=DTS2_Kaeltemittel_p
        communication-direction=IN, data-element=Grundumfang_XIX_Klima.Geltungsbereich_E3_1_1_UNECE_Gen2.RP_IF_DTS2_Kaeltemittel_T_XIX_Grundumfang_XIX_Klima.DE_DTS2_Kaeltemittel_T, system-signal=DTS2_Kaeltemittel_T
        communication-direction=IN, data-element=Grundumfang_XIX_Klima.Geltungsbereich_E3_1_1_UNECE_Gen2.RP_IF_DTS2_Kommunikation_XIX_Grundumfang_XIX_Klima.DE_DTS2_Kommunikation, system-signal=DTS2_Kommunikation
        communication-direction=IN, data-element=Grundumfang_XIX_Klima.Geltungsbereich_E3_1_1_UNECE_Gen2.RP_IF_DTS2_R744_Fehler_XIX_Grundumfang_XIX_Klima.DE_DTS2_R744_Fehler, system-signal=DTS2_R744_Fehler
        communication-direction=IN, data-element=Grundumfang_XIX_Klima.Geltungsbereich_E3_1_1_UNECE_Gen2.RP_IF_DTS2_R744_interne_Sensor_T_XIX_Grundumfang_XIX_Klima.DE_DTS2_R744_interne_Sensor_T, system-signal=DTS2_R744_interne_Sensor_T
        communication-direction=IN, data-element=Grundumfang_XIX_Klima.Geltungsbereich_E3_1_1_UNECE_Gen2.RP_IF_DTS2_R744_Kaeltemittel_p_XIX_Grundumfang_XIX_Klima.DE_DTS2_R744_Kaeltemittel_p, system-signal=DTS2_R744_Kaeltemittel_p
        communication-direction=IN, data-element=Grundumfang_XIX_Klima.Geltungsbereich_E3_1_1_UNECE_Gen2.RP_IF_DTS2_R744_Kaeltemittel_t_XIX_Grundumfang_XIX_Klima.DE_DTS2_R744_Kaeltemittel_t, system-signal=DTS2_R744_Kaeltemittel_t
        communication-direction=IN, data-element=Grundumfang_XIX_Klima.Geltungsbereich_E3_1_1_UNECE_Gen2.RP_IF_DTS2_R744_Kommunikation_XIX_Grundumfang_XIX_Klima.DE_DTS2_R744_Kommunikation, system-signal=DTS2_R744_Kommunikation
        communication-direction=IN, data-element=Grundumfang_XIX_Klima.Geltungsbereich_E3_1_1_UNECE_Gen2.RP_IF_DTS2_R744_ResponseError_XIX_Grundumfang_XIX_Klima.DE_DTS2_R744_ResponseError, system-signal=DTS2_R744_ResponseError
        communication-direction=IN, data-element=Grundumfang_XIX_Klima.Geltungsbereich_E3_1_1_UNECE_Gen2.RP_IF_DTS2_R744_TNCTOC_XIX_Grundumfang_XIX_Klima.DE_DTS2_R744_TNCTOC, system-signal=DTS2_R744_TNCTOC
        communication-direction=IN, data-element=Grundumfang_XIX_Klima.Geltungsbereich_E3_1_1_UNECE_Gen2.RP_IF_DTS2_ResponseError_XIX_Grundumfang_XIX_Klima.DE_DTS2_ResponseError, system-signal=DTS2_ResponseError
        communication-direction=IN, data-element=Grundumfang_XIX_Klima.Geltungsbereich_E3_1_1_UNECE_Gen2.RP_IF_DTS2_TNCTOC_XIX_Grundumfang_XIX_Klima.DE_DTS2_TNCTOC, system-signal=DTS2_TNCTOC
        communication-direction=IN, data-element=Grundumfang_XIX_Klima.Geltungsbereich_E3_1_1_UNECE_Gen2.RP_IF_DTS2b_R744_Fehler_XIX_Grundumfang_XIX_Klima.DE_DTS2b_R744_Fehler, system-signal=DTS2b_R744_Fehler
        communication-direction=IN, data-element=Grundumfang_XIX_Klima.Geltungsbereich_E3_1_1_UNECE_Gen2.RP_IF_DTS2b_R744_interne_Sensor_T_XIX_Grundumfang_XIX_Klima.DE_DTS2b_R744_interne_Sensor_T, system-signal=DTS2b_R744_interne_Sensor_T
        communication-direction=IN, data-element=Grundumfang_XIX_Klima.Geltungsbereich_E3_1_1_UNECE_Gen2.RP_IF_DTS2b_R744_Kaeltemittel_p_XIX_Grundumfang_XIX_Klima.DE_DTS2b_R744_Kaeltemittel_p, system-signal=DTS2b_R744_Kaeltemittel_p
        communication-direction=IN, data-element=Grundumfang_XIX_Klima.Geltungsbereich_E3_1_1_UNECE_Gen2.RP_IF_DTS2b_R744_Kaeltemittel_t_XIX_Grundumfang_XIX_Klima.DE_DTS2b_R744_Kaeltemittel_t, system-signal=DTS2b_R744_Kaeltemittel_t
        communication-direction=IN, data-element=Grundumfang_XIX_Klima.Geltungsbereich_E3_1_1_UNECE_Gen2.RP_IF_DTS2b_R744_Kommunikation_XIX_Grundumfang_XIX_Klima.DE_DTS2b_R744_Kommunikation, system-signal=DTS2b_R744_Kommunikation
        communication-direction=IN, data-element=Grundumfang_XIX_Klima.Geltungsbereich_E3_1_1_UNECE_Gen2.RP_IF_DTS2b_R744_ResponseError_XIX_Grundumfang_XIX_Klima.DE_DTS2b_R744_ResponseError, system-signal=DTS2b_R744_ResponseError
        communication-direction=IN, data-element=Grundumfang_XIX_Klima.Geltungsbereich_E3_1_1_UNECE_Gen2.RP_IF_DTS2b_R744_TNCTOC_XIX_Grundumfang_XIX_Klima.DE_DTS2b_R744_TNCTOC, system-signal=DTS2b_R744_TNCTOC
        communication-direction=IN, data-element=Grundumfang_XIX_Klima.Geltungsbereich_E3_1_1_UNECE_Gen2.RP_IF_DTS2c_R744_Fehler_XIX_Grundumfang_XIX_Klima.DE_DTS2c_R744_Fehler, system-signal=DTS2c_R744_Fehler
        communication-direction=IN, data-element=Grundumfang_XIX_Klima.Geltungsbereich_E3_1_1_UNECE_Gen2.RP_IF_DTS2c_R744_interne_Sensor_T_XIX_Grundumfang_XIX_Klima.DE_DTS2c_R744_interne_Sensor_T, system-signal=DTS2c_R744_interne_Sensor_T
        communication-direction=IN, data-element=Grundumfang_XIX_Klima.Geltungsbereich_E3_1_1_UNECE_Gen2.RP_IF_DTS2c_R744_Kaeltemittel_p_XIX_Grundumfang_XIX_Klima.DE_DTS2c_R744_Kaeltemittel_p, system-signal=DTS2c_R744_Kaeltemittel_p
        communication-direction=IN, data-element=Grundumfang_XIX_Klima.Geltungsbereich_E3_1_1_UNECE_Gen2.RP_IF_DTS2c_R744_Kaeltemittel_t_XIX_Grundumfang_XIX_Klima.DE_DTS2c_R744_Kaeltemittel_t, system-signal=DTS2c_R744_Kaeltemittel_t
        communication-direction=IN, data-element=Grundumfang_XIX_Klima.Geltungsbereich_E3_1_1_UNECE_Gen2.RP_IF_DTS2c_R744_Kommunikation_XIX_Grundumfang_XIX_Klima.DE_DTS2c_R744_Kommunikation, system-signal=DTS2c_R744_Kommunikation
        communication-direction=IN, data-element=Grundumfang_XIX_Klima.Geltungsbereich_E3_1_1_UNECE_Gen2.RP_IF_DTS2c_R744_ResponseError_XIX_Grundumfang_XIX_Klima.DE_DTS2c_R744_ResponseError, system-signal=DTS2c_R744_ResponseError
        communication-direction=IN, data-element=Grundumfang_XIX_Klima.Geltungsbereich_E3_1_1_UNECE_Gen2.RP_IF_DTS2c_R744_TNCTOC_XIX_Grundumfang_XIX_Klima.DE_DTS2c_R744_TNCTOC, system-signal=DTS2c_R744_TNCTOC
        communication-direction=IN, data-element=Grundumfang_XIX_Klima.Geltungsbereich_E3_1_1_UNECE_Gen2.RP_IF_DTS3_Fehler_XIX_Grundumfang_XIX_Klima.DE_DTS3_Fehler, system-signal=DTS3_Fehler
        communication-direction=IN, data-element=Grundumfang_XIX_Klima.Geltungsbereich_E3_1_1_UNECE_Gen2.RP_IF_DTS3_interne_Sensor_T_XIX_Grundumfang_XIX_Klima.DE_DTS3_interne_Sensor_T, system-signal=DTS3_interne_Sensor_T
        communication-direction=IN, data-element=Grundumfang_XIX_Klima.Geltungsbereich_E3_1_1_UNECE_Gen2.RP_IF_DTS3_Kaeltemittel_p_XIX_Grundumfang_XIX_Klima.DE_DTS3_Kaeltemittel_p, system-signal=DTS3_Kaeltemittel_p
        communication-direction=IN, data-element=Grundumfang_XIX_Klima.Geltungsbereich_E3_1_1_UNECE_Gen2.RP_IF_DTS3_Kaeltemittel_T_XIX_Grundumfang_XIX_Klima.DE_DTS3_Kaeltemittel_T, system-signal=DTS3_Kaeltemittel_T
        communication-direction=IN, data-element=Grundumfang_XIX_Klima.Geltungsbereich_E3_1_1_UNECE_Gen2.RP_IF_DTS3_Kommunikation_XIX_Grundumfang_XIX_Klima.DE_DTS3_Kommunikation, system-signal=DTS3_Kommunikation
        communication-direction=IN, data-element=Grundumfang_XIX_Klima.Geltungsbereich_E3_1_1_UNECE_Gen2.RP_IF_DTS3_R744_Fehler_XIX_Grundumfang_XIX_Klima.DE_DTS3_R744_Fehler, system-signal=DTS3_R744_Fehler
        communication-direction=IN, data-element=Grundumfang_XIX_Klima.Geltungsbereich_E3_1_1_UNECE_Gen2.RP_IF_DTS3_R744_interne_Sensor_T_XIX_Grundumfang_XIX_Klima.DE_DTS3_R744_interne_Sensor_T, system-signal=DTS3_R744_interne_Sensor_T
        communication-direction=IN, data-element=Grundumfang_XIX_Klima.Geltungsbereich_E3_1_1_UNECE_Gen2.RP_IF_DTS3_R744_Kaeltemittel_p_XIX_Grundumfang_XIX_Klima.DE_DTS3_R744_Kaeltemittel_p, system-signal=DTS3_R744_Kaeltemittel_p
        communication-direction=IN, data-element=Grundumfang_XIX_Klima.Geltungsbereich_E3_1_1_UNECE_Gen2.RP_IF_DTS3_R744_Kaeltemittel_t_XIX_Grundumfang_XIX_Klima.DE_DTS3_R744_Kaeltemittel_t, system-signal=DTS3_R744_Kaeltemittel_t
        communication-direction=IN, data-element=Grundumfang_XIX_Klima.Geltungsbereich_E3_1_1_UNECE_Gen2.RP_IF_DTS3_R744_Kommunikation_XIX_Grundumfang_XIX_Klima.DE_DTS3_R744_Kommunikation, system-signal=DTS3_R744_Kommunikation
        communication-direction=IN, data-element=Grundumfang_XIX_Klima.Geltungsbereich_E3_1_1_UNECE_Gen2.RP_IF_DTS3_R744_ResponseError_XIX_Grundumfang_XIX_Klima.DE_DTS3_R744_ResponseError, system-signal=DTS3_R744_ResponseError
        communication-direction=IN, data-element=Grundumfang_XIX_Klima.Geltungsbereich_E3_1_1_UNECE_Gen2.RP_IF_DTS3_R744_TNCTOC_XIX_Grundumfang_XIX_Klima.DE_DTS3_R744_TNCTOC, system-signal=DTS3_R744_TNCTOC
        communication-direction=IN, data-element=Grundumfang_XIX_Klima.Geltungsbereich_E3_1_1_UNECE_Gen2.RP_IF_DTS3_ResponseError_XIX_Grundumfang_XIX_Klima.DE_DTS3_ResponseError, system-signal=DTS3_ResponseError
        communication-direction=IN, data-element=Grundumfang_XIX_Klima.Geltungsbereich_E3_1_1_UNECE_Gen2.RP_IF_DTS3_TNCTOC_XIX_Grundumfang_XIX_Klima.DE_DTS3_TNCTOC, system-signal=DTS3_TNCTOC
        communication-direction=IN, data-element=Grundumfang_XIX_Klima.Geltungsbereich_E3_1_1_UNECE_Gen2.RP_IF_DTS3b_R744_Fehler_XIX_Grundumfang_XIX_Klima.DE_DTS3b_R744_Fehler, system-signal=DTS3b_R744_Fehler
        communication-direction=IN, data-element=Grundumfang_XIX_Klima.Geltungsbereich_E3_1_1_UNECE_Gen2.RP_IF_DTS3b_R744_interne_Sensor_T_XIX_Grundumfang_XIX_Klima.DE_DTS3b_R744_interne_Sensor_T, system-signal=DTS3b_R744_interne_Sensor_T
        communication-direction=IN, data-element=Grundumfang_XIX_Klima.Geltungsbereich_E3_1_1_UNECE_Gen2.RP_IF_DTS3b_R744_Kaeltemittel_p_XIX_Grundumfang_XIX_Klima.DE_DTS3b_R744_Kaeltemittel_p, system-signal=DTS3b_R744_Kaeltemittel_p
        communication-direction=IN, data-element=Grundumfang_XIX_Klima.Geltungsbereich_E3_1_1_UNECE_Gen2.RP_IF_DTS3b_R744_Kaeltemittel_t_XIX_Grundumfang_XIX_Klima.DE_DTS3b_R744_Kaeltemittel_t, system-signal=DTS3b_R744_Kaeltemittel_t
        communication-direction=IN, data-element=Grundumfang_XIX_Klima.Geltungsbereich_E3_1_1_UNECE_Gen2.RP_IF_DTS3b_R744_Kommunikation_XIX_Grundumfang_XIX_Klima.DE_DTS3b_R744_Kommunikation, system-signal=DTS3b_R744_Kommunikation
        communication-direction=IN, data-element=Grundumfang_XIX_Klima.Geltungsbereich_E3_1_1_UNECE_Gen2.RP_IF_DTS3b_R744_ResponseError_XIX_Grundumfang_XIX_Klima.DE_DTS3b_R744_ResponseError, system-signal=DTS3b_R744_ResponseError
        communication-direction=IN, data-element=Grundumfang_XIX_Klima.Geltungsbereich_E3_1_1_UNECE_Gen2.RP_IF_DTS3b_R744_TNCTOC_XIX_Grundumfang_XIX_Klima.DE_DTS3b_R744_TNCTOC, system-signal=DTS3b_R744_TNCTOC
        communication-direction=IN, data-element=Grundumfang_XIX_Klima.Geltungsbereich_E3_1_1_UNECE_Gen2.RP_IF_EASV1_Err_Blockierung_TF_XIX_Grundumfang_XIX_Klima.DE_EASV1_Err_Blockierung_TF, system-signal=EASV1_Err_Blockierung_TF
        communication-direction=IN, data-element=Grundumfang_XIX_Klima.Geltungsbereich_E3_1_1_UNECE_Gen2.RP_IF_EASV1_Err_Blockierung_TNCTOC_XIX_Grundumfang_XIX_Klima.DE_EASV1_Err_Blockierung_TNCTOC, system-signal=EASV1_Err_Blockierung_TNCTOC
        communication-direction=IN, data-element=Grundumfang_XIX_Klima.Geltungsbereich_E3_1_1_UNECE_Gen2.RP_IF_EASV1_Err_EDefekt_MoKomp_TF_XIX_Grundumfang_XIX_Klima.DE_EASV1_Err_EDefekt_MoKomp_TF, system-signal=EASV1_Err_EDefekt_MoKomp_TF
        communication-direction=IN, data-element=Grundumfang_XIX_Klima.Geltungsbereich_E3_1_1_UNECE_Gen2.RP_IF_EASV1_Err_EDefekt_MoKomp_TNCTOC_XIX_Grundumfang_XIX_Klima.DE_EASV1_Err_EDefekt_MoKomp_TNCTOC, system-signal=EASV1_Err_EDefekt_MoKomp_TNCTOC
        communication-direction=IN, data-element=Grundumfang_XIX_Klima.Geltungsbereich_E3_1_1_UNECE_Gen2.RP_IF_EASV1_Err_EDefekt_TSens_TF_XIX_Grundumfang_XIX_Klima.DE_EASV1_Err_EDefekt_TSens_TF, system-signal=EASV1_Err_EDefekt_TSens_TF
        communication-direction=IN, data-element=Grundumfang_XIX_Klima.Geltungsbereich_E3_1_1_UNECE_Gen2.RP_IF_EASV1_Err_EDefekt_TSens_TNCTOC_XIX_Grundumfang_XIX_Klima.DE_EASV1_Err_EDefekt_TSens_TNCTOC, system-signal=EASV1_Err_EDefekt_TSens_TNCTOC
        communication-direction=IN, data-element=Grundumfang_XIX_Klima.Geltungsbereich_E3_1_1_UNECE_Gen2.RP_IF_EASV1_Err_Notlaufpos_TF_XIX_Grundumfang_XIX_Klima.DE_EASV1_Err_Notlaufpos_TF, system-signal=EASV1_Err_Notlaufpos_TF
        communication-direction=IN, data-element=Grundumfang_XIX_Klima.Geltungsbereich_E3_1_1_UNECE_Gen2.RP_IF_EASV1_Err_Notlaufpos_TNCTOC_XIX_Grundumfang_XIX_Klima.DE_EASV1_Err_Notlaufpos_TNCTOC, system-signal=EASV1_Err_Notlaufpos_TNCTOC
        communication-direction=IN, data-element=Grundumfang_XIX_Klima.Geltungsbereich_E3_1_1_UNECE_Gen2.RP_IF_EASV1_Err_RAMROMNADChange_TF_XIX_Grundumfang_XIX_Klima.DE_EASV1_Err_RAMROMNADChange_TF, system-signal=EASV1_Err_RAMROMNADChange_TF
        communication-direction=IN, data-element=Grundumfang_XIX_Klima.Geltungsbereich_E3_1_1_UNECE_Gen2.RP_IF_EASV1_Err_RAMROMNADChange_TNCTOC_XIX_Grundumfang_XIX_Klima.DE_EASV1_Err_RAMROMNADChange_TNCTOC, system-signal=EASV1_Err_RAMROMNADChange_TNCTOC
        communication-direction=IN, data-element=Grundumfang_XIX_Klima.Geltungsbereich_E3_1_1_UNECE_Gen2.RP_IF_EASV1_Err_Ueberspannung_TF_XIX_Grundumfang_XIX_Klima.DE_EASV1_Err_Ueberspannung_TF, system-signal=EASV1_Err_Ueberspannung_TF
        communication-direction=IN, data-element=Grundumfang_XIX_Klima.Geltungsbereich_E3_1_1_UNECE_Gen2.RP_IF_EASV1_Err_Ueberspannung_TNCTOC_XIX_Grundumfang_XIX_Klima.DE_EASV1_Err_Ueberspannung_TNCTOC, system-signal=EASV1_Err_Ueberspannung_TNCTOC
        communication-direction=IN, data-element=Grundumfang_XIX_Klima.Geltungsbereich_E3_1_1_UNECE_Gen2.RP_IF_EASV1_Err_Uebertemperatur_TF_XIX_Grundumfang_XIX_Klima.DE_EASV1_Err_Uebertemperatur_TF, system-signal=EASV1_Err_Uebertemperatur_TF
        communication-direction=IN, data-element=Grundumfang_XIX_Klima.Geltungsbereich_E3_1_1_UNECE_Gen2.RP_IF_EASV1_Err_Uebertemperatur_TNCTOC_XIX_Grundumfang_XIX_Klima.DE_EASV1_Err_Uebertemperatur_TNCTOC, system-signal=EASV1_Err_Uebertemperatur_TNCTOC
        communication-direction=IN, data-element=Grundumfang_XIX_Klima.Geltungsbereich_E3_1_1_UNECE_Gen2.RP_IF_EASV1_Err_Unterspannung_TF_XIX_Grundumfang_XIX_Klima.DE_EASV1_Err_Unterspannung_TF, system-signal=EASV1_Err_Unterspannung_TF
        communication-direction=IN, data-element=Grundumfang_XIX_Klima.Geltungsbereich_E3_1_1_UNECE_Gen2.RP_IF_EASV1_Err_Unterspannung_TNCTOC_XIX_Grundumfang_XIX_Klima.DE_EASV1_Err_Unterspannung_TNCTOC, system-signal=EASV1_Err_Unterspannung_TNCTOC
        communication-direction=IN, data-element=Grundumfang_XIX_Klima.Geltungsbereich_E3_1_1_UNECE_Gen2.RP_IF_EASV1_ErrMem_State_XIX_Grundumfang_XIX_Klima.DE_EASV1_ErrMem_State, system-signal=EASV1_ErrMem_State
        communication-direction=IN, data-element=Grundumfang_XIX_Klima.Geltungsbereich_E3_1_1_UNECE_Gen2.RP_IF_EASV1_Geschwindigkeitsstatus_XIX_Grundumfang_XIX_Klima.DE_EASV1_Geschwindigkeitsstatus, system-signal=EASV1_Geschwindigkeitsstatus
        communication-direction=IN, data-element=Grundumfang_XIX_Klima.Geltungsbereich_E3_1_1_UNECE_Gen2.RP_IF_EASV1_Ist_Position_Aktuator_XIX_Grundumfang_XIX_Klima.DE_EASV1_Ist_Position_Aktuator, system-signal=EASV1_Ist_Position_Aktuator
        communication-direction=IN, data-element=Grundumfang_XIX_Klima.Geltungsbereich_E3_1_1_UNECE_Gen2.RP_IF_EASV1_ResponseError_XIX_Grundumfang_XIX_Klima.DE_EASV1_ResponseError, system-signal=EASV1_ResponseError
        communication-direction=IN, data-element=Grundumfang_XIX_Klima.Geltungsbereich_E3_1_1_UNECE_Gen2.RP_IF_EASV1_ResponseError_TNCTOC_XIX_Grundumfang_XIX_Klima.DE_EASV1_ResponseError_TNCTOC, system-signal=EASV1_ResponseError_TNCTOC
        communication-direction=IN, data-element=Grundumfang_XIX_Klima.Geltungsbereich_E3_1_1_UNECE_Gen2.RP_IF_EASV1_Spulenbestromung_XIX_Grundumfang_XIX_Klima.DE_EASV1_Spulenbestromung, system-signal=EASV1_Spulenbestromung
        communication-direction=IN, data-element=Grundumfang_XIX_Klima.Geltungsbereich_E3_1_1_UNECE_Gen2.RP_IF_EASV1_Temp_XIX_Grundumfang_XIX_Klima.DE_EASV1_Temp, system-signal=EASV1_Temp
        communication-direction=IN, data-element=Grundumfang_XIX_Klima.Geltungsbereich_E3_1_1_UNECE_Gen2.RP_IF_EASV1_Temp_Warning_XIX_Grundumfang_XIX_Klima.DE_EASV1_Temp_Warning, system-signal=EASV1_Temp_Warning
        communication-direction=IN, data-element=Grundumfang_XIX_Klima.Geltungsbereich_E3_1_1_UNECE_Gen2.RP_IF_EASV2_Err_Blockierung_TF_XIX_Grundumfang_XIX_Klima.DE_EASV2_Err_Blockierung_TF, system-signal=EASV2_Err_Blockierung_TF
        communication-direction=IN, data-element=Grundumfang_XIX_Klima.Geltungsbereich_E3_1_1_UNECE_Gen2.RP_IF_EASV2_Err_Blockierung_TNCTOC_XIX_Grundumfang_XIX_Klima.DE_EASV2_Err_Blockierung_TNCTOC, system-signal=EASV2_Err_Blockierung_TNCTOC
        communication-direction=IN, data-element=Grundumfang_XIX_Klima.Geltungsbereich_E3_1_1_UNECE_Gen2.RP_IF_EASV2_Err_EDefekt_MoKomp_TF_XIX_Grundumfang_XIX_Klima.DE_EASV2_Err_EDefekt_MoKomp_TF, system-signal=EASV2_Err_EDefekt_MoKomp_TF
        communication-direction=IN, data-element=Grundumfang_XIX_Klima.Geltungsbereich_E3_1_1_UNECE_Gen2.RP_IF_EASV2_Err_EDefekt_MoKomp_TNCTOC_XIX_Grundumfang_XIX_Klima.DE_EASV2_Err_EDefekt_MoKomp_TNCTOC, system-signal=EASV2_Err_EDefekt_MoKomp_TNCTOC
        communication-direction=IN, data-element=Grundumfang_XIX_Klima.Geltungsbereich_E3_1_1_UNECE_Gen2.RP_IF_EASV2_Err_EDefekt_TSens_TF_XIX_Grundumfang_XIX_Klima.DE_EASV2_Err_EDefekt_TSens_TF, system-signal=EASV2_Err_EDefekt_TSens_TF
        communication-direction=IN, data-element=Grundumfang_XIX_Klima.Geltungsbereich_E3_1_1_UNECE_Gen2.RP_IF_EASV2_Err_EDefekt_TSens_TNCTOC_XIX_Grundumfang_XIX_Klima.DE_EASV2_Err_EDefekt_TSens_TNCTOC, system-signal=EASV2_Err_EDefekt_TSens_TNCTOC
        communication-direction=IN, data-element=Grundumfang_XIX_Klima.Geltungsbereich_E3_1_1_UNECE_Gen2.RP_IF_EASV2_Err_Notlaufpos_TF_XIX_Grundumfang_XIX_Klima.DE_EASV2_Err_Notlaufpos_TF, system-signal=EASV2_Err_Notlaufpos_TF
        communication-direction=IN, data-element=Grundumfang_XIX_Klima.Geltungsbereich_E3_1_1_UNECE_Gen2.RP_IF_EASV2_Err_Notlaufpos_TNCTOC_XIX_Grundumfang_XIX_Klima.DE_EASV2_Err_Notlaufpos_TNCTOC, system-signal=EASV2_Err_Notlaufpos_TNCTOC
        communication-direction=IN, data-element=Grundumfang_XIX_Klima.Geltungsbereich_E3_1_1_UNECE_Gen2.RP_IF_EASV2_Err_RAMROMNADChange_TF_XIX_Grundumfang_XIX_Klima.DE_EASV2_Err_RAMROMNADChange_TF, system-signal=EASV2_Err_RAMROMNADChange_TF
        communication-direction=IN, data-element=Grundumfang_XIX_Klima.Geltungsbereich_E3_1_1_UNECE_Gen2.RP_IF_EASV2_Err_RAMROMNADChange_TNCTOC_XIX_Grundumfang_XIX_Klima.DE_EASV2_Err_RAMROMNADChange_TNCTOC, system-signal=EASV2_Err_RAMROMNADChange_TNCTOC
        communication-direction=IN, data-element=Grundumfang_XIX_Klima.Geltungsbereich_E3_1_1_UNECE_Gen2.RP_IF_EASV2_Err_Ueberspannung_TF_XIX_Grundumfang_XIX_Klima.DE_EASV2_Err_Ueberspannung_TF, system-signal=EASV2_Err_Ueberspannung_TF
        communication-direction=IN, data-element=Grundumfang_XIX_Klima.Geltungsbereich_E3_1_1_UNECE_Gen2.RP_IF_EASV2_Err_Ueberspannung_TNCTOC_XIX_Grundumfang_XIX_Klima.DE_EASV2_Err_Ueberspannung_TNCTOC, system-signal=EASV2_Err_Ueberspannung_TNCTOC
        communication-direction=IN, data-element=Grundumfang_XIX_Klima.Geltungsbereich_E3_1_1_UNECE_Gen2.RP_IF_EASV2_Err_Uebertemperatur_TF_XIX_Grundumfang_XIX_Klima.DE_EASV2_Err_Uebertemperatur_TF, system-signal=EASV2_Err_Uebertemperatur_TF
        communication-direction=IN, data-element=Grundumfang_XIX_Klima.Geltungsbereich_E3_1_1_UNECE_Gen2.RP_IF_EASV2_Err_Uebertemperatur_TNCTOC_XIX_Grundumfang_XIX_Klima.DE_EASV2_Err_Uebertemperatur_TNCTOC, system-signal=EASV2_Err_Uebertemperatur_TNCTOC
        communication-direction=IN, data-element=Grundumfang_XIX_Klima.Geltungsbereich_E3_1_1_UNECE_Gen2.RP_IF_EASV2_Err_Unterspannung_TF_XIX_Grundumfang_XIX_Klima.DE_EASV2_Err_Unterspannung_TF, system-signal=EASV2_Err_Unterspannung_TF
        communication-direction=IN, data-element=Grundumfang_XIX_Klima.Geltungsbereich_E3_1_1_UNECE_Gen2.RP_IF_EASV2_Err_Unterspannung_TNCTOC_XIX_Grundumfang_XIX_Klima.DE_EASV2_Err_Unterspannung_TNCTOC, system-signal=EASV2_Err_Unterspannung_TNCTOC
        communication-direction=IN, data-element=Grundumfang_XIX_Klima.Geltungsbereich_E3_1_1_UNECE_Gen2.RP_IF_EASV2_ErrMem_State_XIX_Grundumfang_XIX_Klima.DE_EASV2_ErrMem_State, system-signal=EASV2_ErrMem_State
        communication-direction=IN, data-element=Grundumfang_XIX_Klima.Geltungsbereich_E3_1_1_UNECE_Gen2.RP_IF_EASV2_Geschwindigkeitsstatus_XIX_Grundumfang_XIX_Klima.DE_EASV2_Geschwindigkeitsstatus, system-signal=EASV2_Geschwindigkeitsstatus
        communication-direction=IN, data-element=Grundumfang_XIX_Klima.Geltungsbereich_E3_1_1_UNECE_Gen2.RP_IF_EASV2_Ist_Position_Aktuator_XIX_Grundumfang_XIX_Klima.DE_EASV2_Ist_Position_Aktuator, system-signal=EASV2_Ist_Position_Aktuator
        communication-direction=IN, data-element=Grundumfang_XIX_Klima.Geltungsbereich_E3_1_1_UNECE_Gen2.RP_IF_EASV2_ResponseError_XIX_Grundumfang_XIX_Klima.DE_EASV2_ResponseError, system-signal=EASV2_ResponseError
        communication-direction=IN, data-element=Grundumfang_XIX_Klima.Geltungsbereich_E3_1_1_UNECE_Gen2.RP_IF_EASV2_ResponseError_TNCTOC_XIX_Grundumfang_XIX_Klima.DE_EASV2_ResponseError_TNCTOC, system-signal=EASV2_ResponseError_TNCTOC
        communication-direction=IN, data-element=Grundumfang_XIX_Klima.Geltungsbereich_E3_1_1_UNECE_Gen2.RP_IF_EASV2_Spulenbestromung_XIX_Grundumfang_XIX_Klima.DE_EASV2_Spulenbestromung, system-signal=EASV2_Spulenbestromung
        communication-direction=IN, data-element=Grundumfang_XIX_Klima.Geltungsbereich_E3_1_1_UNECE_Gen2.RP_IF_EASV2_Temp_XIX_Grundumfang_XIX_Klima.DE_EASV2_Temp, system-signal=EASV2_Temp
        communication-direction=IN, data-element=Grundumfang_XIX_Klima.Geltungsbereich_E3_1_1_UNECE_Gen2.RP_IF_EASV2_Temp_Warning_XIX_Grundumfang_XIX_Klima.DE_EASV2_Temp_Warning, system-signal=EASV2_Temp_Warning
        communication-direction=IN, data-element=Grundumfang_XIX_Klima.Geltungsbereich_E3_1_1_UNECE_Gen2.RP_IF_EASV3_Err_Blockierung_TF_XIX_Grundumfang_XIX_Klima.DE_EASV3_Err_Blockierung_TF, system-signal=EASV3_Err_Blockierung_TF
        communication-direction=IN, data-element=Grundumfang_XIX_Klima.Geltungsbereich_E3_1_1_UNECE_Gen2.RP_IF_EASV3_Err_Blockierung_TNCTOC_XIX_Grundumfang_XIX_Klima.DE_EASV3_Err_Blockierung_TNCTOC, system-signal=EASV3_Err_Blockierung_TNCTOC
        communication-direction=IN, data-element=Grundumfang_XIX_Klima.Geltungsbereich_E3_1_1_UNECE_Gen2.RP_IF_EASV3_Err_EDefekt_MoKomp_TF_XIX_Grundumfang_XIX_Klima.DE_EASV3_Err_EDefekt_MoKomp_TF, system-signal=EASV3_Err_EDefekt_MoKomp_TF
        communication-direction=IN, data-element=Grundumfang_XIX_Klima.Geltungsbereich_E3_1_1_UNECE_Gen2.RP_IF_EASV3_Err_EDefekt_MoKomp_TNCTOC_XIX_Grundumfang_XIX_Klima.DE_EASV3_Err_EDefekt_MoKomp_TNCTOC, system-signal=EASV3_Err_EDefekt_MoKomp_TNCTOC
        communication-direction=IN, data-element=Grundumfang_XIX_Klima.Geltungsbereich_E3_1_1_UNECE_Gen2.RP_IF_EASV3_Err_EDefekt_TSens_TF_XIX_Grundumfang_XIX_Klima.DE_EASV3_Err_EDefekt_TSens_TF, system-signal=EASV3_Err_EDefekt_TSens_TF
        communication-direction=IN, data-element=Grundumfang_XIX_Klima.Geltungsbereich_E3_1_1_UNECE_Gen2.RP_IF_EASV3_Err_EDefekt_TSens_TNCTOC_XIX_Grundumfang_XIX_Klima.DE_EASV3_Err_EDefekt_TSens_TNCTOC, system-signal=EASV3_Err_EDefekt_TSens_TNCTOC
        communication-direction=IN, data-element=Grundumfang_XIX_Klima.Geltungsbereich_E3_1_1_UNECE_Gen2.RP_IF_EASV3_Err_Notlaufpos_TF_XIX_Grundumfang_XIX_Klima.DE_EASV3_Err_Notlaufpos_TF, system-signal=EASV3_Err_Notlaufpos_TF
        communication-direction=IN, data-element=Grundumfang_XIX_Klima.Geltungsbereich_E3_1_1_UNECE_Gen2.RP_IF_EASV3_Err_Notlaufpos_TNCTOC_XIX_Grundumfang_XIX_Klima.DE_EASV3_Err_Notlaufpos_TNCTOC, system-signal=EASV3_Err_Notlaufpos_TNCTOC
        communication-direction=IN, data-element=Grundumfang_XIX_Klima.Geltungsbereich_E3_1_1_UNECE_Gen2.RP_IF_EASV3_Err_RAMROMNADChange_TF_XIX_Grundumfang_XIX_Klima.DE_EASV3_Err_RAMROMNADChange_TF, system-signal=EASV3_Err_RAMROMNADChange_TF
        communication-direction=IN, data-element=Grundumfang_XIX_Klima.Geltungsbereich_E3_1_1_UNECE_Gen2.RP_IF_EASV3_Err_RAMROMNADChange_TNCTOC_XIX_Grundumfang_XIX_Klima.DE_EASV3_Err_RAMROMNADChange_TNCTOC, system-signal=EASV3_Err_RAMROMNADChange_TNCTOC
        communication-direction=IN, data-element=Grundumfang_XIX_Klima.Geltungsbereich_E3_1_1_UNECE_Gen2.RP_IF_EASV3_Err_Ueberspannung_TF_XIX_Grundumfang_XIX_Klima.DE_EASV3_Err_Ueberspannung_TF, system-signal=EASV3_Err_Ueberspannung_TF
        communication-direction=IN, data-element=Grundumfang_XIX_Klima.Geltungsbereich_E3_1_1_UNECE_Gen2.RP_IF_EASV3_Err_Ueberspannung_TNCTOC_XIX_Grundumfang_XIX_Klima.DE_EASV3_Err_Ueberspannung_TNCTOC, system-signal=EASV3_Err_Ueberspannung_TNCTOC
        communication-direction=IN, data-element=Grundumfang_XIX_Klima.Geltungsbereich_E3_1_1_UNECE_Gen2.RP_IF_EASV3_Err_Uebertemperatur_TF_XIX_Grundumfang_XIX_Klima.DE_EASV3_Err_Uebertemperatur_TF, system-signal=EASV3_Err_Uebertemperatur_TF
        communication-direction=IN, data-element=Grundumfang_XIX_Klima.Geltungsbereich_E3_1_1_UNECE_Gen2.RP_IF_EASV3_Err_Uebertemperatur_TNCTOC_XIX_Grundumfang_XIX_Klima.DE_EASV3_Err_Uebertemperatur_TNCTOC, system-signal=EASV3_Err_Uebertemperatur_TNCTOC
        communication-direction=IN, data-element=Grundumfang_XIX_Klima.Geltungsbereich_E3_1_1_UNECE_Gen2.RP_IF_EASV3_Err_Unterspannung_TF_XIX_Grundumfang_XIX_Klima.DE_EASV3_Err_Unterspannung_TF, system-signal=EASV3_Err_Unterspannung_TF
        communication-direction=IN, data-element=Grundumfang_XIX_Klima.Geltungsbereich_E3_1_1_UNECE_Gen2.RP_IF_EASV3_Err_Unterspannung_TNCTOC_XIX_Grundumfang_XIX_Klima.DE_EASV3_Err_Unterspannung_TNCTOC, system-signal=EASV3_Err_Unterspannung_TNCTOC
        communication-direction=IN, data-element=Grundumfang_XIX_Klima.Geltungsbereich_E3_1_1_UNECE_Gen2.RP_IF_EASV3_ErrMem_State_XIX_Grundumfang_XIX_Klima.DE_EASV3_ErrMem_State, system-signal=EASV3_ErrMem_State
        communication-direction=IN, data-element=Grundumfang_XIX_Klima.Geltungsbereich_E3_1_1_UNECE_Gen2.RP_IF_EASV3_Geschwindigkeitsstatus_XIX_Grundumfang_XIX_Klima.DE_EASV3_Geschwindigkeitsstatus, system-signal=EASV3_Geschwindigkeitsstatus
        communication-direction=IN, data-element=Grundumfang_XIX_Klima.Geltungsbereich_E3_1_1_UNECE_Gen2.RP_IF_EASV3_Ist_Position_Aktuator_XIX_Grundumfang_XIX_Klima.DE_EASV3_Ist_Position_Aktuator, system-signal=EASV3_Ist_Position_Aktuator
        communication-direction=IN, data-element=Grundumfang_XIX_Klima.Geltungsbereich_E3_1_1_UNECE_Gen2.RP_IF_EASV3_ResponseError_XIX_Grundumfang_XIX_Klima.DE_EASV3_ResponseError, system-signal=EASV3_ResponseError
        communication-direction=IN, data-element=Grundumfang_XIX_Klima.Geltungsbereich_E3_1_1_UNECE_Gen2.RP_IF_EASV3_ResponseError_TNCTOC_XIX_Grundumfang_XIX_Klima.DE_EASV3_ResponseError_TNCTOC, system-signal=EASV3_ResponseError_TNCTOC
        communication-direction=IN, data-element=Grundumfang_XIX_Klima.Geltungsbereich_E3_1_1_UNECE_Gen2.RP_IF_EASV3_Spulenbestromung_XIX_Grundumfang_XIX_Klima.DE_EASV3_Spulenbestromung, system-signal=EASV3_Spulenbestromung
        communication-direction=IN, data-element=Grundumfang_XIX_Klima.Geltungsbereich_E3_1_1_UNECE_Gen2.RP_IF_EASV3_Temp_XIX_Grundumfang_XIX_Klima.DE_EASV3_Temp, system-signal=EASV3_Temp
        communication-direction=IN, data-element=Grundumfang_XIX_Klima.Geltungsbereich_E3_1_1_UNECE_Gen2.RP_IF_EASV3_Temp_Warning_XIX_Grundumfang_XIX_Klima.DE_EASV3_Temp_Warning, system-signal=EASV3_Temp_Warning
        communication-direction=IN, data-element=Grundumfang_XIX_Klima.Geltungsbereich_E3_1_1_UNECE_Gen2.RP_IF_EASV4_Err_Blockierung_TF_XIX_Grundumfang_XIX_Klima.DE_EASV4_Err_Blockierung_TF, system-signal=EASV4_Err_Blockierung_TF
        communication-direction=IN, data-element=Grundumfang_XIX_Klima.Geltungsbereich_E3_1_1_UNECE_Gen2.RP_IF_EASV4_Err_Blockierung_TNCTOC_XIX_Grundumfang_XIX_Klima.DE_EASV4_Err_Blockierung_TNCTOC, system-signal=EASV4_Err_Blockierung_TNCTOC
        communication-direction=IN, data-element=Grundumfang_XIX_Klima.Geltungsbereich_E3_1_1_UNECE_Gen2.RP_IF_EASV4_Err_EDefekt_MoKomp_TF_XIX_Grundumfang_XIX_Klima.DE_EASV4_Err_EDefekt_MoKomp_TF, system-signal=EASV4_Err_EDefekt_MoKomp_TF
        communication-direction=IN, data-element=Grundumfang_XIX_Klima.Geltungsbereich_E3_1_1_UNECE_Gen2.RP_IF_EASV4_Err_EDefekt_MoKomp_TNCTOC_XIX_Grundumfang_XIX_Klima.DE_EASV4_Err_EDefekt_MoKomp_TNCTOC, system-signal=EASV4_Err_EDefekt_MoKomp_TNCTOC
        communication-direction=IN, data-element=Grundumfang_XIX_Klima.Geltungsbereich_E3_1_1_UNECE_Gen2.RP_IF_EASV4_Err_EDefekt_TSens_TF_XIX_Grundumfang_XIX_Klima.DE_EASV4_Err_EDefekt_TSens_TF, system-signal=EASV4_Err_EDefekt_TSens_TF
        communication-direction=IN, data-element=Grundumfang_XIX_Klima.Geltungsbereich_E3_1_1_UNECE_Gen2.RP_IF_EASV4_Err_EDefekt_TSens_TNCTOC_XIX_Grundumfang_XIX_Klima.DE_EASV4_Err_EDefekt_TSens_TNCTOC, system-signal=EASV4_Err_EDefekt_TSens_TNCTOC
        communication-direction=IN, data-element=Grundumfang_XIX_Klima.Geltungsbereich_E3_1_1_UNECE_Gen2.RP_IF_EASV4_Err_Notlaufpos_TF_XIX_Grundumfang_XIX_Klima.DE_EASV4_Err_Notlaufpos_TF, system-signal=EASV4_Err_Notlaufpos_TF
        communication-direction=IN, data-element=Grundumfang_XIX_Klima.Geltungsbereich_E3_1_1_UNECE_Gen2.RP_IF_EASV4_Err_Notlaufpos_TNCTOC_XIX_Grundumfang_XIX_Klima.DE_EASV4_Err_Notlaufpos_TNCTOC, system-signal=EASV4_Err_Notlaufpos_TNCTOC
        communication-direction=IN, data-element=Grundumfang_XIX_Klima.Geltungsbereich_E3_1_1_UNECE_Gen2.RP_IF_EASV4_Err_RAMROMNADChange_TF_XIX_Grundumfang_XIX_Klima.DE_EASV4_Err_RAMROMNADChange_TF, system-signal=EASV4_Err_RAMROMNADChange_TF
        communication-direction=IN, data-element=Grundumfang_XIX_Klima.Geltungsbereich_E3_1_1_UNECE_Gen2.RP_IF_EASV4_Err_RAMROMNADChange_TNCTOC_XIX_Grundumfang_XIX_Klima.DE_EASV4_Err_RAMROMNADChange_TNCTOC, system-signal=EASV4_Err_RAMROMNADChange_TNCTOC
        communication-direction=IN, data-element=Grundumfang_XIX_Klima.Geltungsbereich_E3_1_1_UNECE_Gen2.RP_IF_EASV4_Err_Ueberspannung_TF_XIX_Grundumfang_XIX_Klima.DE_EASV4_Err_Ueberspannung_TF, system-signal=EASV4_Err_Ueberspannung_TF
        communication-direction=IN, data-element=Grundumfang_XIX_Klima.Geltungsbereich_E3_1_1_UNECE_Gen2.RP_IF_EASV4_Err_Ueberspannung_TNCTOC_XIX_Grundumfang_XIX_Klima.DE_EASV4_Err_Ueberspannung_TNCTOC, system-signal=EASV4_Err_Ueberspannung_TNCTOC
        communication-direction=IN, data-element=Grundumfang_XIX_Klima.Geltungsbereich_E3_1_1_UNECE_Gen2.RP_IF_EASV4_Err_Uebertemperatur_TF_XIX_Grundumfang_XIX_Klima.DE_EASV4_Err_Uebertemperatur_TF, system-signal=EASV4_Err_Uebertemperatur_TF
        communication-direction=IN, data-element=Grundumfang_XIX_Klima.Geltungsbereich_E3_1_1_UNECE_Gen2.RP_IF_EASV4_Err_Uebertemperatur_TNCTOC_XIX_Grundumfang_XIX_Klima.DE_EASV4_Err_Uebertemperatur_TNCTOC, system-signal=EASV4_Err_Uebertemperatur_TNCTOC
        communication-direction=IN, data-element=Grundumfang_XIX_Klima.Geltungsbereich_E3_1_1_UNECE_Gen2.RP_IF_EASV4_Err_Unterspannung_TF_XIX_Grundumfang_XIX_Klima.DE_EASV4_Err_Unterspannung_TF, system-signal=EASV4_Err_Unterspannung_TF
        communication-direction=IN, data-element=Grundumfang_XIX_Klima.Geltungsbereich_E3_1_1_UNECE_Gen2.RP_IF_EASV4_Err_Unterspannung_TNCTOC_XIX_Grundumfang_XIX_Klima.DE_EASV4_Err_Unterspannung_TNCTOC, system-signal=EASV4_Err_Unterspannung_TNCTOC
        communication-direction=IN, data-element=Grundumfang_XIX_Klima.Geltungsbereich_E3_1_1_UNECE_Gen2.RP_IF_EASV4_ErrMem_State_XIX_Grundumfang_XIX_Klima.DE_EASV4_ErrMem_State, system-signal=EASV4_ErrMem_State
        communication-direction=IN, data-element=Grundumfang_XIX_Klima.Geltungsbereich_E3_1_1_UNECE_Gen2.RP_IF_EASV4_Geschwindigkeitsstatus_XIX_Grundumfang_XIX_Klima.DE_EASV4_Geschwindigkeitsstatus, system-signal=EASV4_Geschwindigkeitsstatus
        communication-direction=IN, data-element=Grundumfang_XIX_Klima.Geltungsbereich_E3_1_1_UNECE_Gen2.RP_IF_EASV4_Ist_Position_Aktuator_XIX_Grundumfang_XIX_Klima.DE_EASV4_Ist_Position_Aktuator, system-signal=EASV4_Ist_Position_Aktuator
        communication-direction=IN, data-element=Grundumfang_XIX_Klima.Geltungsbereich_E3_1_1_UNECE_Gen2.RP_IF_EASV4_ResponseError_XIX_Grundumfang_XIX_Klima.DE_EASV4_ResponseError, system-signal=EASV4_ResponseError
        communication-direction=IN, data-element=Grundumfang_XIX_Klima.Geltungsbereich_E3_1_1_UNECE_Gen2.RP_IF_EASV4_ResponseError_TNCTOC_XIX_Grundumfang_XIX_Klima.DE_EASV4_ResponseError_TNCTOC, system-signal=EASV4_ResponseError_TNCTOC
        communication-direction=IN, data-element=Grundumfang_XIX_Klima.Geltungsbereich_E3_1_1_UNECE_Gen2.RP_IF_EASV4_Spulenbestromung_XIX_Grundumfang_XIX_Klima.DE_EASV4_Spulenbestromung, system-signal=EASV4_Spulenbestromung
        communication-direction=IN, data-element=Grundumfang_XIX_Klima.Geltungsbereich_E3_1_1_UNECE_Gen2.RP_IF_EASV4_Temp_XIX_Grundumfang_XIX_Klima.DE_EASV4_Temp, system-signal=EASV4_Temp
        communication-direction=IN, data-element=Grundumfang_XIX_Klima.Geltungsbereich_E3_1_1_UNECE_Gen2.RP_IF_EASV4_Temp_Warning_XIX_Grundumfang_XIX_Klima.DE_EASV4_Temp_Warning, system-signal=EASV4_Temp_Warning
        communication-direction=IN, data-element=Grundumfang_XIX_Klima.Geltungsbereich_E3_1_1_UNECE_Gen2.RP_IF_EASV5_Err_Blockierung_TF_XIX_Grundumfang_XIX_Klima.DE_EASV5_Err_Blockierung_TF, system-signal=EASV5_Err_Blockierung_TF
        communication-direction=IN, data-element=Grundumfang_XIX_Klima.Geltungsbereich_E3_1_1_UNECE_Gen2.RP_IF_EASV5_Err_Blockierung_TNCTOC_XIX_Grundumfang_XIX_Klima.DE_EASV5_Err_Blockierung_TNCTOC, system-signal=EASV5_Err_Blockierung_TNCTOC
        communication-direction=IN, data-element=Grundumfang_XIX_Klima.Geltungsbereich_E3_1_1_UNECE_Gen2.RP_IF_EASV5_Err_EDefekt_MoKomp_TF_XIX_Grundumfang_XIX_Klima.DE_EASV5_Err_EDefekt_MoKomp_TF, system-signal=EASV5_Err_EDefekt_MoKomp_TF
        communication-direction=IN, data-element=Grundumfang_XIX_Klima.Geltungsbereich_E3_1_1_UNECE_Gen2.RP_IF_EASV5_Err_EDefekt_MoKomp_TNCTOC_XIX_Grundumfang_XIX_Klima.DE_EASV5_Err_EDefekt_MoKomp_TNCTOC, system-signal=EASV5_Err_EDefekt_MoKomp_TNCTOC
        communication-direction=IN, data-element=Grundumfang_XIX_Klima.Geltungsbereich_E3_1_1_UNECE_Gen2.RP_IF_EASV5_Err_EDefekt_TSens_TF_XIX_Grundumfang_XIX_Klima.DE_EASV5_Err_EDefekt_TSens_TF, system-signal=EASV5_Err_EDefekt_TSens_TF
        communication-direction=IN, data-element=Grundumfang_XIX_Klima.Geltungsbereich_E3_1_1_UNECE_Gen2.RP_IF_EASV5_Err_EDefekt_TSens_TNCTOC_XIX_Grundumfang_XIX_Klima.DE_EASV5_Err_EDefekt_TSens_TNCTOC, system-signal=EASV5_Err_EDefekt_TSens_TNCTOC
        communication-direction=IN, data-element=Grundumfang_XIX_Klima.Geltungsbereich_E3_1_1_UNECE_Gen2.RP_IF_EASV5_Err_Notlaufpos_TF_XIX_Grundumfang_XIX_Klima.DE_EASV5_Err_Notlaufpos_TF, system-signal=EASV5_Err_Notlaufpos_TF
        communication-direction=IN, data-element=Grundumfang_XIX_Klima.Geltungsbereich_E3_1_1_UNECE_Gen2.RP_IF_EASV5_Err_Notlaufpos_TNCTOC_XIX_Grundumfang_XIX_Klima.DE_EASV5_Err_Notlaufpos_TNCTOC, system-signal=EASV5_Err_Notlaufpos_TNCTOC
        communication-direction=IN, data-element=Grundumfang_XIX_Klima.Geltungsbereich_E3_1_1_UNECE_Gen2.RP_IF_EASV5_Err_RAMROMNADChange_TF_XIX_Grundumfang_XIX_Klima.DE_EASV5_Err_RAMROMNADChange_TF, system-signal=EASV5_Err_RAMROMNADChange_TF
        communication-direction=IN, data-element=Grundumfang_XIX_Klima.Geltungsbereich_E3_1_1_UNECE_Gen2.RP_IF_EASV5_Err_RAMROMNADChange_TNCTOC_XIX_Grundumfang_XIX_Klima.DE_EASV5_Err_RAMROMNADChange_TNCTOC, system-signal=EASV5_Err_RAMROMNADChange_TNCTOC
        communication-direction=IN, data-element=Grundumfang_XIX_Klima.Geltungsbereich_E3_1_1_UNECE_Gen2.RP_IF_EASV5_Err_Ueberspannung_TF_XIX_Grundumfang_XIX_Klima.DE_EASV5_Err_Ueberspannung_TF, system-signal=EASV5_Err_Ueberspannung_TF
        communication-direction=IN, data-element=Grundumfang_XIX_Klima.Geltungsbereich_E3_1_1_UNECE_Gen2.RP_IF_EASV5_Err_Ueberspannung_TNCTOC_XIX_Grundumfang_XIX_Klima.DE_EASV5_Err_Ueberspannung_TNCTOC, system-signal=EASV5_Err_Ueberspannung_TNCTOC
        communication-direction=IN, data-element=Grundumfang_XIX_Klima.Geltungsbereich_E3_1_1_UNECE_Gen2.RP_IF_EASV5_Err_Uebertemperatur_TF_XIX_Grundumfang_XIX_Klima.DE_EASV5_Err_Uebertemperatur_TF, system-signal=EASV5_Err_Uebertemperatur_TF
        communication-direction=IN, data-element=Grundumfang_XIX_Klima.Geltungsbereich_E3_1_1_UNECE_Gen2.RP_IF_EASV5_Err_Uebertemperatur_TNCTOC_XIX_Grundumfang_XIX_Klima.DE_EASV5_Err_Uebertemperatur_TNCTOC, system-signal=EASV5_Err_Uebertemperatur_TNCTOC
        communication-direction=IN, data-element=Grundumfang_XIX_Klima.Geltungsbereich_E3_1_1_UNECE_Gen2.RP_IF_EASV5_Err_Unterspannung_TF_XIX_Grundumfang_XIX_Klima.DE_EASV5_Err_Unterspannung_TF, system-signal=EASV5_Err_Unterspannung_TF
        communication-direction=IN, data-element=Grundumfang_XIX_Klima.Geltungsbereich_E3_1_1_UNECE_Gen2.RP_IF_EASV5_Err_Unterspannung_TNCTOC_XIX_Grundumfang_XIX_Klima.DE_EASV5_Err_Unterspannung_TNCTOC, system-signal=EASV5_Err_Unterspannung_TNCTOC
        communication-direction=IN, data-element=Grundumfang_XIX_Klima.Geltungsbereich_E3_1_1_UNECE_Gen2.RP_IF_EASV5_ErrMem_State_XIX_Grundumfang_XIX_Klima.DE_EASV5_ErrMem_State, system-signal=EASV5_ErrMem_State
        communication-direction=IN, data-element=Grundumfang_XIX_Klima.Geltungsbereich_E3_1_1_UNECE_Gen2.RP_IF_EASV5_Geschwindigkeitsstatus_XIX_Grundumfang_XIX_Klima.DE_EASV5_Geschwindigkeitsstatus, system-signal=EASV5_Geschwindigkeitsstatus
        communication-direction=IN, data-element=Grundumfang_XIX_Klima.Geltungsbereich_E3_1_1_UNECE_Gen2.RP_IF_EASV5_Ist_Position_Aktuator_XIX_Grundumfang_XIX_Klima.DE_EASV5_Ist_Position_Aktuator, system-signal=EASV5_Ist_Position_Aktuator
        communication-direction=IN, data-element=Grundumfang_XIX_Klima.Geltungsbereich_E3_1_1_UNECE_Gen2.RP_IF_EASV5_ResponseError_XIX_Grundumfang_XIX_Klima.DE_EASV5_ResponseError, system-signal=EASV5_ResponseError
        communication-direction=IN, data-element=Grundumfang_XIX_Klima.Geltungsbereich_E3_1_1_UNECE_Gen2.RP_IF_EASV5_ResponseError_TNCTOC_XIX_Grundumfang_XIX_Klima.DE_EASV5_ResponseError_TNCTOC, system-signal=EASV5_ResponseError_TNCTOC
        communication-direction=IN, data-element=Grundumfang_XIX_Klima.Geltungsbereich_E3_1_1_UNECE_Gen2.RP_IF_EASV5_Spulenbestromung_XIX_Grundumfang_XIX_Klima.DE_EASV5_Spulenbestromung, system-signal=EASV5_Spulenbestromung
        communication-direction=IN, data-element=Grundumfang_XIX_Klima.Geltungsbereich_E3_1_1_UNECE_Gen2.RP_IF_EASV5_temp_XIX_Grundumfang_XIX_Klima.DE_EASV5_temp, system-signal=EASV5_temp
        communication-direction=IN, data-element=Grundumfang_XIX_Klima.Geltungsbereich_E3_1_1_UNECE_Gen2.RP_IF_EASV5_Temp_Warning_XIX_Grundumfang_XIX_Klima.DE_EASV5_Temp_Warning, system-signal=EASV5_Temp_Warning
        communication-direction=IN, data-element=Grundumfang_XIX_Klima.Geltungsbereich_E3_1_1_UNECE_Gen2.RP_IF_eCall_Funktionsstatus_02_XIX_Grundumfang_XIX_Klima.DE_eCall_Funktionsstatus_02, system-signal=eCall_Funktionsstatus_02
        communication-direction=IN, data-element=Grundumfang_XIX_Klima.Geltungsbereich_E3_1_1_UNECE_Gen2.RP_IF_EKK4_Comp_Error_Mask_Nr_XIX_Grundumfang_XIX_Klima.DE_EKK4_Comp_Error_Mask_Nr, system-signal=EKK4_Comp_Error_Mask_Nr
        communication-direction=IN, data-element=Grundumfang_XIX_Klima.Geltungsbereich_E3_1_1_UNECE_Gen2.RP_IF_EKK4_COMP_SPEED_XIX_Grundumfang_XIX_Klima.DE_EKK4_COMP_SPEED, system-signal=EKK4_COMP_SPEED
        communication-direction=IN, data-element=Grundumfang_XIX_Klima.Geltungsbereich_E3_1_1_UNECE_Gen2.RP_IF_EKK4_COMP_ST_XIX_Grundumfang_XIX_Klima.DE_EKK4_COMP_ST, system-signal=EKK4_COMP_ST
        communication-direction=IN, data-element=Grundumfang_XIX_Klima.Geltungsbereich_E3_1_1_UNECE_Gen2.RP_IF_EKK4_Err_Ind_Nr_1_8_15_22_XIX_Grundumfang_XIX_Klima.DE_EKK4_Err_Ind_Nr_1_8_15_22, system-signal=EKK4_Err_Ind_Nr_1_8_15_22
        communication-direction=IN, data-element=Grundumfang_XIX_Klima.Geltungsbereich_E3_1_1_UNECE_Gen2.RP_IF_EKK4_Err_Ind_Nr_2_9_16_23_XIX_Grundumfang_XIX_Klima.DE_EKK4_Err_Ind_Nr_2_9_16_23, system-signal=EKK4_Err_Ind_Nr_2_9_16_23
        communication-direction=IN, data-element=Grundumfang_XIX_Klima.Geltungsbereich_E3_1_1_UNECE_Gen2.RP_IF_EKK4_Err_Ind_Nr_3_10_17_24_XIX_Grundumfang_XIX_Klima.DE_EKK4_Err_Ind_Nr_3_10_17_24, system-signal=EKK4_Err_Ind_Nr_3_10_17_24
        communication-direction=IN, data-element=Grundumfang_XIX_Klima.Geltungsbereich_E3_1_1_UNECE_Gen2.RP_IF_EKK4_Err_Ind_Nr_4_11_18_25_XIX_Grundumfang_XIX_Klima.DE_EKK4_Err_Ind_Nr_4_11_18_25, system-signal=EKK4_Err_Ind_Nr_4_11_18_25
        communication-direction=IN, data-element=Grundumfang_XIX_Klima.Geltungsbereich_E3_1_1_UNECE_Gen2.RP_IF_EKK4_Err_Ind_Nr_5_12_19_26_XIX_Grundumfang_XIX_Klima.DE_EKK4_Err_Ind_Nr_5_12_19_26, system-signal=EKK4_Err_Ind_Nr_5_12_19_26
        communication-direction=IN, data-element=Grundumfang_XIX_Klima.Geltungsbereich_E3_1_1_UNECE_Gen2.RP_IF_EKK4_Err_Ind_Nr_6_13_20_27_XIX_Grundumfang_XIX_Klima.DE_EKK4_Err_Ind_Nr_6_13_20_27, system-signal=EKK4_Err_Ind_Nr_6_13_20_27
        communication-direction=IN, data-element=Grundumfang_XIX_Klima.Geltungsbereich_E3_1_1_UNECE_Gen2.RP_IF_EKK4_Err_Ind_Nr_7_14_21_28_XIX_Grundumfang_XIX_Klima.DE_EKK4_Err_Ind_Nr_7_14_21_28, system-signal=EKK4_Err_Ind_Nr_7_14_21_28
        communication-direction=IN, data-element=Grundumfang_XIX_Klima.Geltungsbereich_E3_1_1_UNECE_Gen2.RP_IF_EKK4_Err_Ind_TF_1_7_XIX_Grundumfang_XIX_Klima.DE_EKK4_Err_Ind_TF_1_7, system-signal=EKK4_Err_Ind_TF_1_7
        communication-direction=IN, data-element=Grundumfang_XIX_Klima.Geltungsbereich_E3_1_1_UNECE_Gen2.RP_IF_EKK4_Err_Ind_TF_2_8_XIX_Grundumfang_XIX_Klima.DE_EKK4_Err_Ind_TF_2_8, system-signal=EKK4_Err_Ind_TF_2_8
        communication-direction=IN, data-element=Grundumfang_XIX_Klima.Geltungsbereich_E3_1_1_UNECE_Gen2.RP_IF_EKK4_Err_Ind_TF_3_9_XIX_Grundumfang_XIX_Klima.DE_EKK4_Err_Ind_TF_3_9, system-signal=EKK4_Err_Ind_TF_3_9
        communication-direction=IN, data-element=Grundumfang_XIX_Klima.Geltungsbereich_E3_1_1_UNECE_Gen2.RP_IF_EKK4_Err_Ind_TF_4_10_XIX_Grundumfang_XIX_Klima.DE_EKK4_Err_Ind_TF_4_10, system-signal=EKK4_Err_Ind_TF_4_10
        communication-direction=IN, data-element=Grundumfang_XIX_Klima.Geltungsbereich_E3_1_1_UNECE_Gen2.RP_IF_EKK4_Err_Ind_TF_5_11_XIX_Grundumfang_XIX_Klima.DE_EKK4_Err_Ind_TF_5_11, system-signal=EKK4_Err_Ind_TF_5_11
        communication-direction=IN, data-element=Grundumfang_XIX_Klima.Geltungsbereich_E3_1_1_UNECE_Gen2.RP_IF_EKK4_Err_Ind_TF_6_12_XIX_Grundumfang_XIX_Klima.DE_EKK4_Err_Ind_TF_6_12, system-signal=EKK4_Err_Ind_TF_6_12
        communication-direction=IN, data-element=Grundumfang_XIX_Klima.Geltungsbereich_E3_1_1_UNECE_Gen2.RP_IF_EKK4_ErrMem_State_XIX_Grundumfang_XIX_Klima.DE_EKK4_ErrMem_State, system-signal=EKK4_ErrMem_State
        communication-direction=IN, data-element=Grundumfang_XIX_Klima.Geltungsbereich_E3_1_1_UNECE_Gen2.RP_IF_EKK4_Fehler_AE_XIX_Grundumfang_XIX_Klima.DE_EKK4_Fehler_AE, system-signal=EKK4_Fehler_AE
        communication-direction=IN, data-element=Grundumfang_XIX_Klima.Geltungsbereich_E3_1_1_UNECE_Gen2.RP_IF_EKK4_HIGH_VOLTAGE_XIX_Grundumfang_XIX_Klima.DE_EKK4_HIGH_VOLTAGE, system-signal=EKK4_HIGH_VOLTAGE
        communication-direction=IN, data-element=Grundumfang_XIX_Klima.Geltungsbereich_E3_1_1_UNECE_Gen2.RP_IF_EKK4_INPUT_CURRENT_XIX_Grundumfang_XIX_Klima.DE_EKK4_INPUT_CURRENT, system-signal=EKK4_INPUT_CURRENT
        communication-direction=IN, data-element=Grundumfang_XIX_Klima.Geltungsbereich_E3_1_1_UNECE_Gen2.RP_IF_EKK4_INV_TEMP_XIX_Grundumfang_XIX_Klima.DE_EKK4_INV_TEMP, system-signal=EKK4_INV_TEMP
        communication-direction=IN, data-element=Grundumfang_XIX_Klima.Geltungsbereich_E3_1_1_UNECE_Gen2.RP_IF_EKK4_Level_Rsp_XIX_Grundumfang_XIX_Klima.DE_EKK4_Level_Rsp, system-signal=EKK4_Level_Rsp
        communication-direction=IN, data-element=Grundumfang_XIX_Klima.Geltungsbereich_E3_1_1_UNECE_Gen2.RP_IF_EKK4_Match_XIX_Grundumfang_XIX_Klima.DE_EKK4_Match, system-signal=EKK4_Match
        communication-direction=IN, data-element=Grundumfang_XIX_Klima.Geltungsbereich_E3_1_1_UNECE_Gen2.RP_IF_EKK4_MUX_Err_Ind_XIX_Grundumfang_XIX_Klima.DE_EKK4_MUX_Err_Ind, system-signal=EKK4_MUX_Err_Ind
        communication-direction=IN, data-element=Grundumfang_XIX_Klima.Geltungsbereich_E3_1_1_UNECE_Gen2.RP_IF_EKK4_Number_of_Err_Ind_TF_XIX_Grundumfang_XIX_Klima.DE_EKK4_Number_of_Err_Ind_TF, system-signal=EKK4_Number_of_Err_Ind_TF
        communication-direction=IN, data-element=Grundumfang_XIX_Klima.Geltungsbereich_E3_1_1_UNECE_Gen2.RP_IF_EKK4_ParameterChange_XIX_Grundumfang_XIX_Klima.DE_EKK4_ParameterChange, system-signal=EKK4_ParameterChange
        communication-direction=IN, data-element=Grundumfang_XIX_Klima.Geltungsbereich_E3_1_1_UNECE_Gen2.RP_IF_EKK4_Q_High_Voltage_XIX_Grundumfang_XIX_Klima.DE_EKK4_Q_High_Voltage, system-signal=EKK4_Q_High_Voltage
        communication-direction=IN, data-element=Grundumfang_XIX_Klima.Geltungsbereich_E3_1_1_UNECE_Gen2.RP_IF_EKK4_Reason_Err_Ind_TF_1_7_XIX_Grundumfang_XIX_Klima.DE_EKK4_Reason_Err_Ind_TF_1_7, system-signal=EKK4_Reason_Err_Ind_TF_1_7
        communication-direction=IN, data-element=Grundumfang_XIX_Klima.Geltungsbereich_E3_1_1_UNECE_Gen2.RP_IF_EKK4_Reason_Err_Ind_TF_2_8_XIX_Grundumfang_XIX_Klima.DE_EKK4_Reason_Err_Ind_TF_2_8, system-signal=EKK4_Reason_Err_Ind_TF_2_8
        communication-direction=IN, data-element=Grundumfang_XIX_Klima.Geltungsbereich_E3_1_1_UNECE_Gen2.RP_IF_EKK4_Reason_Err_Ind_TF_3_9_XIX_Grundumfang_XIX_Klima.DE_EKK4_Reason_Err_Ind_TF_3_9, system-signal=EKK4_Reason_Err_Ind_TF_3_9
        communication-direction=IN, data-element=Grundumfang_XIX_Klima.Geltungsbereich_E3_1_1_UNECE_Gen2.RP_IF_EKK4_Reason_Err_Ind_TF_4_10_XIX_Grundumfang_XIX_Klima.DE_EKK4_Reason_Err_Ind_TF_4_10, system-signal=EKK4_Reason_Err_Ind_TF_4_10
        communication-direction=IN, data-element=Grundumfang_XIX_Klima.Geltungsbereich_E3_1_1_UNECE_Gen2.RP_IF_EKK4_Reason_Err_Ind_TF_5_11_XIX_Grundumfang_XIX_Klima.DE_EKK4_Reason_Err_Ind_TF_5_11, system-signal=EKK4_Reason_Err_Ind_TF_5_11
        communication-direction=IN, data-element=Grundumfang_XIX_Klima.Geltungsbereich_E3_1_1_UNECE_Gen2.RP_IF_EKK4_Reason_Err_Ind_TF_6_12_XIX_Grundumfang_XIX_Klima.DE_EKK4_Reason_Err_Ind_TF_6_12, system-signal=EKK4_Reason_Err_Ind_TF_6_12
        communication-direction=IN, data-element=Grundumfang_XIX_Klima.Geltungsbereich_E3_1_1_UNECE_Gen2.RP_IF_EKK4_ResponseError_XIX_Grundumfang_XIX_Klima.DE_EKK4_ResponseError, system-signal=EKK4_ResponseError
        communication-direction=IN, data-element=Grundumfang_XIX_Klima.Geltungsbereich_E3_1_1_UNECE_Gen2.RP_IF_EKK4_TF_Change_XIX_Grundumfang_XIX_Klima.DE_EKK4_TF_Change, system-signal=EKK4_TF_Change
        communication-direction=OUT, data-element=Grundumfang_XIX_Klima.Geltungsbereich_E3_1_1_UNECE_Gen2.SP_IF_EKK_Active_Discharge_XIX_Grundumfang_XIX_Klima.DE_EKK_Active_Discharge, system-signal=EKK_Active_Discharge
        communication-direction=OUT, data-element=Grundumfang_XIX_Klima.Geltungsbereich_E3_1_1_UNECE_Gen2.SP_IF_EKK_ENB_COMP_XIX_Grundumfang_XIX_Klima.DE_EKK_ENB_COMP, system-signal=EKK_ENB_COMP
        communication-direction=OUT, data-element=Grundumfang_XIX_Klima.Geltungsbereich_E3_1_1_UNECE_Gen2.SP_IF_EKK_HV_ST_XIX_Grundumfang_XIX_Klima.DE_EKK_HV_ST, system-signal=EKK_HV_ST
        communication-direction=OUT, data-element=Grundumfang_XIX_Klima.Geltungsbereich_E3_1_1_UNECE_Gen2.SP_IF_EKK_KL_15_Status_XIX_Grundumfang_XIX_Klima.DE_EKK_KL_15_Status, system-signal=EKK_KL_15_Status
        communication-direction=OUT, data-element=Grundumfang_XIX_Klima.Geltungsbereich_E3_1_1_UNECE_Gen2.SP_IF_EKK_REQ_COMP_SPEED_XIX_Grundumfang_XIX_Klima.DE_EKK_REQ_COMP_SPEED, system-signal=EKK_REQ_COMP_SPEED
        communication-direction=OUT, data-element=Grundumfang_XIX_Klima.Geltungsbereich_E3_1_1_UNECE_Gen2.SP_IF_EKK_REQ_COMP_SPEED_HiRes_XIX_Grundumfang_XIX_Klima.DE_EKK_REQ_COMP_SPEED_HiRes, system-signal=EKK_REQ_COMP_SPEED_HiRes
        communication-direction=OUT, data-element=Grundumfang_XIX_Klima.Geltungsbereich_E3_1_1_UNECE_Gen2.SP_IF_EKKe_Error_Mask_Nr_XIX_Grundumfang_XIX_Klima.DE_EKKe_Error_Mask_Nr, system-signal=EKKe_Error_Mask_Nr
        communication-direction=OUT, data-element=Grundumfang_XIX_Klima.Geltungsbereich_E3_1_1_UNECE_Gen2.SP_IF_EKKe_Level_REQ_XIX_Grundumfang_XIX_Klima.DE_EKKe_Level_REQ, system-signal=EKKe_Level_REQ
        communication-direction=OUT, data-element=Grundumfang_XIX_Klima.Geltungsbereich_E3_1_1_UNECE_Gen2.SP_IF_EKKe_Q_Mask_XIX_Grundumfang_XIX_Klima.DE_EKKe_Q_Mask, system-signal=EKKe_Q_Mask
        communication-direction=IN, data-element=Grundumfang_XIX_Klima.Geltungsbereich_E3_1_1_UNECE_Gen2.RP_IF_EM1_MinVorlauftemperatur_XIX_Grundumfang_XIX_Klima.DE_EM1_MinVorlauftemperatur, system-signal=EM1_MinVorlauftemperatur
        communication-direction=OUT, data-element=Grundumfang_XIX_Klima.Geltungsbereich_E3_1_1_UNECE_Gen2.SP_IF_Empfindlichkeit_AQS_XIX_Grundumfang_XIX_Klima.DE_Empfindlichkeit_AQS, system-signal=Empfindlichkeit_AQS
        communication-direction=IN, data-element=Grundumfang_XIX_Klima.Geltungsbereich_E3_1_1_UNECE_Gen2.RP_IF_ESC_Anf_KV_XIX_Grundumfang_XIX_Klima.DE_ESC_Anf_KV, system-signal=ESC_Anf_KV
        communication-direction=IN, data-element=Grundumfang_XIX_Klima.Geltungsbereich_E3_1_1_UNECE_Gen2.RP_IF_ESC_Anf_Mindestreku_XIX_Grundumfang_XIX_Klima.DE_ESC_Anf_Mindestreku, system-signal=ESC_Anf_Mindestreku
        communication-direction=IN, data-element=Grundumfang_XIX_Klima.Geltungsbereich_E3_1_1_UNECE_Gen2.RP_IF_ESP_QBit_v_Signal_XIX_Grundumfang_XIX_Klima.DE_ESP_QBit_v_Signal, system-signal=ESP_QBit_v_Signal
        communication-direction=IN, data-element=Grundumfang_XIX_Klima.Geltungsbereich_E3_1_1_UNECE_Gen2.RP_IF_ESP_v_Signal_XIX_Grundumfang_XIX_Klima.DE_ESP_v_Signal, system-signal=ESP_v_Signal
        communication-direction=OUT, data-element=Grundumfang_XIX_Klima.Geltungsbereich_E3_1_1_UNECE_Gen2.SP_IF_ESP_v_Signal_8Bit_XIX_Grundumfang_XIX_Klima.DE_ESP_v_Signal_8Bit, system-signal=ESP_v_Signal_8Bit
        communication-direction=IN, data-element=Grundumfang_XIX_Klima.Geltungsbereich_E3_1_1_UNECE_Gen2.RP_IF_eTM_Batterieheizen_Anf_XIX_Grundumfang_XIX_Klima.DE_eTM_Batterieheizen_Anf, system-signal=eTM_Batterieheizen_Anf
        communication-direction=IN, data-element=Grundumfang_XIX_Klima.Geltungsbereich_E3_1_1_UNECE_Gen2.RP_IF_eTM_BMS_Pumpe1_Befuellung_XIX_Grundumfang_XIX_Klima.DE_eTM_BMS_Pumpe1_Befuellung, system-signal=eTM_BMS_Pumpe1_Befuellung
        communication-direction=IN, data-element=Grundumfang_XIX_Klima.Geltungsbereich_E3_1_1_UNECE_Gen2.RP_IF_eTM_BMS_Pumpe1_SollAnsteuerung_XIX_Grundumfang_XIX_Klima.DE_eTM_BMS_Pumpe1_SollAnsteuerung, system-signal=eTM_BMS_Pumpe1_SollAnsteuerung
        communication-direction=IN, data-element=Grundumfang_XIX_Klima.Geltungsbereich_E3_1_1_UNECE_Gen2.RP_IF_eTM_BMS_ThermischeIstLeistung_XIX_Grundumfang_XIX_Klima.DE_eTM_BMS_ThermischeIstLeistung, system-signal=eTM_BMS_ThermischeIstLeistung
        communication-direction=IN, data-element=Grundumfang_XIX_Klima.Geltungsbereich_E3_1_1_UNECE_Gen2.RP_IF_eTM_BMS_Ventil1_Befuellung_XIX_Grundumfang_XIX_Klima.DE_eTM_BMS_Ventil1_Befuellung, system-signal=eTM_BMS_Ventil1_Befuellung
        communication-direction=IN, data-element=Grundumfang_XIX_Klima.Geltungsbereich_E3_1_1_UNECE_Gen2.RP_IF_eTM_BMS_Ventil2_Befuellung_XIX_Grundumfang_XIX_Klima.DE_eTM_BMS_Ventil2_Befuellung, system-signal=eTM_BMS_Ventil2_Befuellung
        communication-direction=IN, data-element=Grundumfang_XIX_Klima.Geltungsbereich_E3_1_1_UNECE_Gen2.RP_IF_eTM_HVBatt_IstVolumenstrom_XIX_Grundumfang_XIX_Klima.DE_eTM_HVBatt_IstVolumenstrom, system-signal=eTM_HVBatt_IstVolumenstrom
        communication-direction=IN, data-element=Grundumfang_XIX_Klima.Geltungsbereich_E3_1_1_UNECE_Gen2.RP_IF_eTM_HWT_IstVolumenstrom_XIX_Grundumfang_XIX_Klima.DE_eTM_HWT_IstVolumenstrom, system-signal=eTM_HWT_IstVolumenstrom
        communication-direction=IN, data-element=Grundumfang_XIX_Klima.Geltungsbereich_E3_1_1_UNECE_Gen2.RP_IF_eTM_Ist_rLM_XIX_Grundumfang_XIX_Klima.DE_eTM_Ist_rLM, system-signal=eTM_Ist_rLM
        communication-direction=IN, data-element=Grundumfang_XIX_Klima.Geltungsbereich_E3_1_1_UNECE_Gen2.RP_IF_eTM_Kuehlung_Status_XIX_Grundumfang_XIX_Klima.DE_eTM_Kuehlung_Status, system-signal=eTM_Kuehlung_Status
        communication-direction=IN, data-element=Grundumfang_XIX_Klima.Geltungsbereich_E3_1_1_UNECE_Gen2.RP_IF_eTM_Pumpe1_Status_XIX_Grundumfang_XIX_Klima.DE_eTM_Pumpe1_Status, system-signal=eTM_Pumpe1_Status
        communication-direction=IN, data-element=Grundumfang_XIX_Klima.Geltungsbereich_E3_1_1_UNECE_Gen2.RP_IF_eTM_Pumpe1_Volumenstrom_XIX_Grundumfang_XIX_Klima.DE_eTM_Pumpe1_Volumenstrom, system-signal=eTM_Pumpe1_Volumenstrom
        communication-direction=IN, data-element=Grundumfang_XIX_Klima.Geltungsbereich_E3_1_1_UNECE_Gen2.RP_IF_eTM_Pumpe2_Status_XIX_Grundumfang_XIX_Klima.DE_eTM_Pumpe2_Status, system-signal=eTM_Pumpe2_Status
        communication-direction=IN, data-element=Grundumfang_XIX_Klima.Geltungsbereich_E3_1_1_UNECE_Gen2.RP_IF_eTM_Pumpe2_Volumenstrom_XIX_Grundumfang_XIX_Klima.DE_eTM_Pumpe2_Volumenstrom, system-signal=eTM_Pumpe2_Volumenstrom
        communication-direction=IN, data-element=Grundumfang_XIX_Klima.Geltungsbereich_E3_1_1_UNECE_Gen2.RP_IF_eTM_PumpeAntrieb_Ansteuerung_XIX_Grundumfang_XIX_Klima.DE_eTM_PumpeAntrieb_Ansteuerung, system-signal=eTM_PumpeAntrieb_Ansteuerung
        communication-direction=IN, data-element=Grundumfang_XIX_Klima.Geltungsbereich_E3_1_1_UNECE_Gen2.RP_IF_eTM_PumpeBat_Ansteuerung_XIX_Grundumfang_XIX_Klima.DE_eTM_PumpeBat_Ansteuerung, system-signal=eTM_PumpeBat_Ansteuerung
        communication-direction=IN, data-element=Grundumfang_XIX_Klima.Geltungsbereich_E3_1_1_UNECE_Gen2.RP_IF_eTM_PumpeHWT_Ansteuerung_XIX_Grundumfang_XIX_Klima.DE_eTM_PumpeHWT_Ansteuerung, system-signal=eTM_PumpeHWT_Ansteuerung
        communication-direction=IN, data-element=Grundumfang_XIX_Klima.Geltungsbereich_E3_1_1_UNECE_Gen2.RP_IF_eTM_PV1_Ansteuerung_XIX_Grundumfang_XIX_Klima.DE_eTM_PV1_Ansteuerung, system-signal=eTM_PV1_Ansteuerung
        communication-direction=IN, data-element=Grundumfang_XIX_Klima.Geltungsbereich_E3_1_1_UNECE_Gen2.RP_IF_eTM_PV2_Ansteuerung_XIX_Grundumfang_XIX_Klima.DE_eTM_PV2_Ansteuerung, system-signal=eTM_PV2_Ansteuerung
        communication-direction=IN, data-element=Grundumfang_XIX_Klima.Geltungsbereich_E3_1_1_UNECE_Gen2.RP_IF_eTM_PWR_MinVorlaufTemp_XIX_Grundumfang_XIX_Klima.DE_eTM_PWR_MinVorlaufTemp, system-signal=eTM_PWR_MinVorlaufTemp
        communication-direction=IN, data-element=Grundumfang_XIX_Klima.Geltungsbereich_E3_1_1_UNECE_Gen2.RP_IF_eTM_Temperatur_1_XIX_Grundumfang_XIX_Klima.DE_eTM_Temperatur_1, system-signal=eTM_Temperatur_1
        communication-direction=IN, data-element=Grundumfang_XIX_Klima.Geltungsbereich_E3_1_1_UNECE_Gen2.RP_IF_eTM_Temperatur_2_XIX_Grundumfang_XIX_Klima.DE_eTM_Temperatur_2, system-signal=eTM_Temperatur_2
        communication-direction=IN, data-element=Grundumfang_XIX_Klima.Geltungsbereich_E3_1_1_UNECE_Gen2.RP_IF_eTM_Ventil{1..3}_Status_XIX_Grundumfang_XIX_Klima.DE_eTM_Ventil{1..3}_Status, system-signal=eTM_Ventil{1..3}_Status
        communication-direction=IN, data-element=Grundumfang_XIX_Klima.Geltungsbereich_E3_1_1_UNECE_Gen2.RP_IF_eTM_Wasserheizer_IstVolumenstrom_XIX_Grundumfang_XIX_Klima.DE_eTM_Wasserheizer_IstVolumenstrom, system-signal=eTM_Wasserheizer_IstVolumenstrom
        communication-direction=IN, data-element=Grundumfang_XIX_Klima.Geltungsbereich_E3_1_1_UNECE_Gen2.RP_IF_eTM_Wasserheizer_SollTemp_Ausgng_XIX_Grundumfang_XIX_Klima.DE_eTM_Wasserheizer_SollTemp_Ausgng, system-signal=eTM_Wasserheizer_SollTemp_Ausgng
        communication-direction=IN, data-element=Grundumfang_XIX_Klima.Geltungsbereich_E3_1_1_UNECE_Gen2.RP_IF_EXV1_Err_Blockierung_TF_XIX_Grundumfang_XIX_Klima.DE_EXV1_Err_Blockierung_TF, system-signal=EXV1_Err_Blockierung_TF
        communication-direction=IN, data-element=Grundumfang_XIX_Klima.Geltungsbereich_E3_1_1_UNECE_Gen2.RP_IF_EXV1_Err_Blockierung_TNCTOC_XIX_Grundumfang_XIX_Klima.DE_EXV1_Err_Blockierung_TNCTOC, system-signal=EXV1_Err_Blockierung_TNCTOC
        communication-direction=IN, data-element=Grundumfang_XIX_Klima.Geltungsbereich_E3_1_1_UNECE_Gen2.RP_IF_EXV1_Err_EDefekt_MoKomp_TF_XIX_Grundumfang_XIX_Klima.DE_EXV1_Err_EDefekt_MoKomp_TF, system-signal=EXV1_Err_EDefekt_MoKomp_TF
        communication-direction=IN, data-element=Grundumfang_XIX_Klima.Geltungsbereich_E3_1_1_UNECE_Gen2.RP_IF_EXV1_Err_EDefekt_MoKomp_TNCTOC_XIX_Grundumfang_XIX_Klima.DE_EXV1_Err_EDefekt_MoKomp_TNCTOC, system-signal=EXV1_Err_EDefekt_MoKomp_TNCTOC
        communication-direction=IN, data-element=Grundumfang_XIX_Klima.Geltungsbereich_E3_1_1_UNECE_Gen2.RP_IF_EXV1_Err_EDefekt_TSens_TF_XIX_Grundumfang_XIX_Klima.DE_EXV1_Err_EDefekt_TSens_TF, system-signal=EXV1_Err_EDefekt_TSens_TF
        communication-direction=IN, data-element=Grundumfang_XIX_Klima.Geltungsbereich_E3_1_1_UNECE_Gen2.RP_IF_EXV1_Err_EDefekt_TSens_TNCTOC_XIX_Grundumfang_XIX_Klima.DE_EXV1_Err_EDefekt_TSens_TNCTOC, system-signal=EXV1_Err_EDefekt_TSens_TNCTOC
        communication-direction=IN, data-element=Grundumfang_XIX_Klima.Geltungsbereich_E3_1_1_UNECE_Gen2.RP_IF_EXV1_Err_Notlaufpos_TF_XIX_Grundumfang_XIX_Klima.DE_EXV1_Err_Notlaufpos_TF, system-signal=EXV1_Err_Notlaufpos_TF
        communication-direction=IN, data-element=Grundumfang_XIX_Klima.Geltungsbereich_E3_1_1_UNECE_Gen2.RP_IF_EXV1_Err_Notlaufpos_TNCTOC_XIX_Grundumfang_XIX_Klima.DE_EXV1_Err_Notlaufpos_TNCTOC, system-signal=EXV1_Err_Notlaufpos_TNCTOC
        communication-direction=IN, data-element=Grundumfang_XIX_Klima.Geltungsbereich_E3_1_1_UNECE_Gen2.RP_IF_EXV1_Err_RAMROMNADChange_TF_XIX_Grundumfang_XIX_Klima.DE_EXV1_Err_RAMROMNADChange_TF, system-signal=EXV1_Err_RAMROMNADChange_TF
        communication-direction=IN, data-element=Grundumfang_XIX_Klima.Geltungsbereich_E3_1_1_UNECE_Gen2.RP_IF_EXV1_Err_RAMROMNADChange_TNCTOC_XIX_Grundumfang_XIX_Klima.DE_EXV1_Err_RAMROMNADChange_TNCTOC, system-signal=EXV1_Err_RAMROMNADChange_TNCTOC
        communication-direction=IN, data-element=Grundumfang_XIX_Klima.Geltungsbereich_E3_1_1_UNECE_Gen2.RP_IF_EXV1_Err_Ueberspannung_TF_XIX_Grundumfang_XIX_Klima.DE_EXV1_Err_Ueberspannung_TF, system-signal=EXV1_Err_Ueberspannung_TF
        communication-direction=IN, data-element=Grundumfang_XIX_Klima.Geltungsbereich_E3_1_1_UNECE_Gen2.RP_IF_EXV1_Err_Ueberspannung_TNCTOC_XIX_Grundumfang_XIX_Klima.DE_EXV1_Err_Ueberspannung_TNCTOC, system-signal=EXV1_Err_Ueberspannung_TNCTOC
        communication-direction=IN, data-element=Grundumfang_XIX_Klima.Geltungsbereich_E3_1_1_UNECE_Gen2.RP_IF_EXV1_Err_Uebertemperatur_TF_XIX_Grundumfang_XIX_Klima.DE_EXV1_Err_Uebertemperatur_TF, system-signal=EXV1_Err_Uebertemperatur_TF
        communication-direction=IN, data-element=Grundumfang_XIX_Klima.Geltungsbereich_E3_1_1_UNECE_Gen2.RP_IF_EXV1_Err_Uebertemperatur_TNCTOC_XIX_Grundumfang_XIX_Klima.DE_EXV1_Err_Uebertemperatur_TNCTOC, system-signal=EXV1_Err_Uebertemperatur_TNCTOC
        communication-direction=IN, data-element=Grundumfang_XIX_Klima.Geltungsbereich_E3_1_1_UNECE_Gen2.RP_IF_EXV1_Err_Unterspannung_TF_XIX_Grundumfang_XIX_Klima.DE_EXV1_Err_Unterspannung_TF, system-signal=EXV1_Err_Unterspannung_TF
        communication-direction=IN, data-element=Grundumfang_XIX_Klima.Geltungsbereich_E3_1_1_UNECE_Gen2.RP_IF_EXV1_Err_Unterspannung_TNCTOC_XIX_Grundumfang_XIX_Klima.DE_EXV1_Err_Unterspannung_TNCTOC, system-signal=EXV1_Err_Unterspannung_TNCTOC
        communication-direction=IN, data-element=Grundumfang_XIX_Klima.Geltungsbereich_E3_1_1_UNECE_Gen2.RP_IF_EXV1_ErrMem_State_XIX_Grundumfang_XIX_Klima.DE_EXV1_ErrMem_State, system-signal=EXV1_ErrMem_State
        communication-direction=IN, data-element=Grundumfang_XIX_Klima.Geltungsbereich_E3_1_1_UNECE_Gen2.RP_IF_EXV1_Geschwindigkeitsstatus_XIX_Grundumfang_XIX_Klima.DE_EXV1_Geschwindigkeitsstatus, system-signal=EXV1_Geschwindigkeitsstatus
        communication-direction=IN, data-element=Grundumfang_XIX_Klima.Geltungsbereich_E3_1_1_UNECE_Gen2.RP_IF_EXV1_Ist_Position_Aktuator_XIX_Grundumfang_XIX_Klima.DE_EXV1_Ist_Position_Aktuator, system-signal=EXV1_Ist_Position_Aktuator
        communication-direction=IN, data-element=Grundumfang_XIX_Klima.Geltungsbereich_E3_1_1_UNECE_Gen2.RP_IF_EXV1_ResponseError_XIX_Grundumfang_XIX_Klima.DE_EXV1_ResponseError, system-signal=EXV1_ResponseError
        communication-direction=IN, data-element=Grundumfang_XIX_Klima.Geltungsbereich_E3_1_1_UNECE_Gen2.RP_IF_EXV1_ResponseError_TNCTOC_XIX_Grundumfang_XIX_Klima.DE_EXV1_ResponseError_TNCTOC, system-signal=EXV1_ResponseError_TNCTOC
        communication-direction=IN, data-element=Grundumfang_XIX_Klima.Geltungsbereich_E3_1_1_UNECE_Gen2.RP_IF_EXV1_Spulenbestromung_XIX_Grundumfang_XIX_Klima.DE_EXV1_Spulenbestromung, system-signal=EXV1_Spulenbestromung
        communication-direction=IN, data-element=Grundumfang_XIX_Klima.Geltungsbereich_E3_1_1_UNECE_Gen2.RP_IF_EXV1_Temp_XIX_Grundumfang_XIX_Klima.DE_EXV1_Temp, system-signal=EXV1_Temp
        communication-direction=IN, data-element=Grundumfang_XIX_Klima.Geltungsbereich_E3_1_1_UNECE_Gen2.RP_IF_EXV1_Temp_Warning_XIX_Grundumfang_XIX_Klima.DE_EXV1_Temp_Warning, system-signal=EXV1_Temp_Warning
        communication-direction=IN, data-element=Grundumfang_XIX_Klima.Geltungsbereich_E3_1_1_UNECE_Gen2.RP_IF_EXV2_Err_Blockierung_TF_XIX_Grundumfang_XIX_Klima.DE_EXV2_Err_Blockierung_TF, system-signal=EXV2_Err_Blockierung_TF
        communication-direction=IN, data-element=Grundumfang_XIX_Klima.Geltungsbereich_E3_1_1_UNECE_Gen2.RP_IF_EXV2_Err_Blockierung_TNCTOC_XIX_Grundumfang_XIX_Klima.DE_EXV2_Err_Blockierung_TNCTOC, system-signal=EXV2_Err_Blockierung_TNCTOC
        communication-direction=IN, data-element=Grundumfang_XIX_Klima.Geltungsbereich_E3_1_1_UNECE_Gen2.RP_IF_EXV2_Err_EDefekt_MoKomp_TF_XIX_Grundumfang_XIX_Klima.DE_EXV2_Err_EDefekt_MoKomp_TF, system-signal=EXV2_Err_EDefekt_MoKomp_TF
        communication-direction=IN, data-element=Grundumfang_XIX_Klima.Geltungsbereich_E3_1_1_UNECE_Gen2.RP_IF_EXV2_Err_EDefekt_MoKomp_TNCTOC_XIX_Grundumfang_XIX_Klima.DE_EXV2_Err_EDefekt_MoKomp_TNCTOC, system-signal=EXV2_Err_EDefekt_MoKomp_TNCTOC
        communication-direction=IN, data-element=Grundumfang_XIX_Klima.Geltungsbereich_E3_1_1_UNECE_Gen2.RP_IF_EXV2_Err_EDefekt_TSens_TF_XIX_Grundumfang_XIX_Klima.DE_EXV2_Err_EDefekt_TSens_TF, system-signal=EXV2_Err_EDefekt_TSens_TF
        communication-direction=IN, data-element=Grundumfang_XIX_Klima.Geltungsbereich_E3_1_1_UNECE_Gen2.RP_IF_EXV2_Err_EDefekt_TSens_TNCTOC_XIX_Grundumfang_XIX_Klima.DE_EXV2_Err_EDefekt_TSens_TNCTOC, system-signal=EXV2_Err_EDefekt_TSens_TNCTOC
        communication-direction=IN, data-element=Grundumfang_XIX_Klima.Geltungsbereich_E3_1_1_UNECE_Gen2.RP_IF_EXV2_Err_Notlaufpos_TF_XIX_Grundumfang_XIX_Klima.DE_EXV2_Err_Notlaufpos_TF, system-signal=EXV2_Err_Notlaufpos_TF
        communication-direction=IN, data-element=Grundumfang_XIX_Klima.Geltungsbereich_E3_1_1_UNECE_Gen2.RP_IF_EXV2_Err_Notlaufpos_TNCTOC_XIX_Grundumfang_XIX_Klima.DE_EXV2_Err_Notlaufpos_TNCTOC, system-signal=EXV2_Err_Notlaufpos_TNCTOC
        communication-direction=IN, data-element=Grundumfang_XIX_Klima.Geltungsbereich_E3_1_1_UNECE_Gen2.RP_IF_EXV2_Err_RAMROMNADChange_TF_XIX_Grundumfang_XIX_Klima.DE_EXV2_Err_RAMROMNADChange_TF, system-signal=EXV2_Err_RAMROMNADChange_TF
        communication-direction=IN, data-element=Grundumfang_XIX_Klima.Geltungsbereich_E3_1_1_UNECE_Gen2.RP_IF_EXV2_Err_RAMROMNADChange_TNCTOC_XIX_Grundumfang_XIX_Klima.DE_EXV2_Err_RAMROMNADChange_TNCTOC, system-signal=EXV2_Err_RAMROMNADChange_TNCTOC
        communication-direction=IN, data-element=Grundumfang_XIX_Klima.Geltungsbereich_E3_1_1_UNECE_Gen2.RP_IF_EXV2_Err_Ueberspannung_TF_XIX_Grundumfang_XIX_Klima.DE_EXV2_Err_Ueberspannung_TF, system-signal=EXV2_Err_Ueberspannung_TF
        communication-direction=IN, data-element=Grundumfang_XIX_Klima.Geltungsbereich_E3_1_1_UNECE_Gen2.RP_IF_EXV2_Err_Ueberspannung_TNCTOC_XIX_Grundumfang_XIX_Klima.DE_EXV2_Err_Ueberspannung_TNCTOC, system-signal=EXV2_Err_Ueberspannung_TNCTOC
        communication-direction=IN, data-element=Grundumfang_XIX_Klima.Geltungsbereich_E3_1_1_UNECE_Gen2.RP_IF_EXV2_Err_Uebertemperatur_TF_XIX_Grundumfang_XIX_Klima.DE_EXV2_Err_Uebertemperatur_TF, system-signal=EXV2_Err_Uebertemperatur_TF
        communication-direction=IN, data-element=Grundumfang_XIX_Klima.Geltungsbereich_E3_1_1_UNECE_Gen2.RP_IF_EXV2_Err_Uebertemperatur_TNCTOC_XIX_Grundumfang_XIX_Klima.DE_EXV2_Err_Uebertemperatur_TNCTOC, system-signal=EXV2_Err_Uebertemperatur_TNCTOC
        communication-direction=IN, data-element=Grundumfang_XIX_Klima.Geltungsbereich_E3_1_1_UNECE_Gen2.RP_IF_EXV2_Err_Unterspannung_TF_XIX_Grundumfang_XIX_Klima.DE_EXV2_Err_Unterspannung_TF, system-signal=EXV2_Err_Unterspannung_TF
        communication-direction=IN, data-element=Grundumfang_XIX_Klima.Geltungsbereich_E3_1_1_UNECE_Gen2.RP_IF_EXV2_Err_Unterspannung_TNCTOC_XIX_Grundumfang_XIX_Klima.DE_EXV2_Err_Unterspannung_TNCTOC, system-signal=EXV2_Err_Unterspannung_TNCTOC
        communication-direction=IN, data-element=Grundumfang_XIX_Klima.Geltungsbereich_E3_1_1_UNECE_Gen2.RP_IF_EXV2_ErrMem_State_XIX_Grundumfang_XIX_Klima.DE_EXV2_ErrMem_State, system-signal=EXV2_ErrMem_State
        communication-direction=IN, data-element=Grundumfang_XIX_Klima.Geltungsbereich_E3_1_1_UNECE_Gen2.RP_IF_EXV2_Geschwindigkeitsstatus_XIX_Grundumfang_XIX_Klima.DE_EXV2_Geschwindigkeitsstatus, system-signal=EXV2_Geschwindigkeitsstatus
        communication-direction=IN, data-element=Grundumfang_XIX_Klima.Geltungsbereich_E3_1_1_UNECE_Gen2.RP_IF_EXV2_Ist_Position_Aktuator_XIX_Grundumfang_XIX_Klima.DE_EXV2_Ist_Position_Aktuator, system-signal=EXV2_Ist_Position_Aktuator
        communication-direction=IN, data-element=Grundumfang_XIX_Klima.Geltungsbereich_E3_1_1_UNECE_Gen2.RP_IF_EXV2_ResponseError_XIX_Grundumfang_XIX_Klima.DE_EXV2_ResponseError, system-signal=EXV2_ResponseError
        communication-direction=IN, data-element=Grundumfang_XIX_Klima.Geltungsbereich_E3_1_1_UNECE_Gen2.RP_IF_EXV2_ResponseError_TNCTOC_XIX_Grundumfang_XIX_Klima.DE_EXV2_ResponseError_TNCTOC, system-signal=EXV2_ResponseError_TNCTOC
        communication-direction=IN, data-element=Grundumfang_XIX_Klima.Geltungsbereich_E3_1_1_UNECE_Gen2.RP_IF_EXV2_Spulenbestromung_XIX_Grundumfang_XIX_Klima.DE_EXV2_Spulenbestromung, system-signal=EXV2_Spulenbestromung
        communication-direction=IN, data-element=Grundumfang_XIX_Klima.Geltungsbereich_E3_1_1_UNECE_Gen2.RP_IF_EXV2_Temp_XIX_Grundumfang_XIX_Klima.DE_EXV2_Temp, system-signal=EXV2_Temp
        communication-direction=IN, data-element=Grundumfang_XIX_Klima.Geltungsbereich_E3_1_1_UNECE_Gen2.RP_IF_EXV2_Temp_Warning_XIX_Grundumfang_XIX_Klima.DE_EXV2_Temp_Warning, system-signal=EXV2_Temp_Warning
        communication-direction=IN, data-element=Grundumfang_XIX_Klima.Geltungsbereich_E3_1_1_UNECE_Gen2.RP_IF_EXV3_Err_Blockierung_TF_XIX_Grundumfang_XIX_Klima.DE_EXV3_Err_Blockierung_TF, system-signal=EXV3_Err_Blockierung_TF
        communication-direction=IN, data-element=Grundumfang_XIX_Klima.Geltungsbereich_E3_1_1_UNECE_Gen2.RP_IF_EXV3_Err_Blockierung_TNCTOC_XIX_Grundumfang_XIX_Klima.DE_EXV3_Err_Blockierung_TNCTOC, system-signal=EXV3_Err_Blockierung_TNCTOC
        communication-direction=IN, data-element=Grundumfang_XIX_Klima.Geltungsbereich_E3_1_1_UNECE_Gen2.RP_IF_EXV3_Err_EDefekt_MoKomp_TF_XIX_Grundumfang_XIX_Klima.DE_EXV3_Err_EDefekt_MoKomp_TF, system-signal=EXV3_Err_EDefekt_MoKomp_TF
        communication-direction=IN, data-element=Grundumfang_XIX_Klima.Geltungsbereich_E3_1_1_UNECE_Gen2.RP_IF_EXV3_Err_EDefekt_MoKomp_TNCTOC_XIX_Grundumfang_XIX_Klima.DE_EXV3_Err_EDefekt_MoKomp_TNCTOC, system-signal=EXV3_Err_EDefekt_MoKomp_TNCTOC
        communication-direction=IN, data-element=Grundumfang_XIX_Klima.Geltungsbereich_E3_1_1_UNECE_Gen2.RP_IF_EXV3_Err_EDefekt_TSens_TF_XIX_Grundumfang_XIX_Klima.DE_EXV3_Err_EDefekt_TSens_TF, system-signal=EXV3_Err_EDefekt_TSens_TF
        communication-direction=IN, data-element=Grundumfang_XIX_Klima.Geltungsbereich_E3_1_1_UNECE_Gen2.RP_IF_EXV3_Err_EDefekt_TSens_TNCTOC_XIX_Grundumfang_XIX_Klima.DE_EXV3_Err_EDefekt_TSens_TNCTOC, system-signal=EXV3_Err_EDefekt_TSens_TNCTOC
        communication-direction=IN, data-element=Grundumfang_XIX_Klima.Geltungsbereich_E3_1_1_UNECE_Gen2.RP_IF_EXV3_Err_Notlaufpos_TF_XIX_Grundumfang_XIX_Klima.DE_EXV3_Err_Notlaufpos_TF, system-signal=EXV3_Err_Notlaufpos_TF
        communication-direction=IN, data-element=Grundumfang_XIX_Klima.Geltungsbereich_E3_1_1_UNECE_Gen2.RP_IF_EXV3_Err_Notlaufpos_TNCTOC_XIX_Grundumfang_XIX_Klima.DE_EXV3_Err_Notlaufpos_TNCTOC, system-signal=EXV3_Err_Notlaufpos_TNCTOC
        communication-direction=IN, data-element=Grundumfang_XIX_Klima.Geltungsbereich_E3_1_1_UNECE_Gen2.RP_IF_EXV3_Err_RAMROMNADChange_TF_XIX_Grundumfang_XIX_Klima.DE_EXV3_Err_RAMROMNADChange_TF, system-signal=EXV3_Err_RAMROMNADChange_TF
        communication-direction=IN, data-element=Grundumfang_XIX_Klima.Geltungsbereich_E3_1_1_UNECE_Gen2.RP_IF_EXV3_Err_RAMROMNADChange_TNCTOC_XIX_Grundumfang_XIX_Klima.DE_EXV3_Err_RAMROMNADChange_TNCTOC, system-signal=EXV3_Err_RAMROMNADChange_TNCTOC
        communication-direction=IN, data-element=Grundumfang_XIX_Klima.Geltungsbereich_E3_1_1_UNECE_Gen2.RP_IF_EXV3_Err_Ueberspannung_TF_XIX_Grundumfang_XIX_Klima.DE_EXV3_Err_Ueberspannung_TF, system-signal=EXV3_Err_Ueberspannung_TF
        communication-direction=IN, data-element=Grundumfang_XIX_Klima.Geltungsbereich_E3_1_1_UNECE_Gen2.RP_IF_EXV3_Err_Ueberspannung_TNCTOC_XIX_Grundumfang_XIX_Klima.DE_EXV3_Err_Ueberspannung_TNCTOC, system-signal=EXV3_Err_Ueberspannung_TNCTOC
        communication-direction=IN, data-element=Grundumfang_XIX_Klima.Geltungsbereich_E3_1_1_UNECE_Gen2.RP_IF_EXV3_Err_Uebertemperatur_TF_XIX_Grundumfang_XIX_Klima.DE_EXV3_Err_Uebertemperatur_TF, system-signal=EXV3_Err_Uebertemperatur_TF
        communication-direction=IN, data-element=Grundumfang_XIX_Klima.Geltungsbereich_E3_1_1_UNECE_Gen2.RP_IF_EXV3_Err_Uebertemperatur_TNCTOC_XIX_Grundumfang_XIX_Klima.DE_EXV3_Err_Uebertemperatur_TNCTOC, system-signal=EXV3_Err_Uebertemperatur_TNCTOC
        communication-direction=IN, data-element=Grundumfang_XIX_Klima.Geltungsbereich_E3_1_1_UNECE_Gen2.RP_IF_EXV3_Err_Unterspannung_TF_XIX_Grundumfang_XIX_Klima.DE_EXV3_Err_Unterspannung_TF, system-signal=EXV3_Err_Unterspannung_TF
        communication-direction=IN, data-element=Grundumfang_XIX_Klima.Geltungsbereich_E3_1_1_UNECE_Gen2.RP_IF_EXV3_Err_Unterspannung_TNCTOC_XIX_Grundumfang_XIX_Klima.DE_EXV3_Err_Unterspannung_TNCTOC, system-signal=EXV3_Err_Unterspannung_TNCTOC
        communication-direction=IN, data-element=Grundumfang_XIX_Klima.Geltungsbereich_E3_1_1_UNECE_Gen2.RP_IF_EXV3_ErrMem_State_XIX_Grundumfang_XIX_Klima.DE_EXV3_ErrMem_State, system-signal=EXV3_ErrMem_State
        communication-direction=IN, data-element=Grundumfang_XIX_Klima.Geltungsbereich_E3_1_1_UNECE_Gen2.RP_IF_EXV3_Geschwindigkeitsstatus_XIX_Grundumfang_XIX_Klima.DE_EXV3_Geschwindigkeitsstatus, system-signal=EXV3_Geschwindigkeitsstatus
        communication-direction=IN, data-element=Grundumfang_XIX_Klima.Geltungsbereich_E3_1_1_UNECE_Gen2.RP_IF_EXV3_Ist_Position_Aktuator_XIX_Grundumfang_XIX_Klima.DE_EXV3_Ist_Position_Aktuator, system-signal=EXV3_Ist_Position_Aktuator
        communication-direction=IN, data-element=Grundumfang_XIX_Klima.Geltungsbereich_E3_1_1_UNECE_Gen2.RP_IF_EXV3_ResponseError_XIX_Grundumfang_XIX_Klima.DE_EXV3_ResponseError, system-signal=EXV3_ResponseError
        communication-direction=IN, data-element=Grundumfang_XIX_Klima.Geltungsbereich_E3_1_1_UNECE_Gen2.RP_IF_EXV3_ResponseError_TNCTOC_XIX_Grundumfang_XIX_Klima.DE_EXV3_ResponseError_TNCTOC, system-signal=EXV3_ResponseError_TNCTOC
        communication-direction=IN, data-element=Grundumfang_XIX_Klima.Geltungsbereich_E3_1_1_UNECE_Gen2.RP_IF_EXV3_Spulenbestromung_XIX_Grundumfang_XIX_Klima.DE_EXV3_Spulenbestromung, system-signal=EXV3_Spulenbestromung
        communication-direction=IN, data-element=Grundumfang_XIX_Klima.Geltungsbereich_E3_1_1_UNECE_Gen2.RP_IF_EXV3_Temp_XIX_Grundumfang_XIX_Klima.DE_EXV3_Temp, system-signal=EXV3_Temp
        communication-direction=IN, data-element=Grundumfang_XIX_Klima.Geltungsbereich_E3_1_1_UNECE_Gen2.RP_IF_EXV3_Temp_Warning_XIX_Grundumfang_XIX_Klima.DE_EXV3_Temp_Warning, system-signal=EXV3_Temp_Warning
        communication-direction=IN, data-element=Grundumfang_XIX_Klima.Geltungsbereich_E3_1_1_UNECE_Gen2.RP_IF_EXV4_Err_Blockierung_TF_XIX_Grundumfang_XIX_Klima.DE_EXV4_Err_Blockierung_TF, system-signal=EXV4_Err_Blockierung_TF
        communication-direction=IN, data-element=Grundumfang_XIX_Klima.Geltungsbereich_E3_1_1_UNECE_Gen2.RP_IF_EXV4_Err_Blockierung_TNCTOC_XIX_Grundumfang_XIX_Klima.DE_EXV4_Err_Blockierung_TNCTOC, system-signal=EXV4_Err_Blockierung_TNCTOC
        communication-direction=IN, data-element=Grundumfang_XIX_Klima.Geltungsbereich_E3_1_1_UNECE_Gen2.RP_IF_EXV4_Err_EDefekt_MoKomp_TF_XIX_Grundumfang_XIX_Klima.DE_EXV4_Err_EDefekt_MoKomp_TF, system-signal=EXV4_Err_EDefekt_MoKomp_TF
        communication-direction=IN, data-element=Grundumfang_XIX_Klima.Geltungsbereich_E3_1_1_UNECE_Gen2.RP_IF_EXV4_Err_EDefekt_MoKomp_TNCTOC_XIX_Grundumfang_XIX_Klima.DE_EXV4_Err_EDefekt_MoKomp_TNCTOC, system-signal=EXV4_Err_EDefekt_MoKomp_TNCTOC
        communication-direction=IN, data-element=Grundumfang_XIX_Klima.Geltungsbereich_E3_1_1_UNECE_Gen2.RP_IF_EXV4_Err_EDefekt_TSens_TF_XIX_Grundumfang_XIX_Klima.DE_EXV4_Err_EDefekt_TSens_TF, system-signal=EXV4_Err_EDefekt_TSens_TF
        communication-direction=IN, data-element=Grundumfang_XIX_Klima.Geltungsbereich_E3_1_1_UNECE_Gen2.RP_IF_EXV4_Err_EDefekt_TSens_TNCTOC_XIX_Grundumfang_XIX_Klima.DE_EXV4_Err_EDefekt_TSens_TNCTOC, system-signal=EXV4_Err_EDefekt_TSens_TNCTOC
        communication-direction=IN, data-element=Grundumfang_XIX_Klima.Geltungsbereich_E3_1_1_UNECE_Gen2.RP_IF_EXV4_Err_Notlaufpos_TF_XIX_Grundumfang_XIX_Klima.DE_EXV4_Err_Notlaufpos_TF, system-signal=EXV4_Err_Notlaufpos_TF
        communication-direction=IN, data-element=Grundumfang_XIX_Klima.Geltungsbereich_E3_1_1_UNECE_Gen2.RP_IF_EXV4_Err_Notlaufpos_TNCTOC_XIX_Grundumfang_XIX_Klima.DE_EXV4_Err_Notlaufpos_TNCTOC, system-signal=EXV4_Err_Notlaufpos_TNCTOC
        communication-direction=IN, data-element=Grundumfang_XIX_Klima.Geltungsbereich_E3_1_1_UNECE_Gen2.RP_IF_EXV4_Err_RAMROMNADChange_TF_XIX_Grundumfang_XIX_Klima.DE_EXV4_Err_RAMROMNADChange_TF, system-signal=EXV4_Err_RAMROMNADChange_TF
        communication-direction=IN, data-element=Grundumfang_XIX_Klima.Geltungsbereich_E3_1_1_UNECE_Gen2.RP_IF_EXV4_Err_RAMROMNADChange_TNCTOC_XIX_Grundumfang_XIX_Klima.DE_EXV4_Err_RAMROMNADChange_TNCTOC, system-signal=EXV4_Err_RAMROMNADChange_TNCTOC
        communication-direction=IN, data-element=Grundumfang_XIX_Klima.Geltungsbereich_E3_1_1_UNECE_Gen2.RP_IF_EXV4_Err_Ueberspannung_TF_XIX_Grundumfang_XIX_Klima.DE_EXV4_Err_Ueberspannung_TF, system-signal=EXV4_Err_Ueberspannung_TF
        communication-direction=IN, data-element=Grundumfang_XIX_Klima.Geltungsbereich_E3_1_1_UNECE_Gen2.RP_IF_EXV4_Err_Ueberspannung_TNCTOC_XIX_Grundumfang_XIX_Klima.DE_EXV4_Err_Ueberspannung_TNCTOC, system-signal=EXV4_Err_Ueberspannung_TNCTOC
        communication-direction=IN, data-element=Grundumfang_XIX_Klima.Geltungsbereich_E3_1_1_UNECE_Gen2.RP_IF_EXV4_Err_Uebertemperatur_TF_XIX_Grundumfang_XIX_Klima.DE_EXV4_Err_Uebertemperatur_TF, system-signal=EXV4_Err_Uebertemperatur_TF
        communication-direction=IN, data-element=Grundumfang_XIX_Klima.Geltungsbereich_E3_1_1_UNECE_Gen2.RP_IF_EXV4_Err_Uebertemperatur_TNCTOC_XIX_Grundumfang_XIX_Klima.DE_EXV4_Err_Uebertemperatur_TNCTOC, system-signal=EXV4_Err_Uebertemperatur_TNCTOC
        communication-direction=IN, data-element=Grundumfang_XIX_Klima.Geltungsbereich_E3_1_1_UNECE_Gen2.RP_IF_EXV4_Err_Unterspannung_TF_XIX_Grundumfang_XIX_Klima.DE_EXV4_Err_Unterspannung_TF, system-signal=EXV4_Err_Unterspannung_TF
        communication-direction=IN, data-element=Grundumfang_XIX_Klima.Geltungsbereich_E3_1_1_UNECE_Gen2.RP_IF_EXV4_Err_Unterspannung_TNCTOC_XIX_Grundumfang_XIX_Klima.DE_EXV4_Err_Unterspannung_TNCTOC, system-signal=EXV4_Err_Unterspannung_TNCTOC
        communication-direction=IN, data-element=Grundumfang_XIX_Klima.Geltungsbereich_E3_1_1_UNECE_Gen2.RP_IF_EXV4_ErrMem_State_XIX_Grundumfang_XIX_Klima.DE_EXV4_ErrMem_State, system-signal=EXV4_ErrMem_State
        communication-direction=IN, data-element=Grundumfang_XIX_Klima.Geltungsbereich_E3_1_1_UNECE_Gen2.RP_IF_EXV4_Geschwindigkeitsstatus_XIX_Grundumfang_XIX_Klima.DE_EXV4_Geschwindigkeitsstatus, system-signal=EXV4_Geschwindigkeitsstatus
        communication-direction=IN, data-element=Grundumfang_XIX_Klima.Geltungsbereich_E3_1_1_UNECE_Gen2.RP_IF_EXV4_Ist_Position_Aktuator_XIX_Grundumfang_XIX_Klima.DE_EXV4_Ist_Position_Aktuator, system-signal=EXV4_Ist_Position_Aktuator
        communication-direction=IN, data-element=Grundumfang_XIX_Klima.Geltungsbereich_E3_1_1_UNECE_Gen2.RP_IF_EXV4_ResponseError_XIX_Grundumfang_XIX_Klima.DE_EXV4_ResponseError, system-signal=EXV4_ResponseError
        communication-direction=IN, data-element=Grundumfang_XIX_Klima.Geltungsbereich_E3_1_1_UNECE_Gen2.RP_IF_EXV4_ResponseError_TNCTOC_XIX_Grundumfang_XIX_Klima.DE_EXV4_ResponseError_TNCTOC, system-signal=EXV4_ResponseError_TNCTOC
        communication-direction=IN, data-element=Grundumfang_XIX_Klima.Geltungsbereich_E3_1_1_UNECE_Gen2.RP_IF_EXV4_Spulenbestromung_XIX_Grundumfang_XIX_Klima.DE_EXV4_Spulenbestromung, system-signal=EXV4_Spulenbestromung
        communication-direction=IN, data-element=Grundumfang_XIX_Klima.Geltungsbereich_E3_1_1_UNECE_Gen2.RP_IF_EXV4_Temp_XIX_Grundumfang_XIX_Klima.DE_EXV4_Temp, system-signal=EXV4_Temp
        communication-direction=IN, data-element=Grundumfang_XIX_Klima.Geltungsbereich_E3_1_1_UNECE_Gen2.RP_IF_EXV4_Temp_Warning_XIX_Grundumfang_XIX_Klima.DE_EXV4_Temp_Warning, system-signal=EXV4_Temp_Warning
        communication-direction=OUT, data-element=Grundumfang_XIX_Klima.Geltungsbereich_E3_1_1_UNECE_Gen2.SP_IF_FCM_01_alt_XIX_Grundumfang_XIX_Klima.DE_FCM_01_alt, system-signal=FCM_01_alt
        communication-direction=IN, data-element=Grundumfang_XIX_Klima.Geltungsbereich_E3_1_1_UNECE_Gen2.RP_IF_FoD_Transmission_Info_XIX_Grundumfang_XIX_Klima.DE_FoD_Transmission_Info, system-signal=FoD_Transmission_Info
        communication-direction=IN, data-element=SC_447_FoD_Slave_8_XIX_Softwareblock_XIX_Klima.Geltungsbereich_E3_1_1_UNECE_Gen2.RP_IF_FoD_Transmission_Info_XIX_SC_447_FoD_Slave_8_XIX_Softwareblock_XIX_Klima.DE_FoD_Transmission_Info, system-signal=FoD_Transmission_Info
        communication-direction=IN, data-element=Grundumfang_XIX_Klima.Geltungsbereich_E3_1_1_UNECE_Gen2.RP_IF_FRS_active_container_XIX_Grundumfang_XIX_Klima.DE_FRS_active_container, system-signal=FRS_active_container
        communication-direction=OUT, data-element=Grundumfang_XIX_Klima.Geltungsbereich_E3_1_1_UNECE_Gen2.SP_IF_FRS_ChannelSelect_XIX_Grundumfang_XIX_Klima.DE_FRS_ChannelSelect, system-signal=FRS_ChannelSelect
        communication-direction=IN, data-element=Grundumfang_XIX_Klima.Geltungsbereich_E3_1_1_UNECE_Gen2.RP_IF_FRS_CurrentIntensity_XIX_Grundumfang_XIX_Klima.DE_FRS_CurrentIntensity, system-signal=FRS_CurrentIntensity
        communication-direction=IN, data-element=Grundumfang_XIX_Klima.Geltungsbereich_E3_1_1_UNECE_Gen2.RP_IF_FRS_Expiry_Container_{1..3}_XIX_Grundumfang_XIX_Klima.DE_FRS_Expiry_Container_{1..3}, system-signal=FRS_Expiry_Container_{1..3}
        communication-direction=IN, data-element=Grundumfang_XIX_Klima.Geltungsbereich_E3_1_1_UNECE_Gen2.RP_IF_FRS_Fan_status_XIX_Grundumfang_XIX_Klima.DE_FRS_Fan_status, system-signal=FRS_Fan_status
        communication-direction=IN, data-element=Grundumfang_XIX_Klima.Geltungsbereich_E3_1_1_UNECE_Gen2.RP_IF_FRS_FragranceID_Container_{1..3}_XIX_Grundumfang_XIX_Klima.DE_FRS_FragranceID_Container_{1..3}, system-signal=FRS_FragranceID_Container_{1..3}
        communication-direction=OUT, data-element=Grundumfang_XIX_Klima.Geltungsbereich_E3_1_1_UNECE_Gen2.SP_IF_FRS_IntensityReq_XIX_Grundumfang_XIX_Klima.DE_FRS_IntensityReq, system-signal=FRS_IntensityReq
        communication-direction=IN, data-element=Grundumfang_XIX_Klima.Geltungsbereich_E3_1_1_UNECE_Gen2.RP_IF_FRS_Level_Container_{1..3}_XIX_Grundumfang_XIX_Klima.DE_FRS_Level_Container_{1..3}, system-signal=FRS_Level_Container_{1..3}
        communication-direction=IN, data-element=Grundumfang_XIX_Klima.Geltungsbereich_E3_1_1_UNECE_Gen2.RP_IF_FRS_ResponseError_XIX_Grundumfang_XIX_Klima.DE_FRS_ResponseError, system-signal=FRS_ResponseError
        communication-direction=IN, data-element=Grundumfang_XIX_Klima.Geltungsbereich_E3_1_1_UNECE_Gen2.RP_IF_FRS_Status_XIX_Grundumfang_XIX_Klima.DE_FRS_Status, system-signal=FRS_Status
        communication-direction=OUT, data-element=Grundumfang_XIX_Klima.Geltungsbereich_E3_1_1_UNECE_Gen2.SP_IF_FRS_Status_Car_XIX_Grundumfang_XIX_Klima.DE_FRS_Status_Car, system-signal=FRS_Status_Car
        communication-direction=IN, data-element=Grundumfang_XIX_Klima.Geltungsbereich_E3_1_1_UNECE_Gen2.RP_IF_FRS_Status_UBatt_XIX_Grundumfang_XIX_Klima.DE_FRS_Status_UBatt, system-signal=FRS_Status_UBatt
        communication-direction=IN, data-element=Grundumfang_XIX_Klima.Geltungsbereich_E3_1_1_UNECE_Gen2.RP_IF_FRS_Stepper_Status_XIX_Grundumfang_XIX_Klima.DE_FRS_Stepper_Status, system-signal=FRS_Stepper_Status
        communication-direction=IN, data-element=Grundumfang_XIX_Klima.Geltungsbereich_E3_1_1_UNECE_Gen2.RP_IF_FS_Luftfeuchte_rel_XIX_Grundumfang_XIX_Klima.DE_FS_Luftfeuchte_rel, system-signal=FS_Luftfeuchte_rel
        communication-direction=IN, data-element=Grundumfang_XIX_Klima.Geltungsbereich_E3_1_1_UNECE_Gen2.RP_IF_FS_ResponseError_XIX_Grundumfang_XIX_Klima.DE_FS_ResponseError, system-signal=FS_ResponseError
        communication-direction=IN, data-element=Grundumfang_XIX_Klima.Geltungsbereich_E3_1_1_UNECE_Gen2.RP_IF_FS_Taupunkt_XIX_Grundumfang_XIX_Klima.DE_FS_Taupunkt, system-signal=FS_Taupunkt
        communication-direction=IN, data-element=Grundumfang_XIX_Klima.Geltungsbereich_E3_1_1_UNECE_Gen2.RP_IF_FS_Temp_Scheibe_XIX_Grundumfang_XIX_Klima.DE_FS_Temp_Scheibe, system-signal=FS_Temp_Scheibe
        communication-direction=IN, data-element=Grundumfang_XIX_Klima.Geltungsbereich_E3_1_1_UNECE_Gen2.RP_IF_FS_Temp_Sensor_XIX_Grundumfang_XIX_Klima.DE_FS_Temp_Sensor, system-signal=FS_Temp_Sensor
        communication-direction=IN, data-element=Grundumfang_XIX_Klima.Geltungsbereich_E3_1_1_UNECE_Gen2.RP_IF_FSA_HW_XIX_Grundumfang_XIX_Klima.DE_FSA_HW, system-signal=FSA_HW
        communication-direction=IN, data-element=Grundumfang_XIX_Klima.Geltungsbereich_E3_1_1_UNECE_Gen2.RP_IF_FSA_Luftfeuchte_rel_XIX_Grundumfang_XIX_Klima.DE_FSA_Luftfeuchte_rel, system-signal=FSA_Luftfeuchte_rel
        communication-direction=OUT, data-element=Grundumfang_XIX_Klima.Geltungsbereich_E3_1_1_UNECE_Gen2.SP_IF_FSA_Luftfeuchte_rel_XIX_Grundumfang_XIX_Klima.DE_FSA_Luftfeuchte_rel, system-signal=FSA_Luftfeuchte_rel
        communication-direction=IN, data-element=Grundumfang_XIX_Klima.Geltungsbereich_E3_1_1_UNECE_Gen2.RP_IF_FSA_ResponseError_XIX_Grundumfang_XIX_Klima.DE_FSA_ResponseError, system-signal=FSA_ResponseError
        communication-direction=IN, data-element=Grundumfang_XIX_Klima.Geltungsbereich_E3_1_1_UNECE_Gen2.RP_IF_FSA_Sensorheizung_Status_XIX_Grundumfang_XIX_Klima.DE_FSA_Sensorheizung_Status, system-signal=FSA_Sensorheizung_Status
        communication-direction=IN, data-element=Grundumfang_XIX_Klima.Geltungsbereich_E3_1_1_UNECE_Gen2.RP_IF_FSA_SW_XIX_Grundumfang_XIX_Klima.DE_FSA_SW, system-signal=FSA_SW
        communication-direction=IN, data-element=Grundumfang_XIX_Klima.Geltungsbereich_E3_1_1_UNECE_Gen2.RP_IF_FSA_Taupunkt_XIX_Grundumfang_XIX_Klima.DE_FSA_Taupunkt, system-signal=FSA_Taupunkt
        communication-direction=OUT, data-element=Grundumfang_XIX_Klima.Geltungsbereich_E3_1_1_UNECE_Gen2.SP_IF_FSA_Taupunkt_PMS_XIX_Grundumfang_XIX_Klima.DE_FSA_Taupunkt_PMS, system-signal=FSA_Taupunkt_PMS
        communication-direction=IN, data-element=Grundumfang_XIX_Klima.Geltungsbereich_E3_1_1_UNECE_Gen2.RP_IF_FSA_Temp_Luft_XIX_Grundumfang_XIX_Klima.DE_FSA_Temp_Luft, system-signal=FSA_Temp_Luft
        communication-direction=IN, data-element=Grundumfang_XIX_Klima.Geltungsbereich_E3_1_1_UNECE_Gen2.RP_IF_FSA_Temp_Sensor_XIX_Grundumfang_XIX_Klima.DE_FSA_Temp_Sensor, system-signal=FSA_Temp_Sensor
        communication-direction=OUT, data-element=Grundumfang_XIX_Klima.Geltungsbereich_E3_1_1_UNECE_Gen2.SP_IF_FSH_Status_XIX_Grundumfang_XIX_Klima.DE_FSH_Status, system-signal=FSH_Status
        communication-direction=OUT, data-element=Grundumfang_XIX_Klima.Geltungsbereich_E3_1_1_UNECE_Gen2.SP_IF_FSH_Taster_XIX_Grundumfang_XIX_Klima.DE_FSH_Taster, system-signal=FSH_Taster
        communication-direction=IN, data-element=Grundumfang_XIX_Klima.Geltungsbereich_E3_1_1_UNECE_Gen2.RP_IF_FT_FH_Oeffnung_XIX_Grundumfang_XIX_Klima.DE_FT_FH_Oeffnung, system-signal=FT_FH_Oeffnung
        communication-direction=OUT, data-element=Grundumfang_XIX_Klima.Geltungsbereich_E3_1_1_UNECE_Gen2.SP_IF_FT_FH_Oeffnung_4Bit_XIX_Grundumfang_XIX_Klima.DE_FT_FH_Oeffnung_4Bit, system-signal=FT_FH_Oeffnung_4Bit
        communication-direction=IN, data-element=Grundumfang_XIX_Klima.Geltungsbereich_E3_1_1_UNECE_Gen2.RP_IF_FT_Tuer_geoeffnet_XIX_Grundumfang_XIX_Klima.DE_FT_Tuer_geoeffnet, system-signal=FT_Tuer_geoeffnet
        communication-direction=OUT, data-element=Grundumfang_XIX_Klima.Geltungsbereich_E3_1_1_UNECE_Gen2.SP_IF_Geblaesestufe_XIX_Grundumfang_XIX_Klima.DE_Geblaesestufe, system-signal=Geblaesestufe
        communication-direction=IN, data-element=Grundumfang_XIX_Klima.Geltungsbereich_E3_1_1_UNECE_Gen2.RP_IF_GNSS_Breite_Ortung_XIX_Grundumfang_XIX_Klima.DE_GNSS_Breite_Ortung, system-signal=GNSS_Breite_Ortung
        communication-direction=IN, data-element=Grundumfang_XIX_Klima.Geltungsbereich_E3_1_1_UNECE_Gen2.RP_IF_GNSS_DR_Breite_Ortung_XIX_Grundumfang_XIX_Klima.DE_GNSS_DR_Breite_Ortung, system-signal=GNSS_DR_Breite_Ortung
        communication-direction=IN, data-element=Grundumfang_XIX_Klima.Geltungsbereich_E3_1_1_UNECE_Gen2.RP_IF_GNSS_DR_Laenge_Ortung_XIX_Grundumfang_XIX_Klima.DE_GNSS_DR_Laenge_Ortung, system-signal=GNSS_DR_Laenge_Ortung
        communication-direction=IN, data-element=Grundumfang_XIX_Klima.Geltungsbereich_E3_1_1_UNECE_Gen2.RP_IF_GNSS_DR_Ortung_Ausrichtung_XIX_Grundumfang_XIX_Klima.DE_GNSS_DR_Ortung_Ausrichtung, system-signal=GNSS_DR_Ortung_Ausrichtung
        communication-direction=IN, data-element=Grundumfang_XIX_Klima.Geltungsbereich_E3_1_1_UNECE_Gen2.RP_IF_GNSS_DR_Ortung_Hoehe_XIX_Grundumfang_XIX_Klima.DE_GNSS_DR_Ortung_Hoehe, system-signal=GNSS_DR_Ortung_Hoehe
        communication-direction=IN, data-element=Grundumfang_XIX_Klima.Geltungsbereich_E3_1_1_UNECE_Gen2.RP_IF_GNSS_DR_Richtung_Breite_Ortung_XIX_Grundumfang_XIX_Klima.DE_GNSS_DR_Richtung_Breite_Ortung, system-signal=GNSS_DR_Richtung_Breite_Ortung
        communication-direction=IN, data-element=Grundumfang_XIX_Klima.Geltungsbereich_E3_1_1_UNECE_Gen2.RP_IF_GNSS_DR_Richtung_Laenge_Ortung_XIX_Grundumfang_XIX_Klima.DE_GNSS_DR_Richtung_Laenge_Ortung, system-signal=GNSS_DR_Richtung_Laenge_Ortung
        communication-direction=IN, data-element=Grundumfang_XIX_Klima.Geltungsbereich_E3_1_1_UNECE_Gen2.RP_IF_GNSS_DR_UTC_Zeit_XIX_Grundumfang_XIX_Klima.DE_GNSS_DR_UTC_Zeit, system-signal=GNSS_DR_UTC_Zeit
        communication-direction=IN, data-element=Grundumfang_XIX_Klima.Geltungsbereich_E3_1_1_UNECE_Gen2.RP_IF_GNSS_Laenge_Ortung_XIX_Grundumfang_XIX_Klima.DE_GNSS_Laenge_Ortung, system-signal=GNSS_Laenge_Ortung
        communication-direction=IN, data-element=Grundumfang_XIX_Klima.Geltungsbereich_E3_1_1_UNECE_Gen2.RP_IF_GNSS_Ortung_Ausrichtung_XIX_Grundumfang_XIX_Klima.DE_GNSS_Ortung_Ausrichtung, system-signal=GNSS_Ortung_Ausrichtung
        communication-direction=IN, data-element=Grundumfang_XIX_Klima.Geltungsbereich_E3_1_1_UNECE_Gen2.RP_IF_GNSS_Ortung_Hoehe_XIX_Grundumfang_XIX_Klima.DE_GNSS_Ortung_Hoehe, system-signal=GNSS_Ortung_Hoehe
        communication-direction=IN, data-element=Grundumfang_XIX_Klima.Geltungsbereich_E3_1_1_UNECE_Gen2.RP_IF_GNSS_Richtung_Breite_Ortung_XIX_Grundumfang_XIX_Klima.DE_GNSS_Richtung_Breite_Ortung, system-signal=GNSS_Richtung_Breite_Ortung
        communication-direction=IN, data-element=Grundumfang_XIX_Klima.Geltungsbereich_E3_1_1_UNECE_Gen2.RP_IF_GNSS_Richtung_Laenge_Ortung_XIX_Grundumfang_XIX_Klima.DE_GNSS_Richtung_Laenge_Ortung, system-signal=GNSS_Richtung_Laenge_Ortung
        communication-direction=IN, data-element=Grundumfang_XIX_Klima.Geltungsbereich_E3_1_1_UNECE_Gen2.RP_IF_GNSS_UTC_Zeit_XIX_Grundumfang_XIX_Klima.DE_GNSS_UTC_Zeit, system-signal=GNSS_UTC_Zeit
        communication-direction=IN, data-element=Grundumfang_XIX_Klima.Geltungsbereich_E3_1_1_UNECE_Gen2.RP_IF_HBFS_FH_Oeffnung_XIX_Grundumfang_XIX_Klima.DE_HBFS_FH_Oeffnung, system-signal=HBFS_FH_Oeffnung
        communication-direction=OUT, data-element=Grundumfang_XIX_Klima.Geltungsbereich_E3_1_1_UNECE_Gen2.SP_IF_HBFS_FH_Oeffnung_4Bit_XIX_Grundumfang_XIX_Klima.DE_HBFS_FH_Oeffnung_4Bit, system-signal=HBFS_FH_Oeffnung_4Bit
        communication-direction=IN, data-element=Grundumfang_XIX_Klima.Geltungsbereich_E3_1_1_UNECE_Gen2.RP_IF_HBFS_Tuer_geoeffnet_XIX_Grundumfang_XIX_Klima.DE_HBFS_Tuer_geoeffnet, system-signal=HBFS_Tuer_geoeffnet
        communication-direction=IN, data-element=Grundumfang_XIX_Klima.Geltungsbereich_E3_1_1_UNECE_Gen2.RP_IF_HDSG_Anf_Umluftklappe_XIX_Grundumfang_XIX_Klima.DE_HDSG_Anf_Umluftklappe, system-signal=HDSG_Anf_Umluftklappe
        communication-direction=IN, data-element=Grundumfang_XIX_Klima.Geltungsbereich_E3_1_1_UNECE_Gen2.RP_IF_HFS_FH_Oeffnung_XIX_Grundumfang_XIX_Klima.DE_HFS_FH_Oeffnung, system-signal=HFS_FH_Oeffnung
        communication-direction=OUT, data-element=Grundumfang_XIX_Klima.Geltungsbereich_E3_1_1_UNECE_Gen2.SP_IF_HFS_FH_Oeffnung_4Bit_XIX_Grundumfang_XIX_Klima.DE_HFS_FH_Oeffnung_4Bit, system-signal=HFS_FH_Oeffnung_4Bit
        communication-direction=IN, data-element=Grundumfang_XIX_Klima.Geltungsbereich_E3_1_1_UNECE_Gen2.RP_IF_HFS_Tuer_geoeffnet_XIX_Grundumfang_XIX_Klima.DE_HFS_Tuer_geoeffnet, system-signal=HFS_Tuer_geoeffnet
        communication-direction=IN, data-element=Grundumfang_XIX_Klima.Geltungsbereich_E3_1_1_UNECE_Gen2.RP_IF_HLR_FSH_Freigabe_XIX_Grundumfang_XIX_Klima.DE_HLR_FSH_Freigabe, system-signal=HLR_FSH_Freigabe
        communication-direction=IN, data-element=Grundumfang_XIX_Klima.Geltungsbereich_E3_1_1_UNECE_Gen2.RP_IF_HLR_HSH_Freigabe_XIX_Grundumfang_XIX_Klima.DE_HLR_HSH_Freigabe, system-signal=HLR_HSH_Freigabe
        communication-direction=IN, data-element=Grundumfang_XIX_Klima.Geltungsbereich_E3_1_1_UNECE_Gen2.RP_IF_HLR_LRH_Freigabe_XIX_Grundumfang_XIX_Klima.DE_HLR_LRH_Freigabe, system-signal=HLR_LRH_Freigabe
        communication-direction=OUT, data-element=Grundumfang_XIX_Klima.Geltungsbereich_E3_1_1_UNECE_Gen2.SP_IF_HLR_SIH_Freigabe_Fond_XIX_Grundumfang_XIX_Klima.DE_HLR_SIH_Freigabe_Fond, system-signal=HLR_SIH_Freigabe_Fond
        communication-direction=IN, data-element=Grundumfang_XIX_Klima.Geltungsbereich_E3_1_1_UNECE_Gen2.RP_IF_HLR_SIH_Freigabe_HL_XIX_Grundumfang_XIX_Klima.DE_HLR_SIH_Freigabe_HL, system-signal=HLR_SIH_Freigabe_HL
        communication-direction=IN, data-element=Grundumfang_XIX_Klima.Geltungsbereich_E3_1_1_UNECE_Gen2.RP_IF_HLR_SIH_Freigabe_HR_XIX_Grundumfang_XIX_Klima.DE_HLR_SIH_Freigabe_HR, system-signal=HLR_SIH_Freigabe_HR
        communication-direction=IN, data-element=Grundumfang_XIX_Klima.Geltungsbereich_E3_1_1_UNECE_Gen2.RP_IF_HLR_SIH_Freigabe_VL_XIX_Grundumfang_XIX_Klima.DE_HLR_SIH_Freigabe_VL, system-signal=HLR_SIH_Freigabe_VL
        communication-direction=IN, data-element=Grundumfang_XIX_Klima.Geltungsbereich_E3_1_1_UNECE_Gen2.RP_IF_HLR_SIH_Freigabe_VR_XIX_Grundumfang_XIX_Klima.DE_HLR_SIH_Freigabe_VR, system-signal=HLR_SIH_Freigabe_VR
        communication-direction=IN, data-element=Grundumfang_XIX_Klima.Geltungsbereich_E3_1_1_UNECE_Gen2.RP_IF_HLR_SIL_Freigabe_HL_XIX_Grundumfang_XIX_Klima.DE_HLR_SIL_Freigabe_HL, system-signal=HLR_SIL_Freigabe_HL
        communication-direction=IN, data-element=Grundumfang_XIX_Klima.Geltungsbereich_E3_1_1_UNECE_Gen2.RP_IF_HLR_SIL_Freigabe_HR_XIX_Grundumfang_XIX_Klima.DE_HLR_SIL_Freigabe_HR, system-signal=HLR_SIL_Freigabe_HR
        communication-direction=IN, data-element=Grundumfang_XIX_Klima.Geltungsbereich_E3_1_1_UNECE_Gen2.RP_IF_HLR_SIL_Freigabe_VL_XIX_Grundumfang_XIX_Klima.DE_HLR_SIL_Freigabe_VL, system-signal=HLR_SIL_Freigabe_VL
        communication-direction=IN, data-element=Grundumfang_XIX_Klima.Geltungsbereich_E3_1_1_UNECE_Gen2.RP_IF_HLR_SIL_Freigabe_VR_XIX_Grundumfang_XIX_Klima.DE_HLR_SIL_Freigabe_VR, system-signal=HLR_SIL_Freigabe_VR
        communication-direction=OUT, data-element=Grundumfang_XIX_Klima.Geltungsbereich_E3_1_1_UNECE_Gen2.SP_IF_HSH_Relais_Anf_XIX_Grundumfang_XIX_Klima.DE_HSH_Relais_Anf, system-signal=HSH_Relais_Anf
        communication-direction=IN, data-element=Grundumfang_XIX_Klima.Geltungsbereich_E3_1_1_UNECE_Gen2.RP_IF_HSH_Status_XIX_Grundumfang_XIX_Klima.DE_HSH_Status, system-signal=HSH_Status
        communication-direction=OUT, data-element=Grundumfang_XIX_Klima.Geltungsbereich_E3_1_1_UNECE_Gen2.SP_IF_HSH_Taster_XIX_Grundumfang_XIX_Klima.DE_HSH_Taster, system-signal=HSH_Taster
        communication-direction=IN, data-element=Grundumfang_XIX_Klima.Geltungsbereich_E3_1_1_UNECE_Gen2.RP_IF_HV_Bordnetz_aktiv_XIX_Grundumfang_XIX_Klima.DE_HV_Bordnetz_aktiv, system-signal=HV_Bordnetz_aktiv
        communication-direction=IN, data-element=Grundumfang_XIX_Klima.Geltungsbereich_E3_1_1_UNECE_Gen2.RP_IF_HV_Bordnetz_Fehler_XIX_Grundumfang_XIX_Klima.DE_HV_Bordnetz_Fehler, system-signal=HV_Bordnetz_Fehler
        communication-direction=IN, data-element=Grundumfang_XIX_Klima.Geltungsbereich_E3_1_1_UNECE_Gen2.RP_IF_HV_H3_Err_intern_XIX_Grundumfang_XIX_Klima.DE_HV_H3_Err_intern, system-signal=HV_H3_Err_intern
