[part 2 of 22: packages /E3_1_1_UNECE_Gen2 to /ECU]
AUTOSAR XML (schema 4-3-0)
package /E3_1_1_UNECE_Gen2  (continued)
  system System  (continued)
    system mapping System_Mappings  (continued)
      data-mappings:  (continued)
        communication-direction=OUT, data-element=Grundumfang_XIX_SAM.Geltungsbereich_E3_1_1_UNECE_Gen2.SP_IF_NM_BCM1_NM_aktiv_TK_geschlossen_XIX_Grundumfang_XIX_SAM.DE_NM_BCM1_NM_aktiv_TK_geschlossen, system-signal=NM_BCM1_NM_aktiv_TK_geschlossen
        communication-direction=OUT, data-element=Grundumfang_XIX_SAM.Geltungsbereich_E3_1_1_UNECE_Gen2.SP_IF_NM_BCM1_NM_aktiv_Tmin_XIX_Grundumfang_XIX_SAM.DE_NM_BCM1_NM_aktiv_Tmin, system-signal=NM_BCM1_NM_aktiv_Tmin
        communication-direction=OUT, data-element=Grundumfang_XIX_SAM.Geltungsbereich_E3_1_1_UNECE_Gen2.SP_IF_NM_BCM1_NM_aktiv_ZV_XIX_Grundumfang_XIX_SAM.DE_NM_BCM1_NM_aktiv_ZV, system-signal=NM_BCM1_NM_aktiv_ZV
        communication-direction=OUT, data-element=Grundumfang_XIX_SAM.Geltungsbereich_E3_1_1_UNECE_Gen2.SP_IF_NM_BCM1_NM_State_XIX_Grundumfang_XIX_SAM.DE_NM_BCM1_NM_State, system-signal=NM_BCM1_NM_State
        communication-direction=OUT, data-element=Grundumfang_XIX_SAM.Geltungsbereich_E3_1_1_UNECE_Gen2.SP_IF_NM_BCM1_UDS_CC_XIX_Grundumfang_XIX_SAM.DE_NM_BCM1_UDS_CC, system-signal=NM_BCM1_UDS_CC
        communication-direction=OUT, data-element=Grundumfang_XIX_SAM.Geltungsbereich_E3_1_1_UNECE_Gen2.SP_IF_NM_BCM1_Wakeup_XIX_Grundumfang_XIX_SAM.DE_NM_BCM1_Wakeup, system-signal=NM_BCM1_Wakeup
        communication-direction=IN, data-element=Grundumfang_XIX_SAM.Geltungsbereich_E3_1_1_UNECE_Gen2.RP_IF_NR1_ORUData_XIX_Grundumfang_XIX_SAM.DE_NR1_ORUData, system-signal=NR1_ORUData
        communication-direction=IN, data-element=Grundumfang_XIX_SAM.Geltungsbereich_E3_1_1_UNECE_Gen2.RP_IF_NR1_ORUDataIndex_XIX_Grundumfang_XIX_SAM.DE_NR1_ORUDataIndex, system-signal=NR1_ORUDataIndex
        communication-direction=IN, data-element=Grundumfang_XIX_SAM.Geltungsbereich_E3_1_1_UNECE_Gen2.RP_IF_NR2_ORUData_XIX_Grundumfang_XIX_SAM.DE_NR2_ORUData, system-signal=NR2_ORUData
        communication-direction=IN, data-element=Grundumfang_XIX_SAM.Geltungsbereich_E3_1_1_UNECE_Gen2.RP_IF_NR2_ORUDataIndex_XIX_Grundumfang_XIX_SAM.DE_NR2_ORUDataIndex, system-signal=NR2_ORUDataIndex
        communication-direction=IN, data-element=Grundumfang_XIX_SAM.Geltungsbereich_E3_1_1_UNECE_Gen2.RP_IF_NR3_ORUData_XIX_Grundumfang_XIX_SAM.DE_NR3_ORUData, system-signal=NR3_ORUData
        communication-direction=IN, data-element=Grundumfang_XIX_SAM.Geltungsbereich_E3_1_1_UNECE_Gen2.RP_IF_NR3_ORUDataIndex_XIX_Grundumfang_XIX_SAM.DE_NR3_ORUDataIndex, system-signal=NR3_ORUDataIndex
        communication-direction=IN, data-element=Grundumfang_XIX_SAM.Geltungsbereich_E3_1_1_UNECE_Gen2.RP_IF_NR4_ORUData_XIX_Grundumfang_XIX_SAM.DE_NR4_ORUData, system-signal=NR4_ORUData
        communication-direction=IN, data-element=Grundumfang_XIX_SAM.Geltungsbereich_E3_1_1_UNECE_Gen2.RP_IF_NR4_ORUDataIndex_XIX_Grundumfang_XIX_SAM.DE_NR4_ORUDataIndex, system-signal=NR4_ORUDataIndex
        communication-direction=IN, data-element=Druckpunktmassage_fuer_Beifahrersitz_Lehnenmassage_SAM_XIX_DPMBFSLM_XIX_SAM.Geltungsbereich_E3_1_1_UNECE_Gen2.RP_IF_NVEM_Abschaltstufe_XIX_Druckpunktmassage_fuer_Beifahrersitz_Lehnenmassage_SAM_XIX_DPMBFSLM_XIX_SAM.DE_NVEM_Abschaltstufe, system-signal=NVEM_Abschaltstufe
        communication-direction=IN, data-element=Druckpunktmassage_fuer_Fahrersitz_Lehnenmassage_SAM_XIX_DPMFSLM_XIX_SAM.Geltungsbereich_E3_1_1_UNECE_Gen2.RP_IF_NVEM_Abschaltstufe_XIX_Druckpunktmassage_fuer_Fahrersitz_Lehnenmassage_SAM_XIX_DPMFSLM_XIX_SAM.DE_NVEM_Abschaltstufe, system-signal=NVEM_Abschaltstufe
        communication-direction=IN, data-element=Grundumfang_XIX_SAM.Geltungsbereich_E3_1_1_UNECE_Gen2.RP_IF_NVEM_Abschaltstufe_XIX_Grundumfang_XIX_SAM.DE_NVEM_Abschaltstufe, system-signal=NVEM_Abschaltstufe
        communication-direction=IN, data-element=Grundumfang_XIX_SAM.Geltungsbereich_E3_1_1_UNECE_Gen2.RP_IF_OBD_Driving_Cycle_XIX_Grundumfang_XIX_SAM.DE_OBD_Driving_Cycle, system-signal=OBD_Driving_Cycle
        communication-direction=IN, data-element=Grundumfang_XIX_SAM.Geltungsbereich_E3_1_1_UNECE_Gen2.RP_IF_OBD_Warm_Up_Cycle_XIX_Grundumfang_XIX_SAM.DE_OBD_Warm_Up_Cycle, system-signal=OBD_Warm_Up_Cycle
        communication-direction=IN, data-element=Grundumfang_XIX_SAM.Geltungsbereich_E3_1_1_UNECE_Gen2.RP_IF_OCC_ORUData_XIX_Grundumfang_XIX_SAM.DE_OCC_ORUData, system-signal=OCC_ORUData
        communication-direction=IN, data-element=Grundumfang_XIX_SAM.Geltungsbereich_E3_1_1_UNECE_Gen2.RP_IF_OCC_ORUDataIndex_XIX_Grundumfang_XIX_SAM.DE_OCC_ORUDataIndex, system-signal=OCC_ORUDataIndex
        communication-direction=IN, data-element=Basis_Klima_XIX_SAM.Geltungsbereich_E3_1_1_UNECE_Gen2.RP_IF_OPS_ComfortReadyStatus_XIX_Basis_Klima_XIX_SAM.DE_OPS_ComfortReadyStatus, system-signal=OPS_ComfortReadyStatus
        communication-direction=IN, data-element=Grundumfang_XIX_SAM.Geltungsbereich_E3_1_1_UNECE_Gen2.RP_IF_OPS_ComfortReadyStatus_XIX_Grundumfang_XIX_SAM.DE_OPS_ComfortReadyStatus, system-signal=OPS_ComfortReadyStatus
        communication-direction=IN, data-element=Grundumfang_XIX_SAM.Geltungsbereich_E3_1_1_UNECE_Gen2.RP_IF_OPS_DriverPresenceStatus_XIX_Grundumfang_XIX_SAM.DE_OPS_DriverPresenceStatus, system-signal=OPS_DriverPresenceStatus
        communication-direction=IN, data-element=Grundumfang_XIX_SAM.Geltungsbereich_E3_1_1_UNECE_Gen2.RP_IF_ORU_0001_BZ_XIX_Grundumfang_XIX_SAM.DE_ORU_0001_BZ, system-signal=ORU_0001_BZ
        communication-direction=IN, data-element=Grundumfang_XIX_SAM.Geltungsbereich_E3_1_1_UNECE_Gen2.RP_IF_ORU_0001_CRC_XIX_Grundumfang_XIX_SAM.DE_ORU_0001_CRC, system-signal=ORU_0001_CRC
        communication-direction=IN, data-element=Grundumfang_XIX_SAM.Geltungsbereich_E3_1_1_UNECE_Gen2.RP_IF_ORU_0003_BZ_XIX_Grundumfang_XIX_SAM.DE_ORU_0003_BZ, system-signal=ORU_0003_BZ
        communication-direction=IN, data-element=Grundumfang_XIX_SAM.Geltungsbereich_E3_1_1_UNECE_Gen2.RP_IF_ORU_0003_CRC_XIX_Grundumfang_XIX_SAM.DE_ORU_0003_CRC, system-signal=ORU_0003_CRC
        communication-direction=IN, data-element=Grundumfang_XIX_SAM.Geltungsbereich_E3_1_1_UNECE_Gen2.RP_IF_ORU_0006_BZ_XIX_Grundumfang_XIX_SAM.DE_ORU_0006_BZ, system-signal=ORU_0006_BZ
        communication-direction=IN, data-element=Grundumfang_XIX_SAM.Geltungsbereich_E3_1_1_UNECE_Gen2.RP_IF_ORU_0006_CRC_XIX_Grundumfang_XIX_SAM.DE_ORU_0006_CRC, system-signal=ORU_0006_CRC
        communication-direction=OUT, data-element=Grundumfang_XIX_SAM.Geltungsbereich_E3_1_1_UNECE_Gen2.SP_IF_ORU_0009_BZ_XIX_Grundumfang_XIX_SAM.DE_ORU_0009_BZ, system-signal=ORU_0009_BZ
        communication-direction=OUT, data-element=Grundumfang_XIX_SAM.Geltungsbereich_E3_1_1_UNECE_Gen2.SP_IF_ORU_0009_CRC_XIX_Grundumfang_XIX_SAM.DE_ORU_0009_CRC, system-signal=ORU_0009_CRC
        communication-direction=IN, data-element=Grundumfang_XIX_SAM.Geltungsbereich_E3_1_1_UNECE_Gen2.RP_IF_ORU_0013_BZ_XIX_Grundumfang_XIX_SAM.DE_ORU_0013_BZ, system-signal=ORU_0013_BZ
        communication-direction=IN, data-element=Grundumfang_XIX_SAM.Geltungsbereich_E3_1_1_UNECE_Gen2.RP_IF_ORU_0013_CRC_XIX_Grundumfang_XIX_SAM.DE_ORU_0013_CRC, system-signal=ORU_0013_CRC
        communication-direction=IN, data-element=Grundumfang_XIX_SAM.Geltungsbereich_E3_1_1_UNECE_Gen2.RP_IF_ORU_0015_BZ_XIX_Grundumfang_XIX_SAM.DE_ORU_0015_BZ, system-signal=ORU_0015_BZ
        communication-direction=IN, data-element=Grundumfang_XIX_SAM.Geltungsbereich_E3_1_1_UNECE_Gen2.RP_IF_ORU_0015_CRC_XIX_Grundumfang_XIX_SAM.DE_ORU_0015_CRC, system-signal=ORU_0015_CRC
        communication-direction=IN, data-element=Grundumfang_XIX_SAM.Geltungsbereich_E3_1_1_UNECE_Gen2.RP_IF_ORU_0016_BZ_XIX_Grundumfang_XIX_SAM.DE_ORU_0016_BZ, system-signal=ORU_0016_BZ
        communication-direction=IN, data-element=Grundumfang_XIX_SAM.Geltungsbereich_E3_1_1_UNECE_Gen2.RP_IF_ORU_0016_CRC_XIX_Grundumfang_XIX_SAM.DE_ORU_0016_CRC, system-signal=ORU_0016_CRC
        communication-direction=IN, data-element=Grundumfang_XIX_SAM.Geltungsbereich_E3_1_1_UNECE_Gen2.RP_IF_ORU_0019_BZ_XIX_Grundumfang_XIX_SAM.DE_ORU_0019_BZ, system-signal=ORU_0019_BZ
        communication-direction=IN, data-element=Grundumfang_XIX_SAM.Geltungsbereich_E3_1_1_UNECE_Gen2.RP_IF_ORU_0019_CRC_XIX_Grundumfang_XIX_SAM.DE_ORU_0019_CRC, system-signal=ORU_0019_CRC
        communication-direction=IN, data-element=Grundumfang_XIX_SAM.Geltungsbereich_E3_1_1_UNECE_Gen2.RP_IF_ORU_0023_BZ_XIX_Grundumfang_XIX_SAM.DE_ORU_0023_BZ, system-signal=ORU_0023_BZ
        communication-direction=IN, data-element=Grundumfang_XIX_SAM.Geltungsbereich_E3_1_1_UNECE_Gen2.RP_IF_ORU_0023_CRC_XIX_Grundumfang_XIX_SAM.DE_ORU_0023_CRC, system-signal=ORU_0023_CRC
        communication-direction=IN, data-element=Grundumfang_XIX_SAM.Geltungsbereich_E3_1_1_UNECE_Gen2.RP_IF_ORU_0036_BZ_XIX_Grundumfang_XIX_SAM.DE_ORU_0036_BZ, system-signal=ORU_0036_BZ
        communication-direction=IN, data-element=Grundumfang_XIX_SAM.Geltungsbereich_E3_1_1_UNECE_Gen2.RP_IF_ORU_0036_CRC_XIX_Grundumfang_XIX_SAM.DE_ORU_0036_CRC, system-signal=ORU_0036_CRC
        communication-direction=IN, data-element=Grundumfang_XIX_SAM.Geltungsbereich_E3_1_1_UNECE_Gen2.RP_IF_ORU_003D_BZ_XIX_Grundumfang_XIX_SAM.DE_ORU_003D_BZ, system-signal=ORU_003D_BZ
        communication-direction=IN, data-element=Grundumfang_XIX_SAM.Geltungsbereich_E3_1_1_UNECE_Gen2.RP_IF_ORU_003D_CRC_XIX_Grundumfang_XIX_SAM.DE_ORU_003D_CRC, system-signal=ORU_003D_CRC
        communication-direction=IN, data-element=Grundumfang_XIX_SAM.Geltungsbereich_E3_1_1_UNECE_Gen2.RP_IF_ORU_0042_BZ_XIX_Grundumfang_XIX_SAM.DE_ORU_0042_BZ, system-signal=ORU_0042_BZ
        communication-direction=IN, data-element=Grundumfang_XIX_SAM.Geltungsbereich_E3_1_1_UNECE_Gen2.RP_IF_ORU_0042_CRC_XIX_Grundumfang_XIX_SAM.DE_ORU_0042_CRC, system-signal=ORU_0042_CRC
        communication-direction=IN, data-element=Grundumfang_XIX_SAM.Geltungsbereich_E3_1_1_UNECE_Gen2.RP_IF_ORU_0044_BZ_XIX_Grundumfang_XIX_SAM.DE_ORU_0044_BZ, system-signal=ORU_0044_BZ
        communication-direction=IN, data-element=Grundumfang_XIX_SAM.Geltungsbereich_E3_1_1_UNECE_Gen2.RP_IF_ORU_0044_CRC_XIX_Grundumfang_XIX_SAM.DE_ORU_0044_CRC, system-signal=ORU_0044_CRC
        communication-direction=IN, data-element=Grundumfang_XIX_SAM.Geltungsbereich_E3_1_1_UNECE_Gen2.RP_IF_ORU_0048_BZ_XIX_Grundumfang_XIX_SAM.DE_ORU_0048_BZ, system-signal=ORU_0048_BZ
        communication-direction=IN, data-element=Grundumfang_XIX_SAM.Geltungsbereich_E3_1_1_UNECE_Gen2.RP_IF_ORU_0048_CRC_XIX_Grundumfang_XIX_SAM.DE_ORU_0048_CRC, system-signal=ORU_0048_CRC
        communication-direction=IN, data-element=Grundumfang_XIX_SAM.Geltungsbereich_E3_1_1_UNECE_Gen2.RP_IF_ORU_0051_BZ_XIX_Grundumfang_XIX_SAM.DE_ORU_0051_BZ, system-signal=ORU_0051_BZ
        communication-direction=IN, data-element=Grundumfang_XIX_SAM.Geltungsbereich_E3_1_1_UNECE_Gen2.RP_IF_ORU_0051_CRC_XIX_Grundumfang_XIX_SAM.DE_ORU_0051_CRC, system-signal=ORU_0051_CRC
        communication-direction=IN, data-element=Grundumfang_XIX_SAM.Geltungsbereich_E3_1_1_UNECE_Gen2.RP_IF_ORU_0052_BZ_XIX_Grundumfang_XIX_SAM.DE_ORU_0052_BZ, system-signal=ORU_0052_BZ
        communication-direction=IN, data-element=Grundumfang_XIX_SAM.Geltungsbereich_E3_1_1_UNECE_Gen2.RP_IF_ORU_0052_CRC_XIX_Grundumfang_XIX_SAM.DE_ORU_0052_CRC, system-signal=ORU_0052_CRC
        communication-direction=IN, data-element=Grundumfang_XIX_SAM.Geltungsbereich_E3_1_1_UNECE_Gen2.RP_IF_ORU_005B_BZ_XIX_Grundumfang_XIX_SAM.DE_ORU_005B_BZ, system-signal=ORU_005B_BZ
        communication-direction=IN, data-element=Grundumfang_XIX_SAM.Geltungsbereich_E3_1_1_UNECE_Gen2.RP_IF_ORU_005B_CRC_XIX_Grundumfang_XIX_SAM.DE_ORU_005B_CRC, system-signal=ORU_005B_CRC
        communication-direction=IN, data-element=Grundumfang_XIX_SAM.Geltungsbereich_E3_1_1_UNECE_Gen2.RP_IF_ORU_0069_BZ_XIX_Grundumfang_XIX_SAM.DE_ORU_0069_BZ, system-signal=ORU_0069_BZ
        communication-direction=IN, data-element=Grundumfang_XIX_SAM.Geltungsbereich_E3_1_1_UNECE_Gen2.RP_IF_ORU_0069_CRC_XIX_Grundumfang_XIX_SAM.DE_ORU_0069_CRC, system-signal=ORU_0069_CRC
        communication-direction=IN, data-element=Grundumfang_XIX_SAM.Geltungsbereich_E3_1_1_UNECE_Gen2.RP_IF_ORU_006A_BZ_XIX_Grundumfang_XIX_SAM.DE_ORU_006A_BZ, system-signal=ORU_006A_BZ
        communication-direction=IN, data-element=Grundumfang_XIX_SAM.Geltungsbereich_E3_1_1_UNECE_Gen2.RP_IF_ORU_006A_CRC_XIX_Grundumfang_XIX_SAM.DE_ORU_006A_CRC, system-signal=ORU_006A_CRC
        communication-direction=IN, data-element=Grundumfang_XIX_SAM.Geltungsbereich_E3_1_1_UNECE_Gen2.RP_IF_ORU_0076_BZ_XIX_Grundumfang_XIX_SAM.DE_ORU_0076_BZ, system-signal=ORU_0076_BZ
        communication-direction=IN, data-element=Grundumfang_XIX_SAM.Geltungsbereich_E3_1_1_UNECE_Gen2.RP_IF_ORU_0076_CRC_XIX_Grundumfang_XIX_SAM.DE_ORU_0076_CRC, system-signal=ORU_0076_CRC
        communication-direction=IN, data-element=Grundumfang_XIX_SAM.Geltungsbereich_E3_1_1_UNECE_Gen2.RP_IF_ORU_007A_BZ_XIX_Grundumfang_XIX_SAM.DE_ORU_007A_BZ, system-signal=ORU_007A_BZ
        communication-direction=IN, data-element=Grundumfang_XIX_SAM.Geltungsbereich_E3_1_1_UNECE_Gen2.RP_IF_ORU_007A_CRC_XIX_Grundumfang_XIX_SAM.DE_ORU_007A_CRC, system-signal=ORU_007A_CRC
        communication-direction=IN, data-element=Grundumfang_XIX_SAM.Geltungsbereich_E3_1_1_UNECE_Gen2.RP_IF_ORU_007E_BZ_XIX_Grundumfang_XIX_SAM.DE_ORU_007E_BZ, system-signal=ORU_007E_BZ
        communication-direction=IN, data-element=Grundumfang_XIX_SAM.Geltungsbereich_E3_1_1_UNECE_Gen2.RP_IF_ORU_007E_CRC_XIX_Grundumfang_XIX_SAM.DE_ORU_007E_CRC, system-signal=ORU_007E_CRC
        communication-direction=IN, data-element=Grundumfang_XIX_SAM.Geltungsbereich_E3_1_1_UNECE_Gen2.RP_IF_ORU_0082_BZ_XIX_Grundumfang_XIX_SAM.DE_ORU_0082_BZ, system-signal=ORU_0082_BZ
        communication-direction=IN, data-element=Grundumfang_XIX_SAM.Geltungsbereich_E3_1_1_UNECE_Gen2.RP_IF_ORU_0082_CRC_XIX_Grundumfang_XIX_SAM.DE_ORU_0082_CRC, system-signal=ORU_0082_CRC
        communication-direction=IN, data-element=Grundumfang_XIX_SAM.Geltungsbereich_E3_1_1_UNECE_Gen2.RP_IF_ORU_008C_BZ_XIX_Grundumfang_XIX_SAM.DE_ORU_008C_BZ, system-signal=ORU_008C_BZ
        communication-direction=IN, data-element=Grundumfang_XIX_SAM.Geltungsbereich_E3_1_1_UNECE_Gen2.RP_IF_ORU_008C_CRC_XIX_Grundumfang_XIX_SAM.DE_ORU_008C_CRC, system-signal=ORU_008C_CRC
        communication-direction=IN, data-element=Grundumfang_XIX_SAM.Geltungsbereich_E3_1_1_UNECE_Gen2.RP_IF_ORU_00A5_BZ_XIX_Grundumfang_XIX_SAM.DE_ORU_00A5_BZ, system-signal=ORU_00A5_BZ
        communication-direction=IN, data-element=Grundumfang_XIX_SAM.Geltungsbereich_E3_1_1_UNECE_Gen2.RP_IF_ORU_00A5_CRC_XIX_Grundumfang_XIX_SAM.DE_ORU_00A5_CRC, system-signal=ORU_00A5_CRC
        communication-direction=IN, data-element=Grundumfang_XIX_SAM.Geltungsbereich_E3_1_1_UNECE_Gen2.RP_IF_ORU_00BB_BZ_XIX_Grundumfang_XIX_SAM.DE_ORU_00BB_BZ, system-signal=ORU_00BB_BZ
        communication-direction=IN, data-element=Grundumfang_XIX_SAM.Geltungsbereich_E3_1_1_UNECE_Gen2.RP_IF_ORU_00BB_CRC_XIX_Grundumfang_XIX_SAM.DE_ORU_00BB_CRC, system-signal=ORU_00BB_CRC
        communication-direction=IN, data-element=Grundumfang_XIX_SAM.Geltungsbereich_E3_1_1_UNECE_Gen2.RP_IF_ORU_00BC_BZ_XIX_Grundumfang_XIX_SAM.DE_ORU_00BC_BZ, system-signal=ORU_00BC_BZ
        communication-direction=IN, data-element=Grundumfang_XIX_SAM.Geltungsbereich_E3_1_1_UNECE_Gen2.RP_IF_ORU_00BC_CRC_XIX_Grundumfang_XIX_SAM.DE_ORU_00BC_CRC, system-signal=ORU_00BC_CRC
        communication-direction=IN, data-element=Grundumfang_XIX_SAM.Geltungsbereich_E3_1_1_UNECE_Gen2.RP_IF_ORU_00C6_BZ_XIX_Grundumfang_XIX_SAM.DE_ORU_00C6_BZ, system-signal=ORU_00C6_BZ
        communication-direction=IN, data-element=Grundumfang_XIX_SAM.Geltungsbereich_E3_1_1_UNECE_Gen2.RP_IF_ORU_00C6_CRC_XIX_Grundumfang_XIX_SAM.DE_ORU_00C6_CRC, system-signal=ORU_00C6_CRC
        communication-direction=IN, data-element=Grundumfang_XIX_SAM.Geltungsbereich_E3_1_1_UNECE_Gen2.RP_IF_ORU_00CE_BZ_XIX_Grundumfang_XIX_SAM.DE_ORU_00CE_BZ, system-signal=ORU_00CE_BZ
        communication-direction=IN, data-element=Grundumfang_XIX_SAM.Geltungsbereich_E3_1_1_UNECE_Gen2.RP_IF_ORU_00CE_CRC_XIX_Grundumfang_XIX_SAM.DE_ORU_00CE_CRC, system-signal=ORU_00CE_CRC
        communication-direction=IN, data-element=Grundumfang_XIX_SAM.Geltungsbereich_E3_1_1_UNECE_Gen2.RP_IF_ORU_00D6_BZ_XIX_Grundumfang_XIX_SAM.DE_ORU_00D6_BZ, system-signal=ORU_00D6_BZ
        communication-direction=IN, data-element=Grundumfang_XIX_SAM.Geltungsbereich_E3_1_1_UNECE_Gen2.RP_IF_ORU_00D6_CRC_XIX_Grundumfang_XIX_SAM.DE_ORU_00D6_CRC, system-signal=ORU_00D6_CRC
        communication-direction=IN, data-element=Grundumfang_XIX_SAM.Geltungsbereich_E3_1_1_UNECE_Gen2.RP_IF_ORU_00D7_BZ_XIX_Grundumfang_XIX_SAM.DE_ORU_00D7_BZ, system-signal=ORU_00D7_BZ
        communication-direction=IN, data-element=Grundumfang_XIX_SAM.Geltungsbereich_E3_1_1_UNECE_Gen2.RP_IF_ORU_00D7_CRC_XIX_Grundumfang_XIX_SAM.DE_ORU_00D7_CRC, system-signal=ORU_00D7_CRC
        communication-direction=IN, data-element=Grundumfang_XIX_SAM.Geltungsbereich_E3_1_1_UNECE_Gen2.RP_IF_ORU_0631_BZ_XIX_Grundumfang_XIX_SAM.DE_ORU_0631_BZ, system-signal=ORU_0631_BZ
        communication-direction=IN, data-element=Grundumfang_XIX_SAM.Geltungsbereich_E3_1_1_UNECE_Gen2.RP_IF_ORU_0631_CRC_XIX_Grundumfang_XIX_SAM.DE_ORU_0631_CRC, system-signal=ORU_0631_CRC
        communication-direction=IN, data-element=Grundumfang_XIX_SAM.Geltungsbereich_E3_1_1_UNECE_Gen2.RP_IF_ORU_8105_BZ_XIX_Grundumfang_XIX_SAM.DE_ORU_8105_BZ, system-signal=ORU_8105_BZ
        communication-direction=IN, data-element=Grundumfang_XIX_SAM.Geltungsbereich_E3_1_1_UNECE_Gen2.RP_IF_ORU_8105_CRC_XIX_Grundumfang_XIX_SAM.DE_ORU_8105_CRC, system-signal=ORU_8105_CRC
        communication-direction=IN, data-element=Grundumfang_XIX_SAM.Geltungsbereich_E3_1_1_UNECE_Gen2.RP_IF_ORU_8109_BZ_XIX_Grundumfang_XIX_SAM.DE_ORU_8109_BZ, system-signal=ORU_8109_BZ
        communication-direction=IN, data-element=Grundumfang_XIX_SAM.Geltungsbereich_E3_1_1_UNECE_Gen2.RP_IF_ORU_8109_CRC_XIX_Grundumfang_XIX_SAM.DE_ORU_8109_CRC, system-signal=ORU_8109_CRC
        communication-direction=IN, data-element=Grundumfang_XIX_SAM.Geltungsbereich_E3_1_1_UNECE_Gen2.RP_IF_ORU_810A_BZ_XIX_Grundumfang_XIX_SAM.DE_ORU_810A_BZ, system-signal=ORU_810A_BZ
        communication-direction=IN, data-element=Grundumfang_XIX_SAM.Geltungsbereich_E3_1_1_UNECE_Gen2.RP_IF_ORU_810A_CRC_XIX_Grundumfang_XIX_SAM.DE_ORU_810A_CRC, system-signal=ORU_810A_CRC
        communication-direction=IN, data-element=Grundumfang_XIX_SAM.Geltungsbereich_E3_1_1_UNECE_Gen2.RP_IF_ORU_810B_BZ_XIX_Grundumfang_XIX_SAM.DE_ORU_810B_BZ, system-signal=ORU_810B_BZ
        communication-direction=IN, data-element=Grundumfang_XIX_SAM.Geltungsbereich_E3_1_1_UNECE_Gen2.RP_IF_ORU_810B_CRC_XIX_Grundumfang_XIX_SAM.DE_ORU_810B_CRC, system-signal=ORU_810B_CRC
        communication-direction=IN, data-element=Grundumfang_XIX_SAM.Geltungsbereich_E3_1_1_UNECE_Gen2.RP_IF_ORU_810C_BZ_XIX_Grundumfang_XIX_SAM.DE_ORU_810C_BZ, system-signal=ORU_810C_BZ
        communication-direction=IN, data-element=Grundumfang_XIX_SAM.Geltungsbereich_E3_1_1_UNECE_Gen2.RP_IF_ORU_810C_CRC_XIX_Grundumfang_XIX_SAM.DE_ORU_810C_CRC, system-signal=ORU_810C_CRC
        communication-direction=IN, data-element=Grundumfang_XIX_SAM.Geltungsbereich_E3_1_1_UNECE_Gen2.RP_IF_ORU_8133_BZ_XIX_Grundumfang_XIX_SAM.DE_ORU_8133_BZ, system-signal=ORU_8133_BZ
        communication-direction=IN, data-element=Grundumfang_XIX_SAM.Geltungsbereich_E3_1_1_UNECE_Gen2.RP_IF_ORU_8133_CRC_XIX_Grundumfang_XIX_SAM.DE_ORU_8133_CRC, system-signal=ORU_8133_CRC
        communication-direction=IN, data-element=Grundumfang_XIX_SAM.Geltungsbereich_E3_1_1_UNECE_Gen2.RP_IF_ORU_8134_BZ_XIX_Grundumfang_XIX_SAM.DE_ORU_8134_BZ, system-signal=ORU_8134_BZ
        communication-direction=IN, data-element=Grundumfang_XIX_SAM.Geltungsbereich_E3_1_1_UNECE_Gen2.RP_IF_ORU_8134_CRC_XIX_Grundumfang_XIX_SAM.DE_ORU_8134_CRC, system-signal=ORU_8134_CRC
        communication-direction=IN, data-element=Grundumfang_XIX_SAM.Geltungsbereich_E3_1_1_UNECE_Gen2.RP_IF_ORU_8179_BZ_XIX_Grundumfang_XIX_SAM.DE_ORU_8179_BZ, system-signal=ORU_8179_BZ
        communication-direction=IN, data-element=Grundumfang_XIX_SAM.Geltungsbereich_E3_1_1_UNECE_Gen2.RP_IF_ORU_8179_CRC_XIX_Grundumfang_XIX_SAM.DE_ORU_8179_CRC, system-signal=ORU_8179_CRC
        communication-direction=IN, data-element=Grundumfang_XIX_SAM.Geltungsbereich_E3_1_1_UNECE_Gen2.RP_IF_ORU_817B_BZ_XIX_Grundumfang_XIX_SAM.DE_ORU_817B_BZ, system-signal=ORU_817B_BZ
        communication-direction=IN, data-element=Grundumfang_XIX_SAM.Geltungsbereich_E3_1_1_UNECE_Gen2.RP_IF_ORU_817B_CRC_XIX_Grundumfang_XIX_SAM.DE_ORU_817B_CRC, system-signal=ORU_817B_CRC
        communication-direction=IN, data-element=Grundumfang_XIX_SAM.Geltungsbereich_E3_1_1_UNECE_Gen2.RP_IF_ORU_8181_BZ_XIX_Grundumfang_XIX_SAM.DE_ORU_8181_BZ, system-signal=ORU_8181_BZ
        communication-direction=IN, data-element=Grundumfang_XIX_SAM.Geltungsbereich_E3_1_1_UNECE_Gen2.RP_IF_ORU_8181_CRC_XIX_Grundumfang_XIX_SAM.DE_ORU_8181_CRC, system-signal=ORU_8181_CRC
        communication-direction=IN, data-element=Grundumfang_XIX_SAM.Geltungsbereich_E3_1_1_UNECE_Gen2.RP_IF_ORU_AP_Mode_XIX_Grundumfang_XIX_SAM.DE_ORU_AP_Mode, system-signal=ORU_AP_Mode
        communication-direction=IN, data-element=Grundumfang_XIX_SAM.Geltungsbereich_E3_1_1_UNECE_Gen2.RP_IF_ORU_DiagAddress_XIX_Grundumfang_XIX_SAM.DE_ORU_DiagAddress, system-signal=ORU_DiagAddress
        communication-direction=IN, data-element=Grundumfang_XIX_SAM.Geltungsbereich_E3_1_1_UNECE_Gen2.RP_IF_ORU_Status_XIX_Grundumfang_XIX_SAM.DE_ORU_Status, system-signal=ORU_Status
        communication-direction=IN, data-element=Grundumfang_XIX_SAM.Geltungsbereich_E3_1_1_UNECE_Gen2.RP_IF_ORUG01_01_BZ_XIX_Grundumfang_XIX_SAM.DE_ORUG01_01_BZ, system-signal=ORUG01_01_BZ
        communication-direction=IN, data-element=Grundumfang_XIX_SAM.Geltungsbereich_E3_1_1_UNECE_Gen2.RP_IF_ORUG01_01_CRC_XIX_Grundumfang_XIX_SAM.DE_ORUG01_01_CRC, system-signal=ORUG01_01_CRC
        communication-direction=OUT, data-element=Grundumfang_XIX_SAM.Geltungsbereich_E3_1_1_UNECE_Gen2.SP_IF_ORUG02_01_BZ_XIX_Grundumfang_XIX_SAM.DE_ORUG02_01_BZ, system-signal=ORUG02_01_BZ
        communication-direction=OUT, data-element=Grundumfang_XIX_SAM.Geltungsbereich_E3_1_1_UNECE_Gen2.SP_IF_ORUG02_01_CRC_XIX_Grundumfang_XIX_SAM.DE_ORUG02_01_CRC, system-signal=ORUG02_01_CRC
        communication-direction=IN, data-element=Grundumfang_XIX_SAM.Geltungsbereich_E3_1_1_UNECE_Gen2.RP_IF_ORUG1_HVReleased_XIX_Grundumfang_XIX_SAM.DE_ORUG1_HVReleased, system-signal=ORUG1_HVReleased
        communication-direction=IN, data-element=Grundumfang_XIX_SAM.Geltungsbereich_E3_1_1_UNECE_Gen2.RP_IF_ORUG1_TargetRelease_XIX_Grundumfang_XIX_SAM.DE_ORUG1_TargetRelease, system-signal=ORUG1_TargetRelease
        communication-direction=OUT, data-element=Grundumfang_XIX_SAM.Geltungsbereich_E3_1_1_UNECE_Gen2.SP_IF_ORUG2_GuardInfo_XIX_Grundumfang_XIX_SAM.DE_ORUG2_GuardInfo, system-signal=ORUG2_GuardInfo
        communication-direction=OUT, data-element=Grundumfang_XIX_SAM.Geltungsbereich_E3_1_1_UNECE_Gen2.SP_IF_ORUG2_GuardState_XIX_Grundumfang_XIX_SAM.DE_ORUG2_GuardState, system-signal=ORUG2_GuardState
        communication-direction=OUT, data-element=Grundumfang_XIX_SAM.Geltungsbereich_E3_1_1_UNECE_Gen2.SP_IF_ORUG2_TargetRelease_XIX_Grundumfang_XIX_SAM.DE_ORUG2_TargetRelease, system-signal=ORUG2_TargetRelease
        communication-direction=OUT, data-element=Grundumfang_XIX_SAM.Geltungsbereich_E3_1_1_UNECE_Gen2.SP_IF_ORUG2_TorqueLock_XIX_Grundumfang_XIX_SAM.DE_ORUG2_TorqueLock, system-signal=ORUG2_TorqueLock
        communication-direction=OUT, data-element=Grundumfang_XIX_SAM.Geltungsbereich_E3_1_1_UNECE_Gen2.SP_IF_PAO_OFF_Anf_invers_XIX_Grundumfang_XIX_SAM.DE_PAO_OFF_Anf_invers, system-signal=PAO_OFF_Anf_invers
        communication-direction=OUT, data-element=Grundumfang_XIX_SAM.Geltungsbereich_E3_1_1_UNECE_Gen2.SP_IF_PAO_ON_Anf_invers_XIX_Grundumfang_XIX_SAM.DE_PAO_ON_Anf_invers, system-signal=PAO_ON_Anf_invers
        communication-direction=IN, data-element=Grundumfang_XIX_SAM.Geltungsbereich_E3_1_1_UNECE_Gen2.RP_IF_Parken_aktives_System_02_XIX_Grundumfang_XIX_SAM.DE_Parken_aktives_System_02, system-signal=Parken_aktives_System_02
        communication-direction=IN, data-element=Grundumfang_XIX_SAM.Geltungsbereich_E3_1_1_UNECE_Gen2.RP_IF_Perso_Kontonummer_XIX_Grundumfang_XIX_SAM.DE_Perso_Kontonummer, system-signal=Perso_Kontonummer
        communication-direction=IN, data-element=Grundumfang_XIX_SAM.Geltungsbereich_E3_1_1_UNECE_Gen2.RP_IF_Perso_Status_XIX_Grundumfang_XIX_SAM.DE_Perso_Status, system-signal=Perso_Status
        communication-direction=IN, data-element=Grundumfang_XIX_SAM.Geltungsbereich_E3_1_1_UNECE_Gen2.RP_IF_Perso_Steuerung_XIX_Grundumfang_XIX_SAM.DE_Perso_Steuerung, system-signal=Perso_Steuerung
        communication-direction=IN, data-element=Grundumfang_XIX_SAM.Geltungsbereich_E3_1_1_UNECE_Gen2.RP_IF_Perso_Steuerungsparameter_XIX_Grundumfang_XIX_SAM.DE_Perso_Steuerungsparameter, system-signal=Perso_Steuerungsparameter
        communication-direction=IN, data-element=Druckpunktmassage_fuer_Beifahrersitz_Lehnenmassage_SAM_XIX_DPMBFSLM_XIX_SAM.Geltungsbereich_E3_1_1_UNECE_Gen2.RP_IF_PreCrash_BFS_Pneumatik_ansteuern_XIX_Druckpunktmassage_fuer_Beifahrersitz_Lehnenmassage_SAM_XIX_DPMBFSLM_XIX_SAM.DE_PreCrash_BFS_Pneumatik_ansteuern, system-signal=PreCrash_BFS_Pneumatik_ansteuern
        communication-direction=IN, data-element=Druckpunktmassage_fuer_Fahrersitz_Lehnenmassage_SAM_XIX_DPMFSLM_XIX_SAM.Geltungsbereich_E3_1_1_UNECE_Gen2.RP_IF_PreCrash_BFS_Pneumatik_ansteuern_XIX_Druckpunktmassage_fuer_Fahrersitz_Lehnenmassage_SAM_XIX_DPMFSLM_XIX_SAM.DE_PreCrash_BFS_Pneumatik_ansteuern, system-signal=PreCrash_BFS_Pneumatik_ansteuern
        communication-direction=IN, data-element=Grundumfang_XIX_SAM.Geltungsbereich_E3_1_1_UNECE_Gen2.RP_IF_PreCrash_BFS_Pneumatik_ansteuern_XIX_Grundumfang_XIX_SAM.DE_PreCrash_BFS_Pneumatik_ansteuern, system-signal=PreCrash_BFS_Pneumatik_ansteuern
        communication-direction=IN, data-element=Grundumfang_XIX_SAM.Geltungsbereich_E3_1_1_UNECE_Gen2.RP_IF_PreCrash_Fenster_schliessen_XIX_Grundumfang_XIX_SAM.DE_PreCrash_Fenster_schliessen, system-signal=PreCrash_Fenster_schliessen
        communication-direction=IN, data-element=Druckpunktmassage_fuer_Beifahrersitz_Lehnenmassage_SAM_XIX_DPMBFSLM_XIX_SAM.Geltungsbereich_E3_1_1_UNECE_Gen2.RP_IF_PreCrash_FS_Pneumatik_ansteuern_XIX_Druckpunktmassage_fuer_Beifahrersitz_Lehnenmassage_SAM_XIX_DPMBFSLM_XIX_SAM.DE_PreCrash_FS_Pneumatik_ansteuern, system-signal=PreCrash_FS_Pneumatik_ansteuern
        communication-direction=IN, data-element=Druckpunktmassage_fuer_Fahrersitz_Lehnenmassage_SAM_XIX_DPMFSLM_XIX_SAM.Geltungsbereich_E3_1_1_UNECE_Gen2.RP_IF_PreCrash_FS_Pneumatik_ansteuern_XIX_Druckpunktmassage_fuer_Fahrersitz_Lehnenmassage_SAM_XIX_DPMFSLM_XIX_SAM.DE_PreCrash_FS_Pneumatik_ansteuern, system-signal=PreCrash_FS_Pneumatik_ansteuern
        communication-direction=IN, data-element=Grundumfang_XIX_SAM.Geltungsbereich_E3_1_1_UNECE_Gen2.RP_IF_PreCrash_FS_Pneumatik_ansteuern_XIX_Grundumfang_XIX_SAM.DE_PreCrash_FS_Pneumatik_ansteuern, system-signal=PreCrash_FS_Pneumatik_ansteuern
        communication-direction=IN, data-element=Grundumfang_XIX_SAM.Geltungsbereich_E3_1_1_UNECE_Gen2.RP_IF_RCTA_Kritikalitaetslevel_links_XIX_Grundumfang_XIX_SAM.DE_RCTA_Kritikalitaetslevel_links, system-signal=RCTA_Kritikalitaetslevel_links
        communication-direction=IN, data-element=Grundumfang_XIX_SAM.Geltungsbereich_E3_1_1_UNECE_Gen2.RP_IF_RCTA_Kritikalitaetslevel_rechts_XIX_Grundumfang_XIX_SAM.DE_RCTA_Kritikalitaetslevel_rechts, system-signal=RCTA_Kritikalitaetslevel_rechts
        communication-direction=IN, data-element=Grundumfang_XIX_SAM.Geltungsbereich_E3_1_1_UNECE_Gen2.RP_IF_RGB_Slave_01_IntErrorNvm_XIX_Grundumfang_XIX_SAM.DE_RGB_Slave_01_IntErrorNvm, system-signal=RGB_Slave_01_IntErrorNvm
        communication-direction=IN, data-element=Grundumfang_XIX_SAM.Geltungsbereich_E3_1_1_UNECE_Gen2.RP_IF_RGB_Slave_01_IntErrorRam_XIX_Grundumfang_XIX_SAM.DE_RGB_Slave_01_IntErrorRam, system-signal=RGB_Slave_01_IntErrorRam
        communication-direction=IN, data-element=Grundumfang_XIX_SAM.Geltungsbereich_E3_1_1_UNECE_Gen2.RP_IF_RGB_Slave_01_IntErrorRom_XIX_Grundumfang_XIX_SAM.DE_RGB_Slave_01_IntErrorRom, system-signal=RGB_Slave_01_IntErrorRom
        communication-direction=IN, data-element=Grundumfang_XIX_SAM.Geltungsbereich_E3_1_1_UNECE_Gen2.RP_IF_RGB_Slave_01_LedBlauOl_XIX_Grundumfang_XIX_SAM.DE_RGB_Slave_01_LedBlauOl, system-signal=RGB_Slave_01_LedBlauOl
        communication-direction=IN, data-element=Grundumfang_XIX_SAM.Geltungsbereich_E3_1_1_UNECE_Gen2.RP_IF_RGB_Slave_01_LedBlauStg_XIX_Grundumfang_XIX_SAM.DE_RGB_Slave_01_LedBlauStg, system-signal=RGB_Slave_01_LedBlauStg
        communication-direction=IN, data-element=Grundumfang_XIX_SAM.Geltungsbereich_E3_1_1_UNECE_Gen2.RP_IF_RGB_Slave_01_LedGruenOl_XIX_Grundumfang_XIX_SAM.DE_RGB_Slave_01_LedGruenOl, system-signal=RGB_Slave_01_LedGruenOl
        communication-direction=IN, data-element=Grundumfang_XIX_SAM.Geltungsbereich_E3_1_1_UNECE_Gen2.RP_IF_RGB_Slave_01_LedGruenStg_XIX_Grundumfang_XIX_SAM.DE_RGB_Slave_01_LedGruenStg, system-signal=RGB_Slave_01_LedGruenStg
        communication-direction=IN, data-element=Grundumfang_XIX_SAM.Geltungsbereich_E3_1_1_UNECE_Gen2.RP_IF_RGB_Slave_01_LedRotOl_XIX_Grundumfang_XIX_SAM.DE_RGB_Slave_01_LedRotOl, system-signal=RGB_Slave_01_LedRotOl
        communication-direction=IN, data-element=Grundumfang_XIX_SAM.Geltungsbereich_E3_1_1_UNECE_Gen2.RP_IF_RGB_Slave_01_LedRotStg_XIX_Grundumfang_XIX_SAM.DE_RGB_Slave_01_LedRotStg, system-signal=RGB_Slave_01_LedRotStg
        communication-direction=IN, data-element=Grundumfang_XIX_SAM.Geltungsbereich_E3_1_1_UNECE_Gen2.RP_IF_RGB_Slave_01_ResponseError_XIX_Grundumfang_XIX_SAM.DE_RGB_Slave_01_ResponseError, system-signal=RGB_Slave_01_ResponseError
        communication-direction=IN, data-element=Grundumfang_XIX_SAM.Geltungsbereich_E3_1_1_UNECE_Gen2.RP_IF_RGB_Slave_01_TempState_XIX_Grundumfang_XIX_SAM.DE_RGB_Slave_01_TempState, system-signal=RGB_Slave_01_TempState
        communication-direction=IN, data-element=Grundumfang_XIX_SAM.Geltungsbereich_E3_1_1_UNECE_Gen2.RP_IF_RGB_Slave_02_IntErrorNvm_XIX_Grundumfang_XIX_SAM.DE_RGB_Slave_02_IntErrorNvm, system-signal=RGB_Slave_02_IntErrorNvm
        communication-direction=IN, data-element=Grundumfang_XIX_SAM.Geltungsbereich_E3_1_1_UNECE_Gen2.RP_IF_RGB_Slave_02_IntErrorRam_XIX_Grundumfang_XIX_SAM.DE_RGB_Slave_02_IntErrorRam, system-signal=RGB_Slave_02_IntErrorRam
        communication-direction=IN, data-element=Grundumfang_XIX_SAM.Geltungsbereich_E3_1_1_UNECE_Gen2.RP_IF_RGB_Slave_02_IntErrorRom_XIX_Grundumfang_XIX_SAM.DE_RGB_Slave_02_IntErrorRom, system-signal=RGB_Slave_02_IntErrorRom
        communication-direction=IN, data-element=Grundumfang_XIX_SAM.Geltungsbereich_E3_1_1_UNECE_Gen2.RP_IF_RGB_Slave_02_LedBlauOl_XIX_Grundumfang_XIX_SAM.DE_RGB_Slave_02_LedBlauOl, system-signal=RGB_Slave_02_LedBlauOl
        communication-direction=IN, data-element=Grundumfang_XIX_SAM.Geltungsbereich_E3_1_1_UNECE_Gen2.RP_IF_RGB_Slave_02_LedBlauStg_XIX_Grundumfang_XIX_SAM.DE_RGB_Slave_02_LedBlauStg, system-signal=RGB_Slave_02_LedBlauStg
        communication-direction=IN, data-element=Grundumfang_XIX_SAM.Geltungsbereich_E3_1_1_UNECE_Gen2.RP_IF_RGB_Slave_02_LedGruenOl_XIX_Grundumfang_XIX_SAM.DE_RGB_Slave_02_LedGruenOl, system-signal=RGB_Slave_02_LedGruenOl
        communication-direction=IN, data-element=Grundumfang_XIX_SAM.Geltungsbereich_E3_1_1_UNECE_Gen2.RP_IF_RGB_Slave_02_LedGruenStg_XIX_Grundumfang_XIX_SAM.DE_RGB_Slave_02_LedGruenStg, system-signal=RGB_Slave_02_LedGruenStg
        communication-direction=IN, data-element=Grundumfang_XIX_SAM.Geltungsbereich_E3_1_1_UNECE_Gen2.RP_IF_RGB_Slave_02_LedRotOl_XIX_Grundumfang_XIX_SAM.DE_RGB_Slave_02_LedRotOl, system-signal=RGB_Slave_02_LedRotOl
        communication-direction=IN, data-element=Grundumfang_XIX_SAM.Geltungsbereich_E3_1_1_UNECE_Gen2.RP_IF_RGB_Slave_02_LedRotStg_XIX_Grundumfang_XIX_SAM.DE_RGB_Slave_02_LedRotStg, system-signal=RGB_Slave_02_LedRotStg
        communication-direction=IN, data-element=Grundumfang_XIX_SAM.Geltungsbereich_E3_1_1_UNECE_Gen2.RP_IF_RGB_Slave_02_ResponseError_XIX_Grundumfang_XIX_SAM.DE_RGB_Slave_02_ResponseError, system-signal=RGB_Slave_02_ResponseError
        communication-direction=IN, data-element=Grundumfang_XIX_SAM.Geltungsbereich_E3_1_1_UNECE_Gen2.RP_IF_RGB_Slave_02_TempState_XIX_Grundumfang_XIX_SAM.DE_RGB_Slave_02_TempState, system-signal=RGB_Slave_02_TempState
        communication-direction=IN, data-element=Grundumfang_XIX_SAM.Geltungsbereich_E3_1_1_UNECE_Gen2.RP_IF_RGB_Slave_03_IntErrorNvm_XIX_Grundumfang_XIX_SAM.DE_RGB_Slave_03_IntErrorNvm, system-signal=RGB_Slave_03_IntErrorNvm
        communication-direction=IN, data-element=Grundumfang_XIX_SAM.Geltungsbereich_E3_1_1_UNECE_Gen2.RP_IF_RGB_Slave_03_IntErrorRam_XIX_Grundumfang_XIX_SAM.DE_RGB_Slave_03_IntErrorRam, system-signal=RGB_Slave_03_IntErrorRam
        communication-direction=IN, data-element=Grundumfang_XIX_SAM.Geltungsbereich_E3_1_1_UNECE_Gen2.RP_IF_RGB_Slave_03_IntErrorRom_XIX_Grundumfang_XIX_SAM.DE_RGB_Slave_03_IntErrorRom, system-signal=RGB_Slave_03_IntErrorRom
        communication-direction=IN, data-element=Grundumfang_XIX_SAM.Geltungsbereich_E3_1_1_UNECE_Gen2.RP_IF_RGB_Slave_03_LedBlauOl_XIX_Grundumfang_XIX_SAM.DE_RGB_Slave_03_LedBlauOl, system-signal=RGB_Slave_03_LedBlauOl
        communication-direction=IN, data-element=Grundumfang_XIX_SAM.Geltungsbereich_E3_1_1_UNECE_Gen2.RP_IF_RGB_Slave_03_LedBlauStg_XIX_Grundumfang_XIX_SAM.DE_RGB_Slave_03_LedBlauStg, system-signal=RGB_Slave_03_LedBlauStg
        communication-direction=IN, data-element=Grundumfang_XIX_SAM.Geltungsbereich_E3_1_1_UNECE_Gen2.RP_IF_RGB_Slave_03_LedGruenOl_XIX_Grundumfang_XIX_SAM.DE_RGB_Slave_03_LedGruenOl, system-signal=RGB_Slave_03_LedGruenOl
        communication-direction=IN, data-element=Grundumfang_XIX_SAM.Geltungsbereich_E3_1_1_UNECE_Gen2.RP_IF_RGB_Slave_03_LedGruenStg_XIX_Grundumfang_XIX_SAM.DE_RGB_Slave_03_LedGruenStg, system-signal=RGB_Slave_03_LedGruenStg
        communication-direction=IN, data-element=Grundumfang_XIX_SAM.Geltungsbereich_E3_1_1_UNECE_Gen2.RP_IF_RGB_Slave_03_LedRotOl_XIX_Grundumfang_XIX_SAM.DE_RGB_Slave_03_LedRotOl, system-signal=RGB_Slave_03_LedRotOl
        communication-direction=IN, data-element=Grundumfang_XIX_SAM.Geltungsbereich_E3_1_1_UNECE_Gen2.RP_IF_RGB_Slave_03_LedRotStg_XIX_Grundumfang_XIX_SAM.DE_RGB_Slave_03_LedRotStg, system-signal=RGB_Slave_03_LedRotStg
        communication-direction=IN, data-element=Grundumfang_XIX_SAM.Geltungsbereich_E3_1_1_UNECE_Gen2.RP_IF_RGB_Slave_03_ResponseError_XIX_Grundumfang_XIX_SAM.DE_RGB_Slave_03_ResponseError, system-signal=RGB_Slave_03_ResponseError
        communication-direction=IN, data-element=Grundumfang_XIX_SAM.Geltungsbereich_E3_1_1_UNECE_Gen2.RP_IF_RGB_Slave_03_TempState_XIX_Grundumfang_XIX_SAM.DE_RGB_Slave_03_TempState, system-signal=RGB_Slave_03_TempState
        communication-direction=IN, data-element=Grundumfang_XIX_SAM.Geltungsbereich_E3_1_1_UNECE_Gen2.RP_IF_RGB_Slave_04_IntErrorNvm_XIX_Grundumfang_XIX_SAM.DE_RGB_Slave_04_IntErrorNvm, system-signal=RGB_Slave_04_IntErrorNvm
        communication-direction=IN, data-element=Grundumfang_XIX_SAM.Geltungsbereich_E3_1_1_UNECE_Gen2.RP_IF_RGB_Slave_04_IntErrorRam_XIX_Grundumfang_XIX_SAM.DE_RGB_Slave_04_IntErrorRam, system-signal=RGB_Slave_04_IntErrorRam
        communication-direction=IN, data-element=Grundumfang_XIX_SAM.Geltungsbereich_E3_1_1_UNECE_Gen2.RP_IF_RGB_Slave_04_IntErrorRom_XIX_Grundumfang_XIX_SAM.DE_RGB_Slave_04_IntErrorRom, system-signal=RGB_Slave_04_IntErrorRom
        communication-direction=IN, data-element=Grundumfang_XIX_SAM.Geltungsbereich_E3_1_1_UNECE_Gen2.RP_IF_RGB_Slave_04_LedBlauOl_XIX_Grundumfang_XIX_SAM.DE_RGB_Slave_04_LedBlauOl, system-signal=RGB_Slave_04_LedBlauOl
        communication-direction=IN, data-element=Grundumfang_XIX_SAM.Geltungsbereich_E3_1_1_UNECE_Gen2.RP_IF_RGB_Slave_04_LedBlauStg_XIX_Grundumfang_XIX_SAM.DE_RGB_Slave_04_LedBlauStg, system-signal=RGB_Slave_04_LedBlauStg
        communication-direction=IN, data-element=Grundumfang_XIX_SAM.Geltungsbereich_E3_1_1_UNECE_Gen2.RP_IF_RGB_Slave_04_LedGruenOl_XIX_Grundumfang_XIX_SAM.DE_RGB_Slave_04_LedGruenOl, system-signal=RGB_Slave_04_LedGruenOl
        communication-direction=IN, data-element=Grundumfang_XIX_SAM.Geltungsbereich_E3_1_1_UNECE_Gen2.RP_IF_RGB_Slave_04_LedGruenStg_XIX_Grundumfang_XIX_SAM.DE_RGB_Slave_04_LedGruenStg, system-signal=RGB_Slave_04_LedGruenStg
        communication-direction=IN, data-element=Grundumfang_XIX_SAM.Geltungsbereich_E3_1_1_UNECE_Gen2.RP_IF_RGB_Slave_04_LedRotOl_XIX_Grundumfang_XIX_SAM.DE_RGB_Slave_04_LedRotOl, system-signal=RGB_Slave_04_LedRotOl
        communication-direction=IN, data-element=Grundumfang_XIX_SAM.Geltungsbereich_E3_1_1_UNECE_Gen2.RP_IF_RGB_Slave_04_LedRotStg_XIX_Grundumfang_XIX_SAM.DE_RGB_Slave_04_LedRotStg, system-signal=RGB_Slave_04_LedRotStg
        communication-direction=IN, data-element=Grundumfang_XIX_SAM.Geltungsbereich_E3_1_1_UNECE_Gen2.RP_IF_RGB_Slave_04_ResponseError_XIX_Grundumfang_XIX_SAM.DE_RGB_Slave_04_ResponseError, system-signal=RGB_Slave_04_ResponseError
        communication-direction=IN, data-element=Grundumfang_XIX_SAM.Geltungsbereich_E3_1_1_UNECE_Gen2.RP_IF_RGB_Slave_04_TempState_XIX_Grundumfang_XIX_SAM.DE_RGB_Slave_04_TempState, system-signal=RGB_Slave_04_TempState
        communication-direction=IN, data-element=Grundumfang_XIX_SAM.Geltungsbereich_E3_1_1_UNECE_Gen2.RP_IF_RGB_Slave_05_IntErrorNvm_XIX_Grundumfang_XIX_SAM.DE_RGB_Slave_05_IntErrorNvm, system-signal=RGB_Slave_05_IntErrorNvm
        communication-direction=IN, data-element=Grundumfang_XIX_SAM.Geltungsbereich_E3_1_1_UNECE_Gen2.RP_IF_RGB_Slave_05_IntErrorRam_XIX_Grundumfang_XIX_SAM.DE_RGB_Slave_05_IntErrorRam, system-signal=RGB_Slave_05_IntErrorRam
        communication-direction=IN, data-element=Grundumfang_XIX_SAM.Geltungsbereich_E3_1_1_UNECE_Gen2.RP_IF_RGB_Slave_05_IntErrorRom_XIX_Grundumfang_XIX_SAM.DE_RGB_Slave_05_IntErrorRom, system-signal=RGB_Slave_05_IntErrorRom
        communication-direction=IN, data-element=Grundumfang_XIX_SAM.Geltungsbereich_E3_1_1_UNECE_Gen2.RP_IF_RGB_Slave_05_LedBlauOl_XIX_Grundumfang_XIX_SAM.DE_RGB_Slave_05_LedBlauOl, system-signal=RGB_Slave_05_LedBlauOl
        communication-direction=IN, data-element=Grundumfang_XIX_SAM.Geltungsbereich_E3_1_1_UNECE_Gen2.RP_IF_RGB_Slave_05_LedBlauStg_XIX_Grundumfang_XIX_SAM.DE_RGB_Slave_05_LedBlauStg, system-signal=RGB_Slave_05_LedBlauStg
        communication-direction=IN, data-element=Grundumfang_XIX_SAM.Geltungsbereich_E3_1_1_UNECE_Gen2.RP_IF_RGB_Slave_05_LedGruenOl_XIX_Grundumfang_XIX_SAM.DE_RGB_Slave_05_LedGruenOl, system-signal=RGB_Slave_05_LedGruenOl
        communication-direction=IN, data-element=Grundumfang_XIX_SAM.Geltungsbereich_E3_1_1_UNECE_Gen2.RP_IF_RGB_Slave_05_LedGruenStg_XIX_Grundumfang_XIX_SAM.DE_RGB_Slave_05_LedGruenStg, system-signal=RGB_Slave_05_LedGruenStg
        communication-direction=IN, data-element=Grundumfang_XIX_SAM.Geltungsbereich_E3_1_1_UNECE_Gen2.RP_IF_RGB_Slave_05_LedRotOl_XIX_Grundumfang_XIX_SAM.DE_RGB_Slave_05_LedRotOl, system-signal=RGB_Slave_05_LedRotOl
        communication-direction=IN, data-element=Grundumfang_XIX_SAM.Geltungsbereich_E3_1_1_UNECE_Gen2.RP_IF_RGB_Slave_05_LedRotStg_XIX_Grundumfang_XIX_SAM.DE_RGB_Slave_05_LedRotStg, system-signal=RGB_Slave_05_LedRotStg
        communication-direction=IN, data-element=Grundumfang_XIX_SAM.Geltungsbereich_E3_1_1_UNECE_Gen2.RP_IF_RGB_Slave_05_ResponseError_XIX_Grundumfang_XIX_SAM.DE_RGB_Slave_05_ResponseError, system-signal=RGB_Slave_05_ResponseError
        communication-direction=IN, data-element=Grundumfang_XIX_SAM.Geltungsbereich_E3_1_1_UNECE_Gen2.RP_IF_RGB_Slave_05_TempState_XIX_Grundumfang_XIX_SAM.DE_RGB_Slave_05_TempState, system-signal=RGB_Slave_05_TempState
        communication-direction=IN, data-element=Grundumfang_XIX_SAM.Geltungsbereich_E3_1_1_UNECE_Gen2.RP_IF_RGB_Slave_06_IntErrorNvm_XIX_Grundumfang_XIX_SAM.DE_RGB_Slave_06_IntErrorNvm, system-signal=RGB_Slave_06_IntErrorNvm
        communication-direction=IN, data-element=Grundumfang_XIX_SAM.Geltungsbereich_E3_1_1_UNECE_Gen2.RP_IF_RGB_Slave_06_IntErrorRam_XIX_Grundumfang_XIX_SAM.DE_RGB_Slave_06_IntErrorRam, system-signal=RGB_Slave_06_IntErrorRam
        communication-direction=IN, data-element=Grundumfang_XIX_SAM.Geltungsbereich_E3_1_1_UNECE_Gen2.RP_IF_RGB_Slave_06_IntErrorRom_XIX_Grundumfang_XIX_SAM.DE_RGB_Slave_06_IntErrorRom, system-signal=RGB_Slave_06_IntErrorRom
        communication-direction=IN, data-element=Grundumfang_XIX_SAM.Geltungsbereich_E3_1_1_UNECE_Gen2.RP_IF_RGB_Slave_06_LedBlauOl_XIX_Grundumfang_XIX_SAM.DE_RGB_Slave_06_LedBlauOl, system-signal=RGB_Slave_06_LedBlauOl
        communication-direction=IN, data-element=Grundumfang_XIX_SAM.Geltungsbereich_E3_1_1_UNECE_Gen2.RP_IF_RGB_Slave_06_LedBlauStg_XIX_Grundumfang_XIX_SAM.DE_RGB_Slave_06_LedBlauStg, system-signal=RGB_Slave_06_LedBlauStg
        communication-direction=IN, data-element=Grundumfang_XIX_SAM.Geltungsbereich_E3_1_1_UNECE_Gen2.RP_IF_RGB_Slave_06_LedGruenOl_XIX_Grundumfang_XIX_SAM.DE_RGB_Slave_06_LedGruenOl, system-signal=RGB_Slave_06_LedGruenOl
        communication-direction=IN, data-element=Grundumfang_XIX_SAM.Geltungsbereich_E3_1_1_UNECE_Gen2.RP_IF_RGB_Slave_06_LedGruenStg_XIX_Grundumfang_XIX_SAM.DE_RGB_Slave_06_LedGruenStg, system-signal=RGB_Slave_06_LedGruenStg
        communication-direction=IN, data-element=Grundumfang_XIX_SAM.Geltungsbereich_E3_1_1_UNECE_Gen2.RP_IF_RGB_Slave_06_LedRotOl_XIX_Grundumfang_XIX_SAM.DE_RGB_Slave_06_LedRotOl, system-signal=RGB_Slave_06_LedRotOl
        communication-direction=IN, data-element=Grundumfang_XIX_SAM.Geltungsbereich_E3_1_1_UNECE_Gen2.RP_IF_RGB_Slave_06_LedRotStg_XIX_Grundumfang_XIX_SAM.DE_RGB_Slave_06_LedRotStg, system-signal=RGB_Slave_06_LedRotStg
        communication-direction=IN, data-element=Grundumfang_XIX_SAM.Geltungsbereich_E3_1_1_UNECE_Gen2.RP_IF_RGB_Slave_06_ResponseError_XIX_Grundumfang_XIX_SAM.DE_RGB_Slave_06_ResponseError, system-signal=RGB_Slave_06_ResponseError
        communication-direction=IN, data-element=Grundumfang_XIX_SAM.Geltungsbereich_E3_1_1_UNECE_Gen2.RP_IF_RGB_Slave_06_TempState_XIX_Grundumfang_XIX_SAM.DE_RGB_Slave_06_TempState, system-signal=RGB_Slave_06_TempState
        communication-direction=IN, data-element=Grundumfang_XIX_SAM.Geltungsbereich_E3_1_1_UNECE_Gen2.RP_IF_RGB_Slave_07_IntErrorNvm_XIX_Grundumfang_XIX_SAM.DE_RGB_Slave_07_IntErrorNvm, system-signal=RGB_Slave_07_IntErrorNvm
        communication-direction=IN, data-element=Grundumfang_XIX_SAM.Geltungsbereich_E3_1_1_UNECE_Gen2.RP_IF_RGB_Slave_07_IntErrorRam_XIX_Grundumfang_XIX_SAM.DE_RGB_Slave_07_IntErrorRam, system-signal=RGB_Slave_07_IntErrorRam
        communication-direction=IN, data-element=Grundumfang_XIX_SAM.Geltungsbereich_E3_1_1_UNECE_Gen2.RP_IF_RGB_Slave_07_IntErrorRom_XIX_Grundumfang_XIX_SAM.DE_RGB_Slave_07_IntErrorRom, system-signal=RGB_Slave_07_IntErrorRom
        communication-direction=IN, data-element=Grundumfang_XIX_SAM.Geltungsbereich_E3_1_1_UNECE_Gen2.RP_IF_RGB_Slave_07_LedBlauOl_XIX_Grundumfang_XIX_SAM.DE_RGB_Slave_07_LedBlauOl, system-signal=RGB_Slave_07_LedBlauOl
        communication-direction=IN, data-element=Grundumfang_XIX_SAM.Geltungsbereich_E3_1_1_UNECE_Gen2.RP_IF_RGB_Slave_07_LedBlauStg_XIX_Grundumfang_XIX_SAM.DE_RGB_Slave_07_LedBlauStg, system-signal=RGB_Slave_07_LedBlauStg
        communication-direction=IN, data-element=Grundumfang_XIX_SAM.Geltungsbereich_E3_1_1_UNECE_Gen2.RP_IF_RGB_Slave_07_LedGruenOl_XIX_Grundumfang_XIX_SAM.DE_RGB_Slave_07_LedGruenOl, system-signal=RGB_Slave_07_LedGruenOl
        communication-direction=IN, data-element=Grundumfang_XIX_SAM.Geltungsbereich_E3_1_1_UNECE_Gen2.RP_IF_RGB_Slave_07_LedGruenStg_XIX_Grundumfang_XIX_SAM.DE_RGB_Slave_07_LedGruenStg, system-signal=RGB_Slave_07_LedGruenStg
        communication-direction=IN, data-element=Grundumfang_XIX_SAM.Geltungsbereich_E3_1_1_UNECE_Gen2.RP_IF_RGB_Slave_07_LedRotOl_XIX_Grundumfang_XIX_SAM.DE_RGB_Slave_07_LedRotOl, system-signal=RGB_Slave_07_LedRotOl
        communication-direction=IN, data-element=Grundumfang_XIX_SAM.Geltungsbereich_E3_1_1_UNECE_Gen2.RP_IF_RGB_Slave_07_LedRotStg_XIX_Grundumfang_XIX_SAM.DE_RGB_Slave_07_LedRotStg, system-signal=RGB_Slave_07_LedRotStg
        communication-direction=IN, data-element=Grundumfang_XIX_SAM.Geltungsbereich_E3_1_1_UNECE_Gen2.RP_IF_RGB_Slave_07_ResponseError_XIX_Grundumfang_XIX_SAM.DE_RGB_Slave_07_ResponseError, system-signal=RGB_Slave_07_ResponseError
        communication-direction=IN, data-element=Grundumfang_XIX_SAM.Geltungsbereich_E3_1_1_UNECE_Gen2.RP_IF_RGB_Slave_07_TempState_XIX_Grundumfang_XIX_SAM.DE_RGB_Slave_07_TempState, system-signal=RGB_Slave_07_TempState
        communication-direction=IN, data-element=Grundumfang_XIX_SAM.Geltungsbereich_E3_1_1_UNECE_Gen2.RP_IF_RGB_Slave_08_IntErrorNvm_XIX_Grundumfang_XIX_SAM.DE_RGB_Slave_08_IntErrorNvm, system-signal=RGB_Slave_08_IntErrorNvm
        communication-direction=IN, data-element=Grundumfang_XIX_SAM.Geltungsbereich_E3_1_1_UNECE_Gen2.RP_IF_RGB_Slave_08_IntErrorRam_XIX_Grundumfang_XIX_SAM.DE_RGB_Slave_08_IntErrorRam, system-signal=RGB_Slave_08_IntErrorRam
        communication-direction=IN, data-element=Grundumfang_XIX_SAM.Geltungsbereich_E3_1_1_UNECE_Gen2.RP_IF_RGB_Slave_08_IntErrorRom_XIX_Grundumfang_XIX_SAM.DE_RGB_Slave_08_IntErrorRom, system-signal=RGB_Slave_08_IntErrorRom
        communication-direction=IN, data-element=Grundumfang_XIX_SAM.Geltungsbereich_E3_1_1_UNECE_Gen2.RP_IF_RGB_Slave_08_LedBlauOl_XIX_Grundumfang_XIX_SAM.DE_RGB_Slave_08_LedBlauOl, system-signal=RGB_Slave_08_LedBlauOl
        communication-direction=IN, data-element=Grundumfang_XIX_SAM.Geltungsbereich_E3_1_1_UNECE_Gen2.RP_IF_RGB_Slave_08_LedBlauStg_XIX_Grundumfang_XIX_SAM.DE_RGB_Slave_08_LedBlauStg, system-signal=RGB_Slave_08_LedBlauStg
        communication-direction=IN, data-element=Grundumfang_XIX_SAM.Geltungsbereich_E3_1_1_UNECE_Gen2.RP_IF_RGB_Slave_08_LedGruenOl_XIX_Grundumfang_XIX_SAM.DE_RGB_Slave_08_LedGruenOl, system-signal=RGB_Slave_08_LedGruenOl
        communication-direction=IN, data-element=Grundumfang_XIX_SAM.Geltungsbereich_E3_1_1_UNECE_Gen2.RP_IF_RGB_Slave_08_LedGruenStg_XIX_Grundumfang_XIX_SAM.DE_RGB_Slave_08_LedGruenStg, system-signal=RGB_Slave_08_LedGruenStg
        communication-direction=IN, data-element=Grundumfang_XIX_SAM.Geltungsbereich_E3_1_1_UNECE_Gen2.RP_IF_RGB_Slave_08_LedRotOl_XIX_Grundumfang_XIX_SAM.DE_RGB_Slave_08_LedRotOl, system-signal=RGB_Slave_08_LedRotOl
        communication-direction=IN, data-element=Grundumfang_XIX_SAM.Geltungsbereich_E3_1_1_UNECE_Gen2.RP_IF_RGB_Slave_08_LedRotStg_XIX_Grundumfang_XIX_SAM.DE_RGB_Slave_08_LedRotStg, system-signal=RGB_Slave_08_LedRotStg
        communication-direction=IN, data-element=Grundumfang_XIX_SAM.Geltungsbereich_E3_1_1_UNECE_Gen2.RP_IF_RGB_Slave_08_ResponseError_XIX_Grundumfang_XIX_SAM.DE_RGB_Slave_08_ResponseError, system-signal=RGB_Slave_08_ResponseError
        communication-direction=IN, data-element=Grundumfang_XIX_SAM.Geltungsbereich_E3_1_1_UNECE_Gen2.RP_IF_RGB_Slave_08_TempState_XIX_Grundumfang_XIX_SAM.DE_RGB_Slave_08_TempState, system-signal=RGB_Slave_08_TempState
        communication-direction=IN, data-element=Grundumfang_XIX_SAM.Geltungsbereich_E3_1_1_UNECE_Gen2.RP_IF_RGB_Slave_09_IntErrorNvm_XIX_Grundumfang_XIX_SAM.DE_RGB_Slave_09_IntErrorNvm, system-signal=RGB_Slave_09_IntErrorNvm
        communication-direction=IN, data-element=Grundumfang_XIX_SAM.Geltungsbereich_E3_1_1_UNECE_Gen2.RP_IF_RGB_Slave_09_IntErrorRam_XIX_Grundumfang_XIX_SAM.DE_RGB_Slave_09_IntErrorRam, system-signal=RGB_Slave_09_IntErrorRam
        communication-direction=IN, data-element=Grundumfang_XIX_SAM.Geltungsbereich_E3_1_1_UNECE_Gen2.RP_IF_RGB_Slave_09_IntErrorRom_XIX_Grundumfang_XIX_SAM.DE_RGB_Slave_09_IntErrorRom, system-signal=RGB_Slave_09_IntErrorRom
        communication-direction=IN, data-element=Grundumfang_XIX_SAM.Geltungsbereich_E3_1_1_UNECE_Gen2.RP_IF_RGB_Slave_09_LedBlauOl_XIX_Grundumfang_XIX_SAM.DE_RGB_Slave_09_LedBlauOl, system-signal=RGB_Slave_09_LedBlauOl
        communication-direction=IN, data-element=Grundumfang_XIX_SAM.Geltungsbereich_E3_1_1_UNECE_Gen2.RP_IF_RGB_Slave_09_LedBlauStg_XIX_Grundumfang_XIX_SAM.DE_RGB_Slave_09_LedBlauStg, system-signal=RGB_Slave_09_LedBlauStg
        communication-direction=IN, data-element=Grundumfang_XIX_SAM.Geltungsbereich_E3_1_1_UNECE_Gen2.RP_IF_RGB_Slave_09_LedGruenOl_XIX_Grundumfang_XIX_SAM.DE_RGB_Slave_09_LedGruenOl, system-signal=RGB_Slave_09_LedGruenOl
        communication-direction=IN, data-element=Grundumfang_XIX_SAM.Geltungsbereich_E3_1_1_UNECE_Gen2.RP_IF_RGB_Slave_09_LedGruenStg_XIX_Grundumfang_XIX_SAM.DE_RGB_Slave_09_LedGruenStg, system-signal=RGB_Slave_09_LedGruenStg
        communication-direction=IN, data-element=Grundumfang_XIX_SAM.Geltungsbereich_E3_1_1_UNECE_Gen2.RP_IF_RGB_Slave_09_LedRotOl_XIX_Grundumfang_XIX_SAM.DE_RGB_Slave_09_LedRotOl, system-signal=RGB_Slave_09_LedRotOl
        communication-direction=IN, data-element=Grundumfang_XIX_SAM.Geltungsbereich_E3_1_1_UNECE_Gen2.RP_IF_RGB_Slave_09_LedRotStg_XIX_Grundumfang_XIX_SAM.DE_RGB_Slave_09_LedRotStg, system-signal=RGB_Slave_09_LedRotStg
        communication-direction=IN, data-element=Grundumfang_XIX_SAM.Geltungsbereich_E3_1_1_UNECE_Gen2.RP_IF_RGB_Slave_09_ResponseError_XIX_Grundumfang_XIX_SAM.DE_RGB_Slave_09_ResponseError, system-signal=RGB_Slave_09_ResponseError
        communication-direction=IN, data-element=Grundumfang_XIX_SAM.Geltungsbereich_E3_1_1_UNECE_Gen2.RP_IF_RGB_Slave_09_TempState_XIX_Grundumfang_XIX_SAM.DE_RGB_Slave_09_TempState, system-signal=RGB_Slave_09_TempState
        communication-direction=IN, data-element=Grundumfang_XIX_SAM.Geltungsbereich_E3_1_1_UNECE_Gen2.RP_IF_RGB_Slave_10_IntErrorNvm_XIX_Grundumfang_XIX_SAM.DE_RGB_Slave_10_IntErrorNvm, system-signal=RGB_Slave_10_IntErrorNvm
        communication-direction=IN, data-element=Grundumfang_XIX_SAM.Geltungsbereich_E3_1_1_UNECE_Gen2.RP_IF_RGB_Slave_10_IntErrorRam_XIX_Grundumfang_XIX_SAM.DE_RGB_Slave_10_IntErrorRam, system-signal=RGB_Slave_10_IntErrorRam
        communication-direction=IN, data-element=Grundumfang_XIX_SAM.Geltungsbereich_E3_1_1_UNECE_Gen2.RP_IF_RGB_Slave_10_IntErrorRom_XIX_Grundumfang_XIX_SAM.DE_RGB_Slave_10_IntErrorRom, system-signal=RGB_Slave_10_IntErrorRom
        communication-direction=IN, data-element=Grundumfang_XIX_SAM.Geltungsbereich_E3_1_1_UNECE_Gen2.RP_IF_RGB_Slave_10_LedBlauOl_XIX_Grundumfang_XIX_SAM.DE_RGB_Slave_10_LedBlauOl, system-signal=RGB_Slave_10_LedBlauOl
        communication-direction=IN, data-element=Grundumfang_XIX_SAM.Geltungsbereich_E3_1_1_UNECE_Gen2.RP_IF_RGB_Slave_10_LedBlauStg_XIX_Grundumfang_XIX_SAM.DE_RGB_Slave_10_LedBlauStg, system-signal=RGB_Slave_10_LedBlauStg
        communication-direction=IN, data-element=Grundumfang_XIX_SAM.Geltungsbereich_E3_1_1_UNECE_Gen2.RP_IF_RGB_Slave_10_LedGruenOl_XIX_Grundumfang_XIX_SAM.DE_RGB_Slave_10_LedGruenOl, system-signal=RGB_Slave_10_LedGruenOl
        communication-direction=IN, data-element=Grundumfang_XIX_SAM.Geltungsbereich_E3_1_1_UNECE_Gen2.RP_IF_RGB_Slave_10_LedGruenStg_XIX_Grundumfang_XIX_SAM.DE_RGB_Slave_10_LedGruenStg, system-signal=RGB_Slave_10_LedGruenStg
        communication-direction=IN, data-element=Grundumfang_XIX_SAM.Geltungsbereich_E3_1_1_UNECE_Gen2.RP_IF_RGB_Slave_10_LedRotOl_XIX_Grundumfang_XIX_SAM.DE_RGB_Slave_10_LedRotOl, system-signal=RGB_Slave_10_LedRotOl
        communication-direction=IN, data-element=Grundumfang_XIX_SAM.Geltungsbereich_E3_1_1_UNECE_Gen2.RP_IF_RGB_Slave_10_LedRotStg_XIX_Grundumfang_XIX_SAM.DE_RGB_Slave_10_LedRotStg, system-signal=RGB_Slave_10_LedRotStg
        communication-direction=IN, data-element=Grundumfang_XIX_SAM.Geltungsbereich_E3_1_1_UNECE_Gen2.RP_IF_RGB_Slave_10_ResponseError_XIX_Grundumfang_XIX_SAM.DE_RGB_Slave_10_ResponseError, system-signal=RGB_Slave_10_ResponseError
        communication-direction=IN, data-element=Grundumfang_XIX_SAM.Geltungsbereich_E3_1_1_UNECE_Gen2.RP_IF_RGB_Slave_10_TempState_XIX_Grundumfang_XIX_SAM.DE_RGB_Slave_10_TempState, system-signal=RGB_Slave_10_TempState
        communication-direction=IN, data-element=Grundumfang_XIX_SAM.Geltungsbereich_E3_1_1_UNECE_Gen2.RP_IF_RGB_Slave_11_IntErrorNvm_XIX_Grundumfang_XIX_SAM.DE_RGB_Slave_11_IntErrorNvm, system-signal=RGB_Slave_11_IntErrorNvm
        communication-direction=IN, data-element=Grundumfang_XIX_SAM.Geltungsbereich_E3_1_1_UNECE_Gen2.RP_IF_RGB_Slave_11_IntErrorRam_XIX_Grundumfang_XIX_SAM.DE_RGB_Slave_11_IntErrorRam, system-signal=RGB_Slave_11_IntErrorRam
        communication-direction=IN, data-element=Grundumfang_XIX_SAM.Geltungsbereich_E3_1_1_UNECE_Gen2.RP_IF_RGB_Slave_11_IntErrorRom_XIX_Grundumfang_XIX_SAM.DE_RGB_Slave_11_IntErrorRom, system-signal=RGB_Slave_11_IntErrorRom
        communication-direction=IN, data-element=Grundumfang_XIX_SAM.Geltungsbereich_E3_1_1_UNECE_Gen2.RP_IF_RGB_Slave_11_LedBlauOl_XIX_Grundumfang_XIX_SAM.DE_RGB_Slave_11_LedBlauOl, system-signal=RGB_Slave_11_LedBlauOl
        communication-direction=IN, data-element=Grundumfang_XIX_SAM.Geltungsbereich_E3_1_1_UNECE_Gen2.RP_IF_RGB_Slave_11_LedBlauStg_XIX_Grundumfang_XIX_SAM.DE_RGB_Slave_11_LedBlauStg, system-signal=RGB_Slave_11_LedBlauStg
        communication-direction=IN, data-element=Grundumfang_XIX_SAM.Geltungsbereich_E3_1_1_UNECE_Gen2.RP_IF_RGB_Slave_11_LedGruenOl_XIX_Grundumfang_XIX_SAM.DE_RGB_Slave_11_LedGruenOl, system-signal=RGB_Slave_11_LedGruenOl
        communication-direction=IN, data-element=Grundumfang_XIX_SAM.Geltungsbereich_E3_1_1_UNECE_Gen2.RP_IF_RGB_Slave_11_LedGruenStg_XIX_Grundumfang_XIX_SAM.DE_RGB_Slave_11_LedGruenStg, system-signal=RGB_Slave_11_LedGruenStg
        communication-direction=IN, data-element=Grundumfang_XIX_SAM.Geltungsbereich_E3_1_1_UNECE_Gen2.RP_IF_RGB_Slave_11_LedRotOl_XIX_Grundumfang_XIX_SAM.DE_RGB_Slave_11_LedRotOl, system-signal=RGB_Slave_11_LedRotOl
        communication-direction=IN, data-element=Grundumfang_XIX_SAM.Geltungsbereich_E3_1_1_UNECE_Gen2.RP_IF_RGB_Slave_11_LedRotStg_XIX_Grundumfang_XIX_SAM.DE_RGB_Slave_11_LedRotStg, system-signal=RGB_Slave_11_LedRotStg
        communication-direction=IN, data-element=Grundumfang_XIX_SAM.Geltungsbereich_E3_1_1_UNECE_Gen2.RP_IF_RGB_Slave_11_ResponseError_XIX_Grundumfang_XIX_SAM.DE_RGB_Slave_11_ResponseError, system-signal=RGB_Slave_11_ResponseError
        communication-direction=IN, data-element=Grundumfang_XIX_SAM.Geltungsbereich_E3_1_1_UNECE_Gen2.RP_IF_RGB_Slave_11_TempState_XIX_Grundumfang_XIX_SAM.DE_RGB_Slave_11_TempState, system-signal=RGB_Slave_11_TempState
        communication-direction=IN, data-element=Grundumfang_XIX_SAM.Geltungsbereich_E3_1_1_UNECE_Gen2.RP_IF_RGB_Slave_12_IntErrorNvm_XIX_Grundumfang_XIX_SAM.DE_RGB_Slave_12_IntErrorNvm, system-signal=RGB_Slave_12_IntErrorNvm
        communication-direction=IN, data-element=Grundumfang_XIX_SAM.Geltungsbereich_E3_1_1_UNECE_Gen2.RP_IF_RGB_Slave_12_IntErrorRam_XIX_Grundumfang_XIX_SAM.DE_RGB_Slave_12_IntErrorRam, system-signal=RGB_Slave_12_IntErrorRam
        communication-direction=IN, data-element=Grundumfang_XIX_SAM.Geltungsbereich_E3_1_1_UNECE_Gen2.RP_IF_RGB_Slave_12_IntErrorRom_XIX_Grundumfang_XIX_SAM.DE_RGB_Slave_12_IntErrorRom, system-signal=RGB_Slave_12_IntErrorRom
        communication-direction=IN, data-element=Grundumfang_XIX_SAM.Geltungsbereich_E3_1_1_UNECE_Gen2.RP_IF_RGB_Slave_12_LedBlauOl_XIX_Grundumfang_XIX_SAM.DE_RGB_Slave_12_LedBlauOl, system-signal=RGB_Slave_12_LedBlauOl
        communication-direction=IN, data-element=Grundumfang_XIX_SAM.Geltungsbereich_E3_1_1_UNECE_Gen2.RP_IF_RGB_Slave_12_LedBlauStg_XIX_Grundumfang_XIX_SAM.DE_RGB_Slave_12_LedBlauStg, system-signal=RGB_Slave_12_LedBlauStg
        communication-direction=IN, data-element=Grundumfang_XIX_SAM.Geltungsbereich_E3_1_1_UNECE_Gen2.RP_IF_RGB_Slave_12_LedGruenOl_XIX_Grundumfang_XIX_SAM.DE_RGB_Slave_12_LedGruenOl, system-signal=RGB_Slave_12_LedGruenOl
        communication-direction=IN, data-element=Grundumfang_XIX_SAM.Geltungsbereich_E3_1_1_UNECE_Gen2.RP_IF_RGB_Slave_12_LedGruenStg_XIX_Grundumfang_XIX_SAM.DE_RGB_Slave_12_LedGruenStg, system-signal=RGB_Slave_12_LedGruenStg
        communication-direction=IN, data-element=Grundumfang_XIX_SAM.Geltungsbereich_E3_1_1_UNECE_Gen2.RP_IF_RGB_Slave_12_LedRotOl_XIX_Grundumfang_XIX_SAM.DE_RGB_Slave_12_LedRotOl, system-signal=RGB_Slave_12_LedRotOl
        communication-direction=IN, data-element=Grundumfang_XIX_SAM.Geltungsbereich_E3_1_1_UNECE_Gen2.RP_IF_RGB_Slave_12_LedRotStg_XIX_Grundumfang_XIX_SAM.DE_RGB_Slave_12_LedRotStg, system-signal=RGB_Slave_12_LedRotStg
        communication-direction=IN, data-element=Grundumfang_XIX_SAM.Geltungsbereich_E3_1_1_UNECE_Gen2.RP_IF_RGB_Slave_12_ResponseError_XIX_Grundumfang_XIX_SAM.DE_RGB_Slave_12_ResponseError, system-signal=RGB_Slave_12_ResponseError
        communication-direction=IN, data-element=Grundumfang_XIX_SAM.Geltungsbereich_E3_1_1_UNECE_Gen2.RP_IF_RGB_Slave_12_TempState_XIX_Grundumfang_XIX_SAM.DE_RGB_Slave_12_TempState, system-signal=RGB_Slave_12_TempState
        communication-direction=IN, data-element=Grundumfang_XIX_SAM.Geltungsbereich_E3_1_1_UNECE_Gen2.RP_IF_RGB_Slave_13_IntErrorNvm_XIX_Grundumfang_XIX_SAM.DE_RGB_Slave_13_IntErrorNvm, system-signal=RGB_Slave_13_IntErrorNvm
        communication-direction=IN, data-element=Grundumfang_XIX_SAM.Geltungsbereich_E3_1_1_UNECE_Gen2.RP_IF_RGB_Slave_13_IntErrorRam_XIX_Grundumfang_XIX_SAM.DE_RGB_Slave_13_IntErrorRam, system-signal=RGB_Slave_13_IntErrorRam
        communication-direction=IN, data-element=Grundumfang_XIX_SAM.Geltungsbereich_E3_1_1_UNECE_Gen2.RP_IF_RGB_Slave_13_IntErrorRom_XIX_Grundumfang_XIX_SAM.DE_RGB_Slave_13_IntErrorRom, system-signal=RGB_Slave_13_IntErrorRom
        communication-direction=IN, data-element=Grundumfang_XIX_SAM.Geltungsbereich_E3_1_1_UNECE_Gen2.RP_IF_RGB_Slave_13_LedBlauOl_XIX_Grundumfang_XIX_SAM.DE_RGB_Slave_13_LedBlauOl, system-signal=RGB_Slave_13_LedBlauOl
        communication-direction=IN, data-element=Grundumfang_XIX_SAM.Geltungsbereich_E3_1_1_UNECE_Gen2.RP_IF_RGB_Slave_13_LedBlauStg_XIX_Grundumfang_XIX_SAM.DE_RGB_Slave_13_LedBlauStg, system-signal=RGB_Slave_13_LedBlauStg
        communication-direction=IN, data-element=Grundumfang_XIX_SAM.Geltungsbereich_E3_1_1_UNECE_Gen2.RP_IF_RGB_Slave_13_LedGruenOl_XIX_Grundumfang_XIX_SAM.DE_RGB_Slave_13_LedGruenOl, system-signal=RGB_Slave_13_LedGruenOl
        communication-direction=IN, data-element=Grundumfang_XIX_SAM.Geltungsbereich_E3_1_1_UNECE_Gen2.RP_IF_RGB_Slave_13_LedGruenStg_XIX_Grundumfang_XIX_SAM.DE_RGB_Slave_13_LedGruenStg, system-signal=RGB_Slave_13_LedGruenStg
        communication-direction=IN, data-element=Grundumfang_XIX_SAM.Geltungsbereich_E3_1_1_UNECE_Gen2.RP_IF_RGB_Slave_13_LedRotOl_XIX_Grundumfang_XIX_SAM.DE_RGB_Slave_13_LedRotOl, system-signal=RGB_Slave_13_LedRotOl
        communication-direction=IN, data-element=Grundumfang_XIX_SAM.Geltungsbereich_E3_1_1_UNECE_Gen2.RP_IF_RGB_Slave_13_LedRotStg_XIX_Grundumfang_XIX_SAM.DE_RGB_Slave_13_LedRotStg, system-signal=RGB_Slave_13_LedRotStg
        communication-direction=IN, data-element=Grundumfang_XIX_SAM.Geltungsbereich_E3_1_1_UNECE_Gen2.RP_IF_RGB_Slave_13_ResponseError_XIX_Grundumfang_XIX_SAM.DE_RGB_Slave_13_ResponseError, system-signal=RGB_Slave_13_ResponseError
        communication-direction=IN, data-element=Grundumfang_XIX_SAM.Geltungsbereich_E3_1_1_UNECE_Gen2.RP_IF_RGB_Slave_13_TempState_XIX_Grundumfang_XIX_SAM.DE_RGB_Slave_13_TempState, system-signal=RGB_Slave_13_TempState
        communication-direction=IN, data-element=Grundumfang_XIX_SAM.Geltungsbereich_E3_1_1_UNECE_Gen2.RP_IF_RGB_Slave_14_IntErrorNvm_XIX_Grundumfang_XIX_SAM.DE_RGB_Slave_14_IntErrorNvm, system-signal=RGB_Slave_14_IntErrorNvm
        communication-direction=IN, data-element=Grundumfang_XIX_SAM.Geltungsbereich_E3_1_1_UNECE_Gen2.RP_IF_RGB_Slave_14_IntErrorRam_XIX_Grundumfang_XIX_SAM.DE_RGB_Slave_14_IntErrorRam, system-signal=RGB_Slave_14_IntErrorRam
        communication-direction=IN, data-element=Grundumfang_XIX_SAM.Geltungsbereich_E3_1_1_UNECE_Gen2.RP_IF_RGB_Slave_14_IntErrorRom_XIX_Grundumfang_XIX_SAM.DE_RGB_Slave_14_IntErrorRom, system-signal=RGB_Slave_14_IntErrorRom
        communication-direction=IN, data-element=Grundumfang_XIX_SAM.Geltungsbereich_E3_1_1_UNECE_Gen2.RP_IF_RGB_Slave_14_LedBlauOl_XIX_Grundumfang_XIX_SAM.DE_RGB_Slave_14_LedBlauOl, system-signal=RGB_Slave_14_LedBlauOl
        communication-direction=IN, data-element=Grundumfang_XIX_SAM.Geltungsbereich_E3_1_1_UNECE_Gen2.RP_IF_RGB_Slave_14_LedBlauStg_XIX_Grundumfang_XIX_SAM.DE_RGB_Slave_14_LedBlauStg, system-signal=RGB_Slave_14_LedBlauStg
        communication-direction=IN, data-element=Grundumfang_XIX_SAM.Geltungsbereich_E3_1_1_UNECE_Gen2.RP_IF_RGB_Slave_14_LedGruenOl_XIX_Grundumfang_XIX_SAM.DE_RGB_Slave_14_LedGruenOl, system-signal=RGB_Slave_14_LedGruenOl
        communication-direction=IN, data-element=Grundumfang_XIX_SAM.Geltungsbereich_E3_1_1_UNECE_Gen2.RP_IF_RGB_Slave_14_LedGruenStg_XIX_Grundumfang_XIX_SAM.DE_RGB_Slave_14_LedGruenStg, system-signal=RGB_Slave_14_LedGruenStg
        communication-direction=IN, data-element=Grundumfang_XIX_SAM.Geltungsbereich_E3_1_1_UNECE_Gen2.RP_IF_RGB_Slave_14_LedRotOl_XIX_Grundumfang_XIX_SAM.DE_RGB_Slave_14_LedRotOl, system-signal=RGB_Slave_14_LedRotOl
        communication-direction=IN, data-element=Grundumfang_XIX_SAM.Geltungsbereich_E3_1_1_UNECE_Gen2.RP_IF_RGB_Slave_14_LedRotStg_XIX_Grundumfang_XIX_SAM.DE_RGB_Slave_14_LedRotStg, system-signal=RGB_Slave_14_LedRotStg
        communication-direction=IN, data-element=Grundumfang_XIX_SAM.Geltungsbereich_E3_1_1_UNECE_Gen2.RP_IF_RGB_Slave_14_ResponseError_XIX_Grundumfang_XIX_SAM.DE_RGB_Slave_14_ResponseError, system-signal=RGB_Slave_14_ResponseError
        communication-direction=IN, data-element=Grundumfang_XIX_SAM.Geltungsbereich_E3_1_1_UNECE_Gen2.RP_IF_RGB_Slave_14_TempState_XIX_Grundumfang_XIX_SAM.DE_RGB_Slave_14_TempState, system-signal=RGB_Slave_14_TempState
        communication-direction=IN, data-element=Grundumfang_XIX_SAM.Geltungsbereich_E3_1_1_UNECE_Gen2.RP_IF_RGB_Slave_15_IntErrorNvm_XIX_Grundumfang_XIX_SAM.DE_RGB_Slave_15_IntErrorNvm, system-signal=RGB_Slave_15_IntErrorNvm
        communication-direction=IN, data-element=Grundumfang_XIX_SAM.Geltungsbereich_E3_1_1_UNECE_Gen2.RP_IF_RGB_Slave_15_IntErrorRam_XIX_Grundumfang_XIX_SAM.DE_RGB_Slave_15_IntErrorRam, system-signal=RGB_Slave_15_IntErrorRam
        communication-direction=IN, data-element=Grundumfang_XIX_SAM.Geltungsbereich_E3_1_1_UNECE_Gen2.RP_IF_RGB_Slave_15_IntErrorRom_XIX_Grundumfang_XIX_SAM.DE_RGB_Slave_15_IntErrorRom, system-signal=RGB_Slave_15_IntErrorRom
        communication-direction=IN, data-element=Grundumfang_XIX_SAM.Geltungsbereich_E3_1_1_UNECE_Gen2.RP_IF_RGB_Slave_15_LedBlauOl_XIX_Grundumfang_XIX_SAM.DE_RGB_Slave_15_LedBlauOl, system-signal=RGB_Slave_15_LedBlauOl
        communication-direction=IN, data-element=Grundumfang_XIX_SAM.Geltungsbereich_E3_1_1_UNECE_Gen2.RP_IF_RGB_Slave_15_LedBlauStg_XIX_Grundumfang_XIX_SAM.DE_RGB_Slave_15_LedBlauStg, system-signal=RGB_Slave_15_LedBlauStg
        communication-direction=IN, data-element=Grundumfang_XIX_SAM.Geltungsbereich_E3_1_1_UNECE_Gen2.RP_IF_RGB_Slave_15_LedGruenOl_XIX_Grundumfang_XIX_SAM.DE_RGB_Slave_15_LedGruenOl, system-signal=RGB_Slave_15_LedGruenOl
        communication-direction=IN, data-element=Grundumfang_XIX_SAM.Geltungsbereich_E3_1_1_UNECE_Gen2.RP_IF_RGB_Slave_15_LedGruenStg_XIX_Grundumfang_XIX_SAM.DE_RGB_Slave_15_LedGruenStg, system-signal=RGB_Slave_15_LedGruenStg
        communication-direction=IN, data-element=Grundumfang_XIX_SAM.Geltungsbereich_E3_1_1_UNECE_Gen2.RP_IF_RGB_Slave_15_LedRotOl_XIX_Grundumfang_XIX_SAM.DE_RGB_Slave_15_LedRotOl, system-signal=RGB_Slave_15_LedRotOl
        communication-direction=IN, data-element=Grundumfang_XIX_SAM.Geltungsbereich_E3_1_1_UNECE_Gen2.RP_IF_RGB_Slave_15_LedRotStg_XIX_Grundumfang_XIX_SAM.DE_RGB_Slave_15_LedRotStg, system-signal=RGB_Slave_15_LedRotStg
        communication-direction=IN, data-element=Grundumfang_XIX_SAM.Geltungsbereich_E3_1_1_UNECE_Gen2.RP_IF_RGB_Slave_15_ResponseError_XIX_Grundumfang_XIX_SAM.DE_RGB_Slave_15_ResponseError, system-signal=RGB_Slave_15_ResponseError
        communication-direction=IN, data-element=Grundumfang_XIX_SAM.Geltungsbereich_E3_1_1_UNECE_Gen2.RP_IF_RGB_Slave_15_TempState_XIX_Grundumfang_XIX_SAM.DE_RGB_Slave_15_TempState, system-signal=RGB_Slave_15_TempState
        communication-direction=IN, data-element=Grundumfang_XIX_SAM.Geltungsbereich_E3_1_1_UNECE_Gen2.RP_IF_RHP_Fahrzeughupe_Anf_XIX_Grundumfang_XIX_SAM.DE_RHP_Fahrzeughupe_Anf, system-signal=RHP_Fahrzeughupe_Anf
        communication-direction=OUT, data-element=Grundumfang_XIX_SAM.Geltungsbereich_E3_1_1_UNECE_Gen2.SP_IF_RLS_02_BZ_XIX_Grundumfang_XIX_SAM.DE_RLS_02_BZ, system-signal=RLS_02_BZ
        communication-direction=OUT, data-element=Grundumfang_XIX_SAM.Geltungsbereich_E3_1_1_UNECE_Gen2.SP_IF_RLS_02_CRC_XIX_Grundumfang_XIX_SAM.DE_RLS_02_CRC, system-signal=RLS_02_CRC
        communication-direction=IN, data-element=Grundumfang_XIX_SAM.Geltungsbereich_E3_1_1_UNECE_Gen2.RP_IF_RLS_CRC_XIX_Grundumfang_XIX_SAM.DE_RLS_CRC, system-signal=RLS_CRC
        communication-direction=IN, data-element=ABL_XIX_SAM.Geltungsbereich_E3_1_1_UNECE_Gen2.RP_IF_RLS_Qualifizierungsbit_XIX_ABL_XIX_SAM.DE_RLS_Qualifizierungsbit, system-signal=RLS_Qualifizierungsbit
        communication-direction=IN, data-element=Grundumfang_XIX_SAM.Geltungsbereich_E3_1_1_UNECE_Gen2.RP_IF_RLS_Qualifizierungsbit_XIX_Grundumfang_XIX_SAM.DE_RLS_Qualifizierungsbit, system-signal=RLS_Qualifizierungsbit
        communication-direction=OUT, data-element=Grundumfang_XIX_SAM.Geltungsbereich_E3_1_1_UNECE_Gen2.SP_IF_RLS_Qualifizierungsbit_XIX_Grundumfang_XIX_SAM.DE_RLS_Qualifizierungsbit, system-signal=RLS_Qualifizierungsbit
        communication-direction=IN, data-element=ABL_XIX_SAM.Geltungsbereich_E3_1_1_UNECE_Gen2.RP_IF_RLS_ResponseError_XIX_ABL_XIX_SAM.DE_RLS_ResponseError, system-signal=RLS_ResponseError
        communication-direction=IN, data-element=Grundumfang_XIX_SAM.Geltungsbereich_E3_1_1_UNECE_Gen2.RP_IF_RLS_ResponseError_XIX_Grundumfang_XIX_SAM.DE_RLS_ResponseError, system-signal=RLS_ResponseError
        communication-direction=OUT, data-element=Grundumfang_XIX_SAM.Geltungsbereich_E3_1_1_UNECE_Gen2.SP_IF_RLS_ResponseError_XIX_Grundumfang_XIX_SAM.DE_RLS_ResponseError, system-signal=RLS_ResponseError
        communication-direction=IN, data-element=Grundumfang_XIX_SAM.Geltungsbereich_E3_1_1_UNECE_Gen2.RP_IF_RLS_Vorfeldhelligkeit_Boost_XIX_Grundumfang_XIX_SAM.DE_RLS_Vorfeldhelligkeit_Boost, system-signal=RLS_Vorfeldhelligkeit_Boost
        communication-direction=OUT, data-element=Grundumfang_XIX_SAM.Geltungsbereich_E3_1_1_UNECE_Gen2.SP_IF_RLS_Vorfeldhelligkeit_Boost_XIX_Grundumfang_XIX_SAM.DE_RLS_Vorfeldhelligkeit_Boost, system-signal=RLS_Vorfeldhelligkeit_Boost
        communication-direction=IN, data-element=ABL_XIX_SAM.Geltungsbereich_E3_1_1_UNECE_Gen2.RP_IF_RLS_Zaehler_XIX_ABL_XIX_SAM.DE_RLS_Zaehler, system-signal=RLS_Zaehler
        communication-direction=IN, data-element=Grundumfang_XIX_SAM.Geltungsbereich_E3_1_1_UNECE_Gen2.RP_IF_RLS_Zaehler_XIX_Grundumfang_XIX_SAM.DE_RLS_Zaehler, system-signal=RLS_Zaehler
        communication-direction=IN, data-element=Grundumfang_XIX_SAM.Geltungsbereich_E3_1_1_UNECE_Gen2.RP_IF_RS_AdaptierungError_XIX_Grundumfang_XIX_SAM.DE_RS_AdaptierungError, system-signal=RS_AdaptierungError
        communication-direction=OUT, data-element=Grundumfang_XIX_SAM.Geltungsbereich_E3_1_1_UNECE_Gen2.SP_IF_RS_AdaptierungError_XIX_Grundumfang_XIX_SAM.DE_RS_AdaptierungError, system-signal=RS_AdaptierungError
        communication-direction=OUT, data-element=Grundumfang_XIX_SAM.Geltungsbereich_E3_1_1_UNECE_Gen2.SP_IF_RS_defekt_XIX_Grundumfang_XIX_SAM.DE_RS_defekt, system-signal=RS_defekt
        communication-direction=IN, data-element=Grundumfang_XIX_SAM.Geltungsbereich_E3_1_1_UNECE_Gen2.RP_IF_RS_Error_XIX_Grundumfang_XIX_SAM.DE_RS_Error, system-signal=RS_Error
        communication-direction=OUT, data-element=Grundumfang_XIX_SAM.Geltungsbereich_E3_1_1_UNECE_Gen2.SP_IF_RS_Error_XIX_Grundumfang_XIX_SAM.DE_RS_Error, system-signal=RS_Error
        communication-direction=IN, data-element=ABL_XIX_SAM.Geltungsbereich_E3_1_1_UNECE_Gen2.RP_IF_RS_Regenfahrlicht_XIX_ABL_XIX_SAM.DE_RS_Regenfahrlicht, system-signal=RS_Regenfahrlicht
        communication-direction=IN, data-element=Grundumfang_XIX_SAM.Geltungsbereich_E3_1_1_UNECE_Gen2.RP_IF_RS_Regenfahrlicht_XIX_Grundumfang_XIX_SAM.DE_RS_Regenfahrlicht, system-signal=RS_Regenfahrlicht
        communication-direction=OUT, data-element=Grundumfang_XIX_SAM.Geltungsbereich_E3_1_1_UNECE_Gen2.SP_IF_RS_Regenfahrlicht_XIX_Grundumfang_XIX_SAM.DE_RS_Regenfahrlicht, system-signal=RS_Regenfahrlicht
        communication-direction=IN, data-element=Grundumfang_XIX_SAM.Geltungsbereich_E3_1_1_UNECE_Gen2.RP_IF_RS_Regenmenge_XIX_Grundumfang_XIX_SAM.DE_RS_Regenmenge, system-signal=RS_Regenmenge
        communication-direction=OUT, data-element=Grundumfang_XIX_SAM.Geltungsbereich_E3_1_1_UNECE_Gen2.SP_IF_RS_Regenmenge_XIX_Grundumfang_XIX_SAM.DE_RS_Regenmenge, system-signal=RS_Regenmenge
        communication-direction=IN, data-element=Grundumfang_XIX_SAM.Geltungsbereich_E3_1_1_UNECE_Gen2.RP_IF_RS_Schwall_XIX_Grundumfang_XIX_SAM.DE_RS_Schwall, system-signal=RS_Schwall
        communication-direction=OUT, data-element=Grundumfang_XIX_SAM.Geltungsbereich_E3_1_1_UNECE_Gen2.SP_IF_RS_Schwall_XIX_Grundumfang_XIX_SAM.DE_RS_Schwall, system-signal=RS_Schwall
        communication-direction=OUT, data-element=Grundumfang_XIX_SAM.Geltungsbereich_E3_1_1_UNECE_Gen2.SP_IF_RS_Verbau_XIX_Grundumfang_XIX_SAM.DE_RS_Verbau, system-signal=RS_Verbau
        communication-direction=IN, data-element=Grundumfang_XIX_SAM.Geltungsbereich_E3_1_1_UNECE_Gen2.RP_IF_RS_Verglasung_schliessen_XIX_Grundumfang_XIX_SAM.DE_RS_Verglasung_schliessen, system-signal=RS_Verglasung_schliessen
        communication-direction=OUT, data-element=Grundumfang_XIX_SAM.Geltungsbereich_E3_1_1_UNECE_Gen2.SP_IF_RS_Verglasung_schliessen_XIX_Grundumfang_XIX_SAM.DE_RS_Verglasung_schliessen, system-signal=RS_Verglasung_schliessen
        communication-direction=IN, data-element=Grundumfang_XIX_SAM.Geltungsbereich_E3_1_1_UNECE_Gen2.RP_IF_RS_versParklage_Wischer_XIX_Grundumfang_XIX_SAM.DE_RS_versParklage_Wischer, system-signal=RS_versParklage_Wischer
        communication-direction=OUT, data-element=Grundumfang_XIX_SAM.Geltungsbereich_E3_1_1_UNECE_Gen2.SP_IF_RS_versParklage_Wischer_XIX_Grundumfang_XIX_SAM.DE_RS_versParklage_Wischer, system-signal=RS_versParklage_Wischer
        communication-direction=IN, data-element=Grundumfang_XIX_SAM.Geltungsbereich_E3_1_1_UNECE_Gen2.RP_IF_RS_Wischergeschwindigkeit_XIX_Grundumfang_XIX_SAM.DE_RS_Wischergeschwindigkeit, system-signal=RS_Wischergeschwindigkeit
        communication-direction=OUT, data-element=Grundumfang_XIX_SAM.Geltungsbereich_E3_1_1_UNECE_Gen2.SP_IF_RS_Wischergeschwindigkeit_XIX_Grundumfang_XIX_SAM.DE_RS_Wischergeschwindigkeit, system-signal=RS_Wischergeschwindigkeit
        communication-direction=IN, data-element=Grundumfang_XIX_SAM.Geltungsbereich_E3_1_1_UNECE_Gen2.RP_IF_RV_Reinigung_Anf_XIX_Grundumfang_XIX_SAM.DE_RV_Reinigung_Anf, system-signal=RV_Reinigung_Anf
        communication-direction=IN, data-element=ABL_XIX_SAM.Geltungsbereich_E3_1_1_UNECE_Gen2.RP_IF_SAL_01_BZ_XIX_ABL_XIX_SAM.DE_SAL_01_BZ, system-signal=SAL_01_BZ
        communication-direction=IN, data-element=Grundumfang_XIX_SAM.Geltungsbereich_E3_1_1_UNECE_Gen2.RP_IF_SAL_01_BZ_XIX_Grundumfang_XIX_SAM.DE_SAL_01_BZ, system-signal=SAL_01_BZ
        communication-direction=IN, data-element=ABL_XIX_SAM.Geltungsbereich_E3_1_1_UNECE_Gen2.RP_IF_SAL_01_CRC_XIX_ABL_XIX_SAM.DE_SAL_01_CRC, system-signal=SAL_01_CRC
        communication-direction=IN, data-element=Grundumfang_XIX_SAM.Geltungsbereich_E3_1_1_UNECE_Gen2.RP_IF_SAL_01_CRC_XIX_Grundumfang_XIX_SAM.DE_SAL_01_CRC, system-signal=SAL_01_CRC
        communication-direction=IN, data-element=Grundumfang_XIX_SAM.Geltungsbereich_E3_1_1_UNECE_Gen2.RP_IF_SAL_Ambex_CH_state_XIX_Grundumfang_XIX_SAM.DE_SAL_Ambex_CH_state, system-signal=SAL_Ambex_CH_state
        communication-direction=IN, data-element=Grundumfang_XIX_SAM.Geltungsbereich_E3_1_1_UNECE_Gen2.RP_IF_SAL_Ambex_CH_time_XIX_Grundumfang_XIX_SAM.DE_SAL_Ambex_CH_time, system-signal=SAL_Ambex_CH_time
        communication-direction=IN, data-element=Grundumfang_XIX_SAM.Geltungsbereich_E3_1_1_UNECE_Gen2.RP_IF_SAL_Ambex_LH_state_XIX_Grundumfang_XIX_SAM.DE_SAL_Ambex_LH_state, system-signal=SAL_Ambex_LH_state
        communication-direction=IN, data-element=Grundumfang_XIX_SAM.Geltungsbereich_E3_1_1_UNECE_Gen2.RP_IF_SAL_Ambex_LH_time_XIX_Grundumfang_XIX_SAM.DE_SAL_Ambex_LH_time, system-signal=SAL_Ambex_LH_time
        communication-direction=IN, data-element=Grundumfang_XIX_SAM.Geltungsbereich_E3_1_1_UNECE_Gen2.RP_IF_SAL_Ambex_Lichtsensor_ch_lh_ein_XIX_Grundumfang_XIX_SAM.DE_SAL_Ambex_Lichtsensor_ch_lh_ein, system-signal=SAL_Ambex_Lichtsensor_ch_lh_ein
        communication-direction=IN, data-element=ABL_XIX_SAM.Geltungsbereich_E3_1_1_UNECE_Gen2.RP_IF_SAL_Blinkerzyklus_L_XIX_ABL_XIX_SAM.DE_SAL_Blinkerzyklus_L, system-signal=SAL_Blinkerzyklus_L
        communication-direction=IN, data-element=Grundumfang_XIX_SAM.Geltungsbereich_E3_1_1_UNECE_Gen2.RP_IF_SAL_Blinkerzyklus_L_XIX_Grundumfang_XIX_SAM.DE_SAL_Blinkerzyklus_L, system-signal=SAL_Blinkerzyklus_L
        communication-direction=IN, data-element=ABL_XIX_SAM.Geltungsbereich_E3_1_1_UNECE_Gen2.RP_IF_SAL_Blinkerzyklus_R_XIX_ABL_XIX_SAM.DE_SAL_Blinkerzyklus_R, system-signal=SAL_Blinkerzyklus_R
        communication-direction=IN, data-element=Grundumfang_XIX_SAM.Geltungsbereich_E3_1_1_UNECE_Gen2.RP_IF_SAL_Blinkerzyklus_R_XIX_Grundumfang_XIX_SAM.DE_SAL_Blinkerzyklus_R, system-signal=SAL_Blinkerzyklus_R
        communication-direction=IN, data-element=ABL_XIX_SAM.Geltungsbereich_E3_1_1_UNECE_Gen2.RP_IF_SAL_BLK_L_Anf_XIX_ABL_XIX_SAM.DE_SAL_BLK_L_Anf, system-signal=SAL_BLK_L_Anf
        communication-direction=IN, data-element=Grundumfang_XIX_SAM.Geltungsbereich_E3_1_1_UNECE_Gen2.RP_IF_SAL_BLK_L_Anf_XIX_Grundumfang_XIX_SAM.DE_SAL_BLK_L_Anf, system-signal=SAL_BLK_L_Anf
        communication-direction=IN, data-element=ABL_XIX_SAM.Geltungsbereich_E3_1_1_UNECE_Gen2.RP_IF_SAL_BLK_R_Anf_XIX_ABL_XIX_SAM.DE_SAL_BLK_R_Anf, system-signal=SAL_BLK_R_Anf
        communication-direction=IN, data-element=Grundumfang_XIX_SAM.Geltungsbereich_E3_1_1_UNECE_Gen2.RP_IF_SAL_BLK_R_Anf_XIX_Grundumfang_XIX_SAM.DE_SAL_BLK_R_Anf, system-signal=SAL_BLK_R_Anf
        communication-direction=IN, data-element=ABL_XIX_SAM.Geltungsbereich_E3_1_1_UNECE_Gen2.RP_IF_SAL_Bremszyklus_XIX_ABL_XIX_SAM.DE_SAL_Bremszyklus, system-signal=SAL_Bremszyklus
        communication-direction=IN, data-element=Grundumfang_XIX_SAM.Geltungsbereich_E3_1_1_UNECE_Gen2.RP_IF_SAL_Bremszyklus_XIX_Grundumfang_XIX_SAM.DE_SAL_Bremszyklus, system-signal=SAL_Bremszyklus
        communication-direction=IN, data-element=ABL_XIX_SAM.Geltungsbereich_E3_1_1_UNECE_Gen2.RP_IF_SAL_BRL_Anf_XIX_ABL_XIX_SAM.DE_SAL_BRL_Anf, system-signal=SAL_BRL_Anf
        communication-direction=IN, data-element=Grundumfang_XIX_SAM.Geltungsbereich_E3_1_1_UNECE_Gen2.RP_IF_SAL_BRL_Anf_XIX_Grundumfang_XIX_SAM.DE_SAL_BRL_Anf, system-signal=SAL_BRL_Anf
        communication-direction=IN, data-element=ABL_XIX_SAM.Geltungsbereich_E3_1_1_UNECE_Gen2.RP_IF_SAL_CH_Anf_XIX_ABL_XIX_SAM.DE_SAL_CH_Anf, system-signal=SAL_CH_Anf
        communication-direction=IN, data-element=Grundumfang_XIX_SAM.Geltungsbereich_E3_1_1_UNECE_Gen2.RP_IF_SAL_CH_Anf_XIX_Grundumfang_XIX_SAM.DE_SAL_CH_Anf, system-signal=SAL_CH_Anf
        communication-direction=IN, data-element=ABL_XIX_SAM.Geltungsbereich_E3_1_1_UNECE_Gen2.RP_IF_SAL_HGB_Anf_XIX_ABL_XIX_SAM.DE_SAL_HGB_Anf, system-signal=SAL_HGB_Anf
        communication-direction=IN, data-element=Grundumfang_XIX_SAM.Geltungsbereich_E3_1_1_UNECE_Gen2.RP_IF_SAL_HGB_Anf_XIX_Grundumfang_XIX_SAM.DE_SAL_HGB_Anf, system-signal=SAL_HGB_Anf
        communication-direction=IN, data-element=ABL_XIX_SAM.Geltungsbereich_E3_1_1_UNECE_Gen2.RP_IF_SAL_Kl_15_XIX_ABL_XIX_SAM.DE_SAL_Kl_15, system-signal=SAL_Kl_15
        communication-direction=IN, data-element=Grundumfang_XIX_SAM.Geltungsbereich_E3_1_1_UNECE_Gen2.RP_IF_SAL_Kl_15_XIX_Grundumfang_XIX_SAM.DE_SAL_Kl_15, system-signal=SAL_Kl_15
        communication-direction=IN, data-element=ABL_XIX_SAM.Geltungsbereich_E3_1_1_UNECE_Gen2.RP_IF_SAL_Kl_15_vFzg_XIX_ABL_XIX_SAM.DE_SAL_Kl_15_vFzg, system-signal=SAL_Kl_15_vFzg
        communication-direction=IN, data-element=Grundumfang_XIX_SAM.Geltungsbereich_E3_1_1_UNECE_Gen2.RP_IF_SAL_Kl_15_vFzg_XIX_Grundumfang_XIX_SAM.DE_SAL_Kl_15_vFzg, system-signal=SAL_Kl_15_vFzg
        communication-direction=IN, data-element=ABL_XIX_SAM.Geltungsbereich_E3_1_1_UNECE_Gen2.RP_IF_SAL_Kl_15_vFzg_S_XIX_ABL_XIX_SAM.DE_SAL_Kl_15_vFzg_S, system-signal=SAL_Kl_15_vFzg_S
        communication-direction=IN, data-element=Grundumfang_XIX_SAM.Geltungsbereich_E3_1_1_UNECE_Gen2.RP_IF_SAL_Kl_15_vFzg_S_XIX_Grundumfang_XIX_SAM.DE_SAL_Kl_15_vFzg_S, system-signal=SAL_Kl_15_vFzg_S
        communication-direction=IN, data-element=ABL_XIX_SAM.Geltungsbereich_E3_1_1_UNECE_Gen2.RP_IF_SAL_KL_50_XIX_ABL_XIX_SAM.DE_SAL_KL_50, system-signal=SAL_KL_50
        communication-direction=IN, data-element=Grundumfang_XIX_SAM.Geltungsbereich_E3_1_1_UNECE_Gen2.RP_IF_SAL_KL_50_XIX_Grundumfang_XIX_SAM.DE_SAL_KL_50, system-signal=SAL_KL_50
        communication-direction=IN, data-element=ABL_XIX_SAM.Geltungsbereich_E3_1_1_UNECE_Gen2.RP_IF_SAL_KL_50_5s_XIX_ABL_XIX_SAM.DE_SAL_KL_50_5s, system-signal=SAL_KL_50_5s
        communication-direction=IN, data-element=Grundumfang_XIX_SAM.Geltungsbereich_E3_1_1_UNECE_Gen2.RP_IF_SAL_KL_50_5s_XIX_Grundumfang_XIX_SAM.DE_SAL_KL_50_5s, system-signal=SAL_KL_50_5s
        communication-direction=IN, data-element=ABL_XIX_SAM.Geltungsbereich_E3_1_1_UNECE_Gen2.RP_IF_SAL_Kl_75_XIX_ABL_XIX_SAM.DE_SAL_Kl_75, system-signal=SAL_Kl_75
        communication-direction=IN, data-element=Grundumfang_XIX_SAM.Geltungsbereich_E3_1_1_UNECE_Gen2.RP_IF_SAL_Kl_75_XIX_Grundumfang_XIX_SAM.DE_SAL_Kl_75, system-signal=SAL_Kl_75
        communication-direction=IN, data-element=ABL_XIX_SAM.Geltungsbereich_E3_1_1_UNECE_Gen2.RP_IF_SAL_KL_75_vFzg_XIX_ABL_XIX_SAM.DE_SAL_KL_75_vFzg, system-signal=SAL_KL_75_vFzg
        communication-direction=IN, data-element=Grundumfang_XIX_SAM.Geltungsbereich_E3_1_1_UNECE_Gen2.RP_IF_SAL_KL_75_vFzg_XIX_Grundumfang_XIX_SAM.DE_SAL_KL_75_vFzg, system-signal=SAL_KL_75_vFzg
        communication-direction=IN, data-element=ABL_XIX_SAM.Geltungsbereich_E3_1_1_UNECE_Gen2.RP_IF_SAL_KL_75a_XIX_ABL_XIX_SAM.DE_SAL_KL_75a, system-signal=SAL_KL_75a
        communication-direction=IN, data-element=Grundumfang_XIX_SAM.Geltungsbereich_E3_1_1_UNECE_Gen2.RP_IF_SAL_KL_75a_XIX_Grundumfang_XIX_SAM.DE_SAL_KL_75a, system-signal=SAL_KL_75a
        communication-direction=IN, data-element=ABL_XIX_SAM.Geltungsbereich_E3_1_1_UNECE_Gen2.RP_IF_SAL_KL_75a_vFzg_XIX_ABL_XIX_SAM.DE_SAL_KL_75a_vFzg, system-signal=SAL_KL_75a_vFzg
        communication-direction=IN, data-element=Grundumfang_XIX_SAM.Geltungsbereich_E3_1_1_UNECE_Gen2.RP_IF_SAL_KL_75a_vFzg_XIX_Grundumfang_XIX_SAM.DE_SAL_KL_75a_vFzg, system-signal=SAL_KL_75a_vFzg
        communication-direction=IN, data-element=ABL_XIX_SAM.Geltungsbereich_E3_1_1_UNECE_Gen2.RP_IF_SAL_KZL_Anf_XIX_ABL_XIX_SAM.DE_SAL_KZL_Anf, system-signal=SAL_KZL_Anf
        communication-direction=IN, data-element=Grundumfang_XIX_SAM.Geltungsbereich_E3_1_1_UNECE_Gen2.RP_IF_SAL_KZL_Anf_XIX_Grundumfang_XIX_SAM.DE_SAL_KZL_Anf, system-signal=SAL_KZL_Anf
        communication-direction=IN, data-element=ABL_XIX_SAM.Geltungsbereich_E3_1_1_UNECE_Gen2.RP_IF_SAL_LDS_Abblendlicht_Anf_XIX_ABL_XIX_SAM.DE_SAL_LDS_Abblendlicht_Anf, system-signal=SAL_LDS_Abblendlicht_Anf
        communication-direction=IN, data-element=Grundumfang_XIX_SAM.Geltungsbereich_E3_1_1_UNECE_Gen2.RP_IF_SAL_LDS_Abblendlicht_Anf_XIX_Grundumfang_XIX_SAM.DE_SAL_LDS_Abblendlicht_Anf, system-signal=SAL_LDS_Abblendlicht_Anf
        communication-direction=IN, data-element=ABL_XIX_SAM.Geltungsbereich_E3_1_1_UNECE_Gen2.RP_IF_SAL_LDS_Assistenzfahrlicht_Anf_XIX_ABL_XIX_SAM.DE_SAL_LDS_Assistenzfahrlicht_Anf, system-signal=SAL_LDS_Assistenzfahrlicht_Anf
        communication-direction=IN, data-element=Grundumfang_XIX_SAM.Geltungsbereich_E3_1_1_UNECE_Gen2.RP_IF_SAL_LDS_Assistenzfahrlicht_Anf_XIX_Grundumfang_XIX_SAM.DE_SAL_LDS_Assistenzfahrlicht_Anf, system-signal=SAL_LDS_Assistenzfahrlicht_Anf
        communication-direction=IN, data-element=ABL_XIX_SAM.Geltungsbereich_E3_1_1_UNECE_Gen2.RP_IF_SAL_LDS_Nullstellung_Anf_XIX_ABL_XIX_SAM.DE_SAL_LDS_Nullstellung_Anf, system-signal=SAL_LDS_Nullstellung_Anf
        communication-direction=IN, data-element=Grundumfang_XIX_SAM.Geltungsbereich_E3_1_1_UNECE_Gen2.RP_IF_SAL_LDS_Nullstellung_Anf_XIX_Grundumfang_XIX_SAM.DE_SAL_LDS_Nullstellung_Anf, system-signal=SAL_LDS_Nullstellung_Anf
        communication-direction=IN, data-element=ABL_XIX_SAM.Geltungsbereich_E3_1_1_UNECE_Gen2.RP_IF_SAL_LDS_Standlicht_Anf_XIX_ABL_XIX_SAM.DE_SAL_LDS_Standlicht_Anf, system-signal=SAL_LDS_Standlicht_Anf
        communication-direction=IN, data-element=Grundumfang_XIX_SAM.Geltungsbereich_E3_1_1_UNECE_Gen2.RP_IF_SAL_LDS_Standlicht_Anf_XIX_Grundumfang_XIX_SAM.DE_SAL_LDS_Standlicht_Anf, system-signal=SAL_LDS_Standlicht_Anf
        communication-direction=IN, data-element=ABL_XIX_SAM.Geltungsbereich_E3_1_1_UNECE_Gen2.RP_IF_SAL_LH_Anf_XIX_ABL_XIX_SAM.DE_SAL_LH_Anf, system-signal=SAL_LH_Anf
        communication-direction=IN, data-element=Grundumfang_XIX_SAM.Geltungsbereich_E3_1_1_UNECE_Gen2.RP_IF_SAL_LH_Anf_XIX_Grundumfang_XIX_SAM.DE_SAL_LH_Anf, system-signal=SAL_LH_Anf
        communication-direction=OUT, data-element=ABL_XIX_SAM.Geltungsbereich_E3_1_1_UNECE_Gen2.SP_IF_SAL_li1_Blinker_Status_XIX_ABL_XIX_SAM.DE_SAL_li1_Blinker_Status, system-signal=SAL_li1_Blinker_Status
        communication-direction=OUT, data-element=Grundumfang_XIX_SAM.Geltungsbereich_E3_1_1_UNECE_Gen2.SP_IF_SAL_li1_Blinker_Status_XIX_Grundumfang_XIX_SAM.DE_SAL_li1_Blinker_Status, system-signal=SAL_li1_Blinker_Status
        communication-direction=IN, data-element=ABL_XIX_SAM.Geltungsbereich_E3_1_1_UNECE_Gen2.RP_IF_SAL_NSL_Anf_XIX_ABL_XIX_SAM.DE_SAL_NSL_Anf, system-signal=SAL_NSL_Anf
        communication-direction=IN, data-element=Grundumfang_XIX_SAM.Geltungsbereich_E3_1_1_UNECE_Gen2.RP_IF_SAL_NSL_Anf_XIX_Grundumfang_XIX_SAM.DE_SAL_NSL_Anf, system-signal=SAL_NSL_Anf
        communication-direction=IN, data-element=ABL_XIX_SAM.Geltungsbereich_E3_1_1_UNECE_Gen2.RP_IF_SAL_PL_L_Anf_XIX_ABL_XIX_SAM.DE_SAL_PL_L_Anf, system-signal=SAL_PL_L_Anf
        communication-direction=IN, data-element=Grundumfang_XIX_SAM.Geltungsbereich_E3_1_1_UNECE_Gen2.RP_IF_SAL_PL_L_Anf_XIX_Grundumfang_XIX_SAM.DE_SAL_PL_L_Anf, system-signal=SAL_PL_L_Anf
        communication-direction=IN, data-element=ABL_XIX_SAM.Geltungsbereich_E3_1_1_UNECE_Gen2.RP_IF_SAL_PL_R_Anf_XIX_ABL_XIX_SAM.DE_SAL_PL_R_Anf, system-signal=SAL_PL_R_Anf
        communication-direction=IN, data-element=Grundumfang_XIX_SAM.Geltungsbereich_E3_1_1_UNECE_Gen2.RP_IF_SAL_PL_R_Anf_XIX_Grundumfang_XIX_SAM.DE_SAL_PL_R_Anf, system-signal=SAL_PL_R_Anf
        communication-direction=OUT, data-element=ABL_XIX_SAM.Geltungsbereich_E3_1_1_UNECE_Gen2.SP_IF_SAL_re1_Blinker_Status_XIX_ABL_XIX_SAM.DE_SAL_re1_Blinker_Status, system-signal=SAL_re1_Blinker_Status
        communication-direction=OUT, data-element=Grundumfang_XIX_SAM.Geltungsbereich_E3_1_1_UNECE_Gen2.SP_IF_SAL_re1_Blinker_Status_XIX_Grundumfang_XIX_SAM.DE_SAL_re1_Blinker_Status, system-signal=SAL_re1_Blinker_Status
        communication-direction=IN, data-element=ABL_XIX_SAM.Geltungsbereich_E3_1_1_UNECE_Gen2.RP_IF_SAL_RFL_Anf_XIX_ABL_XIX_SAM.DE_SAL_RFL_Anf, system-signal=SAL_RFL_Anf
        communication-direction=IN, data-element=Grundumfang_XIX_SAM.Geltungsbereich_E3_1_1_UNECE_Gen2.RP_IF_SAL_RFL_Anf_XIX_Grundumfang_XIX_SAM.DE_SAL_RFL_Anf, system-signal=SAL_RFL_Anf
        communication-direction=IN, data-element=ABL_XIX_SAM.Geltungsbereich_E3_1_1_UNECE_Gen2.RP_IF_SAL_SL_Anf_XIX_ABL_XIX_SAM.DE_SAL_SL_Anf, system-signal=SAL_SL_Anf
        communication-direction=IN, data-element=Grundumfang_XIX_SAM.Geltungsbereich_E3_1_1_UNECE_Gen2.RP_IF_SAL_SL_Anf_XIX_Grundumfang_XIX_SAM.DE_SAL_SL_Anf, system-signal=SAL_SL_Anf
        communication-direction=IN, data-element=ABL_XIX_SAM.Geltungsbereich_E3_1_1_UNECE_Gen2.RP_IF_SAL_WBT_Bel_XIX_ABL_XIX_SAM.DE_SAL_WBT_Bel, system-signal=SAL_WBT_Bel
        communication-direction=IN, data-element=Grundumfang_XIX_SAM.Geltungsbereich_E3_1_1_UNECE_Gen2.RP_IF_SAL_WBT_Bel_XIX_Grundumfang_XIX_SAM.DE_SAL_WBT_Bel, system-signal=SAL_WBT_Bel
        communication-direction=OUT, data-element=Grundumfang_XIX_SAM.Geltungsbereich_E3_1_1_UNECE_Gen2.SP_IF_SAM_01_BZ_XIX_Grundumfang_XIX_SAM.DE_SAM_01_BZ, system-signal=SAM_01_BZ
        communication-direction=OUT, data-element=Grundumfang_XIX_SAM.Geltungsbereich_E3_1_1_UNECE_Gen2.SP_IF_SAM_01_CRC_XIX_Grundumfang_XIX_SAM.DE_SAM_01_CRC, system-signal=SAM_01_CRC
        communication-direction=OUT, data-element=Grundumfang_XIX_SAM.Geltungsbereich_E3_1_1_UNECE_Gen2.SP_IF_SAM_Fehler_DC_LWR_XIX_Grundumfang_XIX_SAM.DE_SAM_Fehler_DC_LWR, system-signal=SAM_Fehler_DC_LWR
        communication-direction=OUT, data-element=LWR_Auto_XIX_SAM.Geltungsbereich_E3_1_1_UNECE_Gen2.SP_IF_SAM_Fehler_DC_LWR_XIX_LWR_Auto_XIX_SAM.DE_SAM_Fehler_DC_LWR, system-signal=SAM_Fehler_DC_LWR
        communication-direction=OUT, data-element=Grundumfang_XIX_SAM.Geltungsbereich_E3_1_1_UNECE_Gen2.SP_IF_SAM_ORUData_XIX_Grundumfang_XIX_SAM.DE_SAM_ORUData, system-signal=SAM_ORUData
        communication-direction=OUT, data-element=Grundumfang_XIX_SAM.Geltungsbereich_E3_1_1_UNECE_Gen2.SP_IF_SAM_ORUDataIndex_XIX_Grundumfang_XIX_SAM.DE_SAM_ORUDataIndex, system-signal=SAM_ORUDataIndex
        communication-direction=IN, data-element=Grundumfang_XIX_SAM.Geltungsbereich_E3_1_1_UNECE_Gen2.RP_IF_SC_PAO_OFF_Anf_XIX_Grundumfang_XIX_SAM.DE_SC_PAO_OFF_Anf, system-signal=SC_PAO_OFF_Anf
        communication-direction=OUT, data-element=Grundumfang_XIX_SAM.Geltungsbereich_E3_1_1_UNECE_Gen2.SP_IF_SC_PAO_OFF_Anf_XIX_Grundumfang_XIX_SAM.DE_SC_PAO_OFF_Anf, system-signal=SC_PAO_OFF_Anf
        communication-direction=IN, data-element=Grundumfang_XIX_SAM.Geltungsbereich_E3_1_1_UNECE_Gen2.RP_IF_SC_PAO_ON_Anf_XIX_Grundumfang_XIX_SAM.DE_SC_PAO_ON_Anf, system-signal=SC_PAO_ON_Anf
        communication-direction=OUT, data-element=Grundumfang_XIX_SAM.Geltungsbereich_E3_1_1_UNECE_Gen2.SP_IF_SC_PAO_ON_Anf_XIX_Grundumfang_XIX_SAM.DE_SC_PAO_ON_Anf, system-signal=SC_PAO_ON_Anf
        communication-direction=OUT, data-element=Grundumfang_XIX_SAM.Geltungsbereich_E3_1_1_UNECE_Gen2.SP_IF_Schluesselnr_Personalisierung_XIX_Grundumfang_XIX_SAM.DE_Schluesselnr_Personalisierung, system-signal=Schluesselnr_Personalisierung
        communication-direction=OUT, data-element=Grundumfang_XIX_SAM.Geltungsbereich_E3_1_1_UNECE_Gen2.SP_IF_Servicestellung_Wischer_XIX_Grundumfang_XIX_SAM.DE_Servicestellung_Wischer, system-signal=Servicestellung_Wischer
        communication-direction=IN, data-element=Grundumfang_XIX_SAM.Geltungsbereich_E3_1_1_UNECE_Gen2.RP_IF_SI_BUS_{01..03}_XIX_Grundumfang_XIX_SAM.DE_SI_BUS_{01..03}, system-signal=SI_BUS_{01..03}
        communication-direction=IN, data-element=Grundumfang_XIX_SAM.Geltungsbereich_E3_1_1_UNECE_Gen2.RP_IF_SI_BUS_05_XIX_Grundumfang_XIX_SAM.DE_SI_BUS_05, system-signal=SI_BUS_05
        communication-direction=IN, data-element=Grundumfang_XIX_SAM.Geltungsbereich_E3_1_1_UNECE_Gen2.RP_IF_SI_BUS_06_XIX_Grundumfang_XIX_SAM.DE_SI_BUS_06, system-signal=SI_BUS_06
        communication-direction=IN, data-element=ABL_XIX_SAM.Geltungsbereich_E3_1_1_UNECE_Gen2.RP_IF_SI_BUS_09_XIX_ABL_XIX_SAM.DE_SI_BUS_09, system-signal=SI_BUS_09
        communication-direction=IN, data-element=Grundumfang_XIX_SAM.Geltungsbereich_E3_1_1_UNECE_Gen2.RP_IF_SI_BUS_10_XIX_Grundumfang_XIX_SAM.DE_SI_BUS_10, system-signal=SI_BUS_10
        communication-direction=IN, data-element=Grundumfang_XIX_SAM.Geltungsbereich_E3_1_1_UNECE_Gen2.RP_IF_SI_BUS_13_XIX_Grundumfang_XIX_SAM.DE_SI_BUS_13, system-signal=SI_BUS_13
        communication-direction=IN, data-element=Grundumfang_XIX_SAM.Geltungsbereich_E3_1_1_UNECE_Gen2.RP_IF_SI_BUS_14_XIX_Grundumfang_XIX_SAM.DE_SI_BUS_14, system-signal=SI_BUS_14
        communication-direction=IN, data-element=Grundumfang_XIX_SAM.Geltungsbereich_E3_1_1_UNECE_Gen2.RP_IF_SI_Bus_Identifikation_XIX_Grundumfang_XIX_SAM.DE_SI_Bus_Identifikation, system-signal=SI_Bus_Identifikation
        communication-direction=IN, data-element=Grundumfang_XIX_SAM.Geltungsbereich_E3_1_1_UNECE_Gen2.RP_IF_SI_NWDF_XIX_Grundumfang_XIX_SAM.DE_SI_NWDF, system-signal=SI_NWDF
        communication-direction=IN, data-element=Grundumfang_XIX_SAM.Geltungsbereich_E3_1_1_UNECE_Gen2.RP_IF_SI_NWDF_gueltig_XIX_Grundumfang_XIX_SAM.DE_SI_NWDF_gueltig, system-signal=SI_NWDF_gueltig
        communication-direction=IN, data-element=Grundumfang_XIX_SAM.Geltungsbereich_E3_1_1_UNECE_Gen2.RP_IF_SI_P_Mode_XIX_Grundumfang_XIX_SAM.DE_SI_P_Mode, system-signal=SI_P_Mode
        communication-direction=IN, data-element=Grundumfang_XIX_SAM.Geltungsbereich_E3_1_1_UNECE_Gen2.RP_IF_SI_P_Mode_gueltig_XIX_Grundumfang_XIX_SAM.DE_SI_P_Mode_gueltig, system-signal=SI_P_Mode_gueltig
        communication-direction=IN, data-element=Druckpunktmassage_fuer_Beifahrersitz_Lehnenmassage_SAM_XIX_DPMBFSLM_XIX_SAM.Geltungsbereich_E3_1_1_UNECE_Gen2.RP_IF_SI_QRS_Mode_XIX_Druckpunktmassage_fuer_Beifahrersitz_Lehnenmassage_SAM_XIX_DPMBFSLM_XIX_SAM.DE_SI_QRS_Mode, system-signal=SI_QRS_Mode
        communication-direction=IN, data-element=Druckpunktmassage_fuer_Fahrersitz_Lehnenmassage_SAM_XIX_DPMFSLM_XIX_SAM.Geltungsbereich_E3_1_1_UNECE_Gen2.RP_IF_SI_QRS_Mode_XIX_Druckpunktmassage_fuer_Fahrersitz_Lehnenmassage_SAM_XIX_DPMFSLM_XIX_SAM.DE_SI_QRS_Mode, system-signal=SI_QRS_Mode
        communication-direction=IN, data-element=Grundumfang_XIX_SAM.Geltungsbereich_E3_1_1_UNECE_Gen2.RP_IF_SI_QRS_Mode_XIX_Grundumfang_XIX_SAM.DE_SI_QRS_Mode, system-signal=SI_QRS_Mode
        communication-direction=IN, data-element=Druckpunktmassage_fuer_Beifahrersitz_Lehnenmassage_SAM_XIX_DPMBFSLM_XIX_SAM.Geltungsbereich_E3_1_1_UNECE_Gen2.RP_IF_SI_T_Mode_XIX_Druckpunktmassage_fuer_Beifahrersitz_Lehnenmassage_SAM_XIX_DPMBFSLM_XIX_SAM.DE_SI_T_Mode, system-signal=SI_T_Mode
        communication-direction=IN, data-element=Druckpunktmassage_fuer_Fahrersitz_Lehnenmassage_SAM_XIX_DPMFSLM_XIX_SAM.Geltungsbereich_E3_1_1_UNECE_Gen2.RP_IF_SI_T_Mode_XIX_Druckpunktmassage_fuer_Fahrersitz_Lehnenmassage_SAM_XIX_DPMFSLM_XIX_SAM.DE_SI_T_Mode, system-signal=SI_T_Mode
        communication-direction=IN, data-element=Grundumfang_XIX_SAM.Geltungsbereich_E3_1_1_UNECE_Gen2.RP_IF_SI_T_Mode_XIX_Grundumfang_XIX_SAM.DE_SI_T_Mode, system-signal=SI_T_Mode
        communication-direction=IN, data-element=Grundumfang_XIX_SAM.Geltungsbereich_E3_1_1_UNECE_Gen2.RP_IF_SI_T_Schutz_XIX_Grundumfang_XIX_SAM.DE_SI_T_Schutz, system-signal=SI_T_Schutz
        communication-direction=OUT, data-element=Grundumfang_XIX_SAM.Geltungsbereich_E3_1_1_UNECE_Gen2.SP_IF_SIL_Stufe_LED_li_XIX_Grundumfang_XIX_SAM.DE_SIL_Stufe_LED_li, system-signal=SIL_Stufe_LED_li
        communication-direction=OUT, data-element=Grundumfang_XIX_SAM.Geltungsbereich_E3_1_1_UNECE_Gen2.SP_IF_SIL_Stufe_LED_re_XIX_Grundumfang_XIX_SAM.DE_SIL_Stufe_LED_re, system-signal=SIL_Stufe_LED_re
        communication-direction=IN, data-element=Grundumfang_XIX_SAM.Geltungsbereich_E3_1_1_UNECE_Gen2.RP_IF_SitzMem_HBFS_ORUData_XIX_Grundumfang_XIX_SAM.DE_SitzMem_HBFS_ORUData, system-signal=SitzMem_HBFS_ORUData
        communication-direction=IN, data-element=Grundumfang_XIX_SAM.Geltungsbereich_E3_1_1_UNECE_Gen2.RP_IF_SitzMem_HBFS_ORUDataIndex_XIX_Grundumfang_XIX_SAM.DE_SitzMem_HBFS_ORUDataIndex, system-signal=SitzMem_HBFS_ORUDataIndex
        communication-direction=IN, data-element=Grundumfang_XIX_SAM.Geltungsbereich_E3_1_1_UNECE_Gen2.RP_IF_SitzMem_HFS_ORUData_XIX_Grundumfang_XIX_SAM.DE_SitzMem_HFS_ORUData, system-signal=SitzMem_HFS_ORUData
        communication-direction=IN, data-element=Grundumfang_XIX_SAM.Geltungsbereich_E3_1_1_UNECE_Gen2.RP_IF_SitzMem_HFS_ORUDataIndex_XIX_Grundumfang_XIX_SAM.DE_SitzMem_HFS_ORUDataIndex, system-signal=SitzMem_HFS_ORUDataIndex
        communication-direction=IN, data-element=Grundumfang_XIX_SAM.Geltungsbereich_E3_1_1_UNECE_Gen2.RP_IF_SitzMemo_BFS_ORUData_XIX_Grundumfang_XIX_SAM.DE_SitzMemo_BFS_ORUData, system-signal=SitzMemo_BFS_ORUData
        communication-direction=IN, data-element=Grundumfang_XIX_SAM.Geltungsbereich_E3_1_1_UNECE_Gen2.RP_IF_SitzMemo_BFS_ORUDataIndex_XIX_Grundumfang_XIX_SAM.DE_SitzMemo_BFS_ORUDataIndex, system-signal=SitzMemo_BFS_ORUDataIndex
        communication-direction=IN, data-element=Grundumfang_XIX_SAM.Geltungsbereich_E3_1_1_UNECE_Gen2.RP_IF_SitzMemo_FS_ORUData_XIX_Grundumfang_XIX_SAM.DE_SitzMemo_FS_ORUData, system-signal=SitzMemo_FS_ORUData
        communication-direction=IN, data-element=Grundumfang_XIX_SAM.Geltungsbereich_E3_1_1_UNECE_Gen2.RP_IF_SitzMemo_FS_ORUDataIndex_XIX_Grundumfang_XIX_SAM.DE_SitzMemo_FS_ORUDataIndex, system-signal=SitzMemo_FS_ORUDataIndex
        communication-direction=IN, data-element=Grundumfang_XIX_SAM.Geltungsbereich_E3_1_1_UNECE_Gen2.RP_IF_SL2_APS_Taster_XIX_Grundumfang_XIX_SAM.DE_SL2_APS_Taster, system-signal=SL2_APS_Taster
        communication-direction=IN, data-element=Grundumfang_XIX_SAM.Geltungsbereich_E3_1_1_UNECE_Gen2.RP_IF_SL2_FAS_Profile_Taster_XIX_Grundumfang_XIX_SAM.DE_SL2_FAS_Profile_Taster, system-signal=SL2_FAS_Profile_Taster
        communication-direction=IN, data-element=Grundumfang_XIX_SAM.Geltungsbereich_E3_1_1_UNECE_Gen2.RP_IF_SL2_ResponseError_XIX_Grundumfang_XIX_SAM.DE_SL2_ResponseError, system-signal=SL2_ResponseError
        communication-direction=IN, data-element=Grundumfang_XIX_SAM.Geltungsbereich_E3_1_1_UNECE_Gen2.RP_IF_SL2_StatusSchalterleiste_XIX_Grundumfang_XIX_SAM.DE_SL2_StatusSchalterleiste, system-signal=SL2_StatusSchalterleiste
        communication-direction=OUT, data-element=ABL_XIX_SAM.Geltungsbereich_E3_1_1_UNECE_Gen2.SP_IF_SMLS_01_BZ_XIX_ABL_XIX_SAM.DE_SMLS_01_BZ, system-signal=SMLS_01_BZ
        communication-direction=IN, data-element=Grundumfang_XIX_SAM.Geltungsbereich_E3_1_1_UNECE_Gen2.RP_IF_SMLS_01_BZ_XIX_Grundumfang_XIX_SAM.DE_SMLS_01_BZ, system-signal=SMLS_01_BZ
        communication-direction=OUT, data-element=Grundumfang_XIX_SAM.Geltungsbereich_E3_1_1_UNECE_Gen2.SP_IF_SMLS_01_BZ_XIX_Grundumfang_XIX_SAM.DE_SMLS_01_BZ, system-signal=SMLS_01_BZ
        communication-direction=OUT, data-element=ABL_XIX_SAM.Geltungsbereich_E3_1_1_UNECE_Gen2.SP_IF_SMLS_01_CRC_XIX_ABL_XIX_SAM.DE_SMLS_01_CRC, system-signal=SMLS_01_CRC
        communication-direction=IN, data-element=Grundumfang_XIX_SAM.Geltungsbereich_E3_1_1_UNECE_Gen2.RP_IF_SMLS_01_CRC_XIX_Grundumfang_XIX_SAM.DE_SMLS_01_CRC, system-signal=SMLS_01_CRC
        communication-direction=OUT, data-element=Grundumfang_XIX_SAM.Geltungsbereich_E3_1_1_UNECE_Gen2.SP_IF_SMLS_01_CRC_XIX_Grundumfang_XIX_SAM.DE_SMLS_01_CRC, system-signal=SMLS_01_CRC
        communication-direction=OUT, data-element=Grundumfang_XIX_SAM.Geltungsbereich_E3_1_1_UNECE_Gen2.SP_IF_SMLS_alt_XIX_Grundumfang_XIX_SAM.DE_SMLS_alt, system-signal=SMLS_alt
        communication-direction=IN, data-element=Grundumfang_XIX_SAM.Geltungsbereich_E3_1_1_UNECE_Gen2.RP_IF_SMLS_Hupe_XIX_Grundumfang_XIX_SAM.DE_SMLS_Hupe, system-signal=SMLS_Hupe
        communication-direction=OUT, data-element=Grundumfang_XIX_SAM.Geltungsbereich_E3_1_1_UNECE_Gen2.SP_IF_SMLS_Hupe_XIX_Grundumfang_XIX_SAM.DE_SMLS_Hupe, system-signal=SMLS_Hupe
        communication-direction=IN, data-element=Grundumfang_XIX_SAM.Geltungsbereich_E3_1_1_UNECE_Gen2.RP_IF_SMLS_ORUData_XIX_Grundumfang_XIX_SAM.DE_SMLS_ORUData, system-signal=SMLS_ORUData
        communication-direction=IN, data-element=Grundumfang_XIX_SAM.Geltungsbereich_E3_1_1_UNECE_Gen2.RP_IF_SMLS_ORUDataIndex_XIX_Grundumfang_XIX_SAM.DE_SMLS_ORUDataIndex, system-signal=SMLS_ORUDataIndex
        communication-direction=OUT, data-element=Grundumfang_XIX_SAM.Geltungsbereich_E3_1_1_UNECE_Gen2.SP_IF_SOK_FoD_BCM1_Req_Challenge_XIX_Grundumfang_XIX_SAM.DE_SOK_FoD_BCM1_Req_Challenge, system-signal=SOK_FoD_BCM1_Req_Challenge
        communication-direction=IN, data-element=Grundumfang_XIX_SAM.Geltungsbereich_E3_1_1_UNECE_Gen2.RP_IF_SOK_FoD_BCM1_Resp_Challenge_XIX_Grundumfang_XIX_SAM.DE_SOK_FoD_BCM1_Resp_Challenge, system-signal=SOK_FoD_BCM1_Resp_Challenge
        communication-direction=OUT, data-element=Grundumfang_XIX_SAM.Geltungsbereich_E3_1_1_UNECE_Gen2.SP_IF_SOK_KST_Challenge_XIX_Grundumfang_XIX_SAM.DE_SOK_KST_Challenge, system-signal=SOK_KST_Challenge
        communication-direction=IN, data-element=Grundumfang_XIX_SAM.Geltungsbereich_E3_1_1_UNECE_Gen2.RP_IF_SOK_ungeschuetzte_Zeit_XIX_Grundumfang_XIX_SAM.DE_SOK_ungeschuetzte_Zeit, system-signal=SOK_ungeschuetzte_Zeit
        communication-direction=OUT, data-element=Grundumfang_XIX_SAM.Geltungsbereich_E3_1_1_UNECE_Gen2.SP_IF_SOK_ZV_HBFS_Challenge_XIX_Grundumfang_XIX_SAM.DE_SOK_ZV_HBFS_Challenge, system-signal=SOK_ZV_HBFS_Challenge
        communication-direction=OUT, data-element=Grundumfang_XIX_SAM.Geltungsbereich_E3_1_1_UNECE_Gen2.SP_IF_SOK_ZV_HFS_Challenge_XIX_Grundumfang_XIX_SAM.DE_SOK_ZV_HFS_Challenge, system-signal=SOK_ZV_HFS_Challenge
        communication-direction=OUT, data-element=Grundumfang_XIX_SAM.Geltungsbereich_E3_1_1_UNECE_Gen2.SP_IF_SOK_ZV_HW_Challenge_XIX_Grundumfang_XIX_SAM.DE_SOK_ZV_HW_Challenge, system-signal=SOK_ZV_HW_Challenge
        communication-direction=IN, data-element=Grundumfang_XIX_SAM.Geltungsbereich_E3_1_1_UNECE_Gen2.RP_IF_SOK_ZV_Rueck_HW_Challenge_XIX_Grundumfang_XIX_SAM.DE_SOK_ZV_Rueck_HW_Challenge, system-signal=SOK_ZV_Rueck_HW_Challenge
        communication-direction=OUT, data-element=Grundumfang_XIX_SAM.Geltungsbereich_E3_1_1_UNECE_Gen2.SP_IF_Soll_Lehne_LLR_li_1_XIX_Grundumfang_XIX_SAM.DE_Soll_Lehne_LLR_li_1, system-signal=Soll_Lehne_LLR_li_1
        communication-direction=OUT, data-element=Grundumfang_XIX_SAM.Geltungsbereich_E3_1_1_UNECE_Gen2.SP_IF_Soll_Lehne_LLR_li_2_XIX_Grundumfang_XIX_SAM.DE_Soll_Lehne_LLR_li_2, system-signal=Soll_Lehne_LLR_li_2
        communication-direction=OUT, data-element=Grundumfang_XIX_SAM.Geltungsbereich_E3_1_1_UNECE_Gen2.SP_IF_Soll_Lehne_LLR_re_1_XIX_Grundumfang_XIX_SAM.DE_Soll_Lehne_LLR_re_1, system-signal=Soll_Lehne_LLR_re_1
        communication-direction=OUT, data-element=Grundumfang_XIX_SAM.Geltungsbereich_E3_1_1_UNECE_Gen2.SP_IF_Soll_Lehne_LLR_re_2_XIX_Grundumfang_XIX_SAM.DE_Soll_Lehne_LLR_re_2, system-signal=Soll_Lehne_LLR_re_2
        communication-direction=OUT, data-element=Grundumfang_XIX_SAM.Geltungsbereich_E3_1_1_UNECE_Gen2.SP_IF_Soll_Sitz_LLR_li_1_XIX_Grundumfang_XIX_SAM.DE_Soll_Sitz_LLR_li_1, system-signal=Soll_Sitz_LLR_li_1
        communication-direction=OUT, data-element=Grundumfang_XIX_SAM.Geltungsbereich_E3_1_1_UNECE_Gen2.SP_IF_Soll_Sitz_LLR_li_2_XIX_Grundumfang_XIX_SAM.DE_Soll_Sitz_LLR_li_2, system-signal=Soll_Sitz_LLR_li_2
        communication-direction=OUT, data-element=Grundumfang_XIX_SAM.Geltungsbereich_E3_1_1_UNECE_Gen2.SP_IF_Soll_Sitz_LLR_re_1_XIX_Grundumfang_XIX_SAM.DE_Soll_Sitz_LLR_re_1, system-signal=Soll_Sitz_LLR_re_1
        communication-direction=OUT, data-element=Grundumfang_XIX_SAM.Geltungsbereich_E3_1_1_UNECE_Gen2.SP_IF_Soll_Sitz_LLR_re_2_XIX_Grundumfang_XIX_SAM.DE_Soll_Sitz_LLR_re_2, system-signal=Soll_Sitz_LLR_re_2
        communication-direction=IN, data-element=Grundumfang_XIX_SAM.Geltungsbereich_E3_1_1_UNECE_Gen2.RP_IF_SoSe_SunInt_2D_Li_XIX_Grundumfang_XIX_SAM.DE_SoSe_SunInt_2D_Li, system-signal=SoSe_SunInt_2D_Li
        communication-direction=IN, data-element=Grundumfang_XIX_SAM.Geltungsbereich_E3_1_1_UNECE_Gen2.RP_IF_SoSe_SunInt_2D_Re_XIX_Grundumfang_XIX_SAM.DE_SoSe_SunInt_2D_Re, system-signal=SoSe_SunInt_2D_Re
        communication-direction=OUT, data-element=Grundumfang_XIX_SAM.Geltungsbereich_E3_1_1_UNECE_Gen2.SP_IF_SPR_Abschaltstufe_XIX_Grundumfang_XIX_SAM.DE_SPR_Abschaltstufe, system-signal=SPR_Abschaltstufe
        communication-direction=IN, data-element=Grundumfang_XIX_SAM.Geltungsbereich_E3_1_1_UNECE_Gen2.RP_IF_SPR_BFS_CodierPinError_XIX_Grundumfang_XIX_SAM.DE_SPR_BFS_CodierPinError, system-signal=SPR_BFS_CodierPinError
        communication-direction=IN, data-element=Grundumfang_XIX_SAM.Geltungsbereich_E3_1_1_UNECE_Gen2.RP_IF_SPR_BFS_Kompressor_elFehler_XIX_Grundumfang_XIX_SAM.DE_SPR_BFS_Kompressor_elFehler, system-signal=SPR_BFS_Kompressor_elFehler
        communication-direction=IN, data-element=Grundumfang_XIX_SAM.Geltungsbereich_E3_1_1_UNECE_Gen2.RP_IF_SPR_BFS_Leck_erkannt_XIX_Grundumfang_XIX_SAM.DE_SPR_BFS_Leck_erkannt, system-signal=SPR_BFS_Leck_erkannt
        communication-direction=IN, data-element=Grundumfang_XIX_SAM.Geltungsbereich_E3_1_1_UNECE_Gen2.RP_IF_SPR_BFS_Lokal_aktiv_XIX_Grundumfang_XIX_SAM.DE_SPR_BFS_Lokal_aktiv, system-signal=SPR_BFS_Lokal_aktiv
        communication-direction=IN, data-element=Grundumfang_XIX_SAM.Geltungsbereich_E3_1_1_UNECE_Gen2.RP_IF_SPR_BFS_Lordose_hoch_XIX_Grundumfang_XIX_SAM.DE_SPR_BFS_Lordose_hoch, system-signal=SPR_BFS_Lordose_hoch
        communication-direction=IN, data-element=Grundumfang_XIX_SAM.Geltungsbereich_E3_1_1_UNECE_Gen2.RP_IF_SPR_BFS_Lordose_runter_XIX_Grundumfang_XIX_SAM.DE_SPR_BFS_Lordose_runter, system-signal=SPR_BFS_Lordose_runter
        communication-direction=IN, data-element=Grundumfang_XIX_SAM.Geltungsbereich_E3_1_1_UNECE_Gen2.RP_IF_SPR_BFS_Lordose_vor_XIX_Grundumfang_XIX_SAM.DE_SPR_BFS_Lordose_vor, system-signal=SPR_BFS_Lordose_vor
        communication-direction=IN, data-element=Grundumfang_XIX_SAM.Geltungsbereich_E3_1_1_UNECE_Gen2.RP_IF_SPR_BFS_Lordose_zurueck_XIX_Grundumfang_XIX_SAM.DE_SPR_BFS_Lordose_zurueck, system-signal=SPR_BFS_Lordose_zurueck
        communication-direction=IN, data-element=Druckpunktmassage_fuer_Beifahrersitz_Lehnenmassage_SAM_XIX_DPMBFSLM_XIX_SAM.Geltungsbereich_E3_1_1_UNECE_Gen2.RP_IF_SPR_BFS_Massage_Dauer_XIX_Druckpunktmassage_fuer_Beifahrersitz_Lehnenmassage_SAM_XIX_DPMBFSLM_XIX_SAM.DE_SPR_BFS_Massage_Dauer, system-signal=SPR_BFS_Massage_Dauer
        communication-direction=IN, data-element=Grundumfang_XIX_SAM.Geltungsbereich_E3_1_1_UNECE_Gen2.RP_IF_SPR_BFS_Massage_Int_XIX_Grundumfang_XIX_SAM.DE_SPR_BFS_Massage_Int, system-signal=SPR_BFS_Massage_Int
        communication-direction=IN, data-element=Druckpunktmassage_fuer_Beifahrersitz_Lehnenmassage_SAM_XIX_DPMBFSLM_XIX_SAM.Geltungsbereich_E3_1_1_UNECE_Gen2.RP_IF_SPR_BFS_Massage_Intens_Lehne_XIX_Druckpunktmassage_fuer_Beifahrersitz_Lehnenmassage_SAM_XIX_DPMBFSLM_XIX_SAM.DE_SPR_BFS_Massage_Intens_Lehne, system-signal=SPR_BFS_Massage_Intens_Lehne
        communication-direction=IN, data-element=Druckpunktmassage_fuer_Beifahrersitz_Lehnenmassage_SAM_XIX_DPMBFSLM_XIX_SAM.Geltungsbereich_E3_1_1_UNECE_Gen2.RP_IF_SPR_BFS_Massage_Intens_Sitz_XIX_Druckpunktmassage_fuer_Beifahrersitz_Lehnenmassage_SAM_XIX_DPMBFSLM_XIX_SAM.DE_SPR_BFS_Massage_Intens_Sitz, system-signal=SPR_BFS_Massage_Intens_Sitz
        communication-direction=IN, data-element=Grundumfang_XIX_SAM.Geltungsbereich_E3_1_1_UNECE_Gen2.RP_IF_SPR_BFS_Massage_Prg_XIX_Grundumfang_XIX_SAM.DE_SPR_BFS_Massage_Prg, system-signal=SPR_BFS_Massage_Prg
        communication-direction=IN, data-element=Druckpunktmassage_fuer_Beifahrersitz_Lehnenmassage_SAM_XIX_DPMBFSLM_XIX_SAM.Geltungsbereich_E3_1_1_UNECE_Gen2.RP_IF_SPR_BFS_Massage_Prg_erweitert_XIX_Druckpunktmassage_fuer_Beifahrersitz_Lehnenmassage_SAM_XIX_DPMBFSLM_XIX_SAM.DE_SPR_BFS_Massage_Prg_erweitert, system-signal=SPR_BFS_Massage_Prg_erweitert
        communication-direction=IN, data-element=Grundumfang_XIX_SAM.Geltungsbereich_E3_1_1_UNECE_Gen2.RP_IF_SPR_BFS_MassageStatus_XIX_Grundumfang_XIX_SAM.DE_SPR_BFS_MassageStatus, system-signal=SPR_BFS_MassageStatus
        communication-direction=IN, data-element=Druckpunktmassage_fuer_Beifahrersitz_Lehnenmassage_SAM_XIX_DPMBFSLM_XIX_SAM.Geltungsbereich_E3_1_1_UNECE_Gen2.RP_IF_SPR_BFS_Massagetaster_inv_XIX_Druckpunktmassage_fuer_Beifahrersitz_Lehnenmassage_SAM_XIX_DPMBFSLM_XIX_SAM.DE_SPR_BFS_Massagetaster_inv, system-signal=SPR_BFS_Massagetaster_inv
        communication-direction=IN, data-element=Grundumfang_XIX_SAM.Geltungsbereich_E3_1_1_UNECE_Gen2.RP_IF_SPR_BFS_MuFu_Fkt_vor_XIX_Grundumfang_XIX_SAM.DE_SPR_BFS_MuFu_Fkt_vor, system-signal=SPR_BFS_MuFu_Fkt_vor
        communication-direction=IN, data-element=Grundumfang_XIX_SAM.Geltungsbereich_E3_1_1_UNECE_Gen2.RP_IF_SPR_BFS_MuFu_Fkt_zurueck_XIX_Grundumfang_XIX_SAM.DE_SPR_BFS_MuFu_Fkt_zurueck, system-signal=SPR_BFS_MuFu_Fkt_zurueck
        communication-direction=IN, data-element=Grundumfang_XIX_SAM.Geltungsbereich_E3_1_1_UNECE_Gen2.RP_IF_SPR_BFS_PopUp_Request_XIX_Grundumfang_XIX_SAM.DE_SPR_BFS_PopUp_Request, system-signal=SPR_BFS_PopUp_Request
        communication-direction=IN, data-element=Grundumfang_XIX_SAM.Geltungsbereich_E3_1_1_UNECE_Gen2.RP_IF_SPR_BFS_ResponseError_XIX_Grundumfang_XIX_SAM.DE_SPR_BFS_ResponseError, system-signal=SPR_BFS_ResponseError
        communication-direction=IN, data-element=Grundumfang_XIX_SAM.Geltungsbereich_E3_1_1_UNECE_Gen2.RP_IF_SPR_BFS_SG_defekt_XIX_Grundumfang_XIX_SAM.DE_SPR_BFS_SG_defekt, system-signal=SPR_BFS_SG_defekt
        communication-direction=IN, data-element=Grundumfang_XIX_SAM.Geltungsbereich_E3_1_1_UNECE_Gen2.RP_IF_SPR_BFS_SWL_vor_XIX_Grundumfang_XIX_SAM.DE_SPR_BFS_SWL_vor, system-signal=SPR_BFS_SWL_vor
        communication-direction=IN, data-element=Grundumfang_XIX_SAM.Geltungsbereich_E3_1_1_UNECE_Gen2.RP_IF_SPR_BFS_SWL_zurueck_XIX_Grundumfang_XIX_SAM.DE_SPR_BFS_SWL_zurueck, system-signal=SPR_BFS_SWL_zurueck
        communication-direction=IN, data-element=Grundumfang_XIX_SAM.Geltungsbereich_E3_1_1_UNECE_Gen2.RP_IF_SPR_BFS_Systemtest_Status_XIX_Grundumfang_XIX_SAM.DE_SPR_BFS_Systemtest_Status, system-signal=SPR_BFS_Systemtest_Status
        communication-direction=IN, data-element=Grundumfang_XIX_SAM.Geltungsbereich_E3_1_1_UNECE_Gen2.RP_IF_SPR_BFS_Tasterfehler_Massage_XIX_Grundumfang_XIX_SAM.DE_SPR_BFS_Tasterfehler_Massage, system-signal=SPR_BFS_Tasterfehler_Massage
        communication-direction=IN, data-element=Grundumfang_XIX_SAM.Geltungsbereich_E3_1_1_UNECE_Gen2.RP_IF_SPR_BFS_Tasterfehler_Mufu_auf_ab_XIX_Grundumfang_XIX_SAM.DE_SPR_BFS_Tasterfehler_Mufu_auf_ab, system-signal=SPR_BFS_Tasterfehler_Mufu_auf_ab
        communication-direction=IN, data-element=Grundumfang_XIX_SAM.Geltungsbereich_E3_1_1_UNECE_Gen2.RP_IF_SPR_BFS_Tasterfehler_Mufu_Ring_XIX_Grundumfang_XIX_SAM.DE_SPR_BFS_Tasterfehler_Mufu_Ring, system-signal=SPR_BFS_Tasterfehler_Mufu_Ring
        communication-direction=IN, data-element=Grundumfang_XIX_SAM.Geltungsbereich_E3_1_1_UNECE_Gen2.RP_IF_SPR_BFS_Tasterfehler_Mufu_v_z_XIX_Grundumfang_XIX_SAM.DE_SPR_BFS_Tasterfehler_Mufu_v_z, system-signal=SPR_BFS_Tasterfehler_Mufu_v_z
        communication-direction=IN, data-element=Druckpunktmassage_fuer_Beifahrersitz_Lehnenmassage_SAM_XIX_DPMBFSLM_XIX_SAM.Geltungsbereich_E3_1_1_UNECE_Gen2.RP_IF_SPR_BFS_Teller_inv_XIX_Druckpunktmassage_fuer_Beifahrersitz_Lehnenmassage_SAM_XIX_DPMBFSLM_XIX_SAM.DE_SPR_BFS_Teller_inv, system-signal=SPR_BFS_Teller_inv
        communication-direction=IN, data-element=Grundumfang_XIX_SAM.Geltungsbereich_E3_1_1_UNECE_Gen2.RP_IF_SPR_BFS_Ueberspannung_XIX_Grundumfang_XIX_SAM.DE_SPR_BFS_Ueberspannung, system-signal=SPR_BFS_Ueberspannung
        communication-direction=IN, data-element=Grundumfang_XIX_SAM.Geltungsbereich_E3_1_1_UNECE_Gen2.RP_IF_SPR_BFS_Unterspannung_XIX_Grundumfang_XIX_SAM.DE_SPR_BFS_Unterspannung, system-signal=SPR_BFS_Unterspannung
        communication-direction=IN, data-element=Druckpunktmassage_fuer_Beifahrersitz_Lehnenmassage_SAM_XIX_DPMBFSLM_XIX_SAM.Geltungsbereich_E3_1_1_UNECE_Gen2.RP_IF_SPR_BFS_Verstellung_aktiv_XIX_Druckpunktmassage_fuer_Beifahrersitz_Lehnenmassage_SAM_XIX_DPMBFSLM_XIX_SAM.DE_SPR_BFS_Verstellung_aktiv, system-signal=SPR_BFS_Verstellung_aktiv
        communication-direction=IN, data-element=Grundumfang_XIX_SAM.Geltungsbereich_E3_1_1_UNECE_Gen2.RP_IF_SPR_BFS_Verstellung_aktiv_XIX_Grundumfang_XIX_SAM.DE_SPR_BFS_Verstellung_aktiv, system-signal=SPR_BFS_Verstellung_aktiv
        communication-direction=IN, data-element=Druckpunktmassage_fuer_Beifahrersitz_Lehnenmassage_SAM_XIX_DPMBFSLM_XIX_SAM.Geltungsbereich_E3_1_1_UNECE_Gen2.RP_IF_SPR_BFS_Wellness_Status_XIX_Druckpunktmassage_fuer_Beifahrersitz_Lehnenmassage_SAM_XIX_DPMBFSLM_XIX_SAM.DE_SPR_BFS_Wellness_Status, system-signal=SPR_BFS_Wellness_Status
        communication-direction=IN, data-element=Druckpunktmassage_fuer_Beifahrersitz_Lehnenmassage_SAM_XIX_DPMBFSLM_XIX_SAM.Geltungsbereich_E3_1_1_UNECE_Gen2.RP_IF_SPR_BFS_Wippe_inv_XIX_Druckpunktmassage_fuer_Beifahrersitz_Lehnenmassage_SAM_XIX_DPMBFSLM_XIX_SAM.DE_SPR_BFS_Wippe_inv, system-signal=SPR_BFS_Wippe_inv
        communication-direction=IN, data-element=Grundumfang_XIX_SAM.Geltungsbereich_E3_1_1_UNECE_Gen2.RP_IF_SPR_FS_CodierPinError_XIX_Grundumfang_XIX_SAM.DE_SPR_FS_CodierPinError, system-signal=SPR_FS_CodierPinError
        communication-direction=IN, data-element=Grundumfang_XIX_SAM.Geltungsbereich_E3_1_1_UNECE_Gen2.RP_IF_SPR_FS_Kompressor_elFehler_XIX_Grundumfang_XIX_SAM.DE_SPR_FS_Kompressor_elFehler, system-signal=SPR_FS_Kompressor_elFehler
        communication-direction=IN, data-element=Grundumfang_XIX_SAM.Geltungsbereich_E3_1_1_UNECE_Gen2.RP_IF_SPR_FS_Leck_erkannt_XIX_Grundumfang_XIX_SAM.DE_SPR_FS_Leck_erkannt, system-signal=SPR_FS_Leck_erkannt
        communication-direction=IN, data-element=Grundumfang_XIX_SAM.Geltungsbereich_E3_1_1_UNECE_Gen2.RP_IF_SPR_FS_Lokal_aktiv_XIX_Grundumfang_XIX_SAM.DE_SPR_FS_Lokal_aktiv, system-signal=SPR_FS_Lokal_aktiv
        communication-direction=IN, data-element=Grundumfang_XIX_SAM.Geltungsbereich_E3_1_1_UNECE_Gen2.RP_IF_SPR_FS_Lordose_hoch_XIX_Grundumfang_XIX_SAM.DE_SPR_FS_Lordose_hoch, system-signal=SPR_FS_Lordose_hoch
        communication-direction=IN, data-element=Grundumfang_XIX_SAM.Geltungsbereich_E3_1_1_UNECE_Gen2.RP_IF_SPR_FS_Lordose_runter_XIX_Grundumfang_XIX_SAM.DE_SPR_FS_Lordose_runter, system-signal=SPR_FS_Lordose_runter
        communication-direction=IN, data-element=Grundumfang_XIX_SAM.Geltungsbereich_E3_1_1_UNECE_Gen2.RP_IF_SPR_FS_Lordose_vor_XIX_Grundumfang_XIX_SAM.DE_SPR_FS_Lordose_vor, system-signal=SPR_FS_Lordose_vor
        communication-direction=IN, data-element=Grundumfang_XIX_SAM.Geltungsbereich_E3_1_1_UNECE_Gen2.RP_IF_SPR_FS_Lordose_zurueck_XIX_Grundumfang_XIX_SAM.DE_SPR_FS_Lordose_zurueck, system-signal=SPR_FS_Lordose_zurueck
        communication-direction=IN, data-element=Druckpunktmassage_fuer_Fahrersitz_Lehnenmassage_SAM_XIX_DPMFSLM_XIX_SAM.Geltungsbereich_E3_1_1_UNECE_Gen2.RP_IF_SPR_FS_Massage_Dauer_XIX_Druckpunktmassage_fuer_Fahrersitz_Lehnenmassage_SAM_XIX_DPMFSLM_XIX_SAM.DE_SPR_FS_Massage_Dauer, system-signal=SPR_FS_Massage_Dauer
        communication-direction=IN, data-element=Grundumfang_XIX_SAM.Geltungsbereich_E3_1_1_UNECE_Gen2.RP_IF_SPR_FS_Massage_Int_XIX_Grundumfang_XIX_SAM.DE_SPR_FS_Massage_Int, system-signal=SPR_FS_Massage_Int
        communication-direction=IN, data-element=Druckpunktmassage_fuer_Fahrersitz_Lehnenmassage_SAM_XIX_DPMFSLM_XIX_SAM.Geltungsbereich_E3_1_1_UNECE_Gen2.RP_IF_SPR_FS_Massage_Intens_Lehne_XIX_Druckpunktmassage_fuer_Fahrersitz_Lehnenmassage_SAM_XIX_DPMFSLM_XIX_SAM.DE_SPR_FS_Massage_Intens_Lehne, system-signal=SPR_FS_Massage_Intens_Lehne
        communication-direction=IN, data-element=Druckpunktmassage_fuer_Fahrersitz_Lehnenmassage_SAM_XIX_DPMFSLM_XIX_SAM.Geltungsbereich_E3_1_1_UNECE_Gen2.RP_IF_SPR_FS_Massage_Intens_Sitz_XIX_Druckpunktmassage_fuer_Fahrersitz_Lehnenmassage_SAM_XIX_DPMFSLM_XIX_SAM.DE_SPR_FS_Massage_Intens_Sitz, system-signal=SPR_FS_Massage_Intens_Sitz
        communication-direction=IN, data-element=Grundumfang_XIX_SAM.Geltungsbereich_E3_1_1_UNECE_Gen2.RP_IF_SPR_FS_Massage_Prg_XIX_Grundumfang_XIX_SAM.DE_SPR_FS_Massage_Prg, system-signal=SPR_FS_Massage_Prg
        communication-direction=IN, data-element=Druckpunktmassage_fuer_Fahrersitz_Lehnenmassage_SAM_XIX_DPMFSLM_XIX_SAM.Geltungsbereich_E3_1_1_UNECE_Gen2.RP_IF_SPR_FS_Massage_Prg_erweitert_XIX_Druckpunktmassage_fuer_Fahrersitz_Lehnenmassage_SAM_XIX_DPMFSLM_XIX_SAM.DE_SPR_FS_Massage_Prg_erweitert, system-signal=SPR_FS_Massage_Prg_erweitert
        communication-direction=IN, data-element=Grundumfang_XIX_SAM.Geltungsbereich_E3_1_1_UNECE_Gen2.RP_IF_SPR_FS_MassageStatus_XIX_Grundumfang_XIX_SAM.DE_SPR_FS_MassageStatus, system-signal=SPR_FS_MassageStatus
        communication-direction=IN, data-element=Druckpunktmassage_fuer_Fahrersitz_Lehnenmassage_SAM_XIX_DPMFSLM_XIX_SAM.Geltungsbereich_E3_1_1_UNECE_Gen2.RP_IF_SPR_FS_Massagetaster_inv_XIX_Druckpunktmassage_fuer_Fahrersitz_Lehnenmassage_SAM_XIX_DPMFSLM_XIX_SAM.DE_SPR_FS_Massagetaster_inv, system-signal=SPR_FS_Massagetaster_inv
        communication-direction=IN, data-element=Grundumfang_XIX_SAM.Geltungsbereich_E3_1_1_UNECE_Gen2.RP_IF_SPR_FS_MuFu_Fkt_vor_XIX_Grundumfang_XIX_SAM.DE_SPR_FS_MuFu_Fkt_vor, system-signal=SPR_FS_MuFu_Fkt_vor
        communication-direction=IN, data-element=Grundumfang_XIX_SAM.Geltungsbereich_E3_1_1_UNECE_Gen2.RP_IF_SPR_FS_MuFu_Fkt_zurueck_XIX_Grundumfang_XIX_SAM.DE_SPR_FS_MuFu_Fkt_zurueck, system-signal=SPR_FS_MuFu_Fkt_zurueck
        communication-direction=IN, data-element=Grundumfang_XIX_SAM.Geltungsbereich_E3_1_1_UNECE_Gen2.RP_IF_SPR_FS_PopUp_Request_XIX_Grundumfang_XIX_SAM.DE_SPR_FS_PopUp_Request, system-signal=SPR_FS_PopUp_Request
        communication-direction=IN, data-element=Grundumfang_XIX_SAM.Geltungsbereich_E3_1_1_UNECE_Gen2.RP_IF_SPR_FS_ResponseError_XIX_Grundumfang_XIX_SAM.DE_SPR_FS_ResponseError, system-signal=SPR_FS_ResponseError
        communication-direction=IN, data-element=Grundumfang_XIX_SAM.Geltungsbereich_E3_1_1_UNECE_Gen2.RP_IF_SPR_FS_SG_defekt_XIX_Grundumfang_XIX_SAM.DE_SPR_FS_SG_defekt, system-signal=SPR_FS_SG_defekt
        communication-direction=IN, data-element=Grundumfang_XIX_SAM.Geltungsbereich_E3_1_1_UNECE_Gen2.RP_IF_SPR_FS_SWL_vor_XIX_Grundumfang_XIX_SAM.DE_SPR_FS_SWL_vor, system-signal=SPR_FS_SWL_vor
        communication-direction=IN, data-element=Grundumfang_XIX_SAM.Geltungsbereich_E3_1_1_UNECE_Gen2.RP_IF_SPR_FS_SWL_zurueck_XIX_Grundumfang_XIX_SAM.DE_SPR_FS_SWL_zurueck, system-signal=SPR_FS_SWL_zurueck
        communication-direction=IN, data-element=Grundumfang_XIX_SAM.Geltungsbereich_E3_1_1_UNECE_Gen2.RP_IF_SPR_FS_Systemtest_Status_XIX_Grundumfang_XIX_SAM.DE_SPR_FS_Systemtest_Status, system-signal=SPR_FS_Systemtest_Status
        communication-direction=IN, data-element=Grundumfang_XIX_SAM.Geltungsbereich_E3_1_1_UNECE_Gen2.RP_IF_SPR_FS_Tasterfehler_Massage_XIX_Grundumfang_XIX_SAM.DE_SPR_FS_Tasterfehler_Massage, system-signal=SPR_FS_Tasterfehler_Massage
        communication-direction=IN, data-element=Grundumfang_XIX_SAM.Geltungsbereich_E3_1_1_UNECE_Gen2.RP_IF_SPR_FS_Tasterfehler_Mufu_auf_ab_XIX_Grundumfang_XIX_SAM.DE_SPR_FS_Tasterfehler_Mufu_auf_ab, system-signal=SPR_FS_Tasterfehler_Mufu_auf_ab
        communication-direction=IN, data-element=Grundumfang_XIX_SAM.Geltungsbereich_E3_1_1_UNECE_Gen2.RP_IF_SPR_FS_Tasterfehler_Mufu_Ring_XIX_Grundumfang_XIX_SAM.DE_SPR_FS_Tasterfehler_Mufu_Ring, system-signal=SPR_FS_Tasterfehler_Mufu_Ring
        communication-direction=IN, data-element=Grundumfang_XIX_SAM.Geltungsbereich_E3_1_1_UNECE_Gen2.RP_IF_SPR_FS_Tasterfehler_Mufu_v_z_XIX_Grundumfang_XIX_SAM.DE_SPR_FS_Tasterfehler_Mufu_v_z, system-signal=SPR_FS_Tasterfehler_Mufu_v_z
        communication-direction=IN, data-element=Druckpunktmassage_fuer_Fahrersitz_Lehnenmassage_SAM_XIX_DPMFSLM_XIX_SAM.Geltungsbereich_E3_1_1_UNECE_Gen2.RP_IF_SPR_FS_Teller_inv_XIX_Druckpunktmassage_fuer_Fahrersitz_Lehnenmassage_SAM_XIX_DPMFSLM_XIX_SAM.DE_SPR_FS_Teller_inv, system-signal=SPR_FS_Teller_inv
        communication-direction=IN, data-element=Grundumfang_XIX_SAM.Geltungsbereich_E3_1_1_UNECE_Gen2.RP_IF_SPR_FS_Ueberspannung_XIX_Grundumfang_XIX_SAM.DE_SPR_FS_Ueberspannung, system-signal=SPR_FS_Ueberspannung
        communication-direction=IN, data-element=Grundumfang_XIX_SAM.Geltungsbereich_E3_1_1_UNECE_Gen2.RP_IF_SPR_FS_Unterspannung_XIX_Grundumfang_XIX_SAM.DE_SPR_FS_Unterspannung, system-signal=SPR_FS_Unterspannung
        communication-direction=IN, data-element=Druckpunktmassage_fuer_Fahrersitz_Lehnenmassage_SAM_XIX_DPMFSLM_XIX_SAM.Geltungsbereich_E3_1_1_UNECE_Gen2.RP_IF_SPR_FS_Verstellung_aktiv_XIX_Druckpunktmassage_fuer_Fahrersitz_Lehnenmassage_SAM_XIX_DPMFSLM_XIX_SAM.DE_SPR_FS_Verstellung_aktiv, system-signal=SPR_FS_Verstellung_aktiv
        communication-direction=IN, data-element=Grundumfang_XIX_SAM.Geltungsbereich_E3_1_1_UNECE_Gen2.RP_IF_SPR_FS_Verstellung_aktiv_XIX_Grundumfang_XIX_SAM.DE_SPR_FS_Verstellung_aktiv, system-signal=SPR_FS_Verstellung_aktiv
        communication-direction=IN, data-element=Druckpunktmassage_fuer_Fahrersitz_Lehnenmassage_SAM_XIX_DPMFSLM_XIX_SAM.Geltungsbereich_E3_1_1_UNECE_Gen2.RP_IF_SPR_FS_Wellness_Status_XIX_Druckpunktmassage_fuer_Fahrersitz_Lehnenmassage_SAM_XIX_DPMFSLM_XIX_SAM.DE_SPR_FS_Wellness_Status, system-signal=SPR_FS_Wellness_Status
        communication-direction=IN, data-element=Druckpunktmassage_fuer_Fahrersitz_Lehnenmassage_SAM_XIX_DPMFSLM_XIX_SAM.Geltungsbereich_E3_1_1_UNECE_Gen2.RP_IF_SPR_FS_Wippe_inv_XIX_Druckpunktmassage_fuer_Fahrersitz_Lehnenmassage_SAM_XIX_DPMFSLM_XIX_SAM.DE_SPR_FS_Wippe_inv, system-signal=SPR_FS_Wippe_inv
        communication-direction=OUT, data-element=Grundumfang_XIX_SAM.Geltungsbereich_E3_1_1_UNECE_Gen2.SP_IF_SRA_Sequenz_Status_XIX_Grundumfang_XIX_SAM.DE_SRA_Sequenz_Status, system-signal=SRA_Sequenz_Status
        communication-direction=IN, data-element=Grundumfang_XIX_SAM.Geltungsbereich_E3_1_1_UNECE_Gen2.RP_IF_SRL1_ORUData_XIX_Grundumfang_XIX_SAM.DE_SRL1_ORUData, system-signal=SRL1_ORUData
        communication-direction=IN, data-element=Grundumfang_XIX_SAM.Geltungsbereich_E3_1_1_UNECE_Gen2.RP_IF_SRL1_ORUDataIndex_XIX_Grundumfang_XIX_SAM.DE_SRL1_ORUDataIndex, system-signal=SRL1_ORUDataIndex
        communication-direction=IN, data-element=Grundumfang_XIX_SAM.Geltungsbereich_E3_1_1_UNECE_Gen2.RP_IF_SRL2_ORUData_XIX_Grundumfang_XIX_SAM.DE_SRL2_ORUData, system-signal=SRL2_ORUData
        communication-direction=IN, data-element=Grundumfang_XIX_SAM.Geltungsbereich_E3_1_1_UNECE_Gen2.RP_IF_SRL2_ORUDataIndex_XIX_Grundumfang_XIX_SAM.DE_SRL2_ORUDataIndex, system-signal=SRL2_ORUDataIndex
        communication-direction=IN, data-element=Grundumfang_XIX_SAM.Geltungsbereich_E3_1_1_UNECE_Gen2.RP_IF_SRL3_ORUData_XIX_Grundumfang_XIX_SAM.DE_SRL3_ORUData, system-signal=SRL3_ORUData
        communication-direction=IN, data-element=Grundumfang_XIX_SAM.Geltungsbereich_E3_1_1_UNECE_Gen2.RP_IF_SRL3_ORUDataIndex_XIX_Grundumfang_XIX_SAM.DE_SRL3_ORUDataIndex, system-signal=SRL3_ORUDataIndex
        communication-direction=IN, data-element=Grundumfang_XIX_SAM.Geltungsbereich_E3_1_1_UNECE_Gen2.RP_IF_SRL4_ORUData_XIX_Grundumfang_XIX_SAM.DE_SRL4_ORUData, system-signal=SRL4_ORUData
        communication-direction=IN, data-element=Grundumfang_XIX_SAM.Geltungsbereich_E3_1_1_UNECE_Gen2.RP_IF_SRL4_ORUDataIndex_XIX_Grundumfang_XIX_SAM.DE_SRL4_ORUDataIndex, system-signal=SRL4_ORUDataIndex
        communication-direction=IN, data-element=Grundumfang_XIX_SAM.Geltungsbereich_E3_1_1_UNECE_Gen2.RP_IF_SRL5_ORUData_XIX_Grundumfang_XIX_SAM.DE_SRL5_ORUData, system-signal=SRL5_ORUData
        communication-direction=IN, data-element=Grundumfang_XIX_SAM.Geltungsbereich_E3_1_1_UNECE_Gen2.RP_IF_SRL5_ORUDataIndex_XIX_Grundumfang_XIX_SAM.DE_SRL5_ORUDataIndex, system-signal=SRL5_ORUDataIndex
        communication-direction=IN, data-element=Grundumfang_XIX_SAM.Geltungsbereich_E3_1_1_UNECE_Gen2.RP_IF_SRL6_ORUData_XIX_Grundumfang_XIX_SAM.DE_SRL6_ORUData, system-signal=SRL6_ORUData
        communication-direction=IN, data-element=Grundumfang_XIX_SAM.Geltungsbereich_E3_1_1_UNECE_Gen2.RP_IF_SRL6_ORUDataIndex_XIX_Grundumfang_XIX_SAM.DE_SRL6_ORUDataIndex, system-signal=SRL6_ORUDataIndex
        communication-direction=IN, data-element=Grundumfang_XIX_SAM.Geltungsbereich_E3_1_1_UNECE_Gen2.RP_IF_SRL_HL_01_BZ_XIX_Grundumfang_XIX_SAM.DE_SRL_HL_01_BZ, system-signal=SRL_HL_01_BZ
        communication-direction=IN, data-element=Grundumfang_XIX_SAM.Geltungsbereich_E3_1_1_UNECE_Gen2.RP_IF_SRL_HL_01_CRC_XIX_Grundumfang_XIX_SAM.DE_SRL_HL_01_CRC, system-signal=SRL_HL_01_CRC
        communication-direction=IN, data-element=Grundumfang_XIX_SAM.Geltungsbereich_E3_1_1_UNECE_Gen2.RP_IF_SRL_HR_01_BZ_XIX_Grundumfang_XIX_SAM.DE_SRL_HR_01_BZ, system-signal=SRL_HR_01_BZ
        communication-direction=IN, data-element=Grundumfang_XIX_SAM.Geltungsbereich_E3_1_1_UNECE_Gen2.RP_IF_SRL_HR_01_CRC_XIX_Grundumfang_XIX_SAM.DE_SRL_HR_01_CRC, system-signal=SRL_HR_01_CRC
        communication-direction=IN, data-element=Grundumfang_XIX_SAM.Geltungsbereich_E3_1_1_UNECE_Gen2.RP_IF_SRL_SL_01_BZ_XIX_Grundumfang_XIX_SAM.DE_SRL_SL_01_BZ, system-signal=SRL_SL_01_BZ
        communication-direction=IN, data-element=Grundumfang_XIX_SAM.Geltungsbereich_E3_1_1_UNECE_Gen2.RP_IF_SRL_SL_01_CRC_XIX_Grundumfang_XIX_SAM.DE_SRL_SL_01_CRC, system-signal=SRL_SL_01_CRC
        communication-direction=IN, data-element=Grundumfang_XIX_SAM.Geltungsbereich_E3_1_1_UNECE_Gen2.RP_IF_SRL_SR_01_BZ_XIX_Grundumfang_XIX_SAM.DE_SRL_SR_01_BZ, system-signal=SRL_SR_01_BZ
        communication-direction=IN, data-element=Grundumfang_XIX_SAM.Geltungsbereich_E3_1_1_UNECE_Gen2.RP_IF_SRL_SR_01_CRC_XIX_Grundumfang_XIX_SAM.DE_SRL_SR_01_CRC, system-signal=SRL_SR_01_CRC
        communication-direction=IN, data-element=Grundumfang_XIX_SAM.Geltungsbereich_E3_1_1_UNECE_Gen2.RP_IF_SRL_VL_01_BZ_XIX_Grundumfang_XIX_SAM.DE_SRL_VL_01_BZ, system-signal=SRL_VL_01_BZ
        communication-direction=IN, data-element=Grundumfang_XIX_SAM.Geltungsbereich_E3_1_1_UNECE_Gen2.RP_IF_SRL_VL_01_CRC_XIX_Grundumfang_XIX_SAM.DE_SRL_VL_01_CRC, system-signal=SRL_VL_01_CRC
        communication-direction=IN, data-element=Grundumfang_XIX_SAM.Geltungsbereich_E3_1_1_UNECE_Gen2.RP_IF_SRL_VR_01_BZ_XIX_Grundumfang_XIX_SAM.DE_SRL_VR_01_BZ, system-signal=SRL_VR_01_BZ
        communication-direction=IN, data-element=Grundumfang_XIX_SAM.Geltungsbereich_E3_1_1_UNECE_Gen2.RP_IF_SRL_VR_01_CRC_XIX_Grundumfang_XIX_SAM.DE_SRL_VR_01_CRC, system-signal=SRL_VR_01_CRC
        communication-direction=OUT, data-element=Grundumfang_XIX_SAM.Geltungsbereich_E3_1_1_UNECE_Gen2.SP_IF_Stellgliedtest_LRH_XIX_Grundumfang_XIX_SAM.DE_Stellgliedtest_LRH, system-signal=Stellgliedtest_LRH
        communication-direction=IN, data-element=Grundumfang_XIX_SAM.Geltungsbereich_E3_1_1_UNECE_Gen2.RP_IF_STSG_HBFS_AD_oeffnen_Anf_XIX_Grundumfang_XIX_SAM.DE_STSG_HBFS_AD_oeffnen_Anf, system-signal=STSG_HBFS_AD_oeffnen_Anf
        communication-direction=IN, data-element=Grundumfang_XIX_SAM.Geltungsbereich_E3_1_1_UNECE_Gen2.RP_IF_STSG_HBFS_Bew_auf_XIX_Grundumfang_XIX_SAM.DE_STSG_HBFS_Bew_auf, system-signal=STSG_HBFS_Bew_auf
        communication-direction=IN, data-element=Grundumfang_XIX_SAM.Geltungsbereich_E3_1_1_UNECE_Gen2.RP_IF_STSG_HBFS_Bew_zu_XIX_Grundumfang_XIX_SAM.DE_STSG_HBFS_Bew_zu, system-signal=STSG_HBFS_Bew_zu
        communication-direction=IN, data-element=ZV_XIX_SAM.Geltungsbereich_E3_1_1_UNECE_Gen2.RP_IF_STSG_HBFS_BTF_XIX_ZV_XIX_SAM.DE_STSG_HBFS_BTF, system-signal=STSG_HBFS_BTF
        communication-direction=IN, data-element=ZV_XIX_SAM.Geltungsbereich_E3_1_1_UNECE_Gen2.RP_IF_STSG_HBFS_entriegeln_anfordern_XIX_ZV_XIX_SAM.DE_STSG_HBFS_entriegeln_anfordern, system-signal=STSG_HBFS_entriegeln_anfordern
        communication-direction=IN, data-element=Grundumfang_XIX_SAM.Geltungsbereich_E3_1_1_UNECE_Gen2.RP_IF_STSG_HBFS_LKKS_Bereich_XIX_Grundumfang_XIX_SAM.DE_STSG_HBFS_LKKS_Bereich, system-signal=STSG_HBFS_LKKS_Bereich
        communication-direction=IN, data-element=Grundumfang_XIX_SAM.Geltungsbereich_E3_1_1_UNECE_Gen2.RP_IF_STSG_HBFS_ORUData_XIX_Grundumfang_XIX_SAM.DE_STSG_HBFS_ORUData, system-signal=STSG_HBFS_ORUData
        communication-direction=IN, data-element=Grundumfang_XIX_SAM.Geltungsbereich_E3_1_1_UNECE_Gen2.RP_IF_STSG_HBFS_ORUDataIndex_XIX_Grundumfang_XIX_SAM.DE_STSG_HBFS_ORUDataIndex, system-signal=STSG_HBFS_ORUDataIndex
        communication-direction=IN, data-element=Grundumfang_XIX_SAM.Geltungsbereich_E3_1_1_UNECE_Gen2.RP_IF_STSG_HBFS_ST_deaktivieren_XIX_Grundumfang_XIX_SAM.DE_STSG_HBFS_ST_deaktivieren, system-signal=STSG_HBFS_ST_deaktivieren
        communication-direction=IN, data-element=ZV_XIX_SAM.Geltungsbereich_E3_1_1_UNECE_Gen2.RP_IF_STSG_HBFS_TAT_XIX_ZV_XIX_SAM.DE_STSG_HBFS_TAT, system-signal=STSG_HBFS_TAT
        communication-direction=IN, data-element=Grundumfang_XIX_SAM.Geltungsbereich_E3_1_1_UNECE_Gen2.RP_IF_STSG_HFS_AD_oeffnen_Anf_XIX_Grundumfang_XIX_SAM.DE_STSG_HFS_AD_oeffnen_Anf, system-signal=STSG_HFS_AD_oeffnen_Anf
        communication-direction=IN, data-element=Grundumfang_XIX_SAM.Geltungsbereich_E3_1_1_UNECE_Gen2.RP_IF_STSG_HFS_Bew_auf_XIX_Grundumfang_XIX_SAM.DE_STSG_HFS_Bew_auf, system-signal=STSG_HFS_Bew_auf
        communication-direction=IN, data-element=Grundumfang_XIX_SAM.Geltungsbereich_E3_1_1_UNECE_Gen2.RP_IF_STSG_HFS_Bew_zu_XIX_Grundumfang_XIX_SAM.DE_STSG_HFS_Bew_zu, system-signal=STSG_HFS_Bew_zu
        communication-direction=IN, data-element=ZV_XIX_SAM.Geltungsbereich_E3_1_1_UNECE_Gen2.RP_IF_STSG_HFS_BTF_XIX_ZV_XIX_SAM.DE_STSG_HFS_BTF, system-signal=STSG_HFS_BTF
        communication-direction=IN, data-element=ZV_XIX_SAM.Geltungsbereich_E3_1_1_UNECE_Gen2.RP_IF_STSG_HFS_entriegeln_anforderen_XIX_ZV_XIX_SAM.DE_STSG_HFS_entriegeln_anforderen, system-signal=STSG_HFS_entriegeln_anforderen
        communication-direction=IN, data-element=Grundumfang_XIX_SAM.Geltungsbereich_E3_1_1_UNECE_Gen2.RP_IF_STSG_HFS_LKKS_Bereich_XIX_Grundumfang_XIX_SAM.DE_STSG_HFS_LKKS_Bereich, system-signal=STSG_HFS_LKKS_Bereich
        communication-direction=IN, data-element=Grundumfang_XIX_SAM.Geltungsbereich_E3_1_1_UNECE_Gen2.RP_IF_STSG_HFS_ORUData_XIX_Grundumfang_XIX_SAM.DE_STSG_HFS_ORUData, system-signal=STSG_HFS_ORUData
        communication-direction=IN, data-element=Grundumfang_XIX_SAM.Geltungsbereich_E3_1_1_UNECE_Gen2.RP_IF_STSG_HFS_ORUDataIndex_XIX_Grundumfang_XIX_SAM.DE_STSG_HFS_ORUDataIndex, system-signal=STSG_HFS_ORUDataIndex
        communication-direction=IN, data-element=Grundumfang_XIX_SAM.Geltungsbereich_E3_1_1_UNECE_Gen2.RP_IF_STSG_HFS_ST_deaktivieren_XIX_Grundumfang_XIX_SAM.DE_STSG_HFS_ST_deaktivieren, system-signal=STSG_HFS_ST_deaktivieren
        communication-direction=IN, data-element=ZV_XIX_SAM.Geltungsbereich_E3_1_1_UNECE_Gen2.RP_IF_STSG_HFS_TAT_XIX_ZV_XIX_SAM.DE_STSG_HFS_TAT, system-signal=STSG_HFS_TAT
        communication-direction=IN, data-element=Grundumfang_XIX_SAM.Geltungsbereich_E3_1_1_UNECE_Gen2.RP_IF_TSG_BFS_ORUData_XIX_Grundumfang_XIX_SAM.DE_TSG_BFS_ORUData, system-signal=TSG_BFS_ORUData
        communication-direction=IN, data-element=Grundumfang_XIX_SAM.Geltungsbereich_E3_1_1_UNECE_Gen2.RP_IF_TSG_BFS_ORUDataIndex_XIX_Grundumfang_XIX_SAM.DE_TSG_BFS_ORUDataIndex, system-signal=TSG_BFS_ORUDataIndex
        communication-direction=OUT, data-element=Grundumfang_XIX_SAM.Geltungsbereich_E3_1_1_UNECE_Gen2.SP_IF_TSG_FHe01_void1_XIX_Grundumfang_XIX_SAM.DE_TSG_FHe01_void1, system-signal=TSG_FHe01_void1
        communication-direction=OUT, data-element=Grundumfang_XIX_SAM.Geltungsbereich_E3_1_1_UNECE_Gen2.SP_IF_TSG_FHSG_MST_Jahr_k_XIX_Grundumfang_XIX_SAM.DE_TSG_FHSG_MST_Jahr_k, system-signal=TSG_FHSG_MST_Jahr_k
        communication-direction=OUT, data-element=Grundumfang_XIX_SAM.Geltungsbereich_E3_1_1_UNECE_Gen2.SP_IF_TSG_FHSG_MST_KM_Stand_1_XIX_Grundumfang_XIX_SAM.DE_TSG_FHSG_MST_KM_Stand_1, system-signal=TSG_FHSG_MST_KM_Stand_1
        communication-direction=OUT, data-element=Grundumfang_XIX_SAM.Geltungsbereich_E3_1_1_UNECE_Gen2.SP_IF_TSG_FHSG_MST_KM_Stand_2_XIX_Grundumfang_XIX_SAM.DE_TSG_FHSG_MST_KM_Stand_2, system-signal=TSG_FHSG_MST_KM_Stand_2
        communication-direction=OUT, data-element=Grundumfang_XIX_SAM.Geltungsbereich_E3_1_1_UNECE_Gen2.SP_IF_TSG_FHSG_MST_Minute_k_XIX_Grundumfang_XIX_SAM.DE_TSG_FHSG_MST_Minute_k, system-signal=TSG_FHSG_MST_Minute_k
        communication-direction=OUT, data-element=Grundumfang_XIX_SAM.Geltungsbereich_E3_1_1_UNECE_Gen2.SP_IF_TSG_FHSG_MST_Monat_k_XIX_Grundumfang_XIX_SAM.DE_TSG_FHSG_MST_Monat_k, system-signal=TSG_FHSG_MST_Monat_k
        communication-direction=OUT, data-element=Grundumfang_XIX_SAM.Geltungsbereich_E3_1_1_UNECE_Gen2.SP_IF_TSG_FHSG_MST_Sekunde_k_XIX_Grundumfang_XIX_SAM.DE_TSG_FHSG_MST_Sekunde_k, system-signal=TSG_FHSG_MST_Sekunde_k
        communication-direction=OUT, data-element=Grundumfang_XIX_SAM.Geltungsbereich_E3_1_1_UNECE_Gen2.SP_IF_TSG_FHSG_MST_Stunde_k_XIX_Grundumfang_XIX_SAM.DE_TSG_FHSG_MST_Stunde_k, system-signal=TSG_FHSG_MST_Stunde_k
        communication-direction=OUT, data-element=Grundumfang_XIX_SAM.Geltungsbereich_E3_1_1_UNECE_Gen2.SP_IF_TSG_FHSG_MST_Tag_k_XIX_Grundumfang_XIX_SAM.DE_TSG_FHSG_MST_Tag_k, system-signal=TSG_FHSG_MST_Tag_k
        communication-direction=OUT, data-element=Grundumfang_XIX_SAM.Geltungsbereich_E3_1_1_UNECE_Gen2.SP_IF_TSG_FHSG_MST_Time_Indication_Bit_XIX_Grundumfang_XIX_SAM.DE_TSG_FHSG_MST_Time_Indication_Bit, system-signal=TSG_FHSG_MST_Time_Indication_Bit
        communication-direction=OUT, data-element=Grundumfang_XIX_SAM.Geltungsbereich_E3_1_1_UNECE_Gen2.SP_IF_TSG_FHSG_MST_TSG_Seite_XIX_Grundumfang_XIX_SAM.DE_TSG_FHSG_MST_TSG_Seite, system-signal=TSG_FHSG_MST_TSG_Seite
        communication-direction=OUT, data-element=Grundumfang_XIX_SAM.Geltungsbereich_E3_1_1_UNECE_Gen2.SP_IF_TSG_FHSG_MST_Verlernzaehler_k_XIX_Grundumfang_XIX_SAM.DE_TSG_FHSG_MST_Verlernzaehler_k, system-signal=TSG_FHSG_MST_Verlernzaehler_k
        communication-direction=OUT, data-element=Grundumfang_XIX_SAM.Geltungsbereich_E3_1_1_UNECE_Gen2.SP_IF_TSG_FHSG_void_1_XIX_Grundumfang_XIX_SAM.DE_TSG_FHSG_void_1, system-signal=TSG_FHSG_void_1
        communication-direction=OUT, data-element=Grundumfang_XIX_SAM.Geltungsbereich_E3_1_1_UNECE_Gen2.SP_IF_TSG_FHSG_void_7_XIX_Grundumfang_XIX_SAM.DE_TSG_FHSG_void_7, system-signal=TSG_FHSG_void_7
        communication-direction=IN, data-element=Grundumfang_XIX_SAM.Geltungsbereich_E3_1_1_UNECE_Gen2.RP_IF_TSG_FS_ORUData_XIX_Grundumfang_XIX_SAM.DE_TSG_FS_ORUData, system-signal=TSG_FS_ORUData
        communication-direction=IN, data-element=Grundumfang_XIX_SAM.Geltungsbereich_E3_1_1_UNECE_Gen2.RP_IF_TSG_FS_ORUDataIndex_XIX_Grundumfang_XIX_SAM.DE_TSG_FS_ORUDataIndex, system-signal=TSG_FS_ORUDataIndex
        communication-direction=IN, data-element=ZV_XIX_SAM.Geltungsbereich_E3_1_1_UNECE_Gen2.RP_IF_TSG_FT_02_BZ_XIX_ZV_XIX_SAM.DE_TSG_FT_02_BZ, system-signal=TSG_FT_02_BZ
        communication-direction=IN, data-element=ZV_XIX_SAM.Geltungsbereich_E3_1_1_UNECE_Gen2.RP_IF_TSG_FT_02_CRC_XIX_ZV_XIX_SAM.DE_TSG_FT_02_CRC, system-signal=TSG_FT_02_CRC
        communication-direction=OUT, data-element=Grundumfang_XIX_SAM.Geltungsbereich_E3_1_1_UNECE_Gen2.SP_IF_TSG_HBFS_02_BZ_XIX_Grundumfang_XIX_SAM.DE_TSG_HBFS_02_BZ, system-signal=TSG_HBFS_02_BZ
        communication-direction=OUT, data-element=Grundumfang_XIX_SAM.Geltungsbereich_E3_1_1_UNECE_Gen2.SP_IF_TSG_HBFS_02_CRC_XIX_Grundumfang_XIX_SAM.DE_TSG_HBFS_02_CRC, system-signal=TSG_HBFS_02_CRC
        communication-direction=IN, data-element=Grundumfang_XIX_SAM.Geltungsbereich_E3_1_1_UNECE_Gen2.RP_IF_TSG_HBFS_ORUData_XIX_Grundumfang_XIX_SAM.DE_TSG_HBFS_ORUData, system-signal=TSG_HBFS_ORUData
        communication-direction=IN, data-element=Grundumfang_XIX_SAM.Geltungsbereich_E3_1_1_UNECE_Gen2.RP_IF_TSG_HBFS_ORUDataIndex_XIX_Grundumfang_XIX_SAM.DE_TSG_HBFS_ORUDataIndex, system-signal=TSG_HBFS_ORUDataIndex
        communication-direction=OUT, data-element=Grundumfang_XIX_SAM.Geltungsbereich_E3_1_1_UNECE_Gen2.SP_IF_TSG_HFS_02_BZ_XIX_Grundumfang_XIX_SAM.DE_TSG_HFS_02_BZ, system-signal=TSG_HFS_02_BZ
        communication-direction=OUT, data-element=Grundumfang_XIX_SAM.Geltungsbereich_E3_1_1_UNECE_Gen2.SP_IF_TSG_HFS_02_CRC_XIX_Grundumfang_XIX_SAM.DE_TSG_HFS_02_CRC, system-signal=TSG_HFS_02_CRC
        communication-direction=IN, data-element=Grundumfang_XIX_SAM.Geltungsbereich_E3_1_1_UNECE_Gen2.RP_IF_TSG_HFS_ORUData_XIX_Grundumfang_XIX_SAM.DE_TSG_HFS_ORUData, system-signal=TSG_HFS_ORUData
        communication-direction=IN, data-element=Grundumfang_XIX_SAM.Geltungsbereich_E3_1_1_UNECE_Gen2.RP_IF_TSG_HFS_ORUDataIndex_XIX_Grundumfang_XIX_SAM.DE_TSG_HFS_ORUDataIndex, system-signal=TSG_HFS_ORUDataIndex
        communication-direction=OUT, data-element=Grundumfang_XIX_SAM.Geltungsbereich_E3_1_1_UNECE_Gen2.SP_IF_Tuerkontakt_Innenlicht_Status_XIX_Grundumfang_XIX_SAM.DE_Tuerkontakt_Innenlicht_Status, system-signal=Tuerkontakt_Innenlicht_Status
        communication-direction=OUT, data-element=SC_708_IuALicht_MEB_XIX_Softwareblock_XIX_SAM.Geltungsbereich_E3_1_1_UNECE_Gen2.SP_IF_Tuerkontakt_Innenlicht_Status_XIX_SC_708_IuALicht_MEB_XIX_Softwareblock_XIX_SAM.DE_Tuerkontakt_Innenlicht_Status, system-signal=Tuerkontakt_Innenlicht_Status
        communication-direction=IN, data-element=Grundumfang_XIX_SAM.Geltungsbereich_E3_1_1_UNECE_Gen2.RP_IF_Tuerkontakt_Innenlicht_Taste_XIX_Grundumfang_XIX_SAM.DE_Tuerkontakt_Innenlicht_Taste, system-signal=Tuerkontakt_Innenlicht_Taste
        communication-direction=OUT, data-element=Grundumfang_XIX_SAM.Geltungsbereich_E3_1_1_UNECE_Gen2.SP_IF_UGDO_Buttons_XIX_Grundumfang_XIX_SAM.DE_UGDO_Buttons, system-signal=UGDO_Buttons
        communication-direction=IN, data-element=Grundumfang_XIX_SAM.Geltungsbereich_E3_1_1_UNECE_Gen2.RP_IF_UGDO_Failure_Antenne_XIX_Grundumfang_XIX_SAM.DE_UGDO_Failure_Antenne, system-signal=UGDO_Failure_Antenne
        communication-direction=IN, data-element=Grundumfang_XIX_SAM.Geltungsbereich_E3_1_1_UNECE_Gen2.RP_IF_UGDO_Failure_Codierung_XIX_Grundumfang_XIX_SAM.DE_UGDO_Failure_Codierung, system-signal=UGDO_Failure_Codierung
        communication-direction=IN, data-element=Grundumfang_XIX_SAM.Geltungsbereich_E3_1_1_UNECE_Gen2.RP_IF_UGDO_Failure_Hardware_XIX_Grundumfang_XIX_SAM.DE_UGDO_Failure_Hardware, system-signal=UGDO_Failure_Hardware
        communication-direction=IN, data-element=Grundumfang_XIX_SAM.Geltungsbereich_E3_1_1_UNECE_Gen2.RP_IF_UGDO_Function_01_XIX_Grundumfang_XIX_SAM.DE_UGDO_Function_01, system-signal=UGDO_Function_01
        communication-direction=IN, data-element=Grundumfang_XIX_SAM.Geltungsbereich_E3_1_1_UNECE_Gen2.RP_IF_UGDO_LED_Code_01_XIX_Grundumfang_XIX_SAM.DE_UGDO_LED_Code_01, system-signal=UGDO_LED_Code_01
        communication-direction=IN, data-element=Grundumfang_XIX_SAM.Geltungsbereich_E3_1_1_UNECE_Gen2.RP_IF_UGDO_ResponseError_XIX_Grundumfang_XIX_SAM.DE_UGDO_ResponseError, system-signal=UGDO_ResponseError
        communication-direction=OUT, data-element=Grundumfang_XIX_SAM.Geltungsbereich_E3_1_1_UNECE_Gen2.SP_IF_UGDO_Switchboard_XIX_Grundumfang_XIX_SAM.DE_UGDO_Switchboard, system-signal=UGDO_Switchboard
        communication-direction=IN, data-element=Grundumfang_XIX_SAM.Geltungsbereich_E3_1_1_UNECE_Gen2.RP_IF_UH_Jahr_XIX_Grundumfang_XIX_SAM.DE_UH_Jahr, system-signal=UH_Jahr
        communication-direction=IN, data-element=Grundumfang_XIX_SAM.Geltungsbereich_E3_1_1_UNECE_Gen2.RP_IF_UH_Minute_XIX_Grundumfang_XIX_SAM.DE_UH_Minute, system-signal=UH_Minute
        communication-direction=IN, data-element=Grundumfang_XIX_SAM.Geltungsbereich_E3_1_1_UNECE_Gen2.RP_IF_UH_Monat_XIX_Grundumfang_XIX_SAM.DE_UH_Monat, system-signal=UH_Monat
        communication-direction=IN, data-element=Grundumfang_XIX_SAM.Geltungsbereich_E3_1_1_UNECE_Gen2.RP_IF_UH_Sekunde_XIX_Grundumfang_XIX_SAM.DE_UH_Sekunde, system-signal=UH_Sekunde
        communication-direction=IN, data-element=Grundumfang_XIX_SAM.Geltungsbereich_E3_1_1_UNECE_Gen2.RP_IF_UH_Stunde_XIX_Grundumfang_XIX_SAM.DE_UH_Stunde, system-signal=UH_Stunde
        communication-direction=IN, data-element=Grundumfang_XIX_SAM.Geltungsbereich_E3_1_1_UNECE_Gen2.RP_IF_UH_Tag_XIX_Grundumfang_XIX_SAM.DE_UH_Tag, system-signal=UH_Tag
        communication-direction=IN, data-element=Grundumfang_XIX_SAM.Geltungsbereich_E3_1_1_UNECE_Gen2.RP_IF_UHF_01_Data_XIX_Grundumfang_XIX_SAM.DE_UHF_01_Data, system-signal=UHF_01_Data
        communication-direction=IN, data-element=Grundumfang_XIX_SAM.Geltungsbereich_E3_1_1_UNECE_Gen2.RP_IF_UHF_01_Datenlaenge_XIX_Grundumfang_XIX_SAM.DE_UHF_01_Datenlaenge, system-signal=UHF_01_Datenlaenge
        communication-direction=IN, data-element=Grundumfang_XIX_SAM.Geltungsbereich_E3_1_1_UNECE_Gen2.RP_IF_UHF_01_Status_XIX_Grundumfang_XIX_SAM.DE_UHF_01_Status, system-signal=UHF_01_Status
        communication-direction=IN, data-element=Grundumfang_XIX_SAM.Geltungsbereich_E3_1_1_UNECE_Gen2.RP_IF_UHF_01_Typ_XIX_Grundumfang_XIX_SAM.DE_UHF_01_Typ, system-signal=UHF_01_Typ
        communication-direction=IN, data-element=Grundumfang_XIX_SAM.Geltungsbereich_E3_1_1_UNECE_Gen2.RP_IF_UHF_01_Zaehler_XIX_Grundumfang_XIX_SAM.DE_UHF_01_Zaehler, system-signal=UHF_01_Zaehler
        communication-direction=IN, data-element=Grundumfang_XIX_SAM.Geltungsbereich_E3_1_1_UNECE_Gen2.RP_IF_UHF_02_Data_XIX_Grundumfang_XIX_SAM.DE_UHF_02_Data, system-signal=UHF_02_Data
        communication-direction=IN, data-element=Grundumfang_XIX_SAM.Geltungsbereich_E3_1_1_UNECE_Gen2.RP_IF_UHF_02_Zaehler_XIX_Grundumfang_XIX_SAM.DE_UHF_02_Zaehler, system-signal=UHF_02_Zaehler
        communication-direction=IN, data-element=Grundumfang_XIX_SAM.Geltungsbereich_E3_1_1_UNECE_Gen2.RP_IF_UHF_03_Data_XIX_Grundumfang_XIX_SAM.DE_UHF_03_Data, system-signal=UHF_03_Data
        communication-direction=IN, data-element=Grundumfang_XIX_SAM.Geltungsbereich_E3_1_1_UNECE_Gen2.RP_IF_UHF_03_Zaehler_XIX_Grundumfang_XIX_SAM.DE_UHF_03_Zaehler, system-signal=UHF_03_Zaehler
        communication-direction=IN, data-element=Grundumfang_XIX_SAM.Geltungsbereich_E3_1_1_UNECE_Gen2.RP_IF_UHF_04_Data_XIX_Grundumfang_XIX_SAM.DE_UHF_04_Data, system-signal=UHF_04_Data
        communication-direction=IN, data-element=Grundumfang_XIX_SAM.Geltungsbereich_E3_1_1_UNECE_Gen2.RP_IF_UHF_04_Zaehler_XIX_Grundumfang_XIX_SAM.DE_UHF_04_Zaehler, system-signal=UHF_04_Zaehler
        communication-direction=IN, data-element=Grundumfang_XIX_SAM.Geltungsbereich_E3_1_1_UNECE_Gen2.RP_IF_UHF_05_Data_XIX_Grundumfang_XIX_SAM.DE_UHF_05_Data, system-signal=UHF_05_Data
        communication-direction=IN, data-element=Grundumfang_XIX_SAM.Geltungsbereich_E3_1_1_UNECE_Gen2.RP_IF_UHF_05_Zaehler_XIX_Grundumfang_XIX_SAM.DE_UHF_05_Zaehler, system-signal=UHF_05_Zaehler
        communication-direction=IN, data-element=Grundumfang_XIX_SAM.Geltungsbereich_E3_1_1_UNECE_Gen2.RP_IF_UHF_06_Data_XIX_Grundumfang_XIX_SAM.DE_UHF_06_Data, system-signal=UHF_06_Data
        communication-direction=IN, data-element=Grundumfang_XIX_SAM.Geltungsbereich_E3_1_1_UNECE_Gen2.RP_IF_UHF_06_Zaehler_XIX_Grundumfang_XIX_SAM.DE_UHF_06_Zaehler, system-signal=UHF_06_Zaehler
        communication-direction=IN, data-element=Grundumfang_XIX_SAM.Geltungsbereich_E3_1_1_UNECE_Gen2.RP_IF_UHF_07_Data_XIX_Grundumfang_XIX_SAM.DE_UHF_07_Data, system-signal=UHF_07_Data
        communication-direction=IN, data-element=Grundumfang_XIX_SAM.Geltungsbereich_E3_1_1_UNECE_Gen2.RP_IF_UHF_07_Zaehler_XIX_Grundumfang_XIX_SAM.DE_UHF_07_Zaehler, system-signal=UHF_07_Zaehler
        communication-direction=IN, data-element=Grundumfang_XIX_SAM.Geltungsbereich_E3_1_1_UNECE_Gen2.RP_IF_UHF_08_Data_XIX_Grundumfang_XIX_SAM.DE_UHF_08_Data, system-signal=UHF_08_Data
        communication-direction=IN, data-element=Grundumfang_XIX_SAM.Geltungsbereich_E3_1_1_UNECE_Gen2.RP_IF_UHF_08_Zaehler_XIX_Grundumfang_XIX_SAM.DE_UHF_08_Zaehler, system-signal=UHF_08_Zaehler
        communication-direction=IN, data-element=Grundumfang_XIX_SAM.Geltungsbereich_E3_1_1_UNECE_Gen2.RP_IF_UHF_FFB_Funkschluesseltyp_XIX_Grundumfang_XIX_SAM.DE_UHF_FFB_Funkschluesseltyp, system-signal=UHF_FFB_Funkschluesseltyp
        communication-direction=IN, data-element=Grundumfang_XIX_SAM.Geltungsbereich_E3_1_1_UNECE_Gen2.RP_IF_UHF_FFB_SKC_anlernen_XIX_Grundumfang_XIX_SAM.DE_UHF_FFB_SKC_anlernen, system-signal=UHF_FFB_SKC_anlernen
        communication-direction=IN, data-element=Grundumfang_XIX_SAM.Geltungsbereich_E3_1_1_UNECE_Gen2.RP_IF_UHF_Konfig_Auswahl_Kanal_XIX_Grundumfang_XIX_SAM.DE_UHF_Konfig_Auswahl_Kanal, system-signal=UHF_Konfig_Auswahl_Kanal
        communication-direction=IN, data-element=Grundumfang_XIX_SAM.Geltungsbereich_E3_1_1_UNECE_Gen2.RP_IF_UHF_Konfig_Auswahl_Kessymodus_XIX_Grundumfang_XIX_SAM.DE_UHF_Konfig_Auswahl_Kessymodus, system-signal=UHF_Konfig_Auswahl_Kessymodus
        communication-direction=IN, data-element=Grundumfang_XIX_SAM.Geltungsbereich_E3_1_1_UNECE_Gen2.RP_IF_UHF_Konfig_Auswahl_naechst_Kanal_XIX_Grundumfang_XIX_SAM.DE_UHF_Konfig_Auswahl_naechst_Kanal, system-signal=UHF_Konfig_Auswahl_naechst_Kanal
        communication-direction=IN, data-element=Grundumfang_XIX_SAM.Geltungsbereich_E3_1_1_UNECE_Gen2.RP_IF_UHF_Konfig_FFB_Freigabe_XIX_Grundumfang_XIX_SAM.DE_UHF_Konfig_FFB_Freigabe, system-signal=UHF_Konfig_FFB_Freigabe
        communication-direction=IN, data-element=Grundumfang_XIX_SAM.Geltungsbereich_E3_1_1_UNECE_Gen2.RP_IF_UHF_Konfig_Kanal_Umschaltzeit_XIX_Grundumfang_XIX_SAM.DE_UHF_Konfig_Kanal_Umschaltzeit, system-signal=UHF_Konfig_Kanal_Umschaltzeit
        communication-direction=IN, data-element=Grundumfang_XIX_SAM.Geltungsbereich_E3_1_1_UNECE_Gen2.RP_IF_UHF_Konfig_Praeambellaenge_XIX_Grundumfang_XIX_SAM.DE_UHF_Konfig_Praeambellaenge, system-signal=UHF_Konfig_Praeambellaenge
        communication-direction=IN, data-element=Grundumfang_XIX_SAM.Geltungsbereich_E3_1_1_UNECE_Gen2.RP_IF_UHF_Konfig_Zaehler_XIX_Grundumfang_XIX_SAM.DE_UHF_Konfig_Zaehler, system-signal=UHF_Konfig_Zaehler
        communication-direction=OUT, data-element=Grundumfang_XIX_SAM.Geltungsbereich_E3_1_1_UNECE_Gen2.SP_IF_UHF_Sensor_01_Data_XIX_Grundumfang_XIX_SAM.DE_UHF_Sensor_01_Data, system-signal=UHF_Sensor_01_Data
        communication-direction=OUT, data-element=Grundumfang_XIX_SAM.Geltungsbereich_E3_1_1_UNECE_Gen2.SP_IF_UHF_Sensor_01_Datenlaenge_XIX_Grundumfang_XIX_SAM.DE_UHF_Sensor_01_Datenlaenge, system-signal=UHF_Sensor_01_Datenlaenge
        communication-direction=OUT, data-element=Grundumfang_XIX_SAM.Geltungsbereich_E3_1_1_UNECE_Gen2.SP_IF_UHF_Sensor_01_Status_XIX_Grundumfang_XIX_SAM.DE_UHF_Sensor_01_Status, system-signal=UHF_Sensor_01_Status
        communication-direction=OUT, data-element=Grundumfang_XIX_SAM.Geltungsbereich_E3_1_1_UNECE_Gen2.SP_IF_UHF_Sensor_01_Typ_XIX_Grundumfang_XIX_SAM.DE_UHF_Sensor_01_Typ, system-signal=UHF_Sensor_01_Typ
        communication-direction=OUT, data-element=Grundumfang_XIX_SAM.Geltungsbereich_E3_1_1_UNECE_Gen2.SP_IF_UHF_Sensor_01_Zaehler_XIX_Grundumfang_XIX_SAM.DE_UHF_Sensor_01_Zaehler, system-signal=UHF_Sensor_01_Zaehler
        communication-direction=OUT, data-element=Grundumfang_XIX_SAM.Geltungsbereich_E3_1_1_UNECE_Gen2.SP_IF_UHF_Sensor_02_Data_XIX_Grundumfang_XIX_SAM.DE_UHF_Sensor_02_Data, system-signal=UHF_Sensor_02_Data
        communication-direction=OUT, data-element=Grundumfang_XIX_SAM.Geltungsbereich_E3_1_1_UNECE_Gen2.SP_IF_UHF_Sensor_02_Zaehler_XIX_Grundumfang_XIX_SAM.DE_UHF_Sensor_02_Zaehler, system-signal=UHF_Sensor_02_Zaehler
        communication-direction=OUT, data-element=Grundumfang_XIX_SAM.Geltungsbereich_E3_1_1_UNECE_Gen2.SP_IF_UHF_Sensor_03_Data_XIX_Grundumfang_XIX_SAM.DE_UHF_Sensor_03_Data, system-signal=UHF_Sensor_03_Data
        communication-direction=OUT, data-element=Grundumfang_XIX_SAM.Geltungsbereich_E3_1_1_UNECE_Gen2.SP_IF_UHF_Sensor_03_Zaehler_XIX_Grundumfang_XIX_SAM.DE_UHF_Sensor_03_Zaehler, system-signal=UHF_Sensor_03_Zaehler
        communication-direction=OUT, data-element=Grundumfang_XIX_SAM.Geltungsbereich_E3_1_1_UNECE_Gen2.SP_IF_UHF_Sensor_04_Data_XIX_Grundumfang_XIX_SAM.DE_UHF_Sensor_04_Data, system-signal=UHF_Sensor_04_Data
        communication-direction=OUT, data-element=Grundumfang_XIX_SAM.Geltungsbereich_E3_1_1_UNECE_Gen2.SP_IF_UHF_Sensor_04_Zaehler_XIX_Grundumfang_XIX_SAM.DE_UHF_Sensor_04_Zaehler, system-signal=UHF_Sensor_04_Zaehler
        communication-direction=OUT, data-element=Grundumfang_XIX_SAM.Geltungsbereich_E3_1_1_UNECE_Gen2.SP_IF_UHF_Sensor_05_Data_XIX_Grundumfang_XIX_SAM.DE_UHF_Sensor_05_Data, system-signal=UHF_Sensor_05_Data
        communication-direction=OUT, data-element=Grundumfang_XIX_SAM.Geltungsbereich_E3_1_1_UNECE_Gen2.SP_IF_UHF_Sensor_05_Zaehler_XIX_Grundumfang_XIX_SAM.DE_UHF_Sensor_05_Zaehler, system-signal=UHF_Sensor_05_Zaehler
        communication-direction=OUT, data-element=Grundumfang_XIX_SAM.Geltungsbereich_E3_1_1_UNECE_Gen2.SP_IF_UHF_Sensor_06_Data_XIX_Grundumfang_XIX_SAM.DE_UHF_Sensor_06_Data, system-signal=UHF_Sensor_06_Data
        communication-direction=OUT, data-element=Grundumfang_XIX_SAM.Geltungsbereich_E3_1_1_UNECE_Gen2.SP_IF_UHF_Sensor_06_Zaehler_XIX_Grundumfang_XIX_SAM.DE_UHF_Sensor_06_Zaehler, system-signal=UHF_Sensor_06_Zaehler
        communication-direction=OUT, data-element=Grundumfang_XIX_SAM.Geltungsbereich_E3_1_1_UNECE_Gen2.SP_IF_UHF_Sensor_07_Data_XIX_Grundumfang_XIX_SAM.DE_UHF_Sensor_07_Data, system-signal=UHF_Sensor_07_Data
        communication-direction=OUT, data-element=Grundumfang_XIX_SAM.Geltungsbereich_E3_1_1_UNECE_Gen2.SP_IF_UHF_Sensor_07_Zaehler_XIX_Grundumfang_XIX_SAM.DE_UHF_Sensor_07_Zaehler, system-signal=UHF_Sensor_07_Zaehler
        communication-direction=OUT, data-element=Grundumfang_XIX_SAM.Geltungsbereich_E3_1_1_UNECE_Gen2.SP_IF_UHF_Sensor_08_Data_XIX_Grundumfang_XIX_SAM.DE_UHF_Sensor_08_Data, system-signal=UHF_Sensor_08_Data
        communication-direction=OUT, data-element=Grundumfang_XIX_SAM.Geltungsbereich_E3_1_1_UNECE_Gen2.SP_IF_UHF_Sensor_08_Zaehler_XIX_Grundumfang_XIX_SAM.DE_UHF_Sensor_08_Zaehler, system-signal=UHF_Sensor_08_Zaehler
        communication-direction=OUT, data-element=Grundumfang_XIX_SAM.Geltungsbereich_E3_1_1_UNECE_Gen2.SP_IF_UHF_Sensor_RSSI_Wert_IDGeber{1..8}_XIX_Grundumfang_XIX_SAM.DE_UHF_Sensor_RSSI_Wert_IDGeber{1..8}, system-signal=UHF_Sensor_RSSI_Wert_IDGeber{1..8}
        communication-direction=IN, data-element=Grundumfang_XIX_SAM.Geltungsbereich_E3_1_1_UNECE_Gen2.RP_IF_UHF_TranspID_{01..08}_XIX_Grundumfang_XIX_SAM.DE_UHF_TranspID_{01..08}, system-signal=UHF_TranspID_{01..08}
        communication-direction=OUT, data-element=Grundumfang_XIX_SAM.Geltungsbereich_E3_1_1_UNECE_Gen2.SP_IF_Verbauposition_LLR_li_XIX_Grundumfang_XIX_SAM.DE_Verbauposition_LLR_li, system-signal=Verbauposition_LLR_li
        communication-direction=OUT, data-element=Grundumfang_XIX_SAM.Geltungsbereich_E3_1_1_UNECE_Gen2.SP_IF_Verbauposition_LLR_re_XIX_Grundumfang_XIX_SAM.DE_Verbauposition_LLR_re, system-signal=Verbauposition_LLR_re
        communication-direction=OUT, data-element=Grundumfang_XIX_SAM.Geltungsbereich_E3_1_1_UNECE_Gen2.SP_IF_Verglasung_offen_XIX_Grundumfang_XIX_SAM.DE_Verglasung_offen, system-signal=Verglasung_offen
        communication-direction=IN, data-element=VKMS_XIX_SAM.Geltungsbereich_E3_1_1_UNECE_Gen2.RP_IF_VIN_01_MUX_XIX_VKMS_XIX_SAM.DE_VIN_01_MUX, system-signal=VIN_01_MUX
        communication-direction=IN, data-element=VKMS_XIX_SAM.Geltungsbereich_E3_1_1_UNECE_Gen2.RP_IF_VIN_1_XIX_VKMS_XIX_SAM.DE_VIN_1, system-signal=VIN_1
        communication-direction=IN, data-element=VKMS_XIX_SAM.Geltungsbereich_E3_1_1_UNECE_Gen2.RP_IF_VIN_{10..17}_XIX_VKMS_XIX_SAM.DE_VIN_{10..17}, system-signal=VIN_{10..17}
        communication-direction=IN, data-element=VKMS_XIX_SAM.Geltungsbereich_E3_1_1_UNECE_Gen2.RP_IF_VIN_{2..9}_XIX_VKMS_XIX_SAM.DE_VIN_{2..9}, system-signal=VIN_{2..9}
        communication-direction=IN, data-element=Grundumfang_XIX_SAM.Geltungsbereich_E3_1_1_UNECE_Gen2.RP_IF_VIP_Sensor_betaetigt_XIX_Grundumfang_XIX_SAM.DE_VIP_Sensor_betaetigt, system-signal=VIP_Sensor_betaetigt
        communication-direction=IN, data-element=ZV_XIX_SAM.Geltungsbereich_E3_1_1_UNECE_Gen2.RP_IF_VIP_Sensor_betaetigt_XIX_ZV_XIX_SAM.DE_VIP_Sensor_betaetigt, system-signal=VIP_Sensor_betaetigt
        communication-direction=IN, data-element=VIP_XIX_SAM.Geltungsbereich_E3_1_1_UNECE_Gen2.RP_IF_VIP_Sensor_STSG_HBFS_betaetigt_XIX_VIP_XIX_SAM.DE_VIP_Sensor_STSG_HBFS_betaetigt, system-signal=VIP_Sensor_STSG_HBFS_betaetigt
        communication-direction=IN, data-element=ZV_XIX_SAM.Geltungsbereich_E3_1_1_UNECE_Gen2.RP_IF_VIP_Sensor_STSG_HBFS_betaetigt_XIX_ZV_XIX_SAM.DE_VIP_Sensor_STSG_HBFS_betaetigt, system-signal=VIP_Sensor_STSG_HBFS_betaetigt
        communication-direction=IN, data-element=VIP_XIX_SAM.Geltungsbereich_E3_1_1_UNECE_Gen2.RP_IF_VIP_Sensor_STSG_HFS_betaetigt_XIX_VIP_XIX_SAM.DE_VIP_Sensor_STSG_HFS_betaetigt, system-signal=VIP_Sensor_STSG_HFS_betaetigt
        communication-direction=IN, data-element=ZV_XIX_SAM.Geltungsbereich_E3_1_1_UNECE_Gen2.RP_IF_VIP_Sensor_STSG_HFS_betaetigt_XIX_ZV_XIX_SAM.DE_VIP_Sensor_STSG_HFS_betaetigt, system-signal=VIP_Sensor_STSG_HFS_betaetigt
        communication-direction=IN, data-element=Grundumfang_XIX_SAM.Geltungsbereich_E3_1_1_UNECE_Gen2.RP_IF_VMM_02_BZ_XIX_Grundumfang_XIX_SAM.DE_VMM_02_BZ, system-signal=VMM_02_BZ
        communication-direction=IN, data-element=Grundumfang_XIX_SAM.Geltungsbereich_E3_1_1_UNECE_Gen2.RP_IF_VMM_02_CRC_XIX_Grundumfang_XIX_SAM.DE_VMM_02_CRC, system-signal=VMM_02_CRC
        communication-direction=OUT, data-element=Grundumfang_XIX_SAM.Geltungsbereich_E3_1_1_UNECE_Gen2.SP_IF_Waschen_vorne_aktiv_XIX_Grundumfang_XIX_SAM.DE_Waschen_vorne_aktiv, system-signal=Waschen_vorne_aktiv
        communication-direction=OUT, data-element=Grundumfang_XIX_SAM.Geltungsbereich_E3_1_1_UNECE_Gen2.SP_IF_Wendelage_oben_Wischer_XIX_Grundumfang_XIX_SAM.DE_Wendelage_oben_Wischer, system-signal=Wendelage_oben_Wischer
        communication-direction=OUT, data-element=Grundumfang_XIX_SAM.Geltungsbereich_E3_1_1_UNECE_Gen2.SP_IF_Wendelage_unten_Wischer_XIX_Grundumfang_XIX_SAM.DE_Wendelage_unten_Wischer, system-signal=Wendelage_unten_Wischer
        communication-direction=IN, data-element=ZV_XIX_SAM.Geltungsbereich_E3_1_1_UNECE_Gen2.RP_IF_WFS_ID_Geb_autorisiert_in_Kl15_XIX_ZV_XIX_SAM.DE_WFS_ID_Geb_autorisiert_in_Kl15, system-signal=WFS_ID_Geb_autorisiert_in_Kl15
        communication-direction=IN, data-element=Druckpunktmassage_fuer_Beifahrersitz_Lehnenmassage_SAM_XIX_DPMBFSLM_XIX_SAM.Geltungsbereich_E3_1_1_UNECE_Gen2.RP_IF_WFS_Schluessel_Fahrberecht_XIX_Druckpunktmassage_fuer_Beifahrersitz_Lehnenmassage_SAM_XIX_DPMBFSLM_XIX_SAM.DE_WFS_Schluessel_Fahrberecht, system-signal=WFS_Schluessel_Fahrberecht
        communication-direction=IN, data-element=Druckpunktmassage_fuer_Fahrersitz_Lehnenmassage_SAM_XIX_DPMFSLM_XIX_SAM.Geltungsbereich_E3_1_1_UNECE_Gen2.RP_IF_WFS_Schluessel_Fahrberecht_XIX_Druckpunktmassage_fuer_Fahrersitz_Lehnenmassage_SAM_XIX_DPMFSLM_XIX_SAM.DE_WFS_Schluessel_Fahrberecht, system-signal=WFS_Schluessel_Fahrberecht
        communication-direction=IN, data-element=Grundumfang_XIX_SAM.Geltungsbereich_E3_1_1_UNECE_Gen2.RP_IF_WFS_Schluessel_Fahrberecht_XIX_Grundumfang_XIX_SAM.DE_WFS_Schluessel_Fahrberecht, system-signal=WFS_Schluessel_Fahrberecht
        communication-direction=IN, data-element=Grundumfang_XIX_SAM.Geltungsbereich_E3_1_1_UNECE_Gen2.RP_IF_WH_Frontwaschen_XIX_Grundumfang_XIX_SAM.DE_WH_Frontwaschen, system-signal=WH_Frontwaschen
        communication-direction=OUT, data-element=Grundumfang_XIX_SAM.Geltungsbereich_E3_1_1_UNECE_Gen2.SP_IF_WH_Frontwaschen_XIX_Grundumfang_XIX_SAM.DE_WH_Frontwaschen, system-signal=WH_Frontwaschen
        communication-direction=IN, data-element=Grundumfang_XIX_SAM.Geltungsbereich_E3_1_1_UNECE_Gen2.RP_IF_WH_Heckintervall_XIX_Grundumfang_XIX_SAM.DE_WH_Heckintervall, system-signal=WH_Heckintervall
        communication-direction=OUT, data-element=Grundumfang_XIX_SAM.Geltungsbereich_E3_1_1_UNECE_Gen2.SP_IF_WH_Heckintervall_XIX_Grundumfang_XIX_SAM.DE_WH_Heckintervall, system-signal=WH_Heckintervall
        communication-direction=IN, data-element=Grundumfang_XIX_SAM.Geltungsbereich_E3_1_1_UNECE_Gen2.RP_IF_WH_Heckwaschen_XIX_Grundumfang_XIX_SAM.DE_WH_Heckwaschen, system-signal=WH_Heckwaschen
        communication-direction=OUT, data-element=Grundumfang_XIX_SAM.Geltungsbereich_E3_1_1_UNECE_Gen2.SP_IF_WH_Heckwaschen_XIX_Grundumfang_XIX_SAM.DE_WH_Heckwaschen, system-signal=WH_Heckwaschen
        communication-direction=IN, data-element=Grundumfang_XIX_SAM.Geltungsbereich_E3_1_1_UNECE_Gen2.RP_IF_WH_Intervall_XIX_Grundumfang_XIX_SAM.DE_WH_Intervall, system-signal=WH_Intervall
        communication-direction=OUT, data-element=Grundumfang_XIX_SAM.Geltungsbereich_E3_1_1_UNECE_Gen2.SP_IF_WH_Intervall_XIX_Grundumfang_XIX_SAM.DE_WH_Intervall, system-signal=WH_Intervall
        communication-direction=IN, data-element=Grundumfang_XIX_SAM.Geltungsbereich_E3_1_1_UNECE_Gen2.RP_IF_WH_Intervallstufen_XIX_Grundumfang_XIX_SAM.DE_WH_Intervallstufen, system-signal=WH_Intervallstufen
        communication-direction=OUT, data-element=Grundumfang_XIX_SAM.Geltungsbereich_E3_1_1_UNECE_Gen2.SP_IF_WH_Intervallstufen_XIX_Grundumfang_XIX_SAM.DE_WH_Intervallstufen, system-signal=WH_Intervallstufen
        communication-direction=IN, data-element=Grundumfang_XIX_SAM.Geltungsbereich_E3_1_1_UNECE_Gen2.RP_IF_WH_MFA_Fehler_XIX_Grundumfang_XIX_SAM.DE_WH_MFA_Fehler, system-signal=WH_MFA_Fehler
        communication-direction=OUT, data-element=Grundumfang_XIX_SAM.Geltungsbereich_E3_1_1_UNECE_Gen2.SP_IF_WH_Tippwischen_XIX_Grundumfang_XIX_SAM.DE_WH_Tippwischen, system-signal=WH_Tippwischen
        communication-direction=IN, data-element=Grundumfang_XIX_SAM.Geltungsbereich_E3_1_1_UNECE_Gen2.RP_IF_WH_Tipwischen_XIX_Grundumfang_XIX_SAM.DE_WH_Tipwischen, system-signal=WH_Tipwischen
        communication-direction=OUT, data-element=Grundumfang_XIX_SAM.Geltungsbereich_E3_1_1_UNECE_Gen2.SP_IF_WH_Tipwischen_XIX_Grundumfang_XIX_SAM.DE_WH_Tipwischen, system-signal=WH_Tipwischen
        communication-direction=IN, data-element=Grundumfang_XIX_SAM.Geltungsbereich_E3_1_1_UNECE_Gen2.RP_IF_WH_Wischer_Fehler_XIX_Grundumfang_XIX_SAM.DE_WH_Wischer_Fehler, system-signal=WH_Wischer_Fehler
        communication-direction=OUT, data-element=Grundumfang_XIX_SAM.Geltungsbereich_E3_1_1_UNECE_Gen2.SP_IF_WH_Wischer_Fehler_XIX_Grundumfang_XIX_SAM.DE_WH_Wischer_Fehler, system-signal=WH_Wischer_Fehler
        communication-direction=IN, data-element=Grundumfang_XIX_SAM.Geltungsbereich_E3_1_1_UNECE_Gen2.RP_IF_WH_WischerStufe1_XIX_Grundumfang_XIX_SAM.DE_WH_WischerStufe1, system-signal=WH_WischerStufe1
        communication-direction=OUT, data-element=Grundumfang_XIX_SAM.Geltungsbereich_E3_1_1_UNECE_Gen2.SP_IF_WH_WischerStufe1_XIX_Grundumfang_XIX_SAM.DE_WH_WischerStufe1, system-signal=WH_WischerStufe1
        communication-direction=IN, data-element=Grundumfang_XIX_SAM.Geltungsbereich_E3_1_1_UNECE_Gen2.RP_IF_WH_WischerStufe1_invers_XIX_Grundumfang_XIX_SAM.DE_WH_WischerStufe1_invers, system-signal=WH_WischerStufe1_invers
        communication-direction=IN, data-element=Grundumfang_XIX_SAM.Geltungsbereich_E3_1_1_UNECE_Gen2.RP_IF_WH_WischerStufe2_XIX_Grundumfang_XIX_SAM.DE_WH_WischerStufe2, system-signal=WH_WischerStufe2
        communication-direction=OUT, data-element=Grundumfang_XIX_SAM.Geltungsbereich_E3_1_1_UNECE_Gen2.SP_IF_WH_WischerStufe2_XIX_Grundumfang_XIX_SAM.DE_WH_WischerStufe2, system-signal=WH_WischerStufe2
        communication-direction=IN, data-element=Grundumfang_XIX_SAM.Geltungsbereich_E3_1_1_UNECE_Gen2.RP_IF_WH_WischerStufe2_invers_XIX_Grundumfang_XIX_SAM.DE_WH_WischerStufe2_invers, system-signal=WH_WischerStufe2_invers
        communication-direction=IN, data-element=Grundumfang_XIX_SAM.Geltungsbereich_E3_1_1_UNECE_Gen2.RP_IF_Wischer1_Error_XIX_Grundumfang_XIX_SAM.DE_Wischer1_Error, system-signal=Wischer1_Error
        communication-direction=IN, data-element=Grundumfang_XIX_SAM.Geltungsbereich_E3_1_1_UNECE_Gen2.RP_IF_Wischer1_ErrorGueltigkeit_XIX_Grundumfang_XIX_SAM.DE_Wischer1_ErrorGueltigkeit, system-signal=Wischer1_ErrorGueltigkeit
        communication-direction=IN, data-element=Grundumfang_XIX_SAM.Geltungsbereich_E3_1_1_UNECE_Gen2.RP_IF_Wischer1_Ueberlast_XIX_Grundumfang_XIX_SAM.DE_Wischer1_Ueberlast, system-signal=Wischer1_Ueberlast
        communication-direction=OUT, data-element=Grundumfang_XIX_SAM.Geltungsbereich_E3_1_1_UNECE_Gen2.SP_IF_Wischer1_Wischgeschwindigkeit_XIX_Grundumfang_XIX_SAM.DE_Wischer1_Wischgeschwindigkeit, system-signal=Wischer1_Wischgeschwindigkeit
        communication-direction=IN, data-element=Grundumfang_XIX_SAM.Geltungsbereich_E3_1_1_UNECE_Gen2.RP_IF_Wischer2_Error_XIX_Grundumfang_XIX_SAM.DE_Wischer2_Error, system-signal=Wischer2_Error
        communication-direction=IN, data-element=Grundumfang_XIX_SAM.Geltungsbereich_E3_1_1_UNECE_Gen2.RP_IF_Wischer2_ErrorGueltigkeit_XIX_Grundumfang_XIX_SAM.DE_Wischer2_ErrorGueltigkeit, system-signal=Wischer2_ErrorGueltigkeit
        communication-direction=IN, data-element=Grundumfang_XIX_SAM.Geltungsbereich_E3_1_1_UNECE_Gen2.RP_IF_Wischer2_Ueberlast_XIX_Grundumfang_XIX_SAM.DE_Wischer2_Ueberlast, system-signal=Wischer2_Ueberlast
        communication-direction=IN, data-element=Grundumfang_XIX_SAM.Geltungsbereich_E3_1_1_UNECE_Gen2.RP_IF_Wischer_aktiv_XIX_Grundumfang_XIX_SAM.DE_Wischer_aktiv, system-signal=Wischer_aktiv
        communication-direction=IN, data-element=Grundumfang_XIX_SAM.Geltungsbereich_E3_1_1_UNECE_Gen2.RP_IF_Wischer_Parklage_XIX_Grundumfang_XIX_SAM.DE_Wischer_Parklage, system-signal=Wischer_Parklage
        communication-direction=IN, data-element=Grundumfang_XIX_SAM.Geltungsbereich_E3_1_1_UNECE_Gen2.RP_IF_Wischer_ResponseError_XIX_Grundumfang_XIX_SAM.DE_Wischer_ResponseError, system-signal=Wischer_ResponseError
        communication-direction=IN, data-element=Grundumfang_XIX_SAM.Geltungsbereich_E3_1_1_UNECE_Gen2.RP_IF_Wischer_Servicestellung_XIX_Grundumfang_XIX_SAM.DE_Wischer_Servicestellung, system-signal=Wischer_Servicestellung
        communication-direction=OUT, data-element=Grundumfang_XIX_SAM.Geltungsbereich_E3_1_1_UNECE_Gen2.SP_IF_Wischer_vorne_aktiv_XIX_Grundumfang_XIX_SAM.DE_Wischer_vorne_aktiv, system-signal=Wischer_vorne_aktiv
        communication-direction=OUT, data-element=Grundumfang_XIX_SAM.Geltungsbereich_E3_1_1_UNECE_Gen2.SP_IF_Wischer_vorne_blockiert_XIX_Grundumfang_XIX_SAM.DE_Wischer_vorne_blockiert, system-signal=Wischer_vorne_blockiert
        communication-direction=OUT, data-element=Grundumfang_XIX_SAM.Geltungsbereich_E3_1_1_UNECE_Gen2.SP_IF_Wischer_vorne_defekt_XIX_Grundumfang_XIX_SAM.DE_Wischer_vorne_defekt, system-signal=Wischer_vorne_defekt
        communication-direction=OUT, data-element=Grundumfang_XIX_SAM.Geltungsbereich_E3_1_1_UNECE_Gen2.SP_IF_Wischer_vorne_Normal_XIX_Grundumfang_XIX_SAM.DE_Wischer_vorne_Normal, system-signal=Wischer_vorne_Normal
        communication-direction=OUT, data-element=Grundumfang_XIX_SAM.Geltungsbereich_E3_1_1_UNECE_Gen2.SP_IF_Wischer_vorne_Parklage_XIX_Grundumfang_XIX_SAM.DE_Wischer_vorne_Parklage, system-signal=Wischer_vorne_Parklage
        communication-direction=OUT, data-element=Grundumfang_XIX_SAM.Geltungsbereich_E3_1_1_UNECE_Gen2.SP_IF_Wischer_vorne_Schnell_XIX_Grundumfang_XIX_SAM.DE_Wischer_vorne_Schnell, system-signal=Wischer_vorne_Schnell
        communication-direction=IN, data-element=Grundumfang_XIX_SAM.Geltungsbereich_E3_1_1_UNECE_Gen2.RP_IF_Wischer_Wendelage_XIX_Grundumfang_XIX_SAM.DE_Wischer_Wendelage, system-signal=Wischer_Wendelage
        communication-direction=OUT, data-element=Grundumfang_XIX_SAM.Geltungsbereich_E3_1_1_UNECE_Gen2.SP_IF_Wischer_WH_PopUp_Anf_XIX_Grundumfang_XIX_SAM.DE_Wischer_WH_PopUp_Anf, system-signal=Wischer_WH_PopUp_Anf
        communication-direction=OUT, data-element=Grundumfang_XIX_SAM.Geltungsbereich_E3_1_1_UNECE_Gen2.SP_IF_Wischer_WH_Typ_XIX_Grundumfang_XIX_SAM.DE_Wischer_WH_Typ, system-signal=Wischer_WH_Typ
        communication-direction=IN, data-element=Grundumfang_XIX_SAM.Geltungsbereich_E3_1_1_UNECE_Gen2.RP_IF_Wischzykluszaehler_XIX_Grundumfang_XIX_SAM.DE_Wischzykluszaehler, system-signal=Wischzykluszaehler
        communication-direction=IN, data-element=Grundumfang_XIX_SAM.Geltungsbereich_E3_1_1_UNECE_Gen2.RP_IF_WWS2_aktiv_XIX_Grundumfang_XIX_SAM.DE_WWS2_aktiv, system-signal=WWS2_aktiv
        communication-direction=IN, data-element=Grundumfang_XIX_SAM.Geltungsbereich_E3_1_1_UNECE_Gen2.RP_IF_WWS2_Error_XIX_Grundumfang_XIX_SAM.DE_WWS2_Error, system-signal=WWS2_Error
        communication-direction=IN, data-element=Grundumfang_XIX_SAM.Geltungsbereich_E3_1_1_UNECE_Gen2.RP_IF_WWS2_ErrorGueltigkeit_XIX_Grundumfang_XIX_SAM.DE_WWS2_ErrorGueltigkeit, system-signal=WWS2_ErrorGueltigkeit
        communication-direction=IN, data-element=Grundumfang_XIX_SAM.Geltungsbereich_E3_1_1_UNECE_Gen2.RP_IF_WWS2_Parklage_XIX_Grundumfang_XIX_SAM.DE_WWS2_Parklage, system-signal=WWS2_Parklage
        communication-direction=IN, data-element=Grundumfang_XIX_SAM.Geltungsbereich_E3_1_1_UNECE_Gen2.RP_IF_WWS2_Position_Wischerarm_XIX_Grundumfang_XIX_SAM.DE_WWS2_Position_Wischerarm, system-signal=WWS2_Position_Wischerarm
        communication-direction=IN, data-element=Grundumfang_XIX_SAM.Geltungsbereich_E3_1_1_UNECE_Gen2.RP_IF_WWS2_ResponseError_XIX_Grundumfang_XIX_SAM.DE_WWS2_ResponseError, system-signal=WWS2_ResponseError
        communication-direction=IN, data-element=Grundumfang_XIX_SAM.Geltungsbereich_E3_1_1_UNECE_Gen2.RP_IF_WWS2_Servicestellung_XIX_Grundumfang_XIX_SAM.DE_WWS2_Servicestellung, system-signal=WWS2_Servicestellung
        communication-direction=IN, data-element=Grundumfang_XIX_SAM.Geltungsbereich_E3_1_1_UNECE_Gen2.RP_IF_WWS2_Ueberlast_XIX_Grundumfang_XIX_SAM.DE_WWS2_Ueberlast, system-signal=WWS2_Ueberlast
        communication-direction=IN, data-element=Grundumfang_XIX_SAM.Geltungsbereich_E3_1_1_UNECE_Gen2.RP_IF_WWS2_Wendelage_XIX_Grundumfang_XIX_SAM.DE_WWS2_Wendelage, system-signal=WWS2_Wendelage
        communication-direction=IN, data-element=Grundumfang_XIX_SAM.Geltungsbereich_E3_1_1_UNECE_Gen2.RP_IF_WWS_DebugData_XIX_Grundumfang_XIX_SAM.DE_WWS_DebugData, system-signal=WWS_DebugData
        communication-direction=IN, data-element=Grundumfang_XIX_SAM.Geltungsbereich_E3_1_1_UNECE_Gen2.RP_IF_WWS_Position_Wischerarm_XIX_Grundumfang_XIX_SAM.DE_WWS_Position_Wischerarm, system-signal=WWS_Position_Wischerarm
        communication-direction=OUT, data-element=Grundumfang_XIX_SAM.Geltungsbereich_E3_1_1_UNECE_Gen2.SP_IF_WWS_Produktionsmodus_XIX_Grundumfang_XIX_SAM.DE_WWS_Produktionsmodus, system-signal=WWS_Produktionsmodus
        communication-direction=IN, data-element=Grundumfang_XIX_SAM.Geltungsbereich_E3_1_1_UNECE_Gen2.RP_IF_WWS_Produktionsmodus_Status_XIX_Grundumfang_XIX_SAM.DE_WWS_Produktionsmodus_Status, system-signal=WWS_Produktionsmodus_Status
        communication-direction=IN, data-element=Grundumfang_XIX_SAM.Geltungsbereich_E3_1_1_UNECE_Gen2.RP_IF_WWS_Wischgeschwindigkeit_XIX_Grundumfang_XIX_SAM.DE_WWS_Wischgeschwindigkeit, system-signal=WWS_Wischgeschwindigkeit
        communication-direction=OUT, data-element=Grundumfang_XIX_SAM.Geltungsbereich_E3_1_1_UNECE_Gen2.SP_IF_WWSs_01_alt_XIX_Grundumfang_XIX_SAM.DE_WWSs_01_alt, system-signal=WWSs_01_alt
        communication-direction=IN, data-element=Grundumfang_XIX_SAM.Geltungsbereich_E3_1_1_UNECE_Gen2.RP_IF_ZAS_Kl_15_XIX_Grundumfang_XIX_SAM.DE_ZAS_Kl_15, system-signal=ZAS_Kl_15
        communication-direction=OUT, data-element=Grundumfang_XIX_SAM.Geltungsbereich_E3_1_1_UNECE_Gen2.SP_IF_ZAS_Kl_15_XIX_Grundumfang_XIX_SAM.DE_ZAS_Kl_15, system-signal=ZAS_Kl_15
        communication-direction=IN, data-element=SC_708_IuALicht_MEB_XIX_Softwareblock_XIX_SAM.Geltungsbereich_E3_1_1_UNECE_Gen2.RP_IF_ZAS_Kl_15_XIX_SC_708_IuALicht_MEB_XIX_Softwareblock_XIX_SAM.DE_ZAS_Kl_15, system-signal=ZAS_Kl_15
        communication-direction=IN, data-element=Grundumfang_XIX_SAM.Geltungsbereich_E3_1_1_UNECE_Gen2.RP_IF_ZAS_Kl_S_XIX_Grundumfang_XIX_SAM.DE_ZAS_Kl_S, system-signal=ZAS_Kl_S
        communication-direction=OUT, data-element=Grundumfang_XIX_SAM.Geltungsbereich_E3_1_1_UNECE_Gen2.SP_IF_ZAS_Kl_S_XIX_Grundumfang_XIX_SAM.DE_ZAS_Kl_S, system-signal=ZAS_Kl_S
        communication-direction=IN, data-element=SC_708_IuALicht_MEB_XIX_Softwareblock_XIX_SAM.Geltungsbereich_E3_1_1_UNECE_Gen2.RP_IF_ZAS_Kl_S_XIX_SC_708_IuALicht_MEB_XIX_Softwareblock_XIX_SAM.DE_ZAS_Kl_S, system-signal=ZAS_Kl_S
        communication-direction=IN, data-element=Grundumfang_XIX_SAM.Geltungsbereich_E3_1_1_UNECE_Gen2.RP_IF_ZFH_HBFS_AutoHoch_XIX_Grundumfang_XIX_SAM.DE_ZFH_HBFS_AutoHoch, system-signal=ZFH_HBFS_AutoHoch
        communication-direction=IN, data-element=Grundumfang_XIX_SAM.Geltungsbereich_E3_1_1_UNECE_Gen2.RP_IF_ZFH_HBFS_AutoTief_XIX_Grundumfang_XIX_SAM.DE_ZFH_HBFS_AutoTief, system-signal=ZFH_HBFS_AutoTief
        communication-direction=IN, data-element=Grundumfang_XIX_SAM.Geltungsbereich_E3_1_1_UNECE_Gen2.RP_IF_ZFH_HBFS_ManHoch_XIX_Grundumfang_XIX_SAM.DE_ZFH_HBFS_ManHoch, system-signal=ZFH_HBFS_ManHoch
        communication-direction=IN, data-element=Grundumfang_XIX_SAM.Geltungsbereich_E3_1_1_UNECE_Gen2.RP_IF_ZFH_HBFS_ManTief_XIX_Grundumfang_XIX_SAM.DE_ZFH_HBFS_ManTief, system-signal=ZFH_HBFS_ManTief
        communication-direction=IN, data-element=Grundumfang_XIX_SAM.Geltungsbereich_E3_1_1_UNECE_Gen2.RP_IF_ZFH_HFS_AutoHoch_XIX_Grundumfang_XIX_SAM.DE_ZFH_HFS_AutoHoch, system-signal=ZFH_HFS_AutoHoch
        communication-direction=IN, data-element=Grundumfang_XIX_SAM.Geltungsbereich_E3_1_1_UNECE_Gen2.RP_IF_ZFH_HFS_AutoTief_XIX_Grundumfang_XIX_SAM.DE_ZFH_HFS_AutoTief, system-signal=ZFH_HFS_AutoTief
        communication-direction=IN, data-element=Grundumfang_XIX_SAM.Geltungsbereich_E3_1_1_UNECE_Gen2.RP_IF_ZFH_HFS_ManHoch_XIX_Grundumfang_XIX_SAM.DE_ZFH_HFS_ManHoch, system-signal=ZFH_HFS_ManHoch
        communication-direction=IN, data-element=Grundumfang_XIX_SAM.Geltungsbereich_E3_1_1_UNECE_Gen2.RP_IF_ZFH_HFS_ManTief_XIX_Grundumfang_XIX_SAM.DE_ZFH_HFS_ManTief, system-signal=ZFH_HFS_ManTief
        communication-direction=IN, data-element=Grundumfang_XIX_SAM.Geltungsbereich_E3_1_1_UNECE_Gen2.RP_IF_ZFH_zentral_auf_XIX_Grundumfang_XIX_SAM.DE_ZFH_zentral_auf, system-signal=ZFH_zentral_auf
        communication-direction=IN, data-element=Grundumfang_XIX_SAM.Geltungsbereich_E3_1_1_UNECE_Gen2.RP_IF_ZFH_zentral_zu_XIX_Grundumfang_XIX_SAM.DE_ZFH_zentral_zu, system-signal=ZFH_zentral_zu
        communication-direction=IN, data-element=Grundumfang_XIX_SAM.Geltungsbereich_E3_1_1_UNECE_Gen2.RP_IF_ZV_04_BZ_XIX_Grundumfang_XIX_SAM.DE_ZV_04_BZ, system-signal=ZV_04_BZ
        communication-direction=IN, data-element=Grundumfang_XIX_SAM.Geltungsbereich_E3_1_1_UNECE_Gen2.RP_IF_ZV_04_CRC_XIX_Grundumfang_XIX_SAM.DE_ZV_04_CRC, system-signal=ZV_04_CRC
        communication-direction=IN, data-element=Grundumfang_XIX_SAM.Geltungsbereich_E3_1_1_UNECE_Gen2.RP_IF_ZV_Anf_Challenge_Auth_XIX_Grundumfang_XIX_SAM.DE_ZV_Anf_Challenge_Auth, system-signal=ZV_Anf_Challenge_Auth
        communication-direction=IN, data-element=Grundumfang_XIX_SAM.Geltungsbereich_E3_1_1_UNECE_Gen2.RP_IF_ZV_auf_BT_XIX_Grundumfang_XIX_SAM.DE_ZV_auf_BT, system-signal=ZV_auf_BT
        communication-direction=IN, data-element=Grundumfang_XIX_SAM.Geltungsbereich_E3_1_1_UNECE_Gen2.RP_IF_ZV_auf_FT_XIX_Grundumfang_XIX_SAM.DE_ZV_auf_FT, system-signal=ZV_auf_FT
        communication-direction=IN, data-element=Grundumfang_XIX_SAM.Geltungsbereich_E3_1_1_UNECE_Gen2.RP_IF_ZV_auf_Funk_XIX_Grundumfang_XIX_SAM.DE_ZV_auf_Funk, system-signal=ZV_auf_Funk
        communication-direction=IN, data-element=Grundumfang_XIX_SAM.Geltungsbereich_E3_1_1_UNECE_Gen2.RP_IF_ZV_auf_Kessy_XIX_Grundumfang_XIX_SAM.DE_ZV_auf_Kessy, system-signal=ZV_auf_Kessy
        communication-direction=IN, data-element=Grundumfang_XIX_SAM.Geltungsbereich_E3_1_1_UNECE_Gen2.RP_IF_ZV_Bedienstelle_auf_XIX_Grundumfang_XIX_SAM.DE_ZV_Bedienstelle_auf, system-signal=ZV_Bedienstelle_auf
        communication-direction=IN, data-element=Grundumfang_XIX_SAM.Geltungsbereich_E3_1_1_UNECE_Gen2.RP_IF_ZV_BT_offen_XIX_Grundumfang_XIX_SAM.DE_ZV_BT_offen, system-signal=ZV_BT_offen
        communication-direction=IN, data-element=Grundumfang_XIX_SAM.Geltungsbereich_E3_1_1_UNECE_Gen2.RP_IF_ZV_DWA_Einfachhorn_Anf_XIX_Grundumfang_XIX_SAM.DE_ZV_DWA_Einfachhorn_Anf, system-signal=ZV_DWA_Einfachhorn_Anf
        communication-direction=IN, data-element=Grundumfang_XIX_SAM.Geltungsbereich_E3_1_1_UNECE_Gen2.RP_IF_ZV_DWA_Einfachhorn_Takt_XIX_Grundumfang_XIX_SAM.DE_ZV_DWA_Einfachhorn_Takt, system-signal=ZV_DWA_Einfachhorn_Takt
        communication-direction=IN, data-element=Grundumfang_XIX_SAM.Geltungsbereich_E3_1_1_UNECE_Gen2.RP_IF_ZV_Einfachhorn_Anf_XIX_Grundumfang_XIX_SAM.DE_ZV_Einfachhorn_Anf, system-signal=ZV_Einfachhorn_Anf
        communication-direction=IN, data-element=Grundumfang_XIX_SAM.Geltungsbereich_E3_1_1_UNECE_Gen2.RP_IF_ZV_Einfachhorn_Takt_XIX_Grundumfang_XIX_SAM.DE_ZV_Einfachhorn_Takt, system-signal=ZV_Einfachhorn_Takt
        communication-direction=IN, data-element=Grundumfang_XIX_SAM.Geltungsbereich_E3_1_1_UNECE_Gen2.RP_IF_ZV_FT_offen_XIX_Grundumfang_XIX_SAM.DE_ZV_FT_offen, system-signal=ZV_FT_offen
        communication-direction=IN, data-element=Grundumfang_XIX_SAM.Geltungsbereich_E3_1_1_UNECE_Gen2.RP_IF_ZV_gesafet_extern_ist_XIX_Grundumfang_XIX_SAM.DE_ZV_gesafet_extern_ist, system-signal=ZV_gesafet_extern_ist
        communication-direction=IN, data-element=ZV_XIX_SAM.Geltungsbereich_E3_1_1_UNECE_Gen2.RP_IF_ZV_gesafet_extern_soll_XIX_ZV_XIX_SAM.DE_ZV_gesafet_extern_soll, system-signal=ZV_gesafet_extern_soll
        communication-direction=IN, data-element=Grundumfang_XIX_SAM.Geltungsbereich_E3_1_1_UNECE_Gen2.RP_IF_ZV_HBFS_entriegeln_XIX_Grundumfang_XIX_SAM.DE_ZV_HBFS_entriegeln, system-signal=ZV_HBFS_entriegeln
        communication-direction=IN, data-element=Grundumfang_XIX_SAM.Geltungsbereich_E3_1_1_UNECE_Gen2.RP_IF_ZV_HBFS_entriegeln_Auth_XIX_Grundumfang_XIX_SAM.DE_ZV_HBFS_entriegeln_Auth, system-signal=ZV_HBFS_entriegeln_Auth
        communication-direction=IN, data-element=Grundumfang_XIX_SAM.Geltungsbereich_E3_1_1_UNECE_Gen2.RP_IF_ZV_HBFS_entsafen_Auth_XIX_Grundumfang_XIX_SAM.DE_ZV_HBFS_entsafen_Auth, system-signal=ZV_HBFS_entsafen_Auth
        communication-direction=IN, data-element=Grundumfang_XIX_SAM.Geltungsbereich_E3_1_1_UNECE_Gen2.RP_IF_ZV_HBFS_offen_XIX_Grundumfang_XIX_SAM.DE_ZV_HBFS_offen, system-signal=ZV_HBFS_offen
        communication-direction=IN, data-element=Grundumfang_XIX_SAM.Geltungsbereich_E3_1_1_UNECE_Gen2.RP_IF_ZV_HBFS_verriegeln_XIX_Grundumfang_XIX_SAM.DE_ZV_HBFS_verriegeln, system-signal=ZV_HBFS_verriegeln
        communication-direction=IN, data-element=Grundumfang_XIX_SAM.Geltungsbereich_E3_1_1_UNECE_Gen2.RP_IF_ZV_HD_offen_XIX_Grundumfang_XIX_SAM.DE_ZV_HD_offen, system-signal=ZV_HD_offen
        communication-direction=IN, data-element=Grundumfang_XIX_SAM.Geltungsbereich_E3_1_1_UNECE_Gen2.RP_IF_ZV_Heckeinzelentriegelung_XIX_Grundumfang_XIX_SAM.DE_ZV_Heckeinzelentriegelung, system-signal=ZV_Heckeinzelentriegelung
        communication-direction=IN, data-element=Grundumfang_XIX_SAM.Geltungsbereich_E3_1_1_UNECE_Gen2.RP_IF_ZV_HFS_entriegeln_XIX_Grundumfang_XIX_SAM.DE_ZV_HFS_entriegeln, system-signal=ZV_HFS_entriegeln
        communication-direction=IN, data-element=Grundumfang_XIX_SAM.Geltungsbereich_E3_1_1_UNECE_Gen2.RP_IF_ZV_HFS_entriegeln_Auth_XIX_Grundumfang_XIX_SAM.DE_ZV_HFS_entriegeln_Auth, system-signal=ZV_HFS_entriegeln_Auth
        communication-direction=IN, data-element=Grundumfang_XIX_SAM.Geltungsbereich_E3_1_1_UNECE_Gen2.RP_IF_ZV_HFS_entsafen_Auth_XIX_Grundumfang_XIX_SAM.DE_ZV_HFS_entsafen_Auth, system-signal=ZV_HFS_entsafen_Auth
        communication-direction=IN, data-element=Grundumfang_XIX_SAM.Geltungsbereich_E3_1_1_UNECE_Gen2.RP_IF_ZV_HFS_offen_XIX_Grundumfang_XIX_SAM.DE_ZV_HFS_offen, system-signal=ZV_HFS_offen
        communication-direction=IN, data-element=Grundumfang_XIX_SAM.Geltungsbereich_E3_1_1_UNECE_Gen2.RP_IF_ZV_HFS_verriegeln_XIX_Grundumfang_XIX_SAM.DE_ZV_HFS_verriegeln, system-signal=ZV_HFS_verriegeln
        communication-direction=IN, data-element=Grundumfang_XIX_SAM.Geltungsbereich_E3_1_1_UNECE_Gen2.RP_IF_ZV_Hupe_Anf_XIX_Grundumfang_XIX_SAM.DE_ZV_Hupe_Anf, system-signal=ZV_Hupe_Anf
        communication-direction=IN, data-element=Grundumfang_XIX_SAM.Geltungsbereich_E3_1_1_UNECE_Gen2.RP_IF_ZV_Hupe_Takt_XIX_Grundumfang_XIX_SAM.DE_ZV_Hupe_Takt, system-signal=ZV_Hupe_Takt
        communication-direction=IN, data-element=Grundumfang_XIX_SAM.Geltungsbereich_E3_1_1_UNECE_Gen2.RP_IF_ZV_HW_Motor_Lock_HK_XIX_Grundumfang_XIX_SAM.DE_ZV_HW_Motor_Lock_HK, system-signal=ZV_HW_Motor_Lock_HK
        communication-direction=IN, data-element=Grundumfang_XIX_SAM.Geltungsbereich_E3_1_1_UNECE_Gen2.RP_IF_ZV_HW_Motor_Lock_HK_Auth_XIX_Grundumfang_XIX_SAM.DE_ZV_HW_Motor_Lock_HK_Auth, system-signal=ZV_HW_Motor_Lock_HK_Auth
        communication-direction=IN, data-element=Grundumfang_XIX_SAM.Geltungsbereich_E3_1_1_UNECE_Gen2.RP_IF_ZV_HW_Motor_Safe_Hinten_XIX_Grundumfang_XIX_SAM.DE_ZV_HW_Motor_Safe_Hinten, system-signal=ZV_HW_Motor_Safe_Hinten
        communication-direction=IN, data-element=Grundumfang_XIX_SAM.Geltungsbereich_E3_1_1_UNECE_Gen2.RP_IF_ZV_ist_Zustand_verfuegbar_XIX_Grundumfang_XIX_SAM.DE_ZV_ist_Zustand_verfuegbar, system-signal=ZV_ist_Zustand_verfuegbar
        communication-direction=OUT, data-element=Grundumfang_XIX_SAM.Geltungsbereich_E3_1_1_UNECE_Gen2.SP_IF_ZV_Ladeklappe_VerEntriegeln_XIX_Grundumfang_XIX_SAM.DE_ZV_Ladeklappe_VerEntriegeln, system-signal=ZV_Ladeklappe_VerEntriegeln
        communication-direction=OUT, data-element=ZV_XIX_SAM.Geltungsbereich_E3_1_1_UNECE_Gen2.SP_IF_ZV_Ladeklappe_VerEntriegeln_XIX_ZV_XIX_SAM.DE_ZV_Ladeklappe_VerEntriegeln, system-signal=ZV_Ladeklappe_VerEntriegeln
        communication-direction=OUT, data-element=Grundumfang_XIX_SAM.Geltungsbereich_E3_1_1_UNECE_Gen2.SP_IF_ZV_LadeklappenStatus_XIX_Grundumfang_XIX_SAM.DE_ZV_LadeklappenStatus, system-signal=ZV_LadeklappenStatus
        communication-direction=IN, data-element=ZV_XIX_SAM.Geltungsbereich_E3_1_1_UNECE_Gen2.RP_IF_ZV_Laderaumabd_elektr_aktiviert_XIX_ZV_XIX_SAM.DE_ZV_Laderaumabd_elektr_aktiviert, system-signal=ZV_Laderaumabd_elektr_aktiviert
        communication-direction=IN, data-element=Druckpunktmassage_fuer_Beifahrersitz_Lehnenmassage_SAM_XIX_DPMBFSLM_XIX_SAM.Geltungsbereich_E3_1_1_UNECE_Gen2.RP_IF_ZV_Schluessel_Zugang_XIX_Druckpunktmassage_fuer_Beifahrersitz_Lehnenmassage_SAM_XIX_DPMBFSLM_XIX_SAM.DE_ZV_Schluessel_Zugang, system-signal=ZV_Schluessel_Zugang
        communication-direction=IN, data-element=Druckpunktmassage_fuer_Fahrersitz_Lehnenmassage_SAM_XIX_DPMFSLM_XIX_SAM.Geltungsbereich_E3_1_1_UNECE_Gen2.RP_IF_ZV_Schluessel_Zugang_XIX_Druckpunktmassage_fuer_Fahrersitz_Lehnenmassage_SAM_XIX_DPMFSLM_XIX_SAM.DE_ZV_Schluessel_Zugang, system-signal=ZV_Schluessel_Zugang
        communication-direction=IN, data-element=Grundumfang_XIX_SAM.Geltungsbereich_E3_1_1_UNECE_Gen2.RP_IF_ZV_Schluessel_Zugang_XIX_Grundumfang_XIX_SAM.DE_ZV_Schluessel_Zugang, system-signal=ZV_Schluessel_Zugang
        communication-direction=IN, data-element=ZV_XIX_SAM.Geltungsbereich_E3_1_1_UNECE_Gen2.RP_IF_ZV_Status_Cargolock_XIX_ZV_XIX_SAM.DE_ZV_Status_Cargolock, system-signal=ZV_Status_Cargolock
        communication-direction=IN, data-element=ZV_XIX_SAM.Geltungsbereich_E3_1_1_UNECE_Gen2.RP_IF_ZV_STSG_HBFS_Anf_XIX_ZV_XIX_SAM.DE_ZV_STSG_HBFS_Anf, system-signal=ZV_STSG_HBFS_Anf
        communication-direction=IN, data-element=ZV_XIX_SAM.Geltungsbereich_E3_1_1_UNECE_Gen2.RP_IF_ZV_STSG_HFS_Anf_XIX_ZV_XIX_SAM.DE_ZV_STSG_HFS_Anf, system-signal=ZV_STSG_HFS_Anf
        communication-direction=IN, data-element=Grundumfang_XIX_SAM.Geltungsbereich_E3_1_1_UNECE_Gen2.RP_IF_ZV_verriegelt_extern_ist_XIX_Grundumfang_XIX_SAM.DE_ZV_verriegelt_extern_ist, system-signal=ZV_verriegelt_extern_ist
        communication-direction=IN, data-element=SC_708_IuALicht_MEB_XIX_Softwareblock_XIX_SAM.Geltungsbereich_E3_1_1_UNECE_Gen2.RP_IF_ZV_verriegelt_extern_ist_XIX_SC_708_IuALicht_MEB_XIX_Softwareblock_XIX_SAM.DE_ZV_verriegelt_extern_ist, system-signal=ZV_verriegelt_extern_ist
        communication-direction=IN, data-element=SC_708_IuALicht_MEB_XIX_Softwareblock_XIX_SAM.Geltungsbereich_E3_1_1_UNECE_Gen2.RP_IF_ZV_verriegelt_extern_soll_XIX_SC_708_IuALicht_MEB_XIX_Softwareblock_XIX_SAM.DE_ZV_verriegelt_extern_soll, system-signal=ZV_verriegelt_extern_soll
        communication-direction=IN, data-element=Grundumfang_XIX_SAM.Geltungsbereich_E3_1_1_UNECE_Gen2.RP_IF_ZV_verriegelt_intern_ist_XIX_Grundumfang_XIX_SAM.DE_ZV_verriegelt_intern_ist, system-signal=ZV_verriegelt_intern_ist
        communication-direction=IN, data-element=ZV_XIX_SAM.Geltungsbereich_E3_1_1_UNECE_Gen2.RP_IF_ZV_verriegelt_intern_soll_XIX_ZV_XIX_SAM.DE_ZV_verriegelt_intern_soll, system-signal=ZV_verriegelt_intern_soll
        communication-direction=IN, data-element=Grundumfang_XIX_SAM.Geltungsbereich_E3_1_1_UNECE_Gen2.RP_IF_ZV_zentral_entsafen_XIX_Grundumfang_XIX_SAM.DE_ZV_zentral_entsafen, system-signal=ZV_zentral_entsafen
        communication-direction=IN, data-element=Grundumfang_XIX_SAM.Geltungsbereich_E3_1_1_UNECE_Gen2.RP_IF_ZV_zentral_safen_XIX_Grundumfang_XIX_SAM.DE_ZV_zentral_safen, system-signal=ZV_zentral_safen
        communication-direction=IN, data-element=Grundumfang_XIX_SAM.Geltungsbereich_E3_1_1_UNECE_Gen2.RP_IF_ZV_zu_Funk_XIX_Grundumfang_XIX_SAM.DE_ZV_zu_Funk, system-signal=ZV_zu_Funk
        communication-direction=IN, data-element=Grundumfang_XIX_SAM.Geltungsbereich_E3_1_1_UNECE_Gen2.RP_IF_ZV_zu_Kessy_XIX_Grundumfang_XIX_SAM.DE_ZV_zu_Kessy, system-signal=ZV_zu_Kessy
      sw-mappings:
        13 x swc to ecu mapping, all with ecu-instance=SAM:
          MAPPING_ZV_XIX_SAM: component=Geltungsbereich_E3_1_1_UNECE_Gen2.ZV_XIX_SAM
          MAPPING_VKMS_XIX_SAM: component=Geltungsbereich_E3_1_1_UNECE_Gen2.VKMS_XIX_SAM
          MAPPING_VIP_XIX_SAM: component=Geltungsbereich_E3_1_1_UNECE_Gen2.VIP_XIX_SAM
          MAPPING_ABL_XIX_SAM: component=Geltungsbereich_E3_1_1_UNECE_Gen2.ABL_XIX_SAM
          MAPPING_Dimmung_XIX_SAM: component=Geltungsbereich_E3_1_1_UNECE_Gen2.Dimmung_XIX_SAM
          MAPPING_LWR_Auto_XIX_SAM: component=Geltungsbereich_E3_1_1_UNECE_Gen2.LWR_Auto_XIX_SAM
          MAPPING_SC_708_IuALicht_MEB_XIX_Softwareblock_XIX_SAM: component=Geltungsbereich_E3_1_1_UNECE_Gen2.SC_708_IuALicht_MEB_XIX_Softwareblock_XIX_SAM
          MAPPING_SC_447_FoD_Slave_4_XIX_Softwareblock_XIX_SAM: component=Geltungsbereich_E3_1_1_UNECE_Gen2.SC_447_FoD_Slave_4_XIX_Softwareblock_XIX_SAM
          MAPPING_Druckpunktmassage_fuer_Beifahrersitz_Lehnenmassage_SAM_XIX_DPMBFSLM_XIX_SAM: component=Geltungsbereich_E3_1_1_UNECE_Gen2.Druckpunktmassage_fuer_Beifahrersitz_Lehnenmassage_SAM_XIX_DPMBFSLM_XIX_SAM
          MAPPING_Druckpunktmassage_fuer_Fahrersitz_Lehnenmassage_SAM_XIX_DPMFSLM_XIX_SAM: component=Geltungsbereich_E3_1_1_UNECE_Gen2.Druckpunktmassage_fuer_Fahrersitz_Lehnenmassage_SAM_XIX_DPMFSLM_XIX_SAM
          MAPPING_SC_789_ExAmb_MEB_XIX_Softwareblock_XIX_SAM: component=Geltungsbereich_E3_1_1_UNECE_Gen2.SC_789_ExAmb_MEB_XIX_Softwareblock_XIX_SAM
          MAPPING_Basis_Klima_XIX_SAM: component=Geltungsbereich_E3_1_1_UNECE_Gen2.Basis_Klima_XIX_SAM
          MAPPING_Grundumfang_XIX_SAM: component=Geltungsbereich_E3_1_1_UNECE_Gen2.Grundumfang_XIX_SAM
    root-software-compositions:
      root sw composition prototype Geltungsbereich_E3_1_1_UNECE_Gen2: software-composition=Geltungsbereich_E3_1_1_UNECE_Gen2
package /ECU
  ecu instance SAM:
    associated-com-i-pdu-group=[SAM_XIX_E3V_CCAN_Rx, SAM_XIX_E3V_CCAN_Tx, SAM_XIX_E3V_K2CANFD_Rx, SAM_XIX_E3V_K2CANFD_Tx, SAM_XIX_E3V_SAM_LIN10_Rx, SAM_XIX_E3V_SAM_LIN10_Tx, SAM_XIX_E3V_SAM_LIN11_Rx, SAM_XIX_E3V_SAM_LIN11_Tx, SAM_XIX_E3V_SAM_LIN12_Rx, SAM_XIX_E3V_SAM_LIN12_Tx, SAM_XIX_E3V_SAM_LIN1_Rx, SAM_XIX_E3V_SAM_LIN1_Tx, SAM_XIX_E3V_SAM_LIN3_Rx, SAM_XIX_E3V_SAM_LIN3_Tx, SAM_XIX_E3V_SAM_LIN4_Rx, SAM_XIX_E3V_SAM_LIN4_Tx, SAM_XIX_E3V_SAM_LIN5_Rx, SAM_XIX_E3V_SAM_LIN5_Tx, SAM_XIX_E3V_SAM_LIN6_Rx, SAM_XIX_E3V_SAM_LIN6_Tx, SAM_XIX_E3V_SAM_LIN9_Rx, SAM_XIX_E3V_SAM_LIN9_Tx]
    diagnostic-address=9
    sleep-mode-supported=true
    wake-up-over-bus-supported=true
    lin master CT_E3V_SAM_LIN1: protocol-version=2.0, time-base=0.01, time-base-jitter=9.0E-4
    lin master CT_E3V_SAM_LIN6: protocol-version=2.0, time-base=0.01, time-base-jitter=9.0E-4
    can communication controller CT_E3V_CCAN: wake-up-by-controller-supported=true, can-controller-attributes=can-controller-configuration-requirements={max-number-of-time-quanta-per-bit=20, max-sample-point=84.0, max-sync-jump-width=20.0, min-number-of-time-quanta-per-bit=10, min-sample-point=80.0, min-sync-jump-width=20.0}
    5 x lin master, all with protocol-version=2.0, time-base=0.01, time-base-jitter=9.0E-4:
      CT_E3V_SAM_LIN3
      CT_E3V_SAM_LIN5
      CT_E3V_SAM_LIN{9..11}
    can communication controller CT_E3V_K2CANFD: wake-up-by-controller-supported=true, can-controller-attributes=can-controller-configuration-requirements={can-controller-fd-requirements={max-number-of-time-quanta-per-bit=20, max-sample-point=80.0, max-sync-jump-width=20.0, min-number-of-time-quanta-per-bit=20, min-sample-point=80.0, min-sync-jump-width=20.0, tx-bit-rate-switch=false}, max-number-of-time-quanta-per-bit=20, max-sample-point=80.0, max-sync-jump-width=20.0, min-number-of-time-quanta-per-bit=20, min-sample-point=80.0, min-sync-jump-width=20.0}
    lin master CT_E3V_SAM_LIN4: protocol-version=2.0, time-base=0.01, time-base-jitter=9.0E-4
    lin master CT_E3V_SAM_LIN12: protocol-version=2.0, time-base=0.01, time-base-jitter=9.0E-4
    lin communication connector CN_E3V_SAM_LIN1: comm-controller=CT_E3V_SAM_LIN1
    lin communication connector CN_E3V_SAM_LIN6: comm-controller=CT_E3V_SAM_LIN6
    can communication connector CN_E3V_CCAN: comm-controller=CT_E3V_CCAN, pnc-gateway-type=NONE
    lin communication connector CN_E3V_SAM_LIN3: comm-controller=CT_E3V_SAM_LIN3
    lin communication connector CN_E3V_SAM_LIN5: comm-controller=CT_E3V_SAM_LIN5
    lin communication connector CN_E3V_SAM_LIN{9..11}: comm-controller=CT_E3V_SAM_LIN{9..11}
    can communication connector CN_E3V_K2CANFD: comm-controller=CT_E3V_K2CANFD, pnc-gateway-type=NONE
    lin communication connector CN_E3V_SAM_LIN4: comm-controller=CT_E3V_SAM_LIN4
    lin communication connector CN_E3V_SAM_LIN12: comm-controller=CT_E3V_SAM_LIN12
