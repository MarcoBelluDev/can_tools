[part 18 of 22: packages /BaseType to /PhysicalDimension]
AUTOSAR XML (schema 4-3-0)
package /BaseType
  3235 x base type, all with category=FIXED_LENGTH:
    BT_AAG_Anhaenger_abgesteckt: base-type-encoding=NONE
    BT_AAG_Anhaenger_erkannt: base-type-encoding=NONE
    BT_AAG_AVS_Fehler_02: base-type-encoding=NONE
    BT_AAG_AVS_Fehler_02_inv: base-type-encoding=NONE
    BT_AAG_AVS_Stati: base-type-encoding=NONE
    BT_AAG_Blinker_H_aktiv: base-type-encoding=NONE
    BT_AAG_Blinker_HL_def: base-type-encoding=NONE
    BT_AAG_Blinker_HR_def: base-type-encoding=NONE
    BT_AAG_Bremsl_durch_ECD: base-type-encoding=NONE
    BT_AAG_Bremslicht_H_def: base-type-encoding=NONE
    BT_AAG_Bremslicht_Reku: base-type-encoding=NONE
    BT_AAG_BZ: base-type-encoding=NONE
    BT_AAG_LED_aktiv: base-type-encoding=NONE
    BT_AAG_NSL_aktiv: base-type-encoding=NONE
    BT_AAG_ORUData: base-type-encoding=NONE
    BT_AAG_ORUDataIndex: base-type-encoding=NONE
    BT_AAG_Schlusslicht_HL_def: base-type-encoding=NONE
    BT_AAG_Schlusslicht_HR_def: base-type-encoding=NONE
    BT_AB_Abschaltanf_SIH_BF: base-type-encoding=NONE
    BT_AB_Anforderung_eCall: base-type-encoding=NONE
    BT_AB_Anforderung_USM: base-type-encoding=NONE
    BT_AB_Anprall_FGS: base-type-encoding=NONE
    BT_AB_Anprall_Front_Beifahrer: base-type-encoding=NONE
    BT_AB_Anprall_Front_Fahrer: base-type-encoding=NONE
    BT_AB_Anprall_Seite_Beifahrer: base-type-encoding=NONE
    BT_AB_Anprall_Seite_Fahrer: base-type-encoding=NONE
    BT_AB_Anzeige_Fussg: base-type-encoding=NONE
    BT_AB_Belegung_VB: base-type-encoding=NONE
    BT_AB_Belegung_VF: base-type-encoding=NONE
    BT_AB_Crash_Int: base-type-encoding=NONE
    BT_AB_Crashschwere: base-type-encoding=NONE
    BT_AB_Deaktiviert: base-type-encoding=NONE
    BT_AB_Deaktivierung_HV: base-type-encoding=NONE
    BT_AB_Diagnose: base-type-encoding=NONE
    BT_AB_eCS_Error: base-type-encoding=NONE
    BT_AB_EDR_Trigger: base-type-encoding=NONE
    BT_AB_Erh_Auf_VB: base-type-encoding=NONE
    BT_AB_Front_Crash: base-type-encoding=NONE
    BT_AB_Gurtschloss_BF: base-type-encoding=NONE
    BT_AB_Gurtschloss_FA: base-type-encoding=NONE
    BT_AB_Gurtschloss_FA_ext: base-type-encoding=NONE
    BT_AB_Gurtschloss_FA_ext_aktiv: base-type-encoding=NONE
    BT_AB_Gurtschloss_Reihe2_BF: base-type-encoding=NONE
    BT_AB_Gurtschloss_Reihe2_FA: base-type-encoding=NONE
    BT_AB_Gurtschloss_Reihe2_MI: base-type-encoding=NONE
    BT_AB_Gurtschloss_Reihe3_BF: base-type-encoding=NONE
    BT_AB_Gurtschloss_Reihe3_FA: base-type-encoding=NONE
    BT_AB_Gurtschloss_Reihe3_MI: base-type-encoding=NONE
    BT_AB_Gurtwarn_VB: base-type-encoding=NONE
    BT_AB_Gurtwarn_VF: base-type-encoding=NONE
    BT_AB_Heck_Crash: base-type-encoding=NONE
    BT_AB_Lampe: base-type-encoding=NONE
    BT_AB_MKB_Anforderung: base-type-encoding=NONE
    BT_AB_MKB_gueltig: base-type-encoding=NONE
    BT_AB_PAO_Leuchte_Anf: base-type-encoding=NONE
    BT_AB_PSS_SollZustand: base-type-encoding=NONE
    BT_AB_RGS_Anst: base-type-encoding=NONE
    BT_AB_Rollover_Crash: base-type-encoding=NONE
    BT_AB_SB_Crash: base-type-encoding=NONE
    BT_AB_SF_Crash: base-type-encoding=NONE
    BT_AB_Sitzpos_Sens_BF: base-type-encoding=NONE
    BT_AB_Sitzpos_Sens_FA: base-type-encoding=NONE
    BT_AB_Stellgliedtest: base-type-encoding=NONE
    BT_AB_Systemfehler: base-type-encoding=NONE
    BT_AB_Texte_AKS: base-type-encoding=NONE
    BT_AB_VB_deaktiviert: base-type-encoding=NONE
    BT_AB_Versorgungsspannung: base-type-encoding=NONE
    BT_AB_Wickelklappung_Reihe2_BF: base-type-encoding=NONE
    BT_AB_Wickelklappung_Reihe2_FA: base-type-encoding=NONE
    BT_AB_Wickelklappung_Reihe2_MI: base-type-encoding=NONE
    BT_ABS_Bremsung: base-type-encoding=NONE
    BT_ABS_Lampe: base-type-encoding=NONE
    BT_ACF_Lampe_Hands_Off: base-type-encoding=NONE
    BT_ADecu1_01_BZ: base-type-encoding=NONE
    BT_ADecu1_01_CRC: base-type-encoding=NONE
    BT_ADecu1_ORUData: base-type-encoding=NONE
    BT_ADecu1_ORUDataIndex: base-type-encoding=NONE
    BT_ADecu2_01_BZ: base-type-encoding=NONE
    BT_ADecu2_01_CRC: base-type-encoding=NONE
    BT_ADecu2_ORUData: base-type-encoding=NONE
    BT_ADecu2_ORUDataIndex: base-type-encoding=NONE
    BT_AFS_Lampe: base-type-encoding=NONE
    BT_Airbag_01_BZ: base-type-encoding=NONE
    BT_Airbag_01_CRC: base-type-encoding=NONE
    BT_Airbag_02_alt: base-type-encoding=NONE
    BT_Airbag_02_BZ: base-type-encoding=NONE
    BT_Airbag_02_CRC: base-type-encoding=NONE
    BT_Airbag_ORUData: base-type-encoding=NONE
    BT_Airbag_ORUDataIndex: base-type-encoding=NONE
    BT_AMB_Charisma_FahrPr: base-type-encoding=NONE
    BT_AMB_Charisma_Status: base-type-encoding=NONE
    BT_AMBEX_CH_aktiv: base-type-encoding=NONE
    BT_AMBEX_CH_Trigger: base-type-encoding=NONE
    BT_Ambex_DLI_InszStatus: base-type-encoding=NONE
    BT_Ambex_DLI_Soll_Horizontal_L: base-type-encoding=NONE
    BT_Ambex_DLI_Soll_Horizontal_R: base-type-encoding=NONE
    BT_Ambex_DLI_Soll_Vertikal_L: base-type-encoding=NONE
    BT_Ambex_DLI_Soll_Vertikal_R: base-type-encoding=NONE
    BT_Ambex_KY_Anforderung_Zonenortung: base-type-encoding=NONE
    BT_AMBEX_LH_aktiv: base-type-encoding=NONE
    BT_AMBEX_LH_Trigger: base-type-encoding=NONE
    BT_Ambex_SAL_Abl_Vorne: base-type-encoding=NONE
    BT_Ambex_SAL_animprofil: base-type-encoding=NONE
    BT_Ambex_SAL_Bgr_Vorne: base-type-encoding=NONE
    BT_Ambex_SAL_Design1: base-type-encoding=NONE
    BT_AMBEX_SAL_Design10_L: base-type-encoding=NONE
    BT_AMBEX_SAL_Design10_R: base-type-encoding=NONE
    BT_AMBEX_SAL_Design11_L: base-type-encoding=NONE
    BT_AMBEX_SAL_Design11_R: base-type-encoding=NONE
    BT_AMBEX_SAL_Design12_L: base-type-encoding=NONE
    BT_AMBEX_SAL_Design12_R: base-type-encoding=NONE
    BT_Ambex_SAL_Design2: base-type-encoding=NONE
    BT_AMBEX_SAL_Design{3..9}: base-type-encoding=NONE
    BT_Ambex_SAL_Kzl: base-type-encoding=NONE
    BT_Ambex_SAL_Schlusslicht: base-type-encoding=NONE
    BT_Anlernen_LLR_li: base-type-encoding=NONE
    BT_Anlernen_LLR_re: base-type-encoding=NONE
    BT_APP_Kundenwarnung_Panik: base-type-encoding=NONE
    BT_APS_Taster: base-type-encoding=NONE
    BT_APS_Tongeber_defekt: base-type-encoding=NONE
    BT_ASM_Masterzeit_02: base-type-encoding=NONE
    BT_ASR_Anf: base-type-encoding=NONE
    BT_ASR_Schalteingriff: base-type-encoding=NONE
    BT_ASR_Systemstatus: base-type-encoding=NONE
    BT_ASR_Tastung_passiv: base-type-encoding=NONE
    BT_ASW_HMI_defekt: base-type-encoding=NONE
    BT_ASW_wakeup: base-type-encoding=NONE
    BT_ASW_Warnung_aktiv_BFS: base-type-encoding=NONE
    BT_ASW_Warnung_aktiv_FS: base-type-encoding=NONE
    BT_ASW_Warnung_aktiv_HBFS: base-type-encoding=NONE
    BT_ASW_Warnung_aktiv_HFS: base-type-encoding=NONE
    BT_Aussentemp_gef: base-type-encoding=NONE
    BT_BAPe_Data_Byte_{1..6}: base-type-encoding=NONE
    BT_BAPe_FCT_ID: base-type-encoding=NONE
    BT_BAPe_LSG_ID1: base-type-encoding=NONE
    BT_BAPe_LSG_ID2: base-type-encoding=NONE
    BT_BAPe_Opcode: base-type-encoding=NONE
    BT_BAPe_Segment: base-type-encoding=NONE
    BT_BAPs_Data_Byte_{1..6}: base-type-encoding=NONE
    BT_BAPs_FCT_ID: base-type-encoding=NONE
    BT_BAPs_LSG_ID1: base-type-encoding=NONE
    BT_BAPs_LSG_ID2: base-type-encoding=NONE
    BT_BAPs_Opcode: base-type-encoding=NONE
    BT_BAPs_Segment: base-type-encoding=NONE
    BT_bCall_active: base-type-encoding=NONE
    BT_BCM1_Abblendlicht_Anf: base-type-encoding=NONE
    BT_BCM1_Abschaltstufe: base-type-encoding=NONE
    BT_BCM1_Adaptive_Lichtvert_Anf: base-type-encoding=NONE
    BT_BCM1_AFS_Lampe: base-type-encoding=NONE
    BT_BCM1_Allwetterlicht_Anf: base-type-encoding=NONE
    BT_BCM1_Aussen_Temp_ungef: base-type-encoding=NONE
    BT_BCM1_Autobahnlicht_Anf: base-type-encoding=NONE
    BT_BCM1_CH_aktiv: base-type-encoding=NONE
    BT_BCM1_CH_LH_aktiv: base-type-encoding=NONE
    BT_BCM1_DI_Rampe_Innenlicht: base-type-encoding=NONE
    BT_BCM1_DI_Rampe_Leselicht: base-type-encoding=NONE
    BT_BCM1_EasyEntry_Status: base-type-encoding=NONE
    BT_BCM1_Fahrlicht_Hinweis: base-type-encoding=NONE
    BT_BCM1_Fernlicht_Anf: base-type-encoding=NONE
    BT_BCM1_FStatus_Aussentemp_ungef: base-type-encoding=NONE
    BT_BCM1_Gleitende_Leuchtw_Anf: base-type-encoding=NONE
    BT_BCM1_GLW_Fernlicht_Anf: base-type-encoding=NONE
    BT_BCM1_Hinweis_Lichtnachlauf: base-type-encoding=NONE
    BT_BCM1_Innenlicht_gedimmt_H: base-type-encoding=NONE
    BT_BCM1_Innenlicht_gedimmt_V: base-type-encoding=NONE
    BT_BCM1_Innenlicht_H: base-type-encoding=NONE
    BT_BCM1_Innenlicht_V: base-type-encoding=NONE
    BT_BCM1_KD_Fehler: base-type-encoding=NONE
    BT_BCM1_Kl_15_HW_erkannt: base-type-encoding=NONE
    BT_BCM1_Kl_15_Sig_HW_erkannt: base-type-encoding=NONE
    BT_BCM1_Kompressorstrom_ist: base-type-encoding=NONE
    BT_BCM1_KompSchutz: base-type-encoding=NONE
    BT_BCM1_Kurvenlicht_links_Anf: base-type-encoding=NONE
    BT_BCM1_Kurvenlicht_rechts_Anf: base-type-encoding=NONE
    BT_BCM1_Lenksaeule_aktiv: base-type-encoding=NONE
    BT_BCM1_Leselicht_Anf_hl: base-type-encoding=NONE
    BT_BCM1_Leselicht_Anf_hr: base-type-encoding=NONE
    BT_BCM1_Leselicht_Anf_vl: base-type-encoding=NONE
    BT_BCM1_Leselicht_Anf_vr: base-type-encoding=NONE
    BT_BCM1_Leuchten_Aus: base-type-encoding=NONE
    BT_BCM1_LH_aktiv: base-type-encoding=NONE
    BT_BCM1_Licht_Dunkelheit_aktiv: base-type-encoding=NONE
    BT_BCM1_Lichtwarn_Texte: base-type-encoding=NONE
    BT_BCM1_MH_Schalter: base-type-encoding=NONE
    BT_BCM1_MH_WIV_Schalter: base-type-encoding=NONE
    BT_BCM1_Nachlauftyp: base-type-encoding=NONE
    BT_BCM1_Nebellicht_Anf: base-type-encoding=NONE
    BT_BCM1_Nebelschluss_Ahg_Anf: base-type-encoding=NONE
    BT_BCM1_Nebelschluss_Fzg_Anf: base-type-encoding=NONE
    BT_BCM1_NV_Taster: base-type-encoding=NONE
    BT_BCM1_OBD_FStatus_ATemp: base-type-encoding=NONE
    BT_BCM1_Parklicht_li_Anf: base-type-encoding=NONE
    BT_BCM1_Parklicht_re_Anf: base-type-encoding=NONE
    BT_BCM1_PTC_stufig_Status: base-type-encoding=NONE
    BT_BCM1_Regenlicht_Anf: base-type-encoding=NONE
    BT_BCM1_Reisemodus_Texte: base-type-encoding=NONE
    BT_BCM1_Rueckfahrlicht_Schalter: base-type-encoding=NONE
    BT_BCM1_Schlusslicht_Anf: base-type-encoding=NONE
    BT_BCM1_Signaturlicht_Anf: base-type-encoding=NONE
    BT_BCM1_Spannungs_Anf: base-type-encoding=NONE
    BT_BCM1_SRA_aktiv: base-type-encoding=NONE
    BT_BCM1_Standlicht_Anf: base-type-encoding=NONE
    BT_BCM1_Stellgroesse_Kl_58s: base-type-encoding=NONE
    BT_BCM1_Tagfahrlicht_Anf: base-type-encoding=NONE
    BT_BCM1_Touristen_Licht_Anf: base-type-encoding=NONE
    BT_BCM1_Transport_Mode: base-type-encoding=NONE
    BT_BCM1_Umfeldleuchten_Anf: base-type-encoding=NONE
    BT_BCM1_Valet_Parking_Taster: base-type-encoding=NONE
    BT_BCM1_Warnblink_Taster: base-type-encoding=NONE
    BT_BCM2_Bremsl_durch_ECD: base-type-encoding=NONE
    BT_BCM_01_BZ: base-type-encoding=NONE
    BT_BCM_01_CRC: base-type-encoding=NONE
    BT_BCM_Anf_AAW_MoLaWa: base-type-encoding=NONE
    BT_BCM_BF_Spg_Absenkung: base-type-encoding=NONE
    BT_BCM_BFS_aktive_MuFu_Fkt: base-type-encoding=NONE
    BT_BCM_BFS_Fernsteuerung_aktiv: base-type-encoding=NONE
    BT_BCM_BFS_Lordose_ab: base-type-encoding=NONE
    BT_BCM_BFS_Lordose_auf: base-type-encoding=NONE
    BT_BCM_BFS_Lordose_vor: base-type-encoding=NONE
    BT_BCM_BFS_Lordose_zurueck: base-type-encoding=NONE
    BT_BCM_BFS_Massage_Dauer: base-type-encoding=NONE
    BT_BCM_BFS_Massage_Intens_Lehne: base-type-encoding=NONE
    BT_BCM_BFS_Massage_Intens_Sitz: base-type-encoding=NONE
    BT_BCM_BFS_Massage_Intensitaet: base-type-encoding=NONE
    BT_BCM_BFS_Massage_Prg: base-type-encoding=NONE
    BT_BCM_BFS_Massage_Prg_erweitert: base-type-encoding=NONE
    BT_BCM_BFS_Massage_Taster: base-type-encoding=NONE
    BT_BCM_BFS_Memory_Abbruch: base-type-encoding=NONE
    BT_BCM_BFS_Memory_Pos: base-type-encoding=NONE
    BT_BCM_BFS_Memory_Save_Recall: base-type-encoding=NONE
    BT_BCM_BFS_MSG_Status: base-type-encoding=NONE
    BT_BCM_BFS_Multif_Taster: base-type-encoding=NONE
    BT_BCM_BFS_Pneumatik_Verstellung: base-type-encoding=NONE
    BT_BCM_BFS_PreCrash: base-type-encoding=NONE
    BT_BCM_BFS_Programmwippe: base-type-encoding=NONE
    BT_BCM_BFS_SW_eng: base-type-encoding=NONE
    BT_BCM_BFS_SW_weit: base-type-encoding=NONE
    BT_BCM_BFS_Wellness_Status: base-type-encoding=NONE
    BT_BCM_BFT_geoeffnet_plaus: base-type-encoding=NONE
    BT_BCM_Bremsbelag_Sensor: base-type-encoding=NONE
    BT_BCM_Bremsbelag_Sensor_CND: base-type-encoding=NONE
    BT_BCM_Bremsbelag_Sensor_NAR: base-type-encoding=NONE
    BT_BCM_Bremsbelag_Sensor_Rdw: base-type-encoding=NONE
    BT_BCM_Bremsfluessigkeit_Sensor: base-type-encoding=NONE
    BT_BCM_Charisma_Taste2: base-type-encoding=NONE
    BT_BCM_Drehwinkel_HL: base-type-encoding=NONE
    BT_BCM_Drehwinkel_HR: base-type-encoding=NONE
    BT_BCM_Drehwinkel_VL: base-type-encoding=NONE
    BT_BCM_Drehwinkel_VR: base-type-encoding=NONE
    BT_BCM_Drehwinkelsensortausch_HL: base-type-encoding=NONE
    BT_BCM_Drehwinkelsensortausch_HR: base-type-encoding=NONE
    BT_BCM_Drehwinkelsensortausch_VL: base-type-encoding=NONE
    BT_BCM_Drehwinkelsensortausch_VR: base-type-encoding=NONE
    BT_BCM_Eco_Charisma_Taste: base-type-encoding=NONE
    BT_BCM_Fehlerspeicher_loeschen: base-type-encoding=NONE
    BT_BCM_FH_Freigabe: base-type-encoding=NONE
    BT_BCM_FS_aktive_MuFu_Fkt: base-type-encoding=NONE
    BT_BCM_FS_Lordose_ab: base-type-encoding=NONE
    BT_BCM_FS_Lordose_auf: base-type-encoding=NONE
    BT_BCM_FS_Lordose_vor: base-type-encoding=NONE
    BT_BCM_FS_Lordose_zurueck: base-type-encoding=NONE
    BT_BCM_FS_Massage_Dauer: base-type-encoding=NONE
    BT_BCM_FS_Massage_Intens_Lehne: base-type-encoding=NONE
    BT_BCM_FS_Massage_Intens_Sitz: base-type-encoding=NONE
    BT_BCM_FS_Massage_Intensitaet: base-type-encoding=NONE
    BT_BCM_FS_Massage_Prg: base-type-encoding=NONE
    BT_BCM_FS_Massage_Prg_erweitert: base-type-encoding=NONE
    BT_BCM_FS_Massage_Taster: base-type-encoding=NONE
    BT_BCM_FS_Memory_Abbruch: base-type-encoding=NONE
    BT_BCM_FS_Memory_Pos: base-type-encoding=NONE
    BT_BCM_FS_Memory_Save_Recall: base-type-encoding=NONE
    BT_BCM_FS_MSG_Status: base-type-encoding=NONE
    BT_BCM_FS_Multif_Taster: base-type-encoding=NONE
    BT_BCM_FS_Pneumatik_Verstellung: base-type-encoding=NONE
    BT_BCM_FS_PreCrash: base-type-encoding=NONE
    BT_BCM_FS_Programmwippe: base-type-encoding=NONE
    BT_BCM_FS_SW_eng: base-type-encoding=NONE
    BT_BCM_FS_SW_weit: base-type-encoding=NONE
    BT_BCM_FS_Wellness_Status: base-type-encoding=NONE
    BT_BCM_FT_geoeffnet_plaus: base-type-encoding=NONE
    BT_BCM_Handbremse_Hinweis: base-type-encoding=NONE
    BT_BCM_HDF_betaetigt: base-type-encoding=NONE
    BT_BCM_Heizungsabsperrventil_Status: base-type-encoding=NONE
    BT_BCM_Heizungspumpe_Status: base-type-encoding=NONE
    BT_BCM_HSK_Freigabe: base-type-encoding=NONE
    BT_BCM_Hybrid_StartStopp_Taste: base-type-encoding=NONE
    BT_BCM_Hybrid_StSt_Taste_Fehler: base-type-encoding=NONE
    BT_BCM_Kennung_RL_Fzg: base-type-encoding=NONE
    BT_BCM_KiSi_Umschalt_gesperrt: base-type-encoding=NONE
    BT_BCM_Komfortfkt_Freigabe: base-type-encoding=NONE
    BT_BCM_Kompressorkupplung_Status: base-type-encoding=NONE
    BT_BCM_Kuehlmittel_Sensor: base-type-encoding=NONE
    BT_BCM_Kuehlmittel_Sensor_02: base-type-encoding=NONE
    BT_BCM_LINDa_Toggle: base-type-encoding=NONE
    BT_BCM_LRH_Taster: base-type-encoding=NONE
    BT_BCM_Offroad_Taste: base-type-encoding=NONE
    BT_BCM_P_Mode_aktiv: base-type-encoding=NONE
    BT_BCM_P_Mode_FH_Kl15_aus_aktiv: base-type-encoding=NONE
    BT_BCM_P_Mode_FH_Reversierschwelle: base-type-encoding=NONE
    BT_BCM_RACE_Mode_aktiv: base-type-encoding=NONE
    BT_BCM_Relais_2_Batterie: base-type-encoding=NONE
    BT_BCM_RGB_Adressierungsart: base-type-encoding=NONE
    BT_BCM_RGB_Bewertung_Dimmzeit: base-type-encoding=NONE
    BT_BCM_RGB_Blau: base-type-encoding=NONE
    BT_BCM_RGB_Dimmrampe: base-type-encoding=NONE
    BT_BCM_RGB_Dimmzeit_Zeitbasis: base-type-encoding=NONE
    BT_BCM_RGB_Gruen: base-type-encoding=NONE
    BT_BCM_RGB_Gueltigkeit: base-type-encoding=NONE
    BT_BCM_RGB_Intensitaet: base-type-encoding=NONE
    BT_BCM_RGB_Normierung_Intensitaet: base-type-encoding=NONE
    BT_BCM_RGB_Rot: base-type-encoding=NONE
    BT_BCM_RGB_Slave_Adresse: base-type-encoding=NONE
    BT_BCM_RGB_Sonderfunktion: base-type-encoding=NONE
    BT_BCM_Rueckfahrlicht_Anf: base-type-encoding=NONE
    BT_BCM_SBE: base-type-encoding=NONE
    BT_BCM_SGT_Pumpe_BFS: base-type-encoding=NONE
    BT_BCM_SGT_Pumpe_FS: base-type-encoding=NONE
    BT_BCM_Spg_Synchron: base-type-encoding=NONE
    BT_BCM_SPR_Nachregelung_Freigabe: base-type-encoding=NONE
    BT_BCM_Systemfunkionstest_BFS: base-type-encoding=NONE
    BT_BCM_Systemfunkionstest_FS: base-type-encoding=NONE
    BT_BCM_Tankklappensteller_Fehler: base-type-encoding=NONE
    BT_BCM_ValetTaster_Fkts_LED: base-type-encoding=NONE
    BT_BCM_Verdeck_Freigabe: base-type-encoding=NONE
    BT_BCM_Waehlhebel_P_Hinweis: base-type-encoding=NONE
    BT_BCM_Waschwasser_Sensor: base-type-encoding=NONE
    BT_BCM_Wischer_Parklage: base-type-encoding=NONE
    BT_Bel_DiETa_Car: base-type-encoding=NONE
    BT_Bel_DiETa_Lock_Unlock: base-type-encoding=NONE
    BT_Bel_DiETa_Mode: base-type-encoding=NONE
    BT_Bel_DiETa_Parken: base-type-encoding=NONE
    BT_Bel_DiETa_Warnblinken: base-type-encoding=NONE
    BT_Bel_LiSi_Defrost: base-type-encoding=NONE
    BT_Bel_LiSi_FSH: base-type-encoding=NONE
    BT_Bel_LiSi_HSH: base-type-encoding=NONE
    BT_Bel_LTM_Auto: base-type-encoding=NONE
    BT_Bel_LTM_Fahrlicht: base-type-encoding=NONE
    BT_Bel_LTM_Nebellicht: base-type-encoding=NONE
    BT_Bel_LTM_Nebelschlusslicht: base-type-encoding=NONE
    BT_Bel_LTM_Standlicht: base-type-encoding=NONE
    BT_Bel_LTM_Tagfahrlicht: base-type-encoding=NONE
    BT_BEM_02_Abschaltstufen: base-type-encoding=NONE
    BT_BEM_Anf_KL15_schalten: base-type-encoding=NONE
    BT_BEM_Batt_Ab: base-type-encoding=NONE
    BT_BEM_Batteriediagnose: base-type-encoding=NONE
    BT_BEM_DFM: base-type-encoding=NONE
    BT_BEM_EMLIN_ungueltig: base-type-encoding=NONE
    BT_BEM_Generatordiagnose: base-type-encoding=NONE
    BT_BEM_HL_Kontingentierung: base-type-encoding=NONE
    BT_BEM_HL_Regelung_Status: base-type-encoding=NONE
    BT_BEM_Ladezustand: base-type-encoding=NONE
    BT_BEM_MMI_Vorwarnung: base-type-encoding=NONE
    BT_BEM_Red_Innengeblaese: base-type-encoding=NONE
    BT_BEM_REK_aktiv: base-type-encoding=NONE
    BT_BEM_STH_Einschaltverbot: base-type-encoding=NONE
    BT_BEM_STH_Zielzeit: base-type-encoding=NONE
    BT_BEM_UBDM: base-type-encoding=NONE
    BT_BEM_UGenSoll: base-type-encoding=NONE
    BT_BFS_Fond_Bed_Ack: base-type-encoding=NONE
    BT_BFS_FSV_ausgeklappt: base-type-encoding=NONE
    BT_BFS_GHV_aktiv: base-type-encoding=NONE
    BT_BFS_Gurtbringer_Sperre: base-type-encoding=NONE
    BT_BFS_Klapptisch_offen: base-type-encoding=NONE
    BT_BFS_KSS_Fahrt_aktiv: base-type-encoding=NONE
    BT_BFS_KSV_aktiv: base-type-encoding=NONE
    BT_BFS_Lehne_nicht_verriegelt: base-type-encoding=NONE
    BT_BFS_LHV_aktiv: base-type-encoding=NONE
    BT_BFS_LKV_aktiv: base-type-encoding=NONE
    BT_BFS_LNV_aktiv: base-type-encoding=NONE
    BT_BFS_LWV_aktiv: base-type-encoding=NONE
    BT_BFS_MMB_glob_stop: base-type-encoding=NONE
    BT_BFS_MMB_lokal_Stop: base-type-encoding=NONE
    BT_BFS_MMB_storage: base-type-encoding=NONE
    BT_BFS_MMB_storage_beep: base-type-encoding=NONE
    BT_BFS_MMB_store: base-type-encoding=NONE
    BT_BFS_MMB_store_LED_on: base-type-encoding=NONE
    BT_BFS_MMB_tast: base-type-encoding=NONE
    BT_BFS_MMB_tipp: base-type-encoding=NONE
    BT_BFS_Ruhestellung_Status: base-type-encoding=NONE
    BT_BFS_Seat_Locked: base-type-encoding=NONE
    BT_BFS_SHV_aktiv: base-type-encoding=NONE
    BT_BFS_Sitzfahrt_aktiv: base-type-encoding=NONE
    BT_BFS_Sitzsym_Fahrt_aktiv: base-type-encoding=NONE
    BT_BFS_SLV_aktiv: base-type-encoding=NONE
    BT_BFS_SNV_aktiv: base-type-encoding=NONE
    BT_BFS_Status_eTAG: base-type-encoding=NONE
    BT_BFS_STV_aktiv: base-type-encoding=NONE
    BT_BH_Blinker_Fehler: base-type-encoding=NONE
    BT_BH_Blinker_li: base-type-encoding=NONE
    BT_BH_Blinker_li_invers: base-type-encoding=NONE
    BT_BH_Blinker_re: base-type-encoding=NONE
    BT_BH_Blinker_re_invers: base-type-encoding=NONE
    BT_BH_Fernlicht: base-type-encoding=NONE
    BT_BH_Lichthupe: base-type-encoding=NONE
    BT_BK_Lampe_02: base-type-encoding=NONE
    BT_Blinken_li_Fzg_Takt: base-type-encoding=NONE
    BT_Blinken_li_Kombi_Takt: base-type-encoding=NONE
    BT_Blinken_re_Fzg_Takt: base-type-encoding=NONE
    BT_Blinken_re_Kombi_Takt: base-type-encoding=NONE
    BT_Blinkmodi_02_BZ: base-type-encoding=NONE
    BT_Blinkmodi_02_CRC: base-type-encoding=NONE
    BT_BM_Autobahn: base-type-encoding=NONE
    BT_BM_Crash: base-type-encoding=NONE
    BT_BM_DWA_Alarm: base-type-encoding=NONE
    BT_BM_DWA_ein: base-type-encoding=NONE
    BT_BM_GDO: base-type-encoding=NONE
    BT_BM_HD_Oeffnung_angelernt: base-type-encoding=NONE
    BT_BM_links: base-type-encoding=NONE
    BT_BM_NBA_n_codiert_n_aktiv: base-type-encoding=NONE
    BT_BM_NBA_Status: base-type-encoding=NONE
    BT_BM_Not_Bremsung: base-type-encoding=NONE
    BT_BM_Panik: base-type-encoding=NONE
    BT_BM_PiloPa: base-type-encoding=NONE
    BT_BM_Recas: base-type-encoding=NONE
    BT_BM_rechts: base-type-encoding=NONE
    BT_BM_Rollenmodus_Blinken: base-type-encoding=NONE
    BT_BM_Taxi_Notalarm: base-type-encoding=NONE
    BT_BM_Telematik: base-type-encoding=NONE
    BT_BM_Telematik_Abbruchgrund: base-type-encoding=NONE
    BT_BM_Warnblinken: base-type-encoding=NONE
    BT_BM_WBT_Beleuchtung: base-type-encoding=NONE
    BT_BM_Wischblinken: base-type-encoding=NONE
    BT_BM_ZV_auf: base-type-encoding=NONE
    BT_BM_ZV_zu: base-type-encoding=NONE
    BT_BMCe_ORUData: base-type-encoding=NONE
    BT_BMCe_ORUDataIndex: base-type-encoding=NONE
    BT_BMS_07_BZ: base-type-encoding=NONE
    BT_BMS_07_CRC: base-type-encoding=NONE
    BT_BMS_Ausgleichsladung_Anf: base-type-encoding=NONE
    BT_BMS_Balancing_Aktiv: base-type-encoding=NONE
    BT_BMS_Batteriediagnose: base-type-encoding=NONE
    BT_BMS_Energieinhalt: base-type-encoding=NONE
    BT_BMS_Gesamtst_Spgfreiheit: base-type-encoding=NONE
    BT_BMS_KundenWarnung: base-type-encoding=NONE
    BT_BMS_Ladevorgang_aktiv: base-type-encoding=NONE
    BT_BMS_MaxEnergieinhalt: base-type-encoding=NONE
    BT_BMS_RIso_Ext: base-type-encoding=NONE
    BT_BR_Eingriffsmoment: base-type-encoding=NONE
    BT_BRL_Bremslicht_Schalter: base-type-encoding=NONE
    BT_BT_ASW_HMI_defekt: base-type-encoding=NONE
    BT_BT_EC_Spiegel_Helligkeit: base-type-encoding=NONE
    BT_BT_FH_Bew_hoch: base-type-encoding=NONE
    BT_BT_FH_Bew_tief: base-type-encoding=NONE
    BT_BT_FH_Block: base-type-encoding=NONE
    BT_BT_FH_Fang: base-type-encoding=NONE
    BT_BT_FH_normiert: base-type-encoding=NONE
    BT_BT_FH_Oeffnung: base-type-encoding=NONE
    BT_BT_FH_Pos_oben: base-type-encoding=NONE
    BT_BT_FH_S_AutoHoch: base-type-encoding=NONE
    BT_BT_FH_S_AutoTief: base-type-encoding=NONE
    BT_BT_FH_S_ManHoch: base-type-encoding=NONE
    BT_BT_FH_S_ManTief: base-type-encoding=NONE
    BT_BT_FH_Thermo: base-type-encoding=NONE
    BT_BT_gesafet: base-type-encoding=NONE
    BT_BT_Kisi_Fehler: base-type-encoding=NONE
    BT_BT_Lock_Taster: base-type-encoding=NONE
    BT_BT_Lock_Taster_inv: base-type-encoding=NONE
    BT_BT_Lock_Unlock_Taster: base-type-encoding=NONE
    BT_BT_Oben_Block_erw: base-type-encoding=NONE
    BT_BT_Schliesstaster: base-type-encoding=NONE
    BT_BT_Schluesselschalter_auf: base-type-encoding=NONE
    BT_BT_Schluesselschalter_zu: base-type-encoding=NONE
    BT_BT_Schluesselschalter_zu_inv: base-type-encoding=NONE
    BT_BT_SP_ausgerastet: base-type-encoding=NONE
    BT_BT_Sp_Blk_def: base-type-encoding=NONE
    BT_BT_SP_Heizung_aktiv: base-type-encoding=NONE
    BT_BT_Sp_Heizung_Anf: base-type-encoding=NONE
    BT_BT_SP_Heizung_Status: base-type-encoding=NONE
    BT_BT_SP_ht_aktiv: base-type-encoding=NONE
    BT_BT_SP_lr_aktiv: base-type-encoding=NONE
    BT_BT_Sperrklinke: base-type-encoding=NONE
    BT_BT_SWA_HMI_defekt: base-type-encoding=NONE
    BT_BT_TAG_betaetigt: base-type-encoding=NONE
    BT_BT_TCR_Mode_aktiv: base-type-encoding=NONE
    BT_BT_TIG_betaetigt: base-type-encoding=NONE
    BT_BT_TSG_hinten_verbaut: base-type-encoding=NONE
    BT_BT_Tuer_geoeffnet: base-type-encoding=NONE
    BT_BT_Tuer_Status: base-type-encoding=NONE
    BT_BT_Tuer_Status_QBit: base-type-encoding=NONE
    BT_BT_Tueroeffnen_Warnung: base-type-encoding=NONE
    BT_BT_Tuerschloss_defekt: base-type-encoding=NONE
    BT_BT_UEKB_aktiviert: base-type-encoding=NONE
    BT_BT_Unlock_Taster: base-type-encoding=NONE
    BT_BT_Unten_Block_erw: base-type-encoding=NONE
    BT_BT_verriegelt: base-type-encoding=NONE
    BT_BT_Zuziehhilfe_aktiv: base-type-encoding=NONE
    BT_CentralLocking_01_BZ: base-type-encoding=NONE
    BT_CentralLocking_01_CRC: base-type-encoding=NONE
    BT_CHA_Charisma_Taste2_LED: base-type-encoding=NONE
    BT_CHA_Current_Mode: base-type-encoding=NONE
    BT_CHA_Current_Mode_FPA: base-type-encoding=NONE
    BT_CHA_Eco_Charisma_LED: base-type-encoding=NONE
    BT_CHA_EV_LED: base-type-encoding=NONE
    BT_CHA_Fahrer_Umschaltung: base-type-encoding=NONE
    BT_CHA_Kombi_Texte: base-type-encoding=NONE
    BT_CHA_Kombi_Texte_02: base-type-encoding=NONE
    BT_CHA_ReqPrgDispSetup: base-type-encoding=NONE
    BT_CHA_StCurProfDft: base-type-encoding=NONE
    BT_CHA_Ziel_FahrPr_03_01: base-type-encoding=NONE
    BT_CHA_Ziel_FahrPr_03_02: base-type-encoding=NONE
    BT_CHA_Ziel_FahrPr_AMB: base-type-encoding=NONE
    BT_CHA_Ziel_FahrPr_HSP: base-type-encoding=NONE
    BT_CHA_Ziel_FahrPr_HVBatt: base-type-encoding=NONE
    BT_CHA_Ziel_FahrPr_IVB: base-type-encoding=NONE
    BT_CHA_Ziel_FahrPr_KL: base-type-encoding=NONE
    BT_CHA_Ziel_FahrPr_RWB: base-type-encoding=NONE
    BT_CPD_Deaktivierung_Permanent: base-type-encoding=NONE
    BT_CPD_Deaktivierung_Temp: base-type-encoding=NONE
    BT_CPDFct_FlashAndHonk: base-type-encoding=NONE
    BT_CPDFct_Symbol: base-type-encoding=NONE
    BT_DCDC_HR_ORUData: base-type-encoding=NONE
    BT_DCDC_HR_ORUDataIndex: base-type-encoding=NONE
    BT_DCDC_NV_ORUDataIndex: base-type-encoding=NONE
    BT_DCDC_ORUData: base-type-encoding=NONE
    BT_Deaktivierung_RS: base-type-encoding=NONE
    BT_DGN_Verlernzaehler: base-type-encoding=NONE
    BT_DI_Display_Nachtdesign: base-type-encoding=NONE
    BT_DI_Fotosensor: base-type-encoding=NONE
    BT_DI_KL_58xd: base-type-encoding=NONE
    BT_DI_KL_58xs: base-type-encoding=NONE
    BT_DI_KL_58xt: base-type-encoding=NONE
    BT_DiETa_Car: base-type-encoding=NONE
    BT_DiETa_Defrost_Taste: base-type-encoding=NONE
    BT_DiETa_FAS_Stufe: base-type-encoding=NONE
    BT_DiETa_FSH_Taste: base-type-encoding=NONE
    BT_DiETa_HSH_Taste: base-type-encoding=NONE
    BT_DiETa_Klima: base-type-encoding=NONE
    BT_DiETa_Lock_Unlock_Taste: base-type-encoding=NONE
    BT_DiETa_Mode: base-type-encoding=NONE
    BT_DiETa_Mode2: base-type-encoding=NONE
    BT_DiETa_Mode_roh: base-type-encoding=NONE
    BT_DiETa_PAO_OFF_Status: base-type-encoding=NONE
    BT_DiETa_PAO_ON_Status: base-type-encoding=NONE
    BT_DiETa_Parken: base-type-encoding=NONE
    BT_DiETa_Reserve_Byte2_4: base-type-encoding=NONE
    BT_DiETa_Reserve_Byte6_6: base-type-encoding=NONE
    BT_DiETa_Reserve_Byte7_4: base-type-encoding=NONE
    BT_DiETa_Reserve_Byte8: base-type-encoding=NONE
    BT_DiETa_ResponseError: base-type-encoding=NONE
    BT_DiETa_Status: base-type-encoding=NONE
    BT_DiETa_Touch_Event: base-type-encoding=NONE
    BT_DiETa_Warnblink_Taste: base-type-encoding=NONE
    BT_DiETas_01_BZ: base-type-encoding=NONE
    BT_DiETas_01_CRC: base-type-encoding=NONE
    BT_DLI_Ambex_RefStatus: base-type-encoding=NONE
    BT_DRB1_01_BZ: base-type-encoding=NONE
    BT_DRB1_01_CRC: base-type-encoding=NONE
    BT_DRB1_ORUData: base-type-encoding=NONE
    BT_DRB1_ORUDataIndex: base-type-encoding=NONE
    BT_DRB2_01_BZ: base-type-encoding=NONE
    BT_DRB2_01_CRC: base-type-encoding=NONE
    BT_DRB2_ORUData: base-type-encoding=NONE
    BT_DRB2_ORUDataIndex: base-type-encoding=NONE
    BT_DWA_aktiv: base-type-encoding=NONE
    BT_DWA_Alarmquelle: base-type-encoding=NONE
    BT_DWA_Alarmquelle_02: base-type-encoding=NONE
    BT_EA_02_BZ: base-type-encoding=NONE
    BT_EA_02_CRC: base-type-encoding=NONE
    BT_EA_Blinken: base-type-encoding=NONE
    BT_EA_Bremslichtblinken: base-type-encoding=NONE
    BT_EA_eCall_Anf: base-type-encoding=NONE
    BT_EA_Fahrzeughupe_Anf: base-type-encoding=NONE
    BT_EA_Infotainment_Anf: base-type-encoding=NONE
    BT_EA_Innenraumlicht_Anf: base-type-encoding=NONE
    BT_EA_Status_HMI: base-type-encoding=NONE
    BT_EA_Texte: base-type-encoding=NONE
    BT_EA_Tueren_Anf: base-type-encoding=NONE
    BT_EA_Warnlevel: base-type-encoding=NONE
    BT_EBKV_2Box_ORUDataIndex: base-type-encoding=NONE
    BT_EBKV_ORUData: base-type-encoding=NONE
    BT_EBV_Eingriff: base-type-encoding=NONE
    BT_eCall_Funktionsstatus: base-type-encoding=NONE
    BT_eCall_Funktionsstatus_02: base-type-encoding=NONE
    BT_eCall_Mute_Anf: base-type-encoding=NONE
    BT_ECD_Bremslicht: base-type-encoding=NONE
    BT_ECD_Fehler: base-type-encoding=NONE
    BT_ECD_nicht_verfuegbar: base-type-encoding=NONE
    BT_EDS_Eingriff: base-type-encoding=NONE
    BT_eFuse1_ORUData: base-type-encoding=NONE
    BT_eFuse1_ORUDataIndex: base-type-encoding=NONE
    BT_eFuse3_ORUData: base-type-encoding=NONE
    BT_eFuse3_ORUDataIndex: base-type-encoding=NONE
    BT_EM1_Abregelung_Temperatur: base-type-encoding=NONE
    BT_EM1_AnlernenElMotor_Anf: base-type-encoding=NONE
    BT_EM1_AR_aktiv: base-type-encoding=NONE
    BT_EM1_Eta_Sys: base-type-encoding=NONE
    BT_EM1_Fehler_ElAntriebFreilauf_Anf: base-type-encoding=NONE
    BT_EM1_Freigabe_Info_WFS: base-type-encoding=NONE
    BT_EM1_Freigabe_Verfallsinfo_WFS: base-type-encoding=NONE
    BT_EM1_HV_betriebsbereit: base-type-encoding=NONE
    BT_EM1_HYB_13_BZ: base-type-encoding=NONE
    BT_EM1_HYB_13_CRC: base-type-encoding=NONE
    BT_EM1_IstStrom: base-type-encoding=NONE
    BT_EM1_Moment_HVVerbraucher: base-type-encoding=NONE
    BT_EM1_Parken_WFS_Status: base-type-encoding=NONE
    BT_EM1_Sperr_Info_WFS: base-type-encoding=NONE
    BT_EM2_Abregelung_Temperatur: base-type-encoding=NONE
    BT_EM2_AnlernenElMotor_Anf: base-type-encoding=NONE
    BT_EM2_AR_aktiv: base-type-encoding=NONE
    BT_EM2_Eta_Sys: base-type-encoding=NONE
    BT_EM2_Fehler_ElAntriebFreilauf_Anf: base-type-encoding=NONE
    BT_EM2_Freigabe_Info_WFS: base-type-encoding=NONE
    BT_EM2_Freigabe_Verfallsinfo_WFS: base-type-encoding=NONE
    BT_EM2_HV_betriebsbereit: base-type-encoding=NONE
    BT_EM2_HYB_13_BZ: base-type-encoding=NONE
    BT_EM2_HYB_13_CRC: base-type-encoding=NONE
    BT_EM2_IstStrom: base-type-encoding=NONE
    BT_EM2_Parken_WFS_Status: base-type-encoding=NONE
    BT_EM2_Sperr_Info_WFS: base-type-encoding=NONE
    BT_Empfindlichkeit_LS: base-type-encoding=NONE
    BT_Empfindlichkeit_RS: base-type-encoding=NONE
    BT_EPB_DAA_Randbed_erf: base-type-encoding=NONE
    BT_EPB_Fehlerstatus_02: base-type-encoding=NONE
    BT_EPB_Freig_Verzoeg_Anf: base-type-encoding=NONE
    BT_EPB_Pedalweg_Kuppl: base-type-encoding=NONE
    BT_EPB_QBit_Pedalweg_Kuppl: base-type-encoding=NONE
    BT_EPB_QBit_Schalterpos: base-type-encoding=NONE
    BT_EPB_Schalterposition: base-type-encoding=NONE
    BT_EPB_Spannkraft: base-type-encoding=NONE
    BT_EPB_Status: base-type-encoding=NONE
    BT_EPB_Status_02: base-type-encoding=NONE
    BT_EPB_Verzoeg_Anf: base-type-encoding=NONE
    BT_EPH_ORUData: base-type-encoding=NONE
    BT_EPH_ORUDataIndex: base-type-encoding=NONE
    BT_eRWK_AD_oeffnen_Anf: base-type-encoding=NONE
    BT_eRWK_AD_schliessen_Anf: base-type-encoding=NONE
    BT_ESC_50_BZ: base-type-encoding=NONE
    BT_ESC_50_CRC: base-type-encoding=NONE
    BT_ESC_Bremsdruckgradient: base-type-encoding=NONE
    BT_ESC_Bremsfluessigkeits_Sensor: base-type-encoding=NONE
    BT_ESC_Fahrerbremswunsch: base-type-encoding=NONE
    BT_ESC_Fahrerradbremswunschmoment: base-type-encoding=NONE
    BT_ESC_Hydr_Fkt_aktiv: base-type-encoding=NONE
    BT_ESC_Motorstartverzoegerung: base-type-encoding=NONE
    BT_ESC_ORUData: base-type-encoding=NONE
    BT_ESC_ORUDataIndex: base-type-encoding=NONE
    BT_ESC_QBit_Fahrerbremswunsch: base-type-encoding=NONE
    BT_ESC_Raddruck_max: base-type-encoding=NONE
    BT_ESC_Reku_Freigabe: base-type-encoding=NONE
    BT_ESC_SeitenwindAssistent_Eingriff: base-type-encoding=NONE
    BT_ESC_Unterdruckmangel_erkannt: base-type-encoding=NONE
    BT_ESC_v_Signal_Qualifier_High_Low: base-type-encoding=NONE
    BT_ESCGeneratorSollMoment: base-type-encoding=NONE
    BT_ESP_21_BZ: base-type-encoding=NONE
    BT_ESP_21_CRC: base-type-encoding=NONE
    BT_ESP_24_BZ: base-type-encoding=NONE
    BT_ESP_24_CRC: base-type-encoding=NONE
    BT_ESP_Abrutschen_Stillstand: base-type-encoding=NONE
    BT_ESP_ANB_CM_Rueckk_Umsetz: base-type-encoding=NONE
    BT_ESP_Anforderung_EPB: base-type-encoding=NONE
    BT_ESP_Anhaltevorgang_ACC_aktiv: base-type-encoding=NONE
    BT_ESP_Anschleppstart_Freigabe: base-type-encoding=NONE
    BT_ESP_ASP: base-type-encoding=NONE
    BT_ESP_Autohold_aktiv: base-type-encoding=NONE
    BT_ESP_Autohold_Standby: base-type-encoding=NONE
    BT_ESP_AWV3_Brems_aktiv: base-type-encoding=NONE
    BT_ESP_BKV_Unterdruck: base-type-encoding=NONE
    BT_ESP_BKV_Warnung: base-type-encoding=NONE
    BT_ESP_Bremsdruck: base-type-encoding=NONE
    BT_ESP_Bremsruck_AWV2: base-type-encoding=NONE
    BT_ESP_Diagnose: base-type-encoding=NONE
    BT_ESP_Eingr_HL: base-type-encoding=NONE
    BT_ESP_Eingr_HR: base-type-encoding=NONE
    BT_ESP_Eingr_VL: base-type-encoding=NONE
    BT_ESP_Eingr_VR: base-type-encoding=NONE
    BT_ESP_Eingriff: base-type-encoding=NONE
    BT_ESP_Fahrer_bremst: base-type-encoding=NONE
    BT_ESP_Fahrer_tritt_ZBR_Schw: base-type-encoding=NONE
    BT_ESP_Fehlerstatus_Wegimp: base-type-encoding=NONE
    BT_ESP_FStatus_Anfahrhilfe: base-type-encoding=NONE
    BT_ESP_Gierrate: base-type-encoding=NONE
    BT_ESP_Haltebestaetigung: base-type-encoding=NONE
    BT_ESP_HBA_aktiv: base-type-encoding=NONE
    BT_ESP_HBA_Empfindlichkeit: base-type-encoding=NONE
    BT_ESP_HDC_aktiv: base-type-encoding=NONE
    BT_ESP_HDC_FktLampe: base-type-encoding=NONE
    BT_ESP_HDC_Regelgeschw: base-type-encoding=NONE
    BT_ESP_HDC_Standby: base-type-encoding=NONE
    BT_ESP_Konsistenz_ACC_Botschaft: base-type-encoding=NONE
    BT_ESP_Konsistenz_AWV2: base-type-encoding=NONE
    BT_ESP_Konsistenz_TSK: base-type-encoding=NONE
    BT_ESP_Laengsbeschl: base-type-encoding=NONE
    BT_ESP_Lampe: base-type-encoding=NONE
    BT_ESP_Lenkeingriff_ADS: base-type-encoding=NONE
    BT_ESP_m_Raddrehz: base-type-encoding=NONE
    BT_ESP_Meldungen: base-type-encoding=NONE
    BT_ESP_MKB_Abbruch_Geschw: base-type-encoding=NONE
    BT_ESP_Notbremsanzeige: base-type-encoding=NONE
    BT_ESP_Off_Lampe: base-type-encoding=NONE
    BT_ESP_Off_Taster: base-type-encoding=NONE
    BT_ESP_PLA_Abbruch: base-type-encoding=NONE
    BT_ESP_PLA_Bremseingriff: base-type-encoding=NONE
    BT_ESP_Prefill_ausgeloest: base-type-encoding=NONE
    BT_ESP_QBit_Bremsdruck: base-type-encoding=NONE
    BT_ESP_QBit_Fahrer_bremst: base-type-encoding=NONE
    BT_ESP_QBit_Gierrate: base-type-encoding=NONE
    BT_ESP_QBit_Laengsbeschl: base-type-encoding=NONE
    BT_ESP_QBit_Querb: base-type-encoding=NONE
    BT_ESP_QBit_v_ref: base-type-encoding=NONE
    BT_ESP_QBit_v_Signal: base-type-encoding=NONE
    BT_ESP_QBit_Wegimp_VA: base-type-encoding=NONE
    BT_ESP_Querbeschleunigung: base-type-encoding=NONE
    BT_ESP_Rueckwaertsfahrt_erkannt: base-type-encoding=NONE
    BT_ESP_Schwelle_Unterdruck: base-type-encoding=NONE
    BT_ESP_SpannungsAnf: base-type-encoding=NONE
    BT_ESP_StartStopp_Info: base-type-encoding=NONE
    BT_ESP_Status_Anfahrhilfe: base-type-encoding=NONE
    BT_ESP_Status_Bremsdruck: base-type-encoding=NONE
    BT_ESP_Status_Bremsentemp: base-type-encoding=NONE
    BT_ESP_Status_Bremsentemp_02: base-type-encoding=NONE
    BT_ESP_Status_ESP_PLA: base-type-encoding=NONE
    BT_ESP_Stillstandsphase_erschoepft: base-type-encoding=NONE
    BT_ESP_Systemstatus: base-type-encoding=NONE
    BT_ESP_Systemstatus_03: base-type-encoding=NONE
    BT_ESP_Tastung_passiv: base-type-encoding=NONE
    BT_ESP_Textanzeigen_03: base-type-encoding=NONE
    BT_ESP_Tuerkontakt_Fahrertuer: base-type-encoding=NONE
    BT_ESP_v_ref: base-type-encoding=NONE
    BT_ESP_v_ref_Fahrtrichtung: base-type-encoding=NONE
    BT_ESP_v_Signal: base-type-encoding=NONE
    BT_ESP_v_Signal_8Bit: base-type-encoding=NONE
    BT_ESP_Verz_EPB_aktiv: base-type-encoding=NONE
    BT_ESP_Verz_TSK_aktiv: base-type-encoding=NONE
    BT_ESP_Verzoeg_EPB_verf: base-type-encoding=NONE
    BT_ESP_Vorsteuerung: base-type-encoding=NONE
    BT_ESP_VZ_Gierrate: base-type-encoding=NONE
    BT_ESP_Wegimp_Ueberlauf: base-type-encoding=NONE
    BT_ESP_Wegimp_VA: base-type-encoding=NONE
    BT_ESP_ZT_Rueckk_Umsetz: base-type-encoding=NONE
    BT_FA_Hoehenwert_HL_01: base-type-encoding=NONE
    BT_FA_Hoehenwert_VL_01: base-type-encoding=NONE
    BT_FaceRec_Enroll_Challenge_Request: base-type-encoding=NONE
    BT_Fahrerdisplay_Kombi_ORUData: base-type-encoding=NONE
    BT_Fahrerdisplay_Kombi_ORUDataIndex: base-type-encoding=NONE
    BT_FAS_Profile_Taster: base-type-encoding=NONE
    BT_FAS_Taster: base-type-encoding=NONE
    BT_FAS_Taster_Fehler: base-type-encoding=NONE
    BT_FASFrontradar_ORUData: base-type-encoding=NONE
    BT_FASFrontradar_ORUDataIndex: base-type-encoding=NONE
    BT_FBS_IDG_in_Reichweite: base-type-encoding=NONE
    BT_FBS_Warn_Schluessel_Batt: base-type-encoding=NONE
    BT_FFB_Auf_Taste: base-type-encoding=NONE
    BT_FFB_CarFinder: base-type-encoding=NONE
    BT_FFB_HDF_Taste: base-type-encoding=NONE
    BT_FFB_Komfortoeffnen: base-type-encoding=NONE
    BT_FFB_Komfortschliessen: base-type-encoding=NONE
    BT_FFB_Panik_Taste: base-type-encoding=NONE
    BT_FFB_Zu_Taste: base-type-encoding=NONE
    BT_FH_BT_hoch: base-type-encoding=NONE
    BT_FH_BT_tief: base-type-encoding=NONE
    BT_FH_FT_hoch: base-type-encoding=NONE
    BT_FH_FT_tief: base-type-encoding=NONE
    BT_FH_HBFS_hoch: base-type-encoding=NONE
    BT_FH_HBFS_tief: base-type-encoding=NONE
    BT_FH_HFS_hoch: base-type-encoding=NONE
    BT_FH_HFS_tief: base-type-encoding=NONE
    BT_FHSG_MST_Architektur: base-type-encoding=NONE
    BT_FHSG_MST_Aussentemp_ungefiltert: base-type-encoding=NONE
    BT_FHSG_MST_BT_Blockerwartung: base-type-encoding=NONE
    BT_FHSG_MST_Crashfall_erkannt: base-type-encoding=NONE
    BT_FHSG_MST_Drehfalle_hinten_BF: base-type-encoding=NONE
    BT_FHSG_MST_Drehfalle_hinten_FA: base-type-encoding=NONE
    BT_FHSG_MST_Drehfalle_vorne_BF: base-type-encoding=NONE
    BT_FHSG_MST_Drehfalle_vorne_FA: base-type-encoding=NONE
    BT_FHSG_MST_FH_HBFS_AutoHoch: base-type-encoding=NONE
    BT_FHSG_MST_FH_HBFS_AutoTief: base-type-encoding=NONE
    BT_FHSG_MST_FH_HBFS_ManHoch: base-type-encoding=NONE
    BT_FHSG_MST_FH_HBFS_ManTief: base-type-encoding=NONE
    BT_FHSG_MST_FH_HFS_AutoHoch: base-type-encoding=NONE
    BT_FHSG_MST_FH_HFS_AutoTief: base-type-encoding=NONE
    BT_FHSG_MST_FH_HFS_ManHoch: base-type-encoding=NONE
    BT_FHSG_MST_FH_HFS_ManTief: base-type-encoding=NONE
    BT_FHSG_MST_FH_KomfortHoch: base-type-encoding=NONE
    BT_FHSG_MST_FH_Komforttief: base-type-encoding=NONE
    BT_FHSG_MST_FH_Kurzhub_oeffnen_BT: base-type-encoding=NONE
    BT_FHSG_MST_FH_Kurzhub_oeffnen_FT: base-type-encoding=NONE
    BT_FHSG_MST_FH_Kurzhub_oeffnen_HBFS: base-type-encoding=NONE
    BT_FHSG_MST_FH_Kurzhub_oeffnen_HFS: base-type-encoding=NONE
    BT_FHSG_MST_FH_Langhub: base-type-encoding=NONE
    BT_FHSG_MST_FT_Blockerwartung: base-type-encoding=NONE
    BT_FHSG_MST_FT_FH_H_Kisi_ein: base-type-encoding=NONE
    BT_FHSG_MST_HBFS_Blockerwartung: base-type-encoding=NONE
    BT_FHSG_MST_HBFS_gesafet: base-type-encoding=NONE
    BT_FHSG_MST_HFS_Blockerwartung: base-type-encoding=NONE
    BT_FHSG_MST_HFS_gesafet: base-type-encoding=NONE
    BT_FHSG_MST_Lenkigkeit: base-type-encoding=NONE
    BT_FHSG_MST_Precrash: base-type-encoding=NONE
    BT_FHSG_MST_Tuer_HBFS_entriegelt: base-type-encoding=NONE
    BT_FHSG_MST_Tuer_HFS_entriegelt: base-type-encoding=NONE
    BT_FHSG_void_1: base-type-encoding=NONE
    BT_FHSG_void_{3..8}: base-type-encoding=NONE
    BT_FoD_Anz_Funktionsabschaltung: base-type-encoding=NONE
    BT_FoD_DTC_IPA_EPH: base-type-encoding=NONE
    BT_FoD_DTC_RearView: base-type-encoding=NONE
    BT_FoD_DTC_RPA_EPH: base-type-encoding=NONE
    BT_FoD_DTC_TopView_SideView: base-type-encoding=NONE
    BT_FoD_DTC_TPA_rTPA_EPH: base-type-encoding=NONE
    BT_FoD_DTC_TSK_ACC: base-type-encoding=NONE
    BT_FoD_DTC_TSK_GRA: base-type-encoding=NONE
    BT_FoD_State_IPA_RPA: base-type-encoding=NONE
    BT_FoD_State_TopView_SideView_RVC: base-type-encoding=NONE
    BT_FoD_State_TPA_rTPA: base-type-encoding=NONE
    BT_FoD_Transmission_Info: base-type-encoding=NONE
    BT_Fronthaube_geoeffnet: base-type-encoding=NONE
    BT_FS_BFS_Fond_Verst_enable: base-type-encoding=NONE
    BT_FS_BFS_KSS_Anfahrt: base-type-encoding=NONE
    BT_FS_BFS_Sitzsym_Anfahrt: base-type-encoding=NONE
    BT_FS_EE_BFS_enable: base-type-encoding=NONE
    BT_FS_EE_Fond_BFS_enable: base-type-encoding=NONE
    BT_FS_EE_Fond_FS_enable: base-type-encoding=NONE
    BT_FS_Fond_Bed_enable: base-type-encoding=NONE
    BT_FS_GHV_aktiv: base-type-encoding=NONE
    BT_FS_Gurtbringer_Sperre: base-type-encoding=NONE
    BT_FS_KSV_aktiv: base-type-encoding=NONE
    BT_FS_Lehne_nicht_verriegelt: base-type-encoding=NONE
    BT_FS_LHV_aktiv: base-type-encoding=NONE
    BT_FS_LKV_aktiv: base-type-encoding=NONE
    BT_FS_LNV_aktiv: base-type-encoding=NONE
    BT_FS_Luftfeuchte_rel: base-type-encoding=NONE
    BT_FS_LWV_aktiv: base-type-encoding=NONE
    BT_FS_MMB_glob_stop: base-type-encoding=NONE
    BT_FS_MMB_lokal_Stop: base-type-encoding=NONE
    BT_FS_MMB_storage: base-type-encoding=NONE
    BT_FS_MMB_storage_beep: base-type-encoding=NONE
    BT_FS_MMB_store: base-type-encoding=NONE
    BT_FS_MMB_store_LED_on: base-type-encoding=NONE
    BT_FS_MMB_tast: base-type-encoding=NONE
    BT_FS_MMB_tipp: base-type-encoding=NONE
    BT_FS_Push_Tuergriff: base-type-encoding=NONE
    BT_FS_ResponseError: base-type-encoding=NONE
    BT_FS_SHV_aktiv: base-type-encoding=NONE
    BT_FS_Sitzfahrt_aktiv: base-type-encoding=NONE
    BT_FS_SLV_aktiv: base-type-encoding=NONE
    BT_FS_SNV_aktiv: base-type-encoding=NONE
    BT_FS_Spezialposition_anfahren: base-type-encoding=NONE
    BT_FS_Status_eTAG: base-type-encoding=NONE
    BT_FS_Status_eTAG_ext: base-type-encoding=NONE
    BT_FS_STV_aktiv: base-type-encoding=NONE
    BT_FS_Taupunkt: base-type-encoding=NONE
    BT_FS_Temp_Scheibe: base-type-encoding=NONE
    BT_FS_Temp_Sensor: base-type-encoding=NONE
    BT_FSH_Status: base-type-encoding=NONE
    BT_FSH_Taster: base-type-encoding=NONE
    BT_FT_ASW_Warnton: base-type-encoding=NONE
    BT_FT_BFS_Fond_Freigabe: base-type-encoding=NONE
    BT_FT_BFS_Tuer_Status: base-type-encoding=NONE
    BT_FT_Cargolock_bet: base-type-encoding=NONE
    BT_FT_Daemmglas: base-type-encoding=NONE
    BT_FT_FH_Bew_hoch: base-type-encoding=NONE
    BT_FT_FH_Bew_tief: base-type-encoding=NONE
    BT_FT_FH_Block: base-type-encoding=NONE
    BT_FT_FH_Fang: base-type-encoding=NONE
    BT_FT_FH_normiert: base-type-encoding=NONE
    BT_FT_FH_Oeffnung: base-type-encoding=NONE
    BT_FT_FH_Pos_oben: base-type-encoding=NONE
    BT_FT_FH_S_AutoHoch: base-type-encoding=NONE
    BT_FT_FH_S_AutoTief: base-type-encoding=NONE
    BT_FT_FH_S_ManHoch: base-type-encoding=NONE
    BT_FT_FH_S_ManTief: base-type-encoding=NONE
    BT_FT_FH_Thermo: base-type-encoding=NONE
    BT_FT_gesafet: base-type-encoding=NONE
    BT_FT_HBFS_Tuer_Status: base-type-encoding=NONE
    BT_FT_HD_Taste: base-type-encoding=NONE
    BT_FT_HD_Taste_2: base-type-encoding=NONE
    BT_FT_HFS_Tuer_Status: base-type-encoding=NONE
    BT_FT_IRUE_Taste: base-type-encoding=NONE
    BT_FT_kisi_asynchron: base-type-encoding=NONE
    BT_FT_Kisi_Fehler: base-type-encoding=NONE
    BT_FT_Kisi_li_aktiv: base-type-encoding=NONE
    BT_FT_Kisi_re_aktiv: base-type-encoding=NONE
    BT_FT_KiSi_Status_Soll_HBFS: base-type-encoding=NONE
    BT_FT_KiSi_Status_Soll_HFS: base-type-encoding=NONE
    BT_FT_Kisi_Taster_li: base-type-encoding=NONE
    BT_FT_Kisi_Taster_li_02: base-type-encoding=NONE
    BT_FT_Kisi_Taster_re: base-type-encoding=NONE
    BT_FT_Kisi_Taster_re_02: base-type-encoding=NONE
    BT_FT_Lock_Taster: base-type-encoding=NONE
    BT_FT_Lock_Taster_02: base-type-encoding=NONE
    BT_FT_Lock_Unlock_Taster: base-type-encoding=NONE
    BT_FT_Oben_Block_erw: base-type-encoding=NONE
    BT_FT_Schliesstaster: base-type-encoding=NONE
    BT_FT_Schluesselschalter_auf: base-type-encoding=NONE
    BT_FT_Schluesselschalter_zu: base-type-encoding=NONE
    BT_FT_Schluesselschalter_zu_02: base-type-encoding=NONE
    BT_FT_SP_ausgerastet: base-type-encoding=NONE
    BT_FT_Sp_Blk_def: base-type-encoding=NONE
    BT_FT_Sp_Heizung_Anf: base-type-encoding=NONE
    BT_FT_SP_Heizung_ein: base-type-encoding=NONE
    BT_FT_SP_Heizung_Status: base-type-encoding=NONE
    BT_FT_SP_ht_aktiv: base-type-encoding=NONE
    BT_FT_SP_lr_aktiv: base-type-encoding=NONE
    BT_FT_Sperrklinke: base-type-encoding=NONE
    BT_FT_SWA_Taster: base-type-encoding=NONE
    BT_FT_TAG_betaetigt: base-type-encoding=NONE
    BT_FT_TCR_Mode_aktiv: base-type-encoding=NONE
    BT_FT_TD_Taste: base-type-encoding=NONE
    BT_FT_TD_Taste_Fehler: base-type-encoding=NONE
    BT_FT_TD_Taste_Status: base-type-encoding=NONE
    BT_FT_TIG_betaetigt: base-type-encoding=NONE
    BT_FT_TSG_hinten_verbaut: base-type-encoding=NONE
    BT_FT_Tuer_geoeffnet: base-type-encoding=NONE
    BT_FT_Tuer_Status: base-type-encoding=NONE
    BT_FT_Tuer_Status_QBit: base-type-encoding=NONE
    BT_FT_Tueroeffnen_Warnung: base-type-encoding=NONE
    BT_FT_Tuerschloss_defekt: base-type-encoding=NONE
    BT_FT_UEKB_aktiviert: base-type-encoding=NONE
    BT_FT_Unlock_Taster: base-type-encoding=NONE
    BT_FT_Unten_Block_erw: base-type-encoding=NONE
    BT_FT_verriegelt: base-type-encoding=NONE
    BT_FT_Zuziehhilfe_aktiv: base-type-encoding=NONE
    BT_GE_Fahrstufe: base-type-encoding=NONE
    BT_GE_Freig_MMom_Vorhalt: base-type-encoding=NONE
    BT_GE_MMom_Soll_02: base-type-encoding=NONE
    BT_GE_MMom_Status: base-type-encoding=NONE
    BT_GE_MMom_Status_02: base-type-encoding=NONE
    BT_GE_MMom_Vorhalt_02: base-type-encoding=NONE
    BT_GE_Schaltablauf: base-type-encoding=NONE
    BT_GE_Status_Kraftschluss: base-type-encoding=NONE
    BT_GE_Uefkt: base-type-encoding=NONE
    BT_GE_Uefkt_unplausibel: base-type-encoding=NONE
    BT_GE_Ursache_Fahrstufe_N: base-type-encoding=NONE
    BT_GE_Verbot_Ausblendung: base-type-encoding=NONE
    BT_GE_Zielgang: base-type-encoding=NONE
    BT_Getriebe_11_BZ: base-type-encoding=NONE
    BT_Getriebe_11_CRC: base-type-encoding=NONE
    BT_Gong_TFL_Umschaltung: base-type-encoding=NONE
    BT_GRA_Abbrechen: base-type-encoding=NONE
    BT_GRA_ACC_01_BZ: base-type-encoding=NONE
    BT_GRA_ACC_01_CRC: base-type-encoding=NONE
    BT_GRA_Codierung: base-type-encoding=NONE
    BT_GRA_Fehler: base-type-encoding=NONE
    BT_GRA_FoD_Status: base-type-encoding=NONE
    BT_GRA_Hauptschalter: base-type-encoding=NONE
    BT_GRA_LIM_Taste_verfuegbar: base-type-encoding=NONE
    BT_GRA_Limiter: base-type-encoding=NONE
    BT_GRA_PIT_Limiter: base-type-encoding=NONE
    BT_GRA_reserveByte5_3: base-type-encoding=NONE
    BT_GRA_reserveByte{6..8}: base-type-encoding=NONE
    BT_GRA_Tip_Hoch: base-type-encoding=NONE
    BT_GRA_Tip_Runter: base-type-encoding=NONE
    BT_GRA_Tip_Setzen: base-type-encoding=NONE
    BT_GRA_Tip_Stufe_2: base-type-encoding=NONE
    BT_GRA_Tip_Wiederaufnahme: base-type-encoding=NONE
    BT_GRA_TravelAssist: base-type-encoding=NONE
    BT_GRA_Typ_Bedienteil: base-type-encoding=NONE
    BT_GRA_Typ_Bedienteil_erw: base-type-encoding=NONE
    BT_GRA_Typ_Hauptschalter: base-type-encoding=NONE
    BT_GRA_Verstellung_Zeitluecke: base-type-encoding=NONE
    BT_GW_75_va_{12..17}: base-type-encoding=NONE
    BT_GW_KD_Fehler: base-type-encoding=NONE
    BT_HBFS_ASW_HMI_defekt: base-type-encoding=NONE
    BT_HBFS_ASW_Warnton: base-type-encoding=NONE
    BT_HBFS_Fehler_Beleuchtung: base-type-encoding=NONE
    BT_HBFS_Fehler_FH_Normierung: base-type-encoding=NONE
    BT_HBFS_Fehler_FH_Schalter: base-type-encoding=NONE
    BT_HBFS_Fehler_Hallsensor: base-type-encoding=NONE
    BT_HBFS_Fehler_Kodierdaten: base-type-encoding=NONE
    BT_HBFS_Fehler_Parameter: base-type-encoding=NONE
    BT_HBFS_Fehler_SG: base-type-encoding=NONE
    BT_HBFS_Fehler_TIG_TAG: base-type-encoding=NONE
    BT_HBFS_FH_Bew_hoch: base-type-encoding=NONE
    BT_HBFS_FH_Bew_tief: base-type-encoding=NONE
    BT_HBFS_FH_Block: base-type-encoding=NONE
    BT_HBFS_FH_Fang: base-type-encoding=NONE
    BT_HBFS_FH_normiert: base-type-encoding=NONE
    BT_HBFS_FH_Oeffnung: base-type-encoding=NONE
    BT_HBFS_FH_S_AutoHoch: base-type-encoding=NONE
    BT_HBFS_FH_S_AutoTief: base-type-encoding=NONE
    BT_HBFS_FH_S_HFS_AutoHoch: base-type-encoding=NONE
    BT_HBFS_FH_S_HFS_AutoTief: base-type-encoding=NONE
    BT_HBFS_FH_S_HFS_ManHoch: base-type-encoding=NONE
    BT_HBFS_FH_S_HFS_ManTief: base-type-encoding=NONE
    BT_HBFS_FH_S_ManHoch: base-type-encoding=NONE
    BT_HBFS_FH_S_ManTief: base-type-encoding=NONE
    BT_HBFS_FH_Thermo: base-type-encoding=NONE
    BT_HBFS_FH_Ueberspannung: base-type-encoding=NONE
    BT_HBFS_FH_Unterspannung: base-type-encoding=NONE
    BT_HBFS_FH_void_{2..6}: base-type-encoding=NONE
    BT_HBFS_gesafet: base-type-encoding=NONE
    BT_HBFS_Heckrollotaster_betaetigt: base-type-encoding=NONE
    BT_HBFS_KiSi_Fehler: base-type-encoding=NONE
    BT_HBFS_Lock_Taster: base-type-encoding=NONE
    BT_HBFS_Lock_Taster_inv: base-type-encoding=NONE
    BT_HBFS_MRollo_Schalter: base-type-encoding=NONE
    BT_HBFS_Oben_Block_erw: base-type-encoding=NONE
    BT_HBFS_Push_Tuergriff: base-type-encoding=NONE
    BT_HBFS_RelaisFehler: base-type-encoding=NONE
    BT_HBFS_ResponseError: base-type-encoding=NONE
    BT_HBFS_SAD_Schalter: base-type-encoding=NONE
    BT_HBFS_Seitenrollo_hoch: base-type-encoding=NONE
    BT_HBFS_Seitenrollo_tief: base-type-encoding=NONE
    BT_HBFS_SK_betaetigt: base-type-encoding=NONE
    BT_HBFS_SleepIndication: base-type-encoding=NONE
    BT_HBFS_Sperrklinke: base-type-encoding=NONE
    BT_HBFS_Status_eTAG: base-type-encoding=NONE
    BT_HBFS_Status_eTAG_ext: base-type-encoding=NONE
    BT_HBFS_Status_KiSi: base-type-encoding=NONE
    BT_HBFS_Status_KiSi_inv: base-type-encoding=NONE
    BT_HBFS_Status_Routine: base-type-encoding=NONE
    BT_HBFS_Status_Stellgliedtest: base-type-encoding=NONE
    BT_HBFS_TAG_betaetigt: base-type-encoding=NONE
    BT_HBFS_TCR_Mode_aktiv: base-type-encoding=NONE
    BT_HBFS_TIG_betaetigt: base-type-encoding=NONE
    BT_HBFS_TIG_betaetigt_oeffnen: base-type-encoding=NONE
    BT_HBFS_TIG_betaetigt_schliessen: base-type-encoding=NONE
    BT_HBFS_Tuer_geoeffnet: base-type-encoding=NONE
    BT_HBFS_Tuer_Status: base-type-encoding=NONE
    BT_HBFS_Tuer_Status_QBit: base-type-encoding=NONE
    BT_HBFS_Tueroeffnen_Warnung: base-type-encoding=NONE
    BT_HBFS_Tuerschloss_defekt: base-type-encoding=NONE
    BT_HBFS_UEKB_aktiviert: base-type-encoding=NONE
    BT_HBFS_Unlock_Taster: base-type-encoding=NONE
    BT_HBFS_Unten_Block_erw: base-type-encoding=NONE
    BT_HBFS_verriegelt: base-type-encoding=NONE
    BT_HBFS_Vorraste_betaetigt: base-type-encoding=NONE
    BT_HBFS_Zuziehhilfe_aktiv: base-type-encoding=NONE
    BT_HD_Hauptraste: base-type-encoding=NONE
    BT_HD_Hauptraste_Auth: base-type-encoding=NONE
    BT_HD_Vorraste: base-type-encoding=NONE
    BT_HD_Vorraste_Auth: base-type-encoding=NONE
    BT_HFS_ASW_HMI_defekt: base-type-encoding=NONE
    BT_HFS_ASW_Warnton: base-type-encoding=NONE
    BT_HFS_Fehler_Beleuchtung: base-type-encoding=NONE
    BT_HFS_Fehler_FH_Normierung: base-type-encoding=NONE
    BT_HFS_Fehler_FH_Schalter: base-type-encoding=NONE
    BT_HFS_Fehler_Hallsensor: base-type-encoding=NONE
    BT_HFS_Fehler_Kodierdaten: base-type-encoding=NONE
    BT_HFS_Fehler_Parameter: base-type-encoding=NONE
    BT_HFS_Fehler_SG: base-type-encoding=NONE
    BT_HFS_Fehler_TIG_TAG: base-type-encoding=NONE
    BT_HFS_FH_Bew_hoch: base-type-encoding=NONE
    BT_HFS_FH_Bew_tief: base-type-encoding=NONE
    BT_HFS_FH_Block: base-type-encoding=NONE
    BT_HFS_FH_Fang: base-type-encoding=NONE
    BT_HFS_FH_normiert: base-type-encoding=NONE
    BT_HFS_FH_Oeffnung: base-type-encoding=NONE
    BT_HFS_FH_S_AutoHoch: base-type-encoding=NONE
    BT_HFS_FH_S_AutoTief: base-type-encoding=NONE
    BT_HFS_FH_S_HBFS_AutoHoch: base-type-encoding=NONE
    BT_HFS_FH_S_HBFS_AutoTief: base-type-encoding=NONE
    BT_HFS_FH_S_HBFS_ManHoch: base-type-encoding=NONE
    BT_HFS_FH_S_HBFS_ManTief: base-type-encoding=NONE
    BT_HFS_FH_S_ManHoch: base-type-encoding=NONE
    BT_HFS_FH_S_ManTief: base-type-encoding=NONE
    BT_HFS_FH_Thermo: base-type-encoding=NONE
    BT_HFS_FH_Ueberspannung: base-type-encoding=NONE
    BT_HFS_FH_Unterspannung: base-type-encoding=NONE
    BT_HFS_FH_void_{2..6}: base-type-encoding=NONE
    BT_HFS_gesafet: base-type-encoding=NONE
    BT_HFS_Heckrollotaster_betaetigt: base-type-encoding=NONE
    BT_HFS_KiSi_Fehler: base-type-encoding=NONE
    BT_HFS_Lock_Taster: base-type-encoding=NONE
    BT_HFS_Lock_Taster_inv: base-type-encoding=NONE
    BT_HFS_MRollo_Schalter: base-type-encoding=NONE
    BT_HFS_Oben_Block_erw: base-type-encoding=NONE
    BT_HFS_Push_Tuergriff: base-type-encoding=NONE
    BT_HFS_RelaisFehler: base-type-encoding=NONE
    BT_HFS_ResponseError: base-type-encoding=NONE
    BT_HFS_SAD_Schalter: base-type-encoding=NONE
    BT_HFS_Seitenrollo_hoch: base-type-encoding=NONE
    BT_HFS_Seitenrollo_tief: base-type-encoding=NONE
    BT_HFS_SK_betaetigt: base-type-encoding=NONE
    BT_HFS_SleepIndication: base-type-encoding=NONE
    BT_HFS_Sperrklinke: base-type-encoding=NONE
    BT_HFS_Status_eTAG: base-type-encoding=NONE
    BT_HFS_Status_eTAG_ext: base-type-encoding=NONE
    BT_HFS_Status_KiSi: base-type-encoding=NONE
    BT_HFS_Status_Routine: base-type-encoding=NONE
    BT_HFS_Status_Stellgliedtest: base-type-encoding=NONE
    BT_HFS_TAG_betaetigt: base-type-encoding=NONE
    BT_HFS_TCR_Mode_aktiv: base-type-encoding=NONE
    BT_HFS_TIG_betaetigt: base-type-encoding=NONE
    BT_HFS_TIG_betaetigt_oeffnen: base-type-encoding=NONE
    BT_HFS_TIG_betaetigt_schliessen: base-type-encoding=NONE
    BT_HFS_Tuer_geoeffnet: base-type-encoding=NONE
    BT_HFS_Tuer_Status: base-type-encoding=NONE
    BT_HFS_Tuer_Status_QBit: base-type-encoding=NONE
    BT_HFS_Tueroeffnen_Warnung: base-type-encoding=NONE
    BT_HFS_Tuerschloss_defekt: base-type-encoding=NONE
    BT_HFS_UEKB_aktiviert: base-type-encoding=NONE
    BT_HFS_Unlock_Taster: base-type-encoding=NONE
    BT_HFS_Unten_Block_erw: base-type-encoding=NONE
    BT_HFS_verriegelt: base-type-encoding=NONE
    BT_HFS_Vorraste_betaetigt: base-type-encoding=NONE
    BT_HFS_Zuziehhilfe_aktiv: base-type-encoding=NONE
    BT_HLR_FlHz_Freigabe_HL: base-type-encoding=NONE
    BT_HLR_FlHz_Freigabe_HR: base-type-encoding=NONE
    BT_HLR_FlHz_Freigabe_Ruhesitz: base-type-encoding=NONE
    BT_HLR_FlHz_Freigabe_VL: base-type-encoding=NONE
    BT_HLR_FlHz_Freigabe_VR: base-type-encoding=NONE
    BT_HLR_FSH_Freigabe: base-type-encoding=NONE
    BT_HLR_HSH_Freigabe: base-type-encoding=NONE
    BT_HLR_KRH_Freigabe_VL: base-type-encoding=NONE
    BT_HLR_KRH_Freigabe_VR: base-type-encoding=NONE
    BT_HLR_LRH_Freigabe: base-type-encoding=NONE
    BT_HLR_PTC_Freigabe: base-type-encoding=NONE
    BT_HLR_PTC_linear_Freigabe: base-type-encoding=NONE
    BT_HLR_SIH_Freigabe_Fond: base-type-encoding=NONE
    BT_HLR_SIH_Freigabe_HL: base-type-encoding=NONE
    BT_HLR_SIH_Freigabe_HR: base-type-encoding=NONE
    BT_HLR_SIH_Freigabe_VL: base-type-encoding=NONE
    BT_HLR_SIH_Freigabe_VR: base-type-encoding=NONE
    BT_HLR_SIL_Freigabe_HL: base-type-encoding=NONE
    BT_HLR_SIL_Freigabe_HR: base-type-encoding=NONE
    BT_HLR_SIL_Freigabe_VL: base-type-encoding=NONE
    BT_HLR_SIL_Freigabe_VR: base-type-encoding=NONE
    BT_HLR_Sp_Heizung_Freigabe_BT: base-type-encoding=NONE
    BT_HLR_Sp_Heizung_Freigabe_FT: base-type-encoding=NONE
    BT_HLR_TCH_Freigabe: base-type-encoding=NONE
    BT_HMS_aktives_System: base-type-encoding=NONE
    BT_HMS_Anforderung_GE: base-type-encoding=NONE
    BT_HMS_Fehlerstatus: base-type-encoding=NONE
    BT_HMS_Haltemoment: base-type-encoding=NONE
    BT_HMS_halten_nicht_verfuegbar: base-type-encoding=NONE
    BT_HMS_halten_nicht_verfuegbar_02: base-type-encoding=NONE
    BT_HMS_Index_Haltemoment: base-type-encoding=NONE
    BT_HMS_P_beibehalten_GE: base-type-encoding=NONE
    BT_HMS_parken_nicht_verfuegbar: base-type-encoding=NONE
    BT_HMS_Stillstand: base-type-encoding=NONE
    BT_HMS_Systemstatus: base-type-encoding=NONE
    BT_HSH_LED: base-type-encoding=NONE
    BT_HSH_Relais_Anf: base-type-encoding=NONE
    BT_HSH_Status: base-type-encoding=NONE
    BT_HSH_Taster: base-type-encoding=NONE
    BT_HUD_ORUData: base-type-encoding=NONE
    BT_HUD_ORUDataIndex: base-type-encoding=NONE
    BT_HVL_01_BZ: base-type-encoding=NONE
    BT_HVL_01_CRC: base-type-encoding=NONE
    BT_HVL_HVK_Fehler_DCAbschaltung: base-type-encoding=NONE
    BT_HVL_Kuehltemperatur: base-type-encoding=NONE
    BT_HVL_LadeAnforderung: base-type-encoding=NONE
    BT_HVL_OCC_IstModus: base-type-encoding=NONE
    BT_HVL_Status_EoHVL: base-type-encoding=NONE
    BT_HVL_Status_Spgfreiheit: base-type-encoding=NONE
    BT_HVL_Steckerstatus: base-type-encoding=NONE
    BT_HVLS_Ladedose_SG1_alt: base-type-encoding=NONE
    BT_HVLS_Ladedose_SG2_alt: base-type-encoding=NONE
    BT_HVLS_Steckerstatus_SG1: base-type-encoding=NONE
    BT_HVLS_Steckerstatus_SG2: base-type-encoding=NONE
    BT_HW_Drehfalle_Tuer_HL: base-type-encoding=NONE
    BT_HW_Drehfalle_Tuer_HL_Auth: base-type-encoding=NONE
    BT_HW_Drehfalle_Tuer_HR: base-type-encoding=NONE
    BT_HW_Drehfalle_Tuer_HR_Auth: base-type-encoding=NONE
    BT_HW_HD_Taste_Innenraum: base-type-encoding=NONE
    BT_HW_HSB_erkannt: base-type-encoding=NONE
    BT_HW_Softtouch_betaetigt: base-type-encoding=NONE
    BT_HW_Status_Schloss_gesafet_HL: base-type-encoding=NONE
    BT_HW_Status_Schloss_gesafet_HR: base-type-encoding=NONE
    BT_HW_Status_Schloss_safed_HL_Auth: base-type-encoding=NONE
    BT_HW_Status_Schloss_safed_HR_Auth: base-type-encoding=NONE
    BT_HW_Status_Schloss_verr_HL_Auth: base-type-encoding=NONE
    BT_HW_Status_Schloss_verr_HR_Auth: base-type-encoding=NONE
    BT_HW_Status_Schloss_verriegelt_HL: base-type-encoding=NONE
    BT_HW_Status_Schloss_verriegelt_HR: base-type-encoding=NONE
    BT_HW_Tankdeckel_offen: base-type-encoding=NONE
    BT_IAA_Active_User_ID: base-type-encoding=NONE
    BT_IAA_Identified_User_ID: base-type-encoding=NONE
    BT_IAA_PSO_wake_up: base-type-encoding=NONE
    BT_iCall_active: base-type-encoding=NONE
    BT_ICAS1_X_ORUData: base-type-encoding=NONE
    BT_ICAS1_X_ORUDataIndex: base-type-encoding=NONE
    BT_ICC_eKiSi_Unterdrueck: base-type-encoding=NONE
    BT_ICC_Fernbed_ein: base-type-encoding=NONE
    BT_ICC_Innenraumbel_Unterdrueck: base-type-encoding=NONE
    BT_ICC_NV_Dauer_Energie_Anf: base-type-encoding=NONE
    BT_ICC_NV_Dauer_Energie_Modus: base-type-encoding=NONE
    BT_ICC_TFL_Abschaltung: base-type-encoding=NONE
    BT_IL_Bel_BFS_Ausstieg: base-type-encoding=NONE
    BT_IL_Bel_FS_Ausstieg: base-type-encoding=NONE
    BT_IL_Bel_HBFS_Ausstieg: base-type-encoding=NONE
    BT_IL_Bel_HFS_Ausstieg: base-type-encoding=NONE
    BT_IL_Dachkonsole_Adressat: base-type-encoding=NONE
    BT_IL_Dachkonsole_Dimmzeit: base-type-encoding=NONE
    BT_IL_Dachkonsole_Zeitbasis: base-type-encoding=NONE
    BT_IL_Dachkonsole_Zielhelligkeit: base-type-encoding=NONE
    BT_IL_Dimmung_H_Tuerkontur: base-type-encoding=NONE
    BT_IL_Dimmung_Lautspr: base-type-encoding=NONE
    BT_IL_Dimmung_Tuerinnengriff: base-type-encoding=NONE
    BT_IL_Dimmung_Umfeldbel: base-type-encoding=NONE
    BT_IL_Dimmung_V_Tuerkontur: base-type-encoding=NONE
    BT_IL_Innenlicht_aktiv: base-type-encoding=NONE
    BT_IL_Klemme_30G_aktiv: base-type-encoding=NONE
    BT_IL_TSG_BFS_Dimmzeit_{1..4}: base-type-encoding=NONE
    BT_IL_TSG_BFS_Dimmzeit_Basis_{1..4}: base-type-encoding=NONE
    BT_IL_TSG_BFS_Zielhelligkeit_{1..4}: base-type-encoding=NONE
    BT_IL_TSG_FS_Dimmzeit_{1..4}: base-type-encoding=NONE
    BT_IL_TSG_FS_Dimmzeit_Basis_{1..4}: base-type-encoding=NONE
    BT_IL_TSG_FS_Zielhelligkeit_{1..4}: base-type-encoding=NONE
    BT_IL_TSG_HBFS_Dimmzeit_{1..4}: base-type-encoding=NONE
    BT_IL_TSG_HBFS_Dimmzeit_Basis_{1..4}: base-type-encoding=NONE
    BT_IL_TSG_HBFS_Zielhelligkeit_{1..4}: base-type-encoding=NONE
    BT_IL_TSG_HFS_Dimmzeit_{1..4}: base-type-encoding=NONE
    BT_IL_TSG_HFS_Dimmzeit_Basis_{1..4}: base-type-encoding=NONE
    BT_IL_TSG_HFS_Zielhelligkeit_{1..4}: base-type-encoding=NONE
    BT_IL_Tuerkontakt_Taster: base-type-encoding=NONE
    BT_IPA_02_BZ: base-type-encoding=NONE
    BT_IPA_02_CRC: base-type-encoding=NONE
    BT_IPA_Akustik_PL_gefunden: base-type-encoding=NONE
    BT_IPA_Anf_Meldungen: base-type-encoding=NONE
    BT_IPA_PL_Anzeige_links: base-type-encoding=NONE
    BT_IPA_PL_Anzeige_rechts: base-type-encoding=NONE
    BT_IRUE_aktiv: base-type-encoding=NONE
    BT_IRUE_Taster_Fkts_LED: base-type-encoding=NONE
    BT_ISA_Regelung_aktiv: base-type-encoding=NONE
    BT_ISA_Status: base-type-encoding=NONE
    BT_KBI_aktive_Laengsfunktion: base-type-encoding=NONE
    BT_KBI_Aussen_Temp_gef: base-type-encoding=NONE
    BT_KBI_Kilometerstand: base-type-encoding=NONE
    BT_KBI_QBit_Aussen_Temp_gef: base-type-encoding=NONE
    BT_KFG_ORUData: base-type-encoding=NONE
    BT_KFG_ORUDataIndex: base-type-encoding=NONE
    BT_KL_AL_HL_Anf: base-type-encoding=NONE
    BT_KL_AL_HR_Anf: base-type-encoding=NONE
    BT_KL_AL_VL_Anf: base-type-encoding=NONE
    BT_KL_AL_VR_Anf: base-type-encoding=NONE
    BT_KL_Beschlagsgefahr: base-type-encoding=NONE
    BT_KL_Defrost_LED: base-type-encoding=NONE
    BT_KL_FSH_LED: base-type-encoding=NONE
    BT_KL_FSH_Soll: base-type-encoding=NONE
    BT_KL_Geblspng_Fond_Soll: base-type-encoding=NONE
    BT_KL_Geblspng_Soll: base-type-encoding=NONE
    BT_KL_Heizstufe_LSH: base-type-encoding=NONE
    BT_KL_HSH_LED: base-type-encoding=NONE
    BT_KL_HSH_Soll: base-type-encoding=NONE
    BT_KL_HUP_aktiv: base-type-encoding=NONE
    BT_KL_I_Geblaese: base-type-encoding=NONE
    BT_KL_Klappe_Status: base-type-encoding=NONE
    BT_KL_Kompressorstrom_soll: base-type-encoding=NONE
    BT_KL_LRH_PWM: base-type-encoding=NONE
    BT_KL_LRH_Soll: base-type-encoding=NONE
    BT_KL_LRH_Stufe: base-type-encoding=NONE
    BT_KL_LRH_Taster: base-type-encoding=NONE
    BT_KL_LSH_Ansteuerung: base-type-encoding=NONE
    BT_KL_LSH_Betriebsdauer: base-type-encoding=NONE
    BT_KL_LSH_DBetr_Bestaet: base-type-encoding=NONE
    BT_KL_LSH_DBetr_Ein: base-type-encoding=NONE
    BT_KL_PTC_Verbauinfo: base-type-encoding=NONE
    BT_KL_SIH_Soll_li: base-type-encoding=NONE
    BT_KL_SIH_Soll_re: base-type-encoding=NONE
    BT_KL_SIL_Soll_li: base-type-encoding=NONE
    BT_KL_SIL_Soll_re: base-type-encoding=NONE
    BT_KL_Temp_ZH_Soll: base-type-encoding=NONE
    BT_KL_Umluftklappe_Status: base-type-encoding=NONE
    BT_KL_VoKo_LED: base-type-encoding=NONE
    BT_KL_Voko_Status: base-type-encoding=NONE
    BT_KL_ZR_Anforderung: base-type-encoding=NONE
    BT_KL_Zuheizer_Freigabe: base-type-encoding=NONE
    BT_Klemme_15: base-type-encoding=NONE
    BT_Klemme_X_WWS: base-type-encoding=NONE
    BT_Klemmen_Status_01_BZ: base-type-encoding=NONE
    BT_Klemmen_Status_01_CRC: base-type-encoding=NONE
    BT_Klemmen_Status_02_BZ: base-type-encoding=NONE
    BT_Klemmen_Status_02_CRC: base-type-encoding=NONE
    BT_Klemmen_Steuerung_01_BZ: base-type-encoding=NONE
    BT_Klemmen_Steuerung_01_CRC: base-type-encoding=NONE
    BT_KN_BCM1_DiagPfad: base-type-encoding=NONE
    BT_Kombi_02_alt: base-type-encoding=NONE
    BT_KRH_Soll_li: base-type-encoding=NONE
    BT_KRH_Soll_re: base-type-encoding=NONE
    BT_KRH_Stufe_LED_li: base-type-encoding=NONE
    BT_KRH_Stufe_LED_re: base-type-encoding=NONE
    BT_Krypt_Schluesselschalter_auf: base-type-encoding=NONE
    BT_Krypt_Schluesselschalter_zu: base-type-encoding=NONE
    BT_Krypt_Signatur: base-type-encoding=NONE
    BT_KS_Geheimnis_{1..4}: base-type-encoding=NONE
    BT_KST_Anf_Klemme_15: base-type-encoding=NONE
    BT_KST_Anf_Klemme_15_Auth: base-type-encoding=NONE
    BT_KST_Anf_Klemme_50: base-type-encoding=NONE
    BT_KST_Anf_Klemme_S: base-type-encoding=NONE
    BT_KST_Anf_Klemmenfreigabe_ELV: base-type-encoding=NONE
    BT_KST_Anf_Klemmenfreigabe_WFS: base-type-encoding=NONE
    BT_KST_Anf_ZV_Verriegelung: base-type-encoding=NONE
    BT_KST_aut_Abschaltung_Zuendung: base-type-encoding=NONE
    BT_KST_BSW_Fehlermode2: base-type-encoding=NONE
    BT_KST_BSW_Klemme_15_HW_Ist: base-type-encoding=NONE
    BT_KST_BSW_Klemmenhochschalten_Sper: base-type-encoding=NONE
    BT_KST_BSW_Not_Taster_betaetigt: base-type-encoding=NONE
    BT_KST_BSW_ZAT_betaetigt: base-type-encoding=NONE
    BT_KST_ComfortReadyStatus: base-type-encoding=NONE
    BT_KST_Fahrer_Info_Text: base-type-encoding=NONE
    BT_KST_Fahrerhinweis_4: base-type-encoding=NONE
    BT_KST_KL15LockStatus: base-type-encoding=NONE
    BT_KST_Sonderzustand_Anforderung: base-type-encoding=NONE
    BT_KST_Sonderzustand_Status: base-type-encoding=NONE
    BT_KST_Txt_Komfortabschaltung: base-type-encoding=NONE
    BT_KST_Txt_P_Gang: base-type-encoding=NONE
    BT_KST_Txt_Panikabschaltung: base-type-encoding=NONE
    BT_KST_Txt_Werkstatt: base-type-encoding=NONE
    BT_KST_Unterdr_Zuendungsmeldung: base-type-encoding=NONE
    BT_KST_Warn_P1_ZST_def: base-type-encoding=NONE
    BT_KST_Warn_P2_ZST_def: base-type-encoding=NONE
    BT_KST_WFS_Fahrfreigabe_Anforderung: base-type-encoding=NONE
    BT_KST_ZAT_betaetigt: base-type-encoding=NONE
    BT_KST_Zuendungswarnung: base-type-encoding=NONE
    BT_KVA_Ist_Pos: base-type-encoding=NONE
    BT_KY_Ambex_Entfernung_Delta_IDG_{01..08}: base-type-encoding=NONE
    BT_KY_Ambex_Entfernung_IDG_{01..08}: base-type-encoding=NONE
    BT_KY_Ambex_Richtung_Delta_IDG_{01..08}: base-type-encoding=NONE
    BT_KY_Ambex_Richtung_IDG_{01..08}: base-type-encoding=NONE
    BT_KY_Ambex_Status_IDG_{01..08}: base-type-encoding=NONE
    BT_KY_UHF_aktiver_Scantyp: base-type-encoding=NONE
    BT_KY_UHF_Bitrate: base-type-encoding=NONE
    BT_KY_UHF_Telegramm_CRCStatus: base-type-encoding=NONE
    BT_KY_UHF_Transceiver_Modus: base-type-encoding=NONE
    BT_LE1_ORUData: base-type-encoding=NONE
    BT_LE1_ORUDataIndex: base-type-encoding=NONE
    BT_LE1_TorqueLockStatus: base-type-encoding=NONE
    BT_LE2_ORUData: base-type-encoding=NONE
    BT_LE2_ORUDataIndex: base-type-encoding=NONE
    BT_LE2_TorqueLockStatus: base-type-encoding=NONE
    BT_Lenkhilfe_EPS_ORUData: base-type-encoding=NONE
    BT_Lenkhilfe_EPS_ORUDataIndex: base-type-encoding=NONE
    BT_Leselicht_hi_li_LED_defekt: base-type-encoding=NONE
    BT_Leselicht_hi_li_SR3_LED_defekt: base-type-encoding=NONE
    BT_Leselicht_hi_li_SR3_Taste_defekt: base-type-encoding=NONE
    BT_Leselicht_hi_li_Taste_defekt: base-type-encoding=NONE
    BT_Leselicht_hi_re_LED_defekt: base-type-encoding=NONE
    BT_Leselicht_hi_re_SR3_LED_defekt: base-type-encoding=NONE
    BT_Leselicht_hi_re_SR3_Taste_defekt: base-type-encoding=NONE
    BT_Leselicht_hi_re_Taste_defekt: base-type-encoding=NONE
    BT_Leselicht_vo_defekt: base-type-encoding=NONE
    BT_LH_S_3_Bremsl_def: base-type-encoding=NONE
    BT_LH_S_Aussenlicht_def: base-type-encoding=NONE
    BT_LH_S_Blinker_li_def: base-type-encoding=NONE
    BT_LH_S_Blinker_re_def: base-type-encoding=NONE
    BT_LH_S_Brems_Blk_li_def: base-type-encoding=NONE
    BT_LH_S_Brems_Blk_re_def: base-type-encoding=NONE
    BT_LH_S_Bremsl_li_def: base-type-encoding=NONE
    BT_LH_S_Bremsl_li_ges_def: base-type-encoding=NONE
    BT_LH_S_Bremsl_re_def: base-type-encoding=NONE
    BT_LH_S_Bremsl_re_ges_def: base-type-encoding=NONE
    BT_LH_S_Bremslicht_H_aktiv: base-type-encoding=NONE
    BT_LH_S_Kennzl_def: base-type-encoding=NONE
    BT_LH_S_Nebel_li_def: base-type-encoding=NONE
    BT_LH_S_Nebel_mi_def: base-type-encoding=NONE
    BT_LH_S_Nebel_re_def: base-type-encoding=NONE
    BT_LH_S_Rueckf_li_def: base-type-encoding=NONE
    BT_LH_S_Rueckf_mi_def: base-type-encoding=NONE
    BT_LH_S_Rueckf_re_def: base-type-encoding=NONE
    BT_LH_S_Schluss_Brems_li_def: base-type-encoding=NONE
    BT_LH_S_Schluss_Brems_mi_def: base-type-encoding=NONE
    BT_LH_S_Schluss_Brems_Nebel_li_def: base-type-encoding=NONE
    BT_LH_S_Schluss_Brems_Nebel_re_def: base-type-encoding=NONE
    BT_LH_S_Schluss_Brems_re_def: base-type-encoding=NONE
    BT_LH_S_Schluss_Nebel_li_def: base-type-encoding=NONE
    BT_LH_S_Schluss_Nebel_re_def: base-type-encoding=NONE
    BT_LH_S_Schlusslicht_li_def: base-type-encoding=NONE
    BT_LH_S_Schlusslicht_mi_def: base-type-encoding=NONE
    BT_LH_S_Schlusslicht_re_def: base-type-encoding=NONE
    BT_LH_S_SL_BRL_BLK_li_def: base-type-encoding=NONE
    BT_LH_S_SL_BRL_BLK_re_def: base-type-encoding=NONE
    BT_Licht_Anf_01_BZ: base-type-encoding=NONE
    BT_Licht_Anf_01_CRC: base-type-encoding=NONE
    BT_Licht_Vorne_01_BZ: base-type-encoding=NONE
    BT_Licht_Vorne_01_CRC: base-type-encoding=NONE
    BT_LIM_bCall_Taster: base-type-encoding=NONE
    BT_LIM_iCall_Taster: base-type-encoding=NONE
    BT_LIM_P_Mode: base-type-encoding=NONE
    BT_LIM_S_Rollo_hi: base-type-encoding=NONE
    BT_LIM_S_Rollo_vo: base-type-encoding=NONE
    BT_LIM_S_SAD_hi: base-type-encoding=NONE
    BT_LIM_S_SAD_Vo: base-type-encoding=NONE
    BT_LIM_Tasten_Innenlicht_V_def: base-type-encoding=NONE
    BT_LIN_SMLS_ECU_defekt: base-type-encoding=NONE
    BT_LIN_SMLS_elektrischer_Fehler: base-type-encoding=NONE
    BT_LIN_SMLS_mechanischer_Fehler: base-type-encoding=NONE
    BT_LIN_SMLS_RAM_ROM_Fehler: base-type-encoding=NONE
    BT_LIN_SMLS_ResponseError: base-type-encoding=NONE
    BT_LIN_SMLS_Ueberspannung: base-type-encoding=NONE
    BT_LIN_SMLS_Unterspannung: base-type-encoding=NONE
    BT_LIN_SMLS_Zaehler: base-type-encoding=NONE
    BT_LINDa_defekt: base-type-encoding=NONE
    BT_LINDa_HL_SR3_Touch_Event: base-type-encoding=NONE
    BT_LINDa_HL_Touch_Event: base-type-encoding=NONE
    BT_LINDa_HR_SR3_Touch_Event: base-type-encoding=NONE
    BT_LINDa_HR_Touch_Event: base-type-encoding=NONE
    BT_LINDa_reserveByte{1..3}: base-type-encoding=NONE
    BT_LINDa_reserveByte5_4: base-type-encoding=NONE
    BT_LINDa_ResponseError: base-type-encoding=NONE
    BT_LINDa_S_Rollo_vo: base-type-encoding=NONE
    BT_LINDa_Touch_Event: base-type-encoding=NONE
    BT_LINDae_Dummy_4_7: base-type-encoding=NONE
    BT_LiSi_Defrost_Taste: base-type-encoding=NONE
    BT_LiSi_FSH_Taste: base-type-encoding=NONE
    BT_LiSi_HSH_Taste: base-type-encoding=NONE
    BT_LiSi_Touch_Event: base-type-encoding=NONE
    BT_LLP_L_ORUData: base-type-encoding=NONE
    BT_LLP_L_ORUDataIndex: base-type-encoding=NONE
    BT_LLP_R_ORUData: base-type-encoding=NONE
    BT_LLP_R_ORUDataIndex: base-type-encoding=NONE
    BT_LLR_LL1_Blockierung: base-type-encoding=NONE
    BT_LLR_LL1_CodierPinError: base-type-encoding=NONE
    BT_LLR_LL1_Ist_Drehzahl: base-type-encoding=NONE
    BT_LLR_LL1_Lokalaktiv: base-type-encoding=NONE
    BT_LLR_LL1_Luefter_defekt: base-type-encoding=NONE
    BT_LLR_LL1_ResponseError: base-type-encoding=NONE
    BT_LLR_LL1_Ueberspannung: base-type-encoding=NONE
    BT_LLR_LL1_Uebertemperatur: base-type-encoding=NONE
    BT_LLR_LL1_Unterspannung: base-type-encoding=NONE
    BT_LLR_LS1_Blockierung: base-type-encoding=NONE
    BT_LLR_LS1_CodierPinError: base-type-encoding=NONE
    BT_LLR_LS1_Ist_Drehzahl: base-type-encoding=NONE
    BT_LLR_LS1_Lokalaktiv: base-type-encoding=NONE
    BT_LLR_LS1_Luefter_defekt: base-type-encoding=NONE
    BT_LLR_LS1_ResponseError: base-type-encoding=NONE
    BT_LLR_LS1_Ueberspannung: base-type-encoding=NONE
    BT_LLR_LS1_Uebertemperatur: base-type-encoding=NONE
    BT_LLR_LS1_Unterspannung: base-type-encoding=NONE
    BT_LLR_RL1_Blockierung: base-type-encoding=NONE
    BT_LLR_RL1_CodierPinError: base-type-encoding=NONE
    BT_LLR_RL1_Ist_Drehzahl: base-type-encoding=NONE
    BT_LLR_RL1_Lokalaktiv: base-type-encoding=NONE
    BT_LLR_RL1_Luefter_defekt: base-type-encoding=NONE
    BT_LLR_RL1_ResponseError: base-type-encoding=NONE
    BT_LLR_RL1_Ueberspannung: base-type-encoding=NONE
    BT_LLR_RL1_Uebertemperatur: base-type-encoding=NONE
    BT_LLR_RL1_Unterspannung: base-type-encoding=NONE
    BT_LLR_RS1_Blockierung: base-type-encoding=NONE
    BT_LLR_RS1_CodierPinError: base-type-encoding=NONE
    BT_LLR_RS1_Ist_Drehzahl: base-type-encoding=NONE
    BT_LLR_RS1_Lokalaktiv: base-type-encoding=NONE
    BT_LLR_RS1_Luefter_defekt: base-type-encoding=NONE
    BT_LLR_RS1_ResponseError: base-type-encoding=NONE
    BT_LLR_RS1_Ueberspannung: base-type-encoding=NONE
    BT_LLR_RS1_Uebertemperatur: base-type-encoding=NONE
    BT_LLR_RS1_Unterspannung: base-type-encoding=NONE
    BT_LnchCtl_StReq: base-type-encoding=NONE
    BT_LoGeWa_Event_Kombiwarnung: base-type-encoding=NONE
    BT_LR_HZG_01_alt: base-type-encoding=NONE
    BT_LR_HZG_Konfiguration: base-type-encoding=NONE
    BT_LR_HZG_Taster_on_off: base-type-encoding=NONE
    BT_LR_HZG_Temp_Sensor: base-type-encoding=NONE
    BT_LRH_aktiv: base-type-encoding=NONE
    BT_LRH_On_Off: base-type-encoding=NONE
    BT_LRH_Stellglied_aktiv: base-type-encoding=NONE
    BT_LRH_Taster: base-type-encoding=NONE
    BT_LRL1_ORUData: base-type-encoding=NONE
    BT_LRL1_ORUDataIndex: base-type-encoding=NONE
    BT_LRL2_ORUData: base-type-encoding=NONE
    BT_LRL2_ORUDataIndex: base-type-encoding=NONE
    BT_LRL3_ORUData: base-type-encoding=NONE
    BT_LRL3_ORUDataIndex: base-type-encoding=NONE
    BT_LRL_L_01_BZ: base-type-encoding=NONE
    BT_LRL_L_01_CRC: base-type-encoding=NONE
    BT_LRL_M_01_BZ: base-type-encoding=NONE
    BT_LRL_M_01_CRC: base-type-encoding=NONE
    BT_LRL_R_01_BZ: base-type-encoding=NONE
    BT_LRL_R_01_CRC: base-type-encoding=NONE
    BT_LS_defekt: base-type-encoding=NONE
    BT_LS_Dunkel: base-type-encoding=NONE
    BT_LS_Error: base-type-encoding=NONE
    BT_LS_Helligkeit_FW: base-type-encoding=NONE
    BT_LS_Helligkeit_IR: base-type-encoding=NONE
    BT_LS_Licht_ein: base-type-encoding=NONE
    BT_LS_Licht_ein_invers: base-type-encoding=NONE
    BT_LS_TFL_mit_SL_ein: base-type-encoding=NONE
    BT_LS_Verbau: base-type-encoding=NONE
    BT_LSS_Tastencode: base-type-encoding=NONE
    BT_LTM_01_BZ: base-type-encoding=NONE
    BT_LTM_01_CRC: base-type-encoding=NONE
    BT_LTM_Autolicht: base-type-encoding=NONE
    BT_LTM_Beruehrung: base-type-encoding=NONE
    BT_LTM_Lokalaktiv: base-type-encoding=NONE
    BT_LTM_Nebellicht: base-type-encoding=NONE
    BT_LTM_Nebelschlusslicht: base-type-encoding=NONE
    BT_LTM_ResponseError: base-type-encoding=NONE
    BT_LTM_StatusLichttastenmodul: base-type-encoding=NONE
    BT_LTM_Variante: base-type-encoding=NONE
    BT_LV_Abbiegelicht_li_def: base-type-encoding=NONE
    BT_LV_Abbiegelicht_re_def: base-type-encoding=NONE
    BT_LV_Abblend_Fernlicht_li_def: base-type-encoding=NONE
    BT_LV_Abblend_Fernlicht_re_def: base-type-encoding=NONE
    BT_LV_Abblendlicht_Anzeige: base-type-encoding=NONE
    BT_LV_Abblendlicht_li_def: base-type-encoding=NONE
    BT_LV_Abblendlicht_re_def: base-type-encoding=NONE
    BT_LV_Abblendlicht_TFL_li_def: base-type-encoding=NONE
    BT_LV_Abblendlicht_TFL_re_def: base-type-encoding=NONE
    BT_LV_AFL_aktiv_Anzeige: base-type-encoding=NONE
    BT_LV_AFL_defekt: base-type-encoding=NONE
    BT_LV_Aussenlicht_def: base-type-encoding=NONE
    BT_LV_Blinker_li_def: base-type-encoding=NONE
    BT_LV_Blinker_re_def: base-type-encoding=NONE
    BT_LV_Blinker_VL_aktiv: base-type-encoding=NONE
    BT_LV_Blinker_VR_aktiv: base-type-encoding=NONE
    BT_LV_Blk_li_Seite_def: base-type-encoding=NONE
    BT_LV_Blk_re_Seite_def: base-type-encoding=NONE
    BT_LV_Fernlicht_Anzeige: base-type-encoding=NONE
    BT_LV_Fernlicht_li_def: base-type-encoding=NONE
    BT_LV_Fernlicht_re_def: base-type-encoding=NONE
    BT_LV_FLA_aktiv_Anzeige: base-type-encoding=NONE
    BT_LV_FLA_defekt: base-type-encoding=NONE
    BT_LV_FLA_Sensor_blockiert: base-type-encoding=NONE
    BT_LV_LED_Scheinwerfer_li_def: base-type-encoding=NONE
    BT_LV_LED_Scheinwerfer_re_def: base-type-encoding=NONE
    BT_LV_MXB_Status_Anzeige: base-type-encoding=NONE
    BT_LV_Nebellicht_Anzeige: base-type-encoding=NONE
    BT_LV_Nebellicht_li_def: base-type-encoding=NONE
    BT_LV_Nebellicht_re_def: base-type-encoding=NONE
    BT_LV_Nebellicht_TFL_li_def: base-type-encoding=NONE
    BT_LV_Nebellicht_TFL_re_def: base-type-encoding=NONE
    BT_LV_Nebelschlusslicht_Anzeige: base-type-encoding=NONE
    BT_LV_Standlicht_Anzeige: base-type-encoding=NONE
    BT_LV_Standlicht_li_def: base-type-encoding=NONE
    BT_LV_Standlicht_re_def: base-type-encoding=NONE
    BT_LV_Standlicht_TFL_li_def: base-type-encoding=NONE
    BT_LV_Standlicht_TFL_re_def: base-type-encoding=NONE
    BT_LV_Tagfahrlicht_Anzeige: base-type-encoding=NONE
    BT_LV_Tagfahrlicht_li_def: base-type-encoding=NONE
    BT_LV_Tagfahrlicht_re_def: base-type-encoding=NONE
    BT_LWR_Lampe: base-type-encoding=NONE
    BT_LWR_Reisemodus_Texte: base-type-encoding=NONE
    BT_LWR_SollDC: base-type-encoding=NONE
    BT_MaaSBladeMyc_ORUData: base-type-encoding=NONE
    BT_MaaSBladeMyc_ORUDataIndex: base-type-encoding=NONE
    BT_MainBlade_ORUData: base-type-encoding=NONE
    BT_MainBlade_ORUDataIndex: base-type-encoding=NONE
    BT_Master_Zaehler: base-type-encoding=NONE
    BT_MD1_Lage: base-type-encoding=NONE
    BT_MD1_Position: base-type-encoding=NONE
    BT_MD3_Lage: base-type-encoding=NONE
    BT_MD3_Position: base-type-encoding=NONE
    BT_MF_Abzugssperre: base-type-encoding=NONE
    BT_MF_Alarm_Blinker: base-type-encoding=NONE
    BT_MF_Alarm_Blinkertakt: base-type-encoding=NONE
    BT_MF_Anlassersperre: base-type-encoding=NONE
    BT_MF_Blk_li: base-type-encoding=NONE
    BT_MF_Blk_re: base-type-encoding=NONE
    BT_MF_BT_entriegeln: base-type-encoding=NONE
    BT_MF_BT_verriegeln: base-type-encoding=NONE
    BT_MF_DCDC_Istmodus: base-type-encoding=NONE
    BT_MF_Fahrerhinweis_2: base-type-encoding=NONE
    BT_MF_Fahrlicht: base-type-encoding=NONE
    BT_MF_Fernbed_ein: base-type-encoding=NONE
    BT_MF_Fernlicht: base-type-encoding=NONE
    BT_MF_FH_BT_hoch: base-type-encoding=NONE
    BT_MF_FH_BT_tief: base-type-encoding=NONE
    BT_MF_FH_FT_hoch: base-type-encoding=NONE
    BT_MF_FH_FT_tief: base-type-encoding=NONE
    BT_MF_Frontintervall: base-type-encoding=NONE
    BT_MF_Frontwaschen: base-type-encoding=NONE
    BT_MF_FT_entriegeln: base-type-encoding=NONE
    BT_MF_FT_verriegeln: base-type-encoding=NONE
    BT_MF_Fussraumbel: base-type-encoding=NONE
    BT_MF_HBFS_entriegeln: base-type-encoding=NONE
    BT_MF_HBFS_verriegeln: base-type-encoding=NONE
    BT_MF_Heckintervall: base-type-encoding=NONE
    BT_MF_Heckwaschen: base-type-encoding=NONE
    BT_MF_HFS_entriegeln: base-type-encoding=NONE
    BT_MF_HFS_verriegeln: base-type-encoding=NONE
    BT_MF_I_U_VorgabeZwang: base-type-encoding=NONE
    BT_MF_Innenraumbel: base-type-encoding=NONE
    BT_MF_Innenraumbel_Unterdrueck: base-type-encoding=NONE
    BT_MF_interm_Fahrlicht: base-type-encoding=NONE
    BT_MF_interm_Fernlicht: base-type-encoding=NONE
    BT_MF_interm_Takt: base-type-encoding=NONE
    BT_MF_Laderelais: base-type-encoding=NONE
    BT_MF_Lichthupe: base-type-encoding=NONE
    BT_MF_Motorweiterlauf: base-type-encoding=NONE
    BT_MF_nachtr_Stopp_Anf: base-type-encoding=NONE
    BT_MF_Notstart: base-type-encoding=NONE
    BT_MF_Schluessel_scan: base-type-encoding=NONE
    BT_MF_Signalhorn: base-type-encoding=NONE
    BT_MF_Standlicht: base-type-encoding=NONE
    BT_MF_StartStopp_Info: base-type-encoding=NONE
    BT_MF_Summer: base-type-encoding=NONE
    BT_MF_TFL_Abschaltung: base-type-encoding=NONE
    BT_MF_Tippwischen: base-type-encoding=NONE
    BT_MF_Tuerentriegelung_hinten: base-type-encoding=NONE
    BT_MF_U2Batt: base-type-encoding=NONE
    BT_MF_UBattVorgabe: base-type-encoding=NONE
    BT_MF_Variante: base-type-encoding=NONE
    BT_MF_Vorfeldbel_Spiegel: base-type-encoding=NONE
    BT_MF_Warnblinker: base-type-encoding=NONE
    BT_MF_Wischerstufe_1: base-type-encoding=NONE
    BT_MF_Wischerstufe_2: base-type-encoding=NONE
    BT_MF_ZV_Lock: base-type-encoding=NONE
    BT_MFG_01_BZ: base-type-encoding=NONE
    BT_MFG_01_CRC: base-type-encoding=NONE
    BT_MFK_ORUData: base-type-encoding=NONE
    BT_MFK_ORUDataIndex: base-type-encoding=NONE
    BT_MFL_CAN_ORUData: base-type-encoding=NONE
    BT_MFL_CAN_ORUDataIndex: base-type-encoding=NONE
    BT_MFL_Dummy_0_Signal_1: base-type-encoding=NONE
    BT_MFL_Dummy_0_Signal_3: base-type-encoding=NONE
    BT_MFL_ECU_Err: base-type-encoding=NONE
    BT_MFL_Eventcode_1: base-type-encoding=NONE
    BT_MFL_Eventcode_2: base-type-encoding=NONE
    BT_MFL_Fehler_Codierung: base-type-encoding=NONE
    BT_MFL_Lokalaktiv: base-type-encoding=NONE
    BT_MFL_LR_HZG_Err: base-type-encoding=NONE
    BT_MFL_LR_HZG_Status: base-type-encoding=NONE
    BT_MFL_M_Taste: base-type-encoding=NONE
    BT_MFL_Marke: base-type-encoding=NONE
    BT_MFL_Paddle_Verbau: base-type-encoding=NONE
    BT_MFL_Response_Err: base-type-encoding=NONE
    BT_MFL_SatModul_links_Err: base-type-encoding=NONE
    BT_MFL_SatModul_rechts_Err: base-type-encoding=NONE
    BT_MFL_Signalhorn: base-type-encoding=NONE
    BT_MFL_Signalhorn_Err: base-type-encoding=NONE
    BT_MFL_Taste_links_Err: base-type-encoding=NONE
    BT_MFL_Taste_rechts_Err: base-type-encoding=NONE
    BT_MFL_Tastencode_1: base-type-encoding=NONE
    BT_MFL_Tastencode_2: base-type-encoding=NONE
    BT_MFL_Tip_Down: base-type-encoding=NONE
    BT_MFL_Tip_links_Err: base-type-encoding=NONE
    BT_MFL_Tip_rechts_Err: base-type-encoding=NONE
    BT_MFL_Tip_Up: base-type-encoding=NONE
    BT_MFL_Toggle: base-type-encoding=NONE
    BT_MFL_Variante: base-type-encoding=NONE
    BT_MFL_Zaehler: base-type-encoding=NONE
    BT_MIB_Stromsparmodus: base-type-encoding=NONE
    BT_MO_Anforderung_Anzeige_Halten: base-type-encoding=NONE
    BT_MO_Anforderung_HMS: base-type-encoding=NONE
    BT_MO_Aussp_Anlass: base-type-encoding=NONE
    BT_MO_BKV_Unterdruckwarnung: base-type-encoding=NONE
    BT_MO_BLS: base-type-encoding=NONE
    BT_MO_BMS_NV_Anf_stuetzen: base-type-encoding=NONE
    BT_MO_EBoost_verf_praed: base-type-encoding=NONE
    BT_MO_EKlKomLeiRed: base-type-encoding=NONE
    BT_MO_eLaunch_verf: base-type-encoding=NONE
    BT_MO_Entkopplung_Sollschlupf: base-type-encoding=NONE
    BT_MO_Ext_E_Fahrt_aktiv: base-type-encoding=NONE
    BT_MO_Fahrbereitschaft: base-type-encoding=NONE
    BT_MO_Fahrer_bremst: base-type-encoding=NONE
    BT_MO_Fahrpedalgradient: base-type-encoding=NONE
    BT_MO_Fahrpedalrohwert_01: base-type-encoding=NONE
    BT_MO_FMAus_aktiv: base-type-encoding=NONE
    BT_MO_FMAus_Startvariante: base-type-encoding=NONE
    BT_MO_FoD_Performance_Status: base-type-encoding=NONE
    BT_MO_FoD_Performance_Switch_Status: base-type-encoding=NONE
    BT_MO_Freig_Anlass: base-type-encoding=NONE
    BT_MO_Freig_Reku: base-type-encoding=NONE
    BT_MO_Freigabe_Segeln: base-type-encoding=NONE
    BT_MO_Freilauf_Info: base-type-encoding=NONE
    BT_MO_Freilauf_Status: base-type-encoding=NONE
    BT_MO_Gangposition: base-type-encoding=NONE
    BT_MO_Handshake_STH: base-type-encoding=NONE
    BT_MO_Heckspoiler_Anf: base-type-encoding=NONE
    BT_MO_HYB_Fahrbereitschaft: base-type-encoding=NONE
    BT_MO_HYB_VM_aktiv: base-type-encoding=NONE
    BT_MO_Interlock: base-type-encoding=NONE
    BT_MO_Kickdown: base-type-encoding=NONE
    BT_MO_Kl_50: base-type-encoding=NONE
    BT_MO_Kl_75: base-type-encoding=NONE
    BT_MO_Klima_Eingr: base-type-encoding=NONE
    BT_MO_Klima_Regelmodus: base-type-encoding=NONE
    BT_MO_Konsistenz_Bremsped: base-type-encoding=NONE
    BT_MO_Krit_Heckobjekt: base-type-encoding=NONE
    BT_MO_Kuppl_schalter: base-type-encoding=NONE
    BT_MO_Moment_im_Leerlauf: base-type-encoding=NONE
    BT_MO_Motor_laeuft: base-type-encoding=NONE
    BT_MO_NGS_Gangpos: base-type-encoding=NONE
    BT_MO_OBFCM_Reserve: base-type-encoding=NONE
    BT_MO_OnePedalDriving_integriert: base-type-encoding=NONE
    BT_MO_Positionierung_aktiv: base-type-encoding=NONE
    BT_MO_PTC_Status: base-type-encoding=NONE
    BT_MO_QBit_Aussen_Temp: base-type-encoding=NONE
    BT_MO_QBit_Fahrer_bremst: base-type-encoding=NONE
    BT_MO_QBit_Fahrpedalwerte_01: base-type-encoding=NONE
    BT_MO_QBit_Gangposition: base-type-encoding=NONE
    BT_MO_QBit_KL_75: base-type-encoding=NONE
    BT_MO_Red_El_Fahrleistung: base-type-encoding=NONE
    BT_MO_rel_Saugrohrdruck: base-type-encoding=NONE
    BT_MO_rel_Saugrohrdruck_gem_err: base-type-encoding=NONE
    BT_MO_Remotestart_Betrieb: base-type-encoding=NONE
    BT_MO_Remotestart_moeglich: base-type-encoding=NONE
    BT_MO_Schubabschaltung: base-type-encoding=NONE
    BT_MO_Servicemodus: base-type-encoding=NONE
    BT_MO_Sig_Fahrpedalgradient: base-type-encoding=NONE
    BT_MO_Signalquelle_Gangposition: base-type-encoding=NONE
    BT_MO_Solldrehz_Leerlauf: base-type-encoding=NONE
    BT_MO_StartStopp_Fahrerwunsch: base-type-encoding=NONE
    BT_MO_StartStopp_Motorstopp: base-type-encoding=NONE
    BT_MO_StartStopp_Status: base-type-encoding=NONE
    BT_MO_StartStopp_StoppVorbereitung: base-type-encoding=NONE
    BT_MO_StartStopp_Wiederstart: base-type-encoding=NONE
    BT_MO_StartVorauss_erfuellt: base-type-encoding=NONE
    BT_MO_Startwunsch: base-type-encoding=NONE
    BT_MO_Status_MaxDrzEingriff: base-type-encoding=NONE
    BT_MO_Status_MaxDrzEingriff_sek: base-type-encoding=NONE
    BT_MO_Status_MinDrzEingriff: base-type-encoding=NONE
    BT_MO_Status_MinDrzEingriff_sek: base-type-encoding=NONE
    BT_MO_temporaere_Fahrerabwesenheit: base-type-encoding=NONE
    BT_MO_Timeout_ESP: base-type-encoding=NONE
    BT_MO_UBE_Reserve: base-type-encoding=NONE
    BT_MO_Zylinderabschaltung: base-type-encoding=NONE
    BT_MOD_Energie_Anf: base-type-encoding=NONE
    BT_Motor_14_BZ: base-type-encoding=NONE
    BT_Motor_14_CRC: base-type-encoding=NONE
    BT_Motor_35_alt: base-type-encoding=NONE
    BT_Motor_51_BZ: base-type-encoding=NONE
    BT_Motor_51_CRC: base-type-encoding=NONE
    BT_Motor_54_BZ: base-type-encoding=NONE
    BT_Motor_54_CRC: base-type-encoding=NONE
    BT_Motor_BEV_ORUData: base-type-encoding=NONE
    BT_Motor_BEV_ORUDataIndex: base-type-encoding=NONE
    BT_MRollo_Lage: base-type-encoding=NONE
    BT_MRollo_Position: base-type-encoding=NONE
    BT_MSR_Anf: base-type-encoding=NONE
    BT_MTHBFS_M_Taste: base-type-encoding=NONE
    BT_MTHBFS_Pos{1..3}: base-type-encoding=NONE
    BT_MTHFS_M_Taste: base-type-encoding=NONE
    BT_MTHFS_Pos{1..3}: base-type-encoding=NONE
    BT_Niveausensor_HL_verbaut: base-type-encoding=NONE
    BT_Niveausensor_VL_verbaut: base-type-encoding=NONE
    BT_NM_BCM1_CAB_V15: base-type-encoding=ISO-8859-1
    BT_NM_BCM1_Car_Wakeup: base-type-encoding=NONE
    BT_NM_BCM1_CBV_AWB: base-type-encoding=NONE
    BT_NM_BCM1_CBV_CRI: base-type-encoding=NONE
    BT_NM_BCM1_NM_aktiv_Applikation: base-type-encoding=NONE
    BT_NM_BCM1_NM_aktiv_Aussenlicht: base-type-encoding=NONE
    BT_NM_BCM1_NM_aktiv_Diagnose: base-type-encoding=NONE
    BT_NM_BCM1_NM_aktiv_DWA: base-type-encoding=NONE
    BT_NM_BCM1_NM_aktiv_Funk: base-type-encoding=NONE
    BT_NM_BCM1_NM_aktiv_Heizung: base-type-encoding=NONE
    BT_NM_BCM1_NM_aktiv_Innenlicht: base-type-encoding=NONE
    BT_NM_BCM1_NM_aktiv_Kessy: base-type-encoding=NONE
    BT_NM_BCM1_NM_aktiv_KL15: base-type-encoding=NONE
    BT_NM_BCM1_NM_aktiv_Remot_Door_L_Un: base-type-encoding=NONE
    BT_NM_BCM1_NM_aktiv_Remotestart: base-type-encoding=NONE
    BT_NM_BCM1_NM_aktiv_TK_geschlossen: base-type-encoding=NONE
    BT_NM_BCM1_NM_aktiv_Tmin: base-type-encoding=NONE
    BT_NM_BCM1_NM_aktiv_ZV: base-type-encoding=NONE
    BT_NM_BCM1_NM_State: base-type-encoding=NONE
    BT_NM_BCM1_UDS_CC: base-type-encoding=NONE
    BT_NM_BCM1_Wakeup: base-type-encoding=NONE
    BT_NM_eCall_CAB_V15: base-type-encoding=ISO-8859-1
    BT_NM_eCall_Car_Wakeup: base-type-encoding=NONE
    BT_NM_eCall_CBV_AWB: base-type-encoding=NONE
    BT_NM_eCall_CBV_CRI: base-type-encoding=NONE
    BT_NM_eCall_NM_aktiv_C2X: base-type-encoding=NONE
    BT_NM_eCall_NM_aktiv_Call: base-type-encoding=NONE
    BT_NM_eCall_NM_aktiv_Diagnose: base-type-encoding=NONE
    BT_NM_eCall_NM_aktiv_Dienstabfrage: base-type-encoding=NONE
    BT_NM_eCall_NM_aktiv_IAA: base-type-encoding=NONE
    BT_NM_eCall_NM_aktiv_KL15: base-type-encoding=NONE
    BT_NM_eCall_NM_aktiv_Klimatisieren: base-type-encoding=NONE
    BT_NM_eCall_NM_aktiv_Laden: base-type-encoding=NONE
    BT_NM_eCall_NM_aktiv_MQTT_GW: base-type-encoding=NONE
    BT_NM_ecall_NM_aktiv_PredWakeUp: base-type-encoding=NONE
    BT_NM_eCall_NM_aktiv_PSO: base-type-encoding=NONE
    BT_NM_eCall_NM_aktiv_Remote_Control: base-type-encoding=NONE
    BT_NM_eCall_NM_aktiv_RPA: base-type-encoding=NONE
    BT_NM_eCall_NM_aktiv_Settings: base-type-encoding=NONE
    BT_NM_eCall_NM_aktiv_Status: base-type-encoding=NONE
    BT_NM_eCall_NM_aktiv_Tmin: base-type-encoding=NONE
    BT_NM_eCall_NM_State: base-type-encoding=NONE
    BT_NM_eCall_UDS_CC: base-type-encoding=NONE
    BT_NM_ELV_CAB_V15: base-type-encoding=ISO-8859-1
    BT_NM_ELV_Car_Wakeup: base-type-encoding=NONE
    BT_NM_ELV_CBV_AWB: base-type-encoding=NONE
    BT_NM_ELV_CBV_CRI: base-type-encoding=NONE
    BT_NM_ELV_NM_aktiv_Diagnose: base-type-encoding=NONE
    BT_NM_ELV_NM_aktiv_KL15: base-type-encoding=NONE
    BT_NM_ELV_NM_aktiv_Meldung: base-type-encoding=NONE
    BT_NM_ELV_NM_aktiv_Tmin: base-type-encoding=NONE
    BT_NM_ELV_NM_aktiv_Verfahrtrigger: base-type-encoding=NONE
    BT_NM_ELV_NM_aktiv_WFS: base-type-encoding=NONE
    BT_NM_ELV_NM_State: base-type-encoding=NONE
    BT_NM_ELV_UDS_CC: base-type-encoding=NONE
    BT_NM_Gateway_CAB_V15: base-type-encoding=ISO-8859-1
    BT_NM_Gateway_Car_Wakeup: base-type-encoding=NONE
    BT_NM_Gateway_CBV_AWB: base-type-encoding=NONE
    BT_NM_Gateway_CBV_CRI: base-type-encoding=NONE
    BT_NM_Gateway_NM_aktiv_CAB: base-type-encoding=NONE
    BT_NM_Gateway_NM_aktiv_Diagnose: base-type-encoding=NONE
    BT_NM_Gateway_NM_aktiv_Energie: base-type-encoding=NONE
    BT_NM_Gateway_NM_aktiv_FoD: base-type-encoding=NONE
    BT_NM_Gateway_NM_aktiv_IAA_PSO: base-type-encoding=NONE
    BT_NM_Gateway_NM_aktiv_Kessy: base-type-encoding=NONE
    BT_NM_Gateway_NM_aktiv_KL15: base-type-encoding=NONE
    BT_NM_Gateway_NM_aktiv_KS: base-type-encoding=NONE
    BT_NM_Gateway_NM_aktiv_Licht: base-type-encoding=NONE
    BT_NM_Gateway_NM_aktiv_PaCo: base-type-encoding=NONE
    BT_NM_Gateway_NM_aktiv_RTM: base-type-encoding=NONE
    BT_NM_Gateway_NM_aktiv_Standklima: base-type-encoding=NONE
    BT_NM_Gateway_NM_aktiv_Tmin: base-type-encoding=NONE
    BT_NM_Gateway_NM_aktiv_USS: base-type-encoding=NONE
    BT_NM_Gateway_NM_aktiv_ZM: base-type-encoding=NONE
    BT_NM_Gateway_NM_aktiv_ZV: base-type-encoding=NONE
    BT_NM_Gateway_NM_State: base-type-encoding=NONE
    BT_NM_Gateway_UDS_CC: base-type-encoding=NONE
    BT_NM_Kessy2_CAB_V15: base-type-encoding=ISO-8859-1
    BT_NM_Kessy2_Car_Wakeup: base-type-encoding=NONE
    BT_NM_Kessy2_CBV_AWB: base-type-encoding=NONE
    BT_NM_Kessy2_CBV_CRI: base-type-encoding=NONE
    BT_NM_Kessy2_NM_aktiv_Diagnose: base-type-encoding=NONE
    BT_NM_Kessy2_NM_aktiv_KL15: base-type-encoding=NONE
    BT_NM_Kessy2_NM_aktiv_Tmin: base-type-encoding=NONE
    BT_NM_Kessy2_NM_State: base-type-encoding=NONE
    BT_NM_Kessy2_UDS_CC: base-type-encoding=NONE
    BT_NM_Kessy_CAB_V15: base-type-encoding=ISO-8859-1
    BT_NM_Kessy_Car_Wakeup: base-type-encoding=NONE
    BT_NM_Kessy_CBV_AWB: base-type-encoding=NONE
    BT_NM_Kessy_CBV_CRI: base-type-encoding=NONE
    BT_NM_Kessy_NM_aktiv_Diagnose: base-type-encoding=NONE
    BT_NM_Kessy_NM_aktiv_KL15: base-type-encoding=NONE
    BT_NM_Kessy_NM_aktiv_TGS: base-type-encoding=NONE
    BT_NM_Kessy_NM_aktiv_Tmin: base-type-encoding=NONE
    BT_NM_Kessy_NM_State: base-type-encoding=NONE
    BT_NM_Kessy_UDS_CC: base-type-encoding=NONE
    BT_NM_MFG_CAB_V15: base-type-encoding=ISO-8859-1
    BT_NM_MFG_Car_Wakeup: base-type-encoding=NONE
    BT_NM_MFG_CBV_AWB: base-type-encoding=NONE
    BT_NM_MFG_CBV_CRI: base-type-encoding=NONE
    BT_NM_MFG_NM_aktiv_Anhaltesignal: base-type-encoding=NONE
    BT_NM_MFG_NM_aktiv_Bus: base-type-encoding=NONE
    BT_NM_MFG_NM_aktiv_Diagnose: base-type-encoding=NONE
    BT_NM_MFG_NM_aktiv_KL15: base-type-encoding=NONE
    BT_NM_MFG_NM_aktiv_SoSi: base-type-encoding=NONE
    BT_NM_MFG_NM_aktiv_Taxialarm: base-type-encoding=NONE
    BT_NM_MFG_NM_aktiv_Tmin: base-type-encoding=NONE
    BT_NM_MFG_NM_aktiv_Tuerentr_hinten: base-type-encoding=NONE
    BT_NM_MFG_NM_State: base-type-encoding=NONE
    BT_NM_MFG_UDS_CC: base-type-encoding=NONE
    BT_NM_NFC_TGS_CAB_V15: base-type-encoding=ISO-8859-1
    BT_NM_NFC_TGS_Car_Wakeup: base-type-encoding=NONE
    BT_NM_NFC_TGS_CBV_AWB: base-type-encoding=NONE
    BT_NM_NFC_TGS_CBV_CRI: base-type-encoding=NONE
    BT_NM_NFC_TGS_NM_aktiv_Auth: base-type-encoding=NONE
    BT_NM_NFC_TGS_NM_aktiv_Diagnose: base-type-encoding=NONE
    BT_NM_NFC_TGS_NM_aktiv_KL15: base-type-encoding=NONE
    BT_NM_NFC_TGS_NM_aktiv_Tmin: base-type-encoding=NONE
    BT_NM_NFC_TGS_NM_State: base-type-encoding=NONE
    BT_NM_NFC_TGS_UDS_CC: base-type-encoding=NONE
    BT_NM_RSAD_HL_CAB_V15: base-type-encoding=ISO-8859-1
    BT_NM_RSAD_HL_Car_Wakeup: base-type-encoding=NONE
    BT_NM_RSAD_HL_CBV_AWB: base-type-encoding=NONE
    BT_NM_RSAD_HL_CBV_CRI: base-type-encoding=NONE
    BT_NM_RSAD_HL_NM_aktiv_Diagnose: base-type-encoding=NONE
    BT_NM_RSAD_HL_NM_aktiv_KL15: base-type-encoding=NONE
    BT_NM_RSAD_HL_NM_aktiv_Tmin: base-type-encoding=NONE
    BT_NM_RSAD_HL_NM_State: base-type-encoding=NONE
    BT_NM_RSAD_HL_UDS_CC: base-type-encoding=NONE
    BT_NM_RSAD_HR_CAB_V15: base-type-encoding=ISO-8859-1
    BT_NM_RSAD_HR_Car_Wakeup: base-type-encoding=NONE
    BT_NM_RSAD_HR_CBV_AWB: base-type-encoding=NONE
    BT_NM_RSAD_HR_CBV_CRI: base-type-encoding=NONE
    BT_NM_RSAD_HR_NM_aktiv_Diagnose: base-type-encoding=NONE
    BT_NM_RSAD_HR_NM_aktiv_KL15: base-type-encoding=NONE
    BT_NM_RSAD_HR_NM_aktiv_Tmin: base-type-encoding=NONE
    BT_NM_RSAD_HR_NM_State: base-type-encoding=NONE
    BT_NM_RSAD_HR_UDS_CC: base-type-encoding=NONE
    BT_NM_RSAD_IN_CAB_V15: base-type-encoding=ISO-8859-1
    BT_NM_RSAD_IN_Car_Wakeup: base-type-encoding=NONE
    BT_NM_RSAD_IN_CBV_AWB: base-type-encoding=NONE
    BT_NM_RSAD_IN_CBV_CRI: base-type-encoding=NONE
    BT_NM_RSAD_IN_NM_aktiv_Diagnose: base-type-encoding=NONE
    BT_NM_RSAD_IN_NM_aktiv_KL15: base-type-encoding=NONE
    BT_NM_RSAD_IN_NM_aktiv_Tmin: base-type-encoding=NONE
    BT_NM_RSAD_IN_NM_State: base-type-encoding=NONE
    BT_NM_RSAD_IN_UDS_CC: base-type-encoding=NONE
    BT_NM_RSAD_VL_CAB_V15: base-type-encoding=ISO-8859-1
    BT_NM_RSAD_VL_Car_Wakeup: base-type-encoding=NONE
    BT_NM_RSAD_VL_CBV_AWB: base-type-encoding=NONE
    BT_NM_RSAD_VL_CBV_CRI: base-type-encoding=NONE
    BT_NM_RSAD_VL_NM_aktiv_Diagnose: base-type-encoding=NONE
    BT_NM_RSAD_VL_NM_aktiv_KL15: base-type-encoding=NONE
    BT_NM_RSAD_VL_NM_aktiv_Tmin: base-type-encoding=NONE
    BT_NM_RSAD_VL_NM_State: base-type-encoding=NONE
    BT_NM_RSAD_VL_UDS_CC: base-type-encoding=NONE
    BT_NM_RSAD_VR_CAB_V15: base-type-encoding=ISO-8859-1
    BT_NM_RSAD_VR_Car_Wakeup: base-type-encoding=NONE
    BT_NM_RSAD_VR_CBV_AWB: base-type-encoding=NONE
    BT_NM_RSAD_VR_CBV_CRI: base-type-encoding=NONE
    BT_NM_RSAD_VR_NM_aktiv_Diagnose: base-type-encoding=NONE
    BT_NM_RSAD_VR_NM_aktiv_KL15: base-type-encoding=NONE
    BT_NM_RSAD_VR_NM_aktiv_Tmin: base-type-encoding=NONE
    BT_NM_RSAD_VR_NM_State: base-type-encoding=NONE
    BT_NM_RSAD_VR_UDS_CC: base-type-encoding=NONE
    BT_NM_WLC1_aktiv_Diagnose: base-type-encoding=NONE
    BT_NM_WLC1_aktiv_Tmin: base-type-encoding=NONE
    BT_NM_WLC1_Car_Wakeup: base-type-encoding=NONE
    BT_NM_WLC1_CBV_AWB: base-type-encoding=NONE
    BT_NM_WLC1_CBV_CRI: base-type-encoding=NONE
    BT_NM_WLC1_NM_aktiv_KL15: base-type-encoding=NONE
    BT_NM_WLC1_NM_State: base-type-encoding=NONE
    BT_NM_WLC1_UDS_CC: base-type-encoding=NONE
    BT_NR1_ORUData: base-type-encoding=NONE
    BT_NR1_ORUDataIndex: base-type-encoding=NONE
    BT_NR2_ORUData: base-type-encoding=NONE
    BT_NR2_ORUDataIndex: base-type-encoding=NONE
    BT_NR3_ORUData: base-type-encoding=NONE
    BT_NR3_ORUDataIndex: base-type-encoding=NONE
    BT_NR4_ORUData: base-type-encoding=NONE
    BT_NR4_ORUDataIndex: base-type-encoding=NONE
    BT_NVEM_Abschaltstufe: base-type-encoding=NONE
    BT_NVEM_Anf_SD_schalten: base-type-encoding=NONE
    BT_NVEM_Batterie_Service: base-type-encoding=NONE
    BT_NVEM_Freigabe_OnlineUpdate: base-type-encoding=NONE
    BT_NVEM_Freigabe_ORU4: base-type-encoding=NONE
    BT_NVEM_Freigabe_ZusBatt_Laden: base-type-encoding=NONE
    BT_NVEM_HV_Stuetzung_aktiv: base-type-encoding=NONE
    BT_NVEM_Verbraucherabsch_Anz: base-type-encoding=NONE
    BT_OBD_Abs_Load_Val: base-type-encoding=NONE
    BT_OBD_Abs_Pedal_Pos: base-type-encoding=NONE
    BT_OBD_Abs_Throttle_Pos: base-type-encoding=NONE
    BT_OBD_Aussen_Temp_gef: base-type-encoding=NONE
    BT_OBD_Calc_Load_Val: base-type-encoding=NONE
    BT_OBD_ClearMem_Inhibit: base-type-encoding=NONE
    BT_OBD_Driving_Cycle: base-type-encoding=NONE
    BT_OBD_Eng_Cool_Temp: base-type-encoding=NONE
    BT_OBD_Kaltstart_Denominator: base-type-encoding=NONE
    BT_OBD_Minimum_Trip: base-type-encoding=NONE
    BT_OBD_Normed_Trip: base-type-encoding=NONE
    BT_OBD_QBit_Schlechtweg: base-type-encoding=NONE
    BT_OBD_Schlechtweg: base-type-encoding=NONE
    BT_OBD_Sperrung_IUMPR: base-type-encoding=NONE
    BT_OBD_Sperrung_Kaltstart_Denom: base-type-encoding=NONE
    BT_OBD_Warm_Up_Cycle: base-type-encoding=NONE
    BT_OBDProtocol_req: base-type-encoding=NONE
    BT_OCC_ORUData: base-type-encoding=NONE
    BT_OCC_ORUDataIndex: base-type-encoding=NONE
    BT_OCU_Privacymode_Locationdata: base-type-encoding=NONE
    BT_OCU_Privacymode_Status: base-type-encoding=NONE
    BT_OPS_ComfortReadyStatus: base-type-encoding=NONE
    BT_OPS_DriverPresenceStatus: base-type-encoding=NONE
    BT_OPS_OccupantPresenceStatus: base-type-encoding=NONE
    BT_OPS_QBit_DriverPresence: base-type-encoding=NONE
    BT_OPS_SafeDriverPresence_available: base-type-encoding=NONE
    BT_OPS_SafeDriverPresenceStatus: base-type-encoding=NONE
    BT_ORU_0001_BZ: base-type-encoding=NONE
    BT_ORU_0001_CRC: base-type-encoding=NONE
    BT_ORU_0003_BZ: base-type-encoding=NONE
    BT_ORU_0003_CRC: base-type-encoding=NONE
    BT_ORU_0006_BZ: base-type-encoding=NONE
    BT_ORU_0006_CRC: base-type-encoding=NONE
    BT_ORU_0009_BZ: base-type-encoding=NONE
    BT_ORU_0009_CRC: base-type-encoding=NONE
    BT_ORU_0013_BZ: base-type-encoding=NONE
    BT_ORU_0013_CRC: base-type-encoding=NONE
    BT_ORU_0015_BZ: base-type-encoding=NONE
    BT_ORU_0015_CRC: base-type-encoding=NONE
    BT_ORU_0016_BZ: base-type-encoding=NONE
    BT_ORU_0016_CRC: base-type-encoding=NONE
    BT_ORU_0019_BZ: base-type-encoding=NONE
    BT_ORU_0019_CRC: base-type-encoding=NONE
    BT_ORU_0023_BZ: base-type-encoding=NONE
    BT_ORU_0023_CRC: base-type-encoding=NONE
    BT_ORU_0036_BZ: base-type-encoding=NONE
    BT_ORU_0036_CRC: base-type-encoding=NONE
    BT_ORU_003D_BZ: base-type-encoding=NONE
    BT_ORU_003D_CRC: base-type-encoding=NONE
    BT_ORU_0042_BZ: base-type-encoding=NONE
    BT_ORU_0042_CRC: base-type-encoding=NONE
    BT_ORU_0044_BZ: base-type-encoding=NONE
    BT_ORU_0044_CRC: base-type-encoding=NONE
    BT_ORU_0048_BZ: base-type-encoding=NONE
    BT_ORU_0048_CRC: base-type-encoding=NONE
    BT_ORU_0051_BZ: base-type-encoding=NONE
    BT_ORU_0051_CRC: base-type-encoding=NONE
    BT_ORU_0052_BZ: base-type-encoding=NONE
    BT_ORU_0052_CRC: base-type-encoding=NONE
    BT_ORU_005B_BZ: base-type-encoding=NONE
    BT_ORU_005B_CRC: base-type-encoding=NONE
    BT_ORU_0069_BZ: base-type-encoding=NONE
    BT_ORU_0069_CRC: base-type-encoding=NONE
    BT_ORU_006A_BZ: base-type-encoding=NONE
    BT_ORU_006A_CRC: base-type-encoding=NONE
    BT_ORU_0076_BZ: base-type-encoding=NONE
    BT_ORU_0076_CRC: base-type-encoding=NONE
    BT_ORU_007A_BZ: base-type-encoding=NONE
    BT_ORU_007A_CRC: base-type-encoding=NONE
    BT_ORU_007E_BZ: base-type-encoding=NONE
    BT_ORU_007E_CRC: base-type-encoding=NONE
    BT_ORU_0082_BZ: base-type-encoding=NONE
    BT_ORU_0082_CRC: base-type-encoding=NONE
    BT_ORU_008C_BZ: base-type-encoding=NONE
    BT_ORU_008C_CRC: base-type-encoding=NONE
    BT_ORU_00A5_BZ: base-type-encoding=NONE
    BT_ORU_00A5_CRC: base-type-encoding=NONE
    BT_ORU_00BB_BZ: base-type-encoding=NONE
    BT_ORU_00BB_CRC: base-type-encoding=NONE
    BT_ORU_00BC_BZ: base-type-encoding=NONE
    BT_ORU_00BC_CRC: base-type-encoding=NONE
    BT_ORU_00C6_BZ: base-type-encoding=NONE
    BT_ORU_00C6_CRC: base-type-encoding=NONE
    BT_ORU_00CE_BZ: base-type-encoding=NONE
    BT_ORU_00CE_CRC: base-type-encoding=NONE
    BT_ORU_00D6_BZ: base-type-encoding=NONE
    BT_ORU_00D6_CRC: base-type-encoding=NONE
    BT_ORU_00D7_BZ: base-type-encoding=NONE
    BT_ORU_00D7_CRC: base-type-encoding=NONE
    BT_ORU_01_BZ: base-type-encoding=NONE
    BT_ORU_01_CRC: base-type-encoding=NONE
    BT_ORU_0631_BZ: base-type-encoding=NONE
    BT_ORU_0631_CRC: base-type-encoding=NONE
    BT_ORU_8105_BZ: base-type-encoding=NONE
    BT_ORU_8105_CRC: base-type-encoding=NONE
    BT_ORU_8109_BZ: base-type-encoding=NONE
    BT_ORU_8109_CRC: base-type-encoding=NONE
    BT_ORU_810A_BZ: base-type-encoding=NONE
    BT_ORU_810A_CRC: base-type-encoding=NONE
    BT_ORU_810B_BZ: base-type-encoding=NONE
    BT_ORU_810B_CRC: base-type-encoding=NONE
    BT_ORU_810C_BZ: base-type-encoding=NONE
    BT_ORU_810C_CRC: base-type-encoding=NONE
    BT_ORU_8133_BZ: base-type-encoding=NONE
    BT_ORU_8133_CRC: base-type-encoding=NONE
    BT_ORU_8134_BZ: base-type-encoding=NONE
    BT_ORU_8134_CRC: base-type-encoding=NONE
    BT_ORU_8179_BZ: base-type-encoding=NONE
    BT_ORU_8179_CRC: base-type-encoding=NONE
    BT_ORU_817B_BZ: base-type-encoding=NONE
    BT_ORU_817B_CRC: base-type-encoding=NONE
    BT_ORU_8181_BZ: base-type-encoding=NONE
    BT_ORU_8181_CRC: base-type-encoding=NONE
    BT_ORU_AP_Mode: base-type-encoding=NONE
    BT_ORU_DiagAddress: base-type-encoding=NONE
    BT_ORU_EM_Anfrage_Flashdauer: base-type-encoding=NONE
    BT_ORU_EM_Anfrage_freigegebeneNetze: base-type-encoding=NONE
    BT_ORU_EM_Anfrage_Stromaufnahme: base-type-encoding=NONE
    BT_ORU_Inventory: base-type-encoding=NONE
    BT_ORU_Status: base-type-encoding=NONE
    BT_ORU_Warnung: base-type-encoding=NONE
    BT_ORUG01_01_BZ: base-type-encoding=NONE
    BT_ORUG01_01_CRC: base-type-encoding=NONE
    BT_ORUG02_01_BZ: base-type-encoding=NONE
    BT_ORUG02_01_CRC: base-type-encoding=NONE
    BT_ORUG1_ADEngagementLock: base-type-encoding=NONE
    BT_ORUG1_Anforderung_HMS: base-type-encoding=NONE
    BT_ORUG1_GuardInfo: base-type-encoding=NONE
    BT_ORUG1_GuardState: base-type-encoding=NONE
    BT_ORUG1_HVLock: base-type-encoding=NONE
    BT_ORUG1_HVReleased: base-type-encoding=NONE
    BT_ORUG1_Parken_beibehalten_HMS: base-type-encoding=NONE
    BT_ORUG1_TargetRelease: base-type-encoding=NONE
    BT_ORUG1_Warning: base-type-encoding=NONE
    BT_ORUG2_GuardInfo: base-type-encoding=NONE
    BT_ORUG2_GuardState: base-type-encoding=NONE
    BT_ORUG2_TargetRelease: base-type-encoding=NONE
    BT_ORUG2_TorqueLock: base-type-encoding=NONE
    BT_PaCo_DiETa_LED: base-type-encoding=NONE
    BT_PAO_OFF_Anf_invers: base-type-encoding=NONE
    BT_PAO_OFF_Status: base-type-encoding=NONE
    BT_PAO_ON_Anf_invers: base-type-encoding=NONE
    BT_PAO_ON_Status: base-type-encoding=NONE
    BT_PAO_Status_01_BZ: base-type-encoding=NONE
    BT_PAO_Status_01_CRC: base-type-encoding=NONE
    BT_PAO_Status_Reserve_Byte3: base-type-encoding=NONE
    BT_Parken_aktives_System_02: base-type-encoding=NONE
    BT_Parken_Aktivierungslicht_Anf: base-type-encoding=NONE
    BT_Parken_Bestaetigungsblinken_Anf: base-type-encoding=NONE
    BT_Parken_Fahrbereitschaftlicht_Anf: base-type-encoding=NONE
    BT_Parken_Fahrerhinweise_Anf: base-type-encoding=NONE
    BT_Parken_Fahrtrichtungslicht_Anf: base-type-encoding=NONE
    BT_Parken_FFB_LED_Anf: base-type-encoding=NONE
    BT_Parken_Lichtnachlauf_Anf: base-type-encoding=NONE
    BT_Parken_Lichtsteuerung_Anf: base-type-encoding=NONE
    BT_Parken_Schluesselsuche_Anf: base-type-encoding=NONE
    BT_Parken_Seitenspiegel_Anf: base-type-encoding=NONE
    BT_Parken_Wegfahrsperren_Anf: base-type-encoding=NONE
    BT_Parken_ZR_Sondermodus_Anf: base-type-encoding=NONE
    BT_Parken_ZV_Schliessen: base-type-encoding=NONE
    BT_Perso_Aktiv: base-type-encoding=NONE
    BT_Perso_Bedienstelle: base-type-encoding=NONE
    BT_Perso_Fahrernummer: base-type-encoding=NONE
    BT_Perso_Freigabe_Verstellung: base-type-encoding=NONE
    BT_Perso_Kontonummer: base-type-encoding=NONE
    BT_Perso_Schreibschutz: base-type-encoding=NONE
    BT_Perso_Status: base-type-encoding=NONE
    BT_Perso_Steuerung: base-type-encoding=NONE
    BT_Perso_Steuerungsparameter: base-type-encoding=NONE
    BT_PreCrash_Anforderung_AFR: base-type-encoding=NONE
    BT_PreCrash_BFS_KSV_verfahren: base-type-encoding=NONE
    BT_PreCrash_BFS_Laengsverstellung: base-type-encoding=NONE
    BT_PreCrash_BFS_Pneumatik_ansteuern: base-type-encoding=NONE
    BT_PreCrash_BFS_Sitzlehne_verfahren: base-type-encoding=NONE
    BT_PreCrash_Blinken: base-type-encoding=NONE
    BT_PreCrash_Charisma_FahrPr: base-type-encoding=NONE
    BT_PreCrash_Charisma_Status: base-type-encoding=NONE
    BT_PreCrash_Fenster_schliessen: base-type-encoding=NONE
    BT_PreCrash_Fo_KSV_verfahren: base-type-encoding=NONE
    BT_PreCrash_Fo_Pneumatik_ansteuern: base-type-encoding=NONE
    BT_PreCrash_Fo_Sitzlehne_verfahren: base-type-encoding=NONE
    BT_PreCrash_FS_KSV_verfahren: base-type-encoding=NONE
    BT_PreCrash_FS_Laengsverstellung: base-type-encoding=NONE
    BT_PreCrash_FS_Pneumatik_ansteuern: base-type-encoding=NONE
    BT_PreCrash_FS_Sitzlehne_verfahren: base-type-encoding=NONE
    BT_PreCrash_Schiebedach_schliessen: base-type-encoding=NONE
    BT_PreCrash_Tueren_Verriegeln: base-type-encoding=NONE
    BT_RCTA_01_BZ: base-type-encoding=NONE
    BT_RCTA_01_CRC: base-type-encoding=NONE
    BT_RCTA_Anforderung_HMS: base-type-encoding=NONE
    BT_RCTA_Bremsruck_Anforderung: base-type-encoding=NONE
    BT_RCTA_Bremsruck_Freigabe: base-type-encoding=NONE
    BT_RCTA_Info_links: base-type-encoding=NONE
    BT_RCTA_Info_rechts: base-type-encoding=NONE
    BT_RCTA_Kritikalitaetslevel_links: base-type-encoding=NONE
    BT_RCTA_Kritikalitaetslevel_rechts: base-type-encoding=NONE
    BT_RCTA_Modus: base-type-encoding=NONE
    BT_RCTA_Notbremsung_Anforderung: base-type-encoding=NONE
    BT_RCTA_Notbremsung_Freigabe: base-type-encoding=NONE
    BT_RCTA_PaCo_BrakeIntervention: base-type-encoding=NONE
    BT_RCTA_PaCo_BrakingPossible: base-type-encoding=NONE
    BT_RCTA_PaCo_MainState: base-type-encoding=NONE
    BT_RCTA_PaCo_UnavailableReason: base-type-encoding=NONE
    BT_RCTA_Status: base-type-encoding=NONE
    BT_RCTA_Status_FoD: base-type-encoding=NONE
    BT_RCTA_Warnton: base-type-encoding=NONE
    BT_Relais_VoKo_angesteuert: base-type-encoding=NONE
    BT_RGB_Slave_01_IntErrorNvm: base-type-encoding=NONE
    BT_RGB_Slave_01_IntErrorRam: base-type-encoding=NONE
    BT_RGB_Slave_01_IntErrorRom: base-type-encoding=NONE
    BT_RGB_Slave_01_LedBlauOl: base-type-encoding=NONE
    BT_RGB_Slave_01_LedBlauStg: base-type-encoding=NONE
    BT_RGB_Slave_01_LedGruenOl: base-type-encoding=NONE
    BT_RGB_Slave_01_LedGruenStg: base-type-encoding=NONE
    BT_RGB_Slave_01_LedRotOl: base-type-encoding=NONE
    BT_RGB_Slave_01_LedRotStg: base-type-encoding=NONE
    BT_RGB_Slave_01_ResponseError: base-type-encoding=NONE
    BT_RGB_Slave_01_TempState: base-type-encoding=NONE
    BT_RGB_Slave_02_IntErrorNvm: base-type-encoding=NONE
    BT_RGB_Slave_02_IntErrorRam: base-type-encoding=NONE
    BT_RGB_Slave_02_IntErrorRom: base-type-encoding=NONE
    BT_RGB_Slave_02_LedBlauOl: base-type-encoding=NONE
    BT_RGB_Slave_02_LedBlauStg: base-type-encoding=NONE
    BT_RGB_Slave_02_LedGruenOl: base-type-encoding=NONE
    BT_RGB_Slave_02_LedGruenStg: base-type-encoding=NONE
    BT_RGB_Slave_02_LedRotOl: base-type-encoding=NONE
    BT_RGB_Slave_02_LedRotStg: base-type-encoding=NONE
    BT_RGB_Slave_02_ResponseError: base-type-encoding=NONE
    BT_RGB_Slave_02_TempState: base-type-encoding=NONE
    BT_RGB_Slave_03_IntErrorNvm: base-type-encoding=NONE
    BT_RGB_Slave_03_IntErrorRam: base-type-encoding=NONE
    BT_RGB_Slave_03_IntErrorRom: base-type-encoding=NONE
    BT_RGB_Slave_03_LedBlauOl: base-type-encoding=NONE
    BT_RGB_Slave_03_LedBlauStg: base-type-encoding=NONE
    BT_RGB_Slave_03_LedGruenOl: base-type-encoding=NONE
    BT_RGB_Slave_03_LedGruenStg: base-type-encoding=NONE
    BT_RGB_Slave_03_LedRotOl: base-type-encoding=NONE
    BT_RGB_Slave_03_LedRotStg: base-type-encoding=NONE
    BT_RGB_Slave_03_ResponseError: base-type-encoding=NONE
    BT_RGB_Slave_03_TempState: base-type-encoding=NONE
    BT_RGB_Slave_04_IntErrorNvm: base-type-encoding=NONE
    BT_RGB_Slave_04_IntErrorRam: base-type-encoding=NONE
    BT_RGB_Slave_04_IntErrorRom: base-type-encoding=NONE
    BT_RGB_Slave_04_LedBlauOl: base-type-encoding=NONE
    BT_RGB_Slave_04_LedBlauStg: base-type-encoding=NONE
    BT_RGB_Slave_04_LedGruenOl: base-type-encoding=NONE
    BT_RGB_Slave_04_LedGruenStg: base-type-encoding=NONE
    BT_RGB_Slave_04_LedRotOl: base-type-encoding=NONE
    BT_RGB_Slave_04_LedRotStg: base-type-encoding=NONE
    BT_RGB_Slave_04_ResponseError: base-type-encoding=NONE
    BT_RGB_Slave_04_TempState: base-type-encoding=NONE
    BT_RGB_Slave_05_IntErrorNvm: base-type-encoding=NONE
    BT_RGB_Slave_05_IntErrorRam: base-type-encoding=NONE
    BT_RGB_Slave_05_IntErrorRom: base-type-encoding=NONE
    BT_RGB_Slave_05_LedBlauOl: base-type-encoding=NONE
    BT_RGB_Slave_05_LedBlauStg: base-type-encoding=NONE
    BT_RGB_Slave_05_LedGruenOl: base-type-encoding=NONE
    BT_RGB_Slave_05_LedGruenStg: base-type-encoding=NONE
    BT_RGB_Slave_05_LedRotOl: base-type-encoding=NONE
    BT_RGB_Slave_05_LedRotStg: base-type-encoding=NONE
    BT_RGB_Slave_05_ResponseError: base-type-encoding=NONE
    BT_RGB_Slave_05_TempState: base-type-encoding=NONE
    BT_RGB_Slave_06_IntErrorNvm: base-type-encoding=NONE
    BT_RGB_Slave_06_IntErrorRam: base-type-encoding=NONE
    BT_RGB_Slave_06_IntErrorRom: base-type-encoding=NONE
    BT_RGB_Slave_06_LedBlauOl: base-type-encoding=NONE
    BT_RGB_Slave_06_LedBlauStg: base-type-encoding=NONE
    BT_RGB_Slave_06_LedGruenOl: base-type-encoding=NONE
    BT_RGB_Slave_06_LedGruenStg: base-type-encoding=NONE
    BT_RGB_Slave_06_LedRotOl: base-type-encoding=NONE
    BT_RGB_Slave_06_LedRotStg: base-type-encoding=NONE
    BT_RGB_Slave_06_ResponseError: base-type-encoding=NONE
    BT_RGB_Slave_06_TempState: base-type-encoding=NONE
    BT_RGB_Slave_07_IntErrorNvm: base-type-encoding=NONE
    BT_RGB_Slave_07_IntErrorRam: base-type-encoding=NONE
    BT_RGB_Slave_07_IntErrorRom: base-type-encoding=NONE
    BT_RGB_Slave_07_LedBlauOl: base-type-encoding=NONE
    BT_RGB_Slave_07_LedBlauStg: base-type-encoding=NONE
    BT_RGB_Slave_07_LedGruenOl: base-type-encoding=NONE
    BT_RGB_Slave_07_LedGruenStg: base-type-encoding=NONE
    BT_RGB_Slave_07_LedRotOl: base-type-encoding=NONE
    BT_RGB_Slave_07_LedRotStg: base-type-encoding=NONE
    BT_RGB_Slave_07_ResponseError: base-type-encoding=NONE
    BT_RGB_Slave_07_TempState: base-type-encoding=NONE
    BT_RGB_Slave_08_IntErrorNvm: base-type-encoding=NONE
    BT_RGB_Slave_08_IntErrorRam: base-type-encoding=NONE
    BT_RGB_Slave_08_IntErrorRom: base-type-encoding=NONE
    BT_RGB_Slave_08_LedBlauOl: base-type-encoding=NONE
    BT_RGB_Slave_08_LedBlauStg: base-type-encoding=NONE
    BT_RGB_Slave_08_LedGruenOl: base-type-encoding=NONE
    BT_RGB_Slave_08_LedGruenStg: base-type-encoding=NONE
    BT_RGB_Slave_08_LedRotOl: base-type-encoding=NONE
    BT_RGB_Slave_08_LedRotStg: base-type-encoding=NONE
    BT_RGB_Slave_08_ResponseError: base-type-encoding=NONE
    BT_RGB_Slave_08_TempState: base-type-encoding=NONE
    BT_RGB_Slave_09_IntErrorNvm: base-type-encoding=NONE
    BT_RGB_Slave_09_IntErrorRam: base-type-encoding=NONE
    BT_RGB_Slave_09_IntErrorRom: base-type-encoding=NONE
    BT_RGB_Slave_09_LedBlauOl: base-type-encoding=NONE
    BT_RGB_Slave_09_LedBlauStg: base-type-encoding=NONE
    BT_RGB_Slave_09_LedGruenOl: base-type-encoding=NONE
    BT_RGB_Slave_09_LedGruenStg: base-type-encoding=NONE
    BT_RGB_Slave_09_LedRotOl: base-type-encoding=NONE
    BT_RGB_Slave_09_LedRotStg: base-type-encoding=NONE
    BT_RGB_Slave_09_ResponseError: base-type-encoding=NONE
    BT_RGB_Slave_09_TempState: base-type-encoding=NONE
    BT_RGB_Slave_10_IntErrorNvm: base-type-encoding=NONE
    BT_RGB_Slave_10_IntErrorRam: base-type-encoding=NONE
    BT_RGB_Slave_10_IntErrorRom: base-type-encoding=NONE
    BT_RGB_Slave_10_LedBlauOl: base-type-encoding=NONE
    BT_RGB_Slave_10_LedBlauStg: base-type-encoding=NONE
    BT_RGB_Slave_10_LedGruenOl: base-type-encoding=NONE
    BT_RGB_Slave_10_LedGruenStg: base-type-encoding=NONE
    BT_RGB_Slave_10_LedRotOl: base-type-encoding=NONE
    BT_RGB_Slave_10_LedRotStg: base-type-encoding=NONE
    BT_RGB_Slave_10_ResponseError: base-type-encoding=NONE
    BT_RGB_Slave_10_TempState: base-type-encoding=NONE
    BT_RGB_Slave_11_IntErrorNvm: base-type-encoding=NONE
    BT_RGB_Slave_11_IntErrorRam: base-type-encoding=NONE
    BT_RGB_Slave_11_IntErrorRom: base-type-encoding=NONE
    BT_RGB_Slave_11_LedBlauOl: base-type-encoding=NONE
    BT_RGB_Slave_11_LedBlauStg: base-type-encoding=NONE
    BT_RGB_Slave_11_LedGruenOl: base-type-encoding=NONE
    BT_RGB_Slave_11_LedGruenStg: base-type-encoding=NONE
    BT_RGB_Slave_11_LedRotOl: base-type-encoding=NONE
    BT_RGB_Slave_11_LedRotStg: base-type-encoding=NONE
    BT_RGB_Slave_11_ResponseError: base-type-encoding=NONE
    BT_RGB_Slave_11_TempState: base-type-encoding=NONE
    BT_RGB_Slave_12_IntErrorNvm: base-type-encoding=NONE
    BT_RGB_Slave_12_IntErrorRam: base-type-encoding=NONE
    BT_RGB_Slave_12_IntErrorRom: base-type-encoding=NONE
    BT_RGB_Slave_12_LedBlauOl: base-type-encoding=NONE
    BT_RGB_Slave_12_LedBlauStg: base-type-encoding=NONE
    BT_RGB_Slave_12_LedGruenOl: base-type-encoding=NONE
    BT_RGB_Slave_12_LedGruenStg: base-type-encoding=NONE
    BT_RGB_Slave_12_LedRotOl: base-type-encoding=NONE
    BT_RGB_Slave_12_LedRotStg: base-type-encoding=NONE
    BT_RGB_Slave_12_ResponseError: base-type-encoding=NONE
    BT_RGB_Slave_12_TempState: base-type-encoding=NONE
    BT_RGB_Slave_13_IntErrorNvm: base-type-encoding=NONE
    BT_RGB_Slave_13_IntErrorRam: base-type-encoding=NONE
    BT_RGB_Slave_13_IntErrorRom: base-type-encoding=NONE
    BT_RGB_Slave_13_LedBlauOl: base-type-encoding=NONE
    BT_RGB_Slave_13_LedBlauStg: base-type-encoding=NONE
    BT_RGB_Slave_13_LedGruenOl: base-type-encoding=NONE
    BT_RGB_Slave_13_LedGruenStg: base-type-encoding=NONE
    BT_RGB_Slave_13_LedRotOl: base-type-encoding=NONE
    BT_RGB_Slave_13_LedRotStg: base-type-encoding=NONE
    BT_RGB_Slave_13_ResponseError: base-type-encoding=NONE
    BT_RGB_Slave_13_TempState: base-type-encoding=NONE
    BT_RGB_Slave_14_IntErrorNvm: base-type-encoding=NONE
    BT_RGB_Slave_14_IntErrorRam: base-type-encoding=NONE
    BT_RGB_Slave_14_IntErrorRom: base-type-encoding=NONE
    BT_RGB_Slave_14_LedBlauOl: base-type-encoding=NONE
    BT_RGB_Slave_14_LedBlauStg: base-type-encoding=NONE
    BT_RGB_Slave_14_LedGruenOl: base-type-encoding=NONE
    BT_RGB_Slave_14_LedGruenStg: base-type-encoding=NONE
    BT_RGB_Slave_14_LedRotOl: base-type-encoding=NONE
    BT_RGB_Slave_14_LedRotStg: base-type-encoding=NONE
    BT_RGB_Slave_14_ResponseError: base-type-encoding=NONE
    BT_RGB_Slave_14_TempState: base-type-encoding=NONE
    BT_RGB_Slave_15_IntErrorNvm: base-type-encoding=NONE
    BT_RGB_Slave_15_IntErrorRam: base-type-encoding=NONE
    BT_RGB_Slave_15_IntErrorRom: base-type-encoding=NONE
    BT_RGB_Slave_15_LedBlauOl: base-type-encoding=NONE
    BT_RGB_Slave_15_LedBlauStg: base-type-encoding=NONE
    BT_RGB_Slave_15_LedGruenOl: base-type-encoding=NONE
    BT_RGB_Slave_15_LedGruenStg: base-type-encoding=NONE
    BT_RGB_Slave_15_LedRotOl: base-type-encoding=NONE
    BT_RGB_Slave_15_LedRotStg: base-type-encoding=NONE
    BT_RGB_Slave_15_ResponseError: base-type-encoding=NONE
    BT_RGB_Slave_15_TempState: base-type-encoding=NONE
    BT_RHP_01_BZ: base-type-encoding=NONE
    BT_RHP_01_CRC: base-type-encoding=NONE
    BT_RHP_Anf_ASIL: base-type-encoding=NONE
    BT_RHP_Anforderung_HMS: base-type-encoding=NONE
    BT_RHP_EA_AnfStat: base-type-encoding=NONE
    BT_RHP_EA_PreCrash: base-type-encoding=NONE
    BT_RHP_Fahrzeughupe_Anf: base-type-encoding=NONE
    BT_RHP_Freilaufstrategie_TSK: base-type-encoding=NONE
    BT_RHP_HOS: base-type-encoding=NONE
    BT_RHP_Minimale_Bremsung: base-type-encoding=NONE
    BT_RHP_neg_Sollbeschl_Grad: base-type-encoding=NONE
    BT_RHP_OPSEnable: base-type-encoding=NONE
    BT_RHP_pos_Sollbeschl_Grad: base-type-encoding=NONE
    BT_RHP_QFK_AnfStat: base-type-encoding=NONE
    BT_RHP_QFK_Art1: base-type-encoding=NONE
    BT_RHP_QFK_Art2: base-type-encoding=NONE
    BT_RHP_QFK_KrSoll: base-type-encoding=NONE
    BT_RHP_QFK_KrSoll_VZ: base-type-encoding=NONE
    BT_RHP_QFK_KruemmSoll: base-type-encoding=NONE
    BT_RHP_QFK_KruemmSoll_VZ: base-type-encoding=NONE
    BT_RHP_QFK_Signal1: base-type-encoding=NONE
    BT_RHP_QFK_Signal2: base-type-encoding=NONE
    BT_RHP_QFK_Spuerb: base-type-encoding=NONE
    BT_RHP_RBF_Available: base-type-encoding=NONE
    BT_RHP_Ruckfreigabe: base-type-encoding=NONE
    BT_RHP_SCAM_HeatingRequest: base-type-encoding=NONE
    BT_RHP_Sollbeschleunigung: base-type-encoding=NONE
    BT_RHP_Spurwechsel_Ready: base-type-encoding=NONE
    BT_RHP_Status_Function: base-type-encoding=NONE
    BT_RHP_Status_Lat: base-type-encoding=NONE
    BT_RHP_Status_Long: base-type-encoding=NONE
    BT_RHP_Tempolimitassistent_EIN: base-type-encoding=NONE
    BT_RHP_TSK_Status: base-type-encoding=NONE
    BT_RHP_TV_Trigger: base-type-encoding=NONE
    BT_RHP_Uss_Anforderung: base-type-encoding=NONE
    BT_RHP_Verz_Anf: base-type-encoding=NONE
    BT_RHP_Verz_Freigabe: base-type-encoding=NONE
    BT_RHP_Warnblinken: base-type-encoding=NONE
    BT_RHP_Warnruckeln_Anf: base-type-encoding=NONE
    BT_RHP_zul_Regelabw_oben: base-type-encoding=NONE
    BT_RHP_zul_Regelabw_unten: base-type-encoding=NONE
    BT_RLS_02_BZ: base-type-encoding=NONE
    BT_RLS_02_CRC: base-type-encoding=NONE
    BT_RLS_CRC: base-type-encoding=NONE
    BT_RLS_Qualifizierungsbit: base-type-encoding=NONE
    BT_RLS_ResponseError: base-type-encoding=NONE
    BT_RLS_Vorfeldhelligkeit_Boost: base-type-encoding=NONE
    BT_RLS_Zaehler: base-type-encoding=NONE
    BT_Rollo_normiert: base-type-encoding=NONE
    BT_Rollo_Thermoschutz: base-type-encoding=NONE
    BT_Rollo_UEKB_aktiv: base-type-encoding=NONE
    BT_RS_AdaptierungError: base-type-encoding=NONE
    BT_RS_defekt: base-type-encoding=NONE
    BT_RS_Error: base-type-encoding=NONE
    BT_RS_Regenfahrlicht: base-type-encoding=NONE
    BT_RS_Regenmenge: base-type-encoding=NONE
    BT_RS_Schwall: base-type-encoding=NONE
    BT_RS_Verbau: base-type-encoding=NONE
    BT_RS_Verglasung_schliessen: base-type-encoding=NONE
    BT_RS_versParklage_Wischer: base-type-encoding=NONE
    BT_RS_Wischergeschwindigkeit: base-type-encoding=NONE
    BT_RSt_Anforderung_HMS: base-type-encoding=NONE
    BT_RSt_Fahrerhinweise: base-type-encoding=NONE
    BT_RV_Calib_Fehler: base-type-encoding=NONE
    BT_RV_Dark_Screen: base-type-encoding=NONE
    BT_RV_Farbe: base-type-encoding=NONE
    BT_RV_GL_LWS_Fehler: base-type-encoding=NONE
    BT_RV_GL_side: base-type-encoding=NONE
    BT_RV_GL_Trailer_connect: base-type-encoding=NONE
    BT_RV_GL_Trunk_open: base-type-encoding=NONE
    BT_RV_Helligkeit: base-type-encoding=NONE
    BT_RV_HMI_Mode: base-type-encoding=NONE
    BT_RV_Kontrast: base-type-encoding=NONE
    BT_RV_Menu_Item: base-type-encoding=NONE
    BT_RV_Reinigung_Anf: base-type-encoding=NONE
    BT_RV_Settings_enabled: base-type-encoding=NONE
    BT_RV_System_aktiv: base-type-encoding=NONE
    BT_RV_Video_on: base-type-encoding=NONE
    BT_SAD_Anf_ESC_Zuschaltung: base-type-encoding=NONE
    BT_SAD_normiert: base-type-encoding=NONE
    BT_SAD_ParityBit: base-type-encoding=NONE
    BT_SAD_Taster_Deckel_hi: base-type-encoding=NONE
    BT_SAD_Taster_Deckel_vo: base-type-encoding=NONE
    BT_SAD_Taster_Rollo_hi: base-type-encoding=NONE
    BT_SAD_Taster_Rollo_vo: base-type-encoding=NONE
    BT_SAD_Text: base-type-encoding=NONE
    BT_SAD_Thermoschutz: base-type-encoding=NONE
    BT_SAD_ToggleBit: base-type-encoding=NONE
    BT_SAD_UEKB_aktiv: base-type-encoding=NONE
    BT_SAL_01_BZ: base-type-encoding=NONE
    BT_SAL_01_CRC: base-type-encoding=NONE
    BT_SAL_Ambex_CH_state: base-type-encoding=NONE
    BT_SAL_Ambex_CH_time: base-type-encoding=NONE
    BT_SAL_Ambex_LH_state: base-type-encoding=NONE
    BT_SAL_Ambex_LH_time: base-type-encoding=NONE
    BT_SAL_Ambex_Lichtsensor_ch_lh_ein: base-type-encoding=NONE
    BT_SAL_Aussenbeleuchtung_defekt: base-type-encoding=NONE
    BT_SAL_Blinkerzyklus_L: base-type-encoding=NONE
    BT_SAL_Blinkerzyklus_R: base-type-encoding=NONE
    BT_SAL_BLK_L_Anf: base-type-encoding=NONE
    BT_SAL_BLK_R_Anf: base-type-encoding=NONE
    BT_SAL_Bremszyklus: base-type-encoding=NONE
    BT_SAL_BRL_Anf: base-type-encoding=NONE
    BT_SAL_CH_Anf: base-type-encoding=NONE
    BT_SAL_EA_Blinken_Status: base-type-encoding=NONE
    BT_SAL_EA_Warnblinken: base-type-encoding=NONE
    BT_SAL_HGB_Anf: base-type-encoding=NONE
    BT_SAL_Kl_15: base-type-encoding=NONE
    BT_SAL_Kl_15_vFzg: base-type-encoding=NONE
    BT_SAL_Kl_15_vFzg_S: base-type-encoding=NONE
    BT_SAL_KL_50: base-type-encoding=NONE
    BT_SAL_KL_50_5s: base-type-encoding=NONE
    BT_SAL_Kl_75: base-type-encoding=NONE
    BT_SAL_KL_75_vFzg: base-type-encoding=NONE
    BT_SAL_KL_75a: base-type-encoding=NONE
    BT_SAL_KL_75a_vFzg: base-type-encoding=NONE
    BT_SAL_KZL_Anf: base-type-encoding=NONE
    BT_SAL_LDS_Abblendlicht_Anf: base-type-encoding=NONE
    BT_SAL_LDS_Assistenzfahrlicht_Anf: base-type-encoding=NONE
    BT_SAL_LDS_Nullstellung_Anf: base-type-encoding=NONE
    BT_SAL_LDS_Standlicht_Anf: base-type-encoding=NONE
    BT_SAL_LH_Anf: base-type-encoding=NONE
    BT_SAL_li1_Blinker_Status: base-type-encoding=NONE
    BT_SAL_NSL_Anf: base-type-encoding=NONE
    BT_SAL_PL_L_Anf: base-type-encoding=NONE
    BT_SAL_PL_R_Anf: base-type-encoding=NONE
    BT_SAL_re1_Blinker_Status: base-type-encoding=NONE
    BT_SAL_RFL_Anf: base-type-encoding=NONE
    BT_SAL_RHP_Blinken_Status: base-type-encoding=NONE
    BT_SAL_RHP_Warnblinken: base-type-encoding=NONE
    BT_SAL_SL_Anf: base-type-encoding=NONE
    BT_SAL_Strg_Beleuchtung_WBT: base-type-encoding=NONE
    BT_SAL_TA_Blinken_Status: base-type-encoding=NONE
    BT_SAL_WBT_Bel: base-type-encoding=NONE
    BT_SAM_01_BZ: base-type-encoding=NONE
    BT_SAM_01_CRC: base-type-encoding=NONE
    BT_SAM_Fehler_DC_LWR: base-type-encoding=NONE
    BT_SAM_ORUData: base-type-encoding=NONE
    BT_SAM_ORUDataIndex: base-type-encoding=NONE
    BT_SBBR_SL_AnimDimm_Freigabe: base-type-encoding=NONE
    BT_SC_PAO_OFF_Anf: base-type-encoding=NONE
    BT_SC_PAO_ON_Anf: base-type-encoding=NONE
    BT_SC_PAO_Schriftzug_Anf: base-type-encoding=NONE
    BT_SC_PreCrash_LED: base-type-encoding=NONE
    BT_SC_PreCrash_Texte: base-type-encoding=NONE
    BT_SC_PreCrash_Warnung: base-type-encoding=NONE
    BT_SC_PreSense_FCWP: base-type-encoding=NONE
    BT_Schluesselnr_Personalisierung: base-type-encoding=NONE
    BT_Servicestellung_Wischer: base-type-encoding=NONE
    BT_SI_BUS_{01..15}: base-type-encoding=NONE
    BT_SI_Bus_Identifikation: base-type-encoding=NONE
    BT_SI_CAB_V15: base-type-encoding=ISO-8859-1
    BT_SI_Diagnose_Aktiv: base-type-encoding=NONE
    BT_SI_NWDF: base-type-encoding=NONE
    BT_SI_NWDF_30: base-type-encoding=NONE
    BT_SI_NWDF_gueltig: base-type-encoding=NONE
    BT_SI_P_Mode: base-type-encoding=NONE
    BT_SI_P_Mode_gueltig: base-type-encoding=NONE
    BT_SI_QRS_Mode: base-type-encoding=NONE
    BT_SI_Sammel_SG_Fehler: base-type-encoding=NONE
    BT_SI_Sammelfehler: base-type-encoding=NONE
    BT_SI_T_Mode: base-type-encoding=NONE
    BT_SI_T_Schutz: base-type-encoding=NONE
    BT_SignalVoid: base-type-encoding=NONE
    BT_SIH_Stufe_LED_li: base-type-encoding=NONE
    BT_SIH_Stufe_LED_re: base-type-encoding=NONE
    BT_SIL_Stufe_LED_li: base-type-encoding=NONE
    BT_SIL_Stufe_LED_re: base-type-encoding=NONE
    BT_SitzMem_HBFS_ORUData: base-type-encoding=NONE
    BT_SitzMem_HBFS_ORUDataIndex: base-type-encoding=NONE
    BT_SitzMem_HFS_ORUData: base-type-encoding=NONE
    BT_SitzMem_HFS_ORUDataIndex: base-type-encoding=NONE
    BT_SitzMemo_BFS_ORUData: base-type-encoding=NONE
    BT_SitzMemo_BFS_ORUDataIndex: base-type-encoding=NONE
    BT_SitzMemo_FS_ORUData: base-type-encoding=NONE
    BT_SitzMemo_FS_ORUDataIndex: base-type-encoding=NONE
    BT_SL2_APS_Taster: base-type-encoding=NONE
    BT_SL2_FAS_Profile_Taster: base-type-encoding=NONE
    BT_SL2_ResponseError: base-type-encoding=NONE
    BT_SL2_StatusSchalterleiste: base-type-encoding=NONE
    BT_SLS_Helligkeit_IR: base-type-encoding=NONE
    BT_SMLS_01_BZ: base-type-encoding=NONE
    BT_SMLS_01_CRC: base-type-encoding=NONE
    BT_SMLS_alt: base-type-encoding=NONE
    BT_SMLS_Hupe: base-type-encoding=NONE
    BT_SMLS_ORUData: base-type-encoding=NONE
    BT_SMLS_ORUDataIndex: base-type-encoding=NONE
    BT_SMLS_P_verriegelt: base-type-encoding=NONE
    BT_SMLS_P_verriegelt_plausibel: base-type-encoding=NONE
    BT_SMLS_PTT: base-type-encoding=NONE
    BT_SOK_FoD_BCM1_Req_Challenge: base-type-size=8, base-type-encoding=ISO-8859-1
    BT_SOK_FoD_BCM1_Resp_Challenge: base-type-size=8, base-type-encoding=ISO-8859-1
    BT_SOK_KST_Challenge: base-type-size=8, base-type-encoding=ISO-8859-1
    BT_SOK_ungeschuetzte_Zeit: base-type-size=8, base-type-encoding=ISO-8859-1
    BT_SOK_ZV_HBFS_Challenge: base-type-size=8, base-type-encoding=ISO-8859-1
    BT_SOK_ZV_HFS_Challenge: base-type-size=8, base-type-encoding=ISO-8859-1
    BT_SOK_ZV_HW_Challenge: base-type-size=8, base-type-encoding=ISO-8859-1
    BT_SOK_ZV_Rueck_HW_Challenge: base-type-size=8, base-type-encoding=ISO-8859-1
    BT_Soll_Lehne_LLR_li_1: base-type-encoding=NONE
    BT_Soll_Lehne_LLR_li_2: base-type-encoding=NONE
    BT_Soll_Lehne_LLR_re_1: base-type-encoding=NONE
    BT_Soll_Lehne_LLR_re_2: base-type-encoding=NONE
    BT_Soll_Sitz_LLR_li_1: base-type-encoding=NONE
    BT_Soll_Sitz_LLR_li_2: base-type-encoding=NONE
    BT_Soll_Sitz_LLR_re_1: base-type-encoding=NONE
    BT_Soll_Sitz_LLR_re_2: base-type-encoding=NONE
    BT_SoSe_SunInt_2D_Li: base-type-encoding=NONE
    BT_SoSe_SunInt_2D_Re: base-type-encoding=NONE
    BT_SPR_Abschaltstufe: base-type-encoding=NONE
    BT_SPR_BFS_CodierPinError: base-type-encoding=NONE
    BT_SPR_BFS_Kompressor_elFehler: base-type-encoding=NONE
    BT_SPR_BFS_Leck_erkannt: base-type-encoding=NONE
    BT_SPR_BFS_Lokal_aktiv: base-type-encoding=NONE
    BT_SPR_BFS_Lordose_hoch: base-type-encoding=NONE
    BT_SPR_BFS_Lordose_runter: base-type-encoding=NONE
    BT_SPR_BFS_Lordose_vor: base-type-encoding=NONE
    BT_SPR_BFS_Lordose_zurueck: base-type-encoding=NONE
    BT_SPR_BFS_Massage_Dauer: base-type-encoding=NONE
    BT_SPR_BFS_Massage_Int: base-type-encoding=NONE
    BT_SPR_BFS_Massage_Intens_Lehne: base-type-encoding=NONE
    BT_SPR_BFS_Massage_Intens_Sitz: base-type-encoding=NONE
    BT_SPR_BFS_Massage_Prg: base-type-encoding=NONE
    BT_SPR_BFS_Massage_Prg_erweitert: base-type-encoding=NONE
    BT_SPR_BFS_MassageStatus: base-type-encoding=NONE
    BT_SPR_BFS_Massagetaster_inv: base-type-encoding=NONE
    BT_SPR_BFS_MuFu_Fkt_vor: base-type-encoding=NONE
    BT_SPR_BFS_MuFu_Fkt_zurueck: base-type-encoding=NONE
    BT_SPR_BFS_PopUp_Request: base-type-encoding=NONE
    BT_SPR_BFS_ResponseError: base-type-encoding=NONE
    BT_SPR_BFS_SG_defekt: base-type-encoding=NONE
    BT_SPR_BFS_SWL_vor: base-type-encoding=NONE
    BT_SPR_BFS_SWL_zurueck: base-type-encoding=NONE
    BT_SPR_BFS_Systemtest_Status: base-type-encoding=NONE
    BT_SPR_BFS_Tasterfehler_Massage: base-type-encoding=NONE
    BT_SPR_BFS_Tasterfehler_Mufu_auf_ab: base-type-encoding=NONE
    BT_SPR_BFS_Tasterfehler_Mufu_Ring: base-type-encoding=NONE
    BT_SPR_BFS_Tasterfehler_Mufu_v_z: base-type-encoding=NONE
    BT_SPR_BFS_Teller_inv: base-type-encoding=NONE
    BT_SPR_BFS_Ueberspannung: base-type-encoding=NONE
    BT_SPR_BFS_Unterspannung: base-type-encoding=NONE
    BT_SPR_BFS_Verstellung_aktiv: base-type-encoding=NONE
    BT_SPR_BFS_Wellness_Status: base-type-encoding=NONE
    BT_SPR_BFS_Wippe_inv: base-type-encoding=NONE
    BT_SPR_FS_CodierPinError: base-type-encoding=NONE
    BT_SPR_FS_Kompressor_elFehler: base-type-encoding=NONE
    BT_SPR_FS_Leck_erkannt: base-type-encoding=NONE
    BT_SPR_FS_Lokal_aktiv: base-type-encoding=NONE
    BT_SPR_FS_Lordose_hoch: base-type-encoding=NONE
    BT_SPR_FS_Lordose_runter: base-type-encoding=NONE
    BT_SPR_FS_Lordose_vor: base-type-encoding=NONE
    BT_SPR_FS_Lordose_zurueck: base-type-encoding=NONE
    BT_SPR_FS_Massage_Dauer: base-type-encoding=NONE
    BT_SPR_FS_Massage_Int: base-type-encoding=NONE
    BT_SPR_FS_Massage_Intens_Lehne: base-type-encoding=NONE
    BT_SPR_FS_Massage_Intens_Sitz: base-type-encoding=NONE
    BT_SPR_FS_Massage_Prg: base-type-encoding=NONE
    BT_SPR_FS_Massage_Prg_erweitert: base-type-encoding=NONE
    BT_SPR_FS_MassageStatus: base-type-encoding=NONE
    BT_SPR_FS_Massagetaster_inv: base-type-encoding=NONE
    BT_SPR_FS_MuFu_Fkt_vor: base-type-encoding=NONE
    BT_SPR_FS_MuFu_Fkt_zurueck: base-type-encoding=NONE
    BT_SPR_FS_PopUp_Request: base-type-encoding=NONE
    BT_SPR_FS_ResponseError: base-type-encoding=NONE
    BT_SPR_FS_SG_defekt: base-type-encoding=NONE
    BT_SPR_FS_SWL_vor: base-type-encoding=NONE
    BT_SPR_FS_SWL_zurueck: base-type-encoding=NONE
    BT_SPR_FS_Systemtest_Status: base-type-encoding=NONE
    BT_SPR_FS_Tasterfehler_Massage: base-type-encoding=NONE
    BT_SPR_FS_Tasterfehler_Mufu_auf_ab: base-type-encoding=NONE
    BT_SPR_FS_Tasterfehler_Mufu_Ring: base-type-encoding=NONE
    BT_SPR_FS_Tasterfehler_Mufu_v_z: base-type-encoding=NONE
    BT_SPR_FS_Teller_inv: base-type-encoding=NONE
    BT_SPR_FS_Ueberspannung: base-type-encoding=NONE
    BT_SPR_FS_Unterspannung: base-type-encoding=NONE
    BT_SPR_FS_Verstellung_aktiv: base-type-encoding=NONE
    BT_SPR_FS_Wellness_Status: base-type-encoding=NONE
    BT_SPR_FS_Wippe_inv: base-type-encoding=NONE
    BT_SRA_Sequenz_Status: base-type-encoding=NONE
    BT_SRL1_ORUData: base-type-encoding=NONE
    BT_SRL1_ORUDataIndex: base-type-encoding=NONE
    BT_SRL2_ORUData: base-type-encoding=NONE
    BT_SRL2_ORUDataIndex: base-type-encoding=NONE
    BT_SRL3_ORUData: base-type-encoding=NONE
    BT_SRL3_ORUDataIndex: base-type-encoding=NONE
    BT_SRL4_ORUData: base-type-encoding=NONE
    BT_SRL4_ORUDataIndex: base-type-encoding=NONE
    BT_SRL5_ORUData: base-type-encoding=NONE
    BT_SRL5_ORUDataIndex: base-type-encoding=NONE
    BT_SRL6_ORUData: base-type-encoding=NONE
    BT_SRL6_ORUDataIndex: base-type-encoding=NONE
    BT_SRL_HL_01_BZ: base-type-encoding=NONE
    BT_SRL_HL_01_CRC: base-type-encoding=NONE
    BT_SRL_HR_01_BZ: base-type-encoding=NONE
    BT_SRL_HR_01_CRC: base-type-encoding=NONE
    BT_SRL_SL_01_BZ: base-type-encoding=NONE
    BT_SRL_SL_01_CRC: base-type-encoding=NONE
    BT_SRL_SR_01_BZ: base-type-encoding=NONE
    BT_SRL_SR_01_CRC: base-type-encoding=NONE
    BT_SRL_VL_01_BZ: base-type-encoding=NONE
    BT_SRL_VL_01_CRC: base-type-encoding=NONE
    BT_SRL_VR_01_BZ: base-type-encoding=NONE
    BT_SRL_VR_01_CRC: base-type-encoding=NONE
    BT_SSA_FT_ASW_Status: base-type-encoding=NONE
    BT_SSA_HBFT_ASW_Status: base-type-encoding=NONE
    BT_SSA_Heckschloss_ansteuern: base-type-encoding=NONE
    BT_SSA_HFT_ASW_Status: base-type-encoding=NONE
    BT_SSA_Tankklappe_ansteuern: base-type-encoding=NONE
    BT_SSR_HBFS_Pos_Unten: base-type-encoding=NONE
    BT_SSR_HFS_Pos_Unten: base-type-encoding=NONE
    BT_SSR_Temp_Freigabe: base-type-encoding=NONE
    BT_Stellgliedtest_LRH: base-type-encoding=NONE
    BT_STP_Primaeranz: base-type-encoding=NONE
    BT_STSG_HBFS_02_BZ: base-type-encoding=NONE
    BT_STSG_HBFS_02_CRC: base-type-encoding=NONE
    BT_STSG_HBFS_AD_oeffnen_Anf: base-type-encoding=NONE
    BT_STSG_HBFS_Bew_auf: base-type-encoding=NONE
    BT_STSG_HBFS_Bew_zu: base-type-encoding=NONE
    BT_STSG_HBFS_BTF: base-type-encoding=NONE
    BT_STSG_HBFS_BTF_Status: base-type-encoding=NONE
    BT_STSG_HBFS_Einklemm_aktiv: base-type-encoding=NONE
    BT_STSG_HBFS_Einklemm_defekt: base-type-encoding=NONE
    BT_STSG_HBFS_entriegeln_anfordern: base-type-encoding=NONE
    BT_STSG_HBFS_EOE_aktiv: base-type-encoding=NONE
    BT_STSG_HBFS_FFB_Taste_Schiebtuer: base-type-encoding=NONE
    BT_STSG_HBFS_LKKS_Bereich: base-type-encoding=NONE
    BT_STSG_HBFS_ORUData: base-type-encoding=NONE
    BT_STSG_HBFS_ORUDataIndex: base-type-encoding=NONE
    BT_STSG_HBFS_ST_deaktivieren: base-type-encoding=NONE
    BT_STSG_HBFS_Status_Feststeller: base-type-encoding=NONE
    BT_STSG_HBFS_TAG_betaetigt: base-type-encoding=NONE
    BT_STSG_HBFS_TAT: base-type-encoding=NONE
    BT_STSG_HBFS_Thermo_aktiv: base-type-encoding=NONE
    BT_STSG_HBFS_TIG_bet_oeffnen: base-type-encoding=NONE
    BT_STSG_HBFS_TIG_bet_schliessen: base-type-encoding=NONE
    BT_STSG_HBFS_Tuer_Position: base-type-encoding=NONE
    BT_STSG_HBFS_Tuer_Sperrklinke: base-type-encoding=NONE
    BT_STSG_HBFS_Tuer_Vorraste: base-type-encoding=NONE
    BT_STSG_HBFS_UEKB_aktiv: base-type-encoding=NONE
    BT_STSG_HBFS_ZZH_Freigabe: base-type-encoding=NONE
    BT_STSG_HBFS_ZZH_Initialisierung: base-type-encoding=NONE
    BT_STSG_HBFS_ZZH_Status_auf: base-type-encoding=NONE
    BT_STSG_HBFS_ZZH_Status_zu: base-type-encoding=NONE
    BT_STSG_HFS_02_BZ: base-type-encoding=NONE
    BT_STSG_HFS_02_CRC: base-type-encoding=NONE
    BT_STSG_HFS_AD_oeffnen_Anf: base-type-encoding=NONE
    BT_STSG_HFS_Bew_auf: base-type-encoding=NONE
    BT_STSG_HFS_Bew_zu: base-type-encoding=NONE
    BT_STSG_HFS_BTF: base-type-encoding=NONE
    BT_STSG_HFS_BTF_Status: base-type-encoding=NONE
    BT_STSG_HFS_Einklemm_aktiv: base-type-encoding=NONE
    BT_STSG_HFS_Einklemm_defekt: base-type-encoding=NONE
    BT_STSG_HFS_entriegeln_anforderen: base-type-encoding=NONE
    BT_STSG_HFS_EOE_aktiv: base-type-encoding=NONE
    BT_STSG_HFS_FFB_Taste_Schiebetuer: base-type-encoding=NONE
    BT_STSG_HFS_LKKS_Bereich: base-type-encoding=NONE
    BT_STSG_HFS_ORUData: base-type-encoding=NONE
    BT_STSG_HFS_ORUDataIndex: base-type-encoding=NONE
    BT_STSG_HFS_ST_deaktivieren: base-type-encoding=NONE
    BT_STSG_HFS_Status_Feststeller: base-type-encoding=NONE
    BT_STSG_HFS_TAG_betaetigt: base-type-encoding=NONE
    BT_STSG_HFS_TAT: base-type-encoding=NONE
    BT_STSG_HFS_Thermo_aktiv: base-type-encoding=NONE
    BT_STSG_HFS_TIG_bet_oeffnen: base-type-encoding=NONE
    BT_STSG_HFS_TIG_bet_schliessen: base-type-encoding=NONE
    BT_STSG_HFS_Tuer_Position: base-type-encoding=NONE
    BT_STSG_HFS_Tuer_Sperrklinke: base-type-encoding=NONE
    BT_STSG_HFS_Tuer_Vorraste: base-type-encoding=NONE
    BT_STSG_HFS_UEKB_aktiv: base-type-encoding=NONE
    BT_STSG_HFS_ZZH_Freigabe: base-type-encoding=NONE
    BT_STSG_HFS_ZZH_Initialisierung: base-type-encoding=NONE
    BT_STSG_HFS_ZZH_Status_auf: base-type-encoding=NONE
    BT_STSG_HFS_ZZH_Status_zu: base-type-encoding=NONE
    BT_SV_Video_on: base-type-encoding=NONE
    BT_SWA_HMI_Diagnose: base-type-encoding=NONE
    BT_TBF_FS_Touch_Event: base-type-encoding=NONE
    BT_TC_Lampe: base-type-encoding=NONE
    BT_TFL_Matrix_Variante{01..04}_Anf: base-type-encoding=NONE
    BT_TM_01_BZ: base-type-encoding=NONE
    BT_TM_Door_Lock: base-type-encoding=NONE
    BT_TM_Door_Unlock: base-type-encoding=NONE
    BT_TM_Nur_Hupen: base-type-encoding=NONE
    BT_TM_Panik_Alarm: base-type-encoding=NONE
    BT_TM_Spiegel_Anklappen: base-type-encoding=NONE
    BT_TM_Warnblinken: base-type-encoding=NONE
    BT_TM_ZV_Signatur: base-type-encoding=NONE
    BT_TSG_BFS_ORUData: base-type-encoding=NONE
    BT_TSG_BFS_ORUDataIndex: base-type-encoding=NONE
    BT_TSG_FHe01_void1: base-type-encoding=NONE
    BT_TSG_FHSG_HI_Ausstieg: base-type-encoding=NONE
    BT_TSG_FHSG_MST_Jahr_k: base-type-encoding=NONE
    BT_TSG_FHSG_MST_KM_Stand_1: base-type-encoding=NONE
    BT_TSG_FHSG_MST_KM_Stand_2: base-type-encoding=NONE
    BT_TSG_FHSG_MST_Minute_k: base-type-encoding=NONE
    BT_TSG_FHSG_MST_Monat_k: base-type-encoding=NONE
    BT_TSG_FHSG_MST_Sekunde_k: base-type-encoding=NONE
    BT_TSG_FHSG_MST_Stunde_k: base-type-encoding=NONE
    BT_TSG_FHSG_MST_Tag_k: base-type-encoding=NONE
    BT_TSG_FHSG_MST_Time_Indication_Bit: base-type-encoding=NONE
    BT_TSG_FHSG_MST_TSG_Seite: base-type-encoding=NONE
    BT_TSG_FHSG_MST_Verlernzaehler_k: base-type-encoding=NONE
    BT_TSG_FHSG_MST_VSG_H_hoch: base-type-encoding=NONE
    BT_TSG_FHSG_MST_VSG_H_tief: base-type-encoding=NONE
    BT_TSG_FHSG_void_1: base-type-encoding=NONE
    BT_TSG_FHSG_void_7: base-type-encoding=NONE
    BT_TSG_FS_ORUData: base-type-encoding=NONE
    BT_TSG_FS_ORUDataIndex: base-type-encoding=NONE
    BT_TSG_FS_Spiegel_angeklappt: base-type-encoding=NONE
    BT_TSG_FT_02_BZ: base-type-encoding=NONE
    BT_TSG_FT_02_CRC: base-type-encoding=NONE
    BT_TSG_HBFS_02_BZ: base-type-encoding=NONE
    BT_TSG_HBFS_02_CRC: base-type-encoding=NONE
    BT_TSG_HBFS_ORUData: base-type-encoding=NONE
    BT_TSG_HBFS_ORUDataIndex: base-type-encoding=NONE
    BT_TSG_HFS_02_BZ: base-type-encoding=NONE
    BT_TSG_HFS_02_CRC: base-type-encoding=NONE
    BT_TSG_HFS_ORUData: base-type-encoding=NONE
    BT_TSG_HFS_ORUDataIndex: base-type-encoding=NONE
    BT_TSK_a_Soll_gradientenbegrenzt: base-type-encoding=NONE
    BT_TSK_a_Soll_gradientenbegrenzt_02: base-type-encoding=NONE
    BT_TSK_ACC_FoD_Status: base-type-encoding=NONE
    BT_TSK_aktives_System: base-type-encoding=NONE
    BT_TSK_aktives_System_02: base-type-encoding=NONE
    BT_TSK_Anf_Antriebsmoment: base-type-encoding=NONE
    BT_TSK_ax_Getriebe_02: base-type-encoding=NONE
    BT_TSK_Einheit_vMax_Fahrerassistenz: base-type-encoding=NONE
    BT_TSK_erhoehter_Fahrwiderstand: base-type-encoding=NONE
    BT_TSK_Freig_Verzoeg_Anf: base-type-encoding=NONE
    BT_TSK_GRA_FoD_Status: base-type-encoding=NONE
    BT_TSK_Hauptschalter_GRA_ACC: base-type-encoding=NONE
    BT_TSK_Kategorie_Verzoegerungsfkt: base-type-encoding=NONE
    BT_TSK_Limiter_ausgewaehlt: base-type-encoding=NONE
    BT_TSK_Notstopp_Anf: base-type-encoding=NONE
    BT_TSK_Radbremsmom: base-type-encoding=NONE
    BT_TSK_Radsollmoment: base-type-encoding=NONE
    BT_TSK_SRBM_Anf_ASIL: base-type-encoding=NONE
    BT_TSK_SRBM_max_Gradient: base-type-encoding=NONE
    BT_TSK_Standby_Anf_ESP: base-type-encoding=NONE
    BT_TSK_Status: base-type-encoding=NONE
    BT_TSK_Status_ARA: base-type-encoding=NONE
    BT_TSK_Status_EA: base-type-encoding=NONE
    BT_TSK_Status_IPA: base-type-encoding=NONE
    BT_TSK_Status_PLA: base-type-encoding=NONE
    BT_TSK_Status_RHP: base-type-encoding=NONE
    BT_TSK_v_Begrenzung_aktiv: base-type-encoding=NONE
    BT_TSK_vMax_aktuell: base-type-encoding=NONE
    BT_TSK_vMax_Fahrerassistenz: base-type-encoding=NONE
    BT_TSK_zul_Regelabw: base-type-encoding=NONE
    BT_TSK_Zwangszusch_ESP: base-type-encoding=NONE
    BT_Tuerkontakt_Innenlicht_Status: base-type-encoding=NONE
    BT_Tuerkontakt_Innenlicht_Taste: base-type-encoding=NONE
    BT_UGDO_Buttons: base-type-encoding=NONE
    BT_UGDO_Failure_Antenne: base-type-encoding=NONE
    BT_UGDO_Failure_Codierung: base-type-encoding=NONE
    BT_UGDO_Failure_Hardware: base-type-encoding=NONE
    BT_UGDO_Function_01: base-type-encoding=NONE
    BT_UGDO_LED_Code_01: base-type-encoding=NONE
    BT_UGDO_ResponseError: base-type-encoding=NONE
    BT_UGDO_Switchboard: base-type-encoding=NONE
    BT_UH_Jahr: base-type-encoding=NONE
    BT_UH_Minute: base-type-encoding=NONE
    BT_UH_Monat: base-type-encoding=NONE
    BT_UH_Sekunde: base-type-encoding=NONE
    BT_UH_Stunde: base-type-encoding=NONE
    BT_UH_Tag: base-type-encoding=NONE
    BT_UHF_01_Data: base-type-encoding=NONE
    BT_UHF_01_Datenlaenge: base-type-encoding=NONE
    BT_UHF_01_Status: base-type-encoding=NONE
    BT_UHF_01_Typ: base-type-encoding=NONE
    BT_UHF_01_Zaehler: base-type-encoding=NONE
    BT_UHF_02_Data: base-type-encoding=NONE
    BT_UHF_02_Zaehler: base-type-encoding=NONE
    BT_UHF_03_Data: base-type-encoding=NONE
    BT_UHF_03_Zaehler: base-type-encoding=NONE
    BT_UHF_04_Data: base-type-encoding=NONE
    BT_UHF_04_Zaehler: base-type-encoding=NONE
    BT_UHF_05_Data: base-type-encoding=NONE
    BT_UHF_05_Zaehler: base-type-encoding=NONE
    BT_UHF_06_Data: base-type-encoding=NONE
    BT_UHF_06_Zaehler: base-type-encoding=NONE
    BT_UHF_07_Data: base-type-encoding=NONE
    BT_UHF_07_Zaehler: base-type-encoding=NONE
    BT_UHF_08_Data: base-type-encoding=NONE
    BT_UHF_08_Zaehler: base-type-encoding=NONE
    BT_UHF_FFB_Funkschluesseltyp: base-type-encoding=NONE
    BT_UHF_FFB_SKC_anlernen: base-type-encoding=NONE
    BT_UHF_Konfig_Auswahl_Kanal: base-type-encoding=NONE
    BT_UHF_Konfig_Auswahl_Kessymodus: base-type-encoding=NONE
    BT_UHF_Konfig_Auswahl_naechst_Kanal: base-type-encoding=NONE
    BT_UHF_Konfig_FFB_Freigabe: base-type-encoding=NONE
    BT_UHF_Konfig_Kanal_Umschaltzeit: base-type-encoding=NONE
    BT_UHF_Konfig_Praeambellaenge: base-type-encoding=NONE
    BT_UHF_Konfig_Zaehler: base-type-encoding=NONE
    BT_UHF_Sensor_01_Data: base-type-encoding=NONE
    BT_UHF_Sensor_01_Datenlaenge: base-type-encoding=NONE
    BT_UHF_Sensor_01_Status: base-type-encoding=NONE
    BT_UHF_Sensor_01_Typ: base-type-encoding=NONE
    BT_UHF_Sensor_01_Zaehler: base-type-encoding=NONE
    BT_UHF_Sensor_02_Data: base-type-encoding=NONE
    BT_UHF_Sensor_02_Zaehler: base-type-encoding=NONE
    BT_UHF_Sensor_03_Data: base-type-encoding=NONE
    BT_UHF_Sensor_03_Zaehler: base-type-encoding=NONE
    BT_UHF_Sensor_04_Data: base-type-encoding=NONE
    BT_UHF_Sensor_04_Zaehler: base-type-encoding=NONE
    BT_UHF_Sensor_05_Data: base-type-encoding=NONE
    BT_UHF_Sensor_05_Zaehler: base-type-encoding=NONE
    BT_UHF_Sensor_06_Data: base-type-encoding=NONE
    BT_UHF_Sensor_06_Zaehler: base-type-encoding=NONE
    BT_UHF_Sensor_07_Data: base-type-encoding=NONE
    BT_UHF_Sensor_07_Zaehler: base-type-encoding=NONE
    BT_UHF_Sensor_08_Data: base-type-encoding=NONE
    BT_UHF_Sensor_08_Zaehler: base-type-encoding=NONE
    BT_UHF_Sensor_RSSI_Wert_IDGeber{1..8}: base-type-encoding=NONE
    BT_UHF_TranspID_{01..08}: base-type-encoding=NONE
    BT_Uhrzeit_01_alt: base-type-encoding=NONE
    BT_UserStateServer_01_BZ: base-type-encoding=NONE
    BT_UserStateServer_01_CRC: base-type-encoding=NONE
    BT_Vehicle_Driving_Cycle: base-type-encoding=NONE
    BT_Verbauposition_LLR_li: base-type-encoding=NONE
    BT_Verbauposition_LLR_re: base-type-encoding=NONE
    BT_Verglasung_offen: base-type-encoding=NONE
    BT_VIN_01_MUX: base-type-encoding=NONE
    BT_VIN_1: base-type-encoding=NONE
    BT_VIN_{10..17}: base-type-encoding=NONE
    BT_VIN_{2..9}: base-type-encoding=NONE
    BT_VIP_Freigabe: base-type-encoding=NONE
    BT_VIP_Sensor_betaetigt: base-type-encoding=NONE
    BT_VIP_Sensor_STSG_HBFS_betaetigt: base-type-encoding=NONE
    BT_VIP_Sensor_STSG_HFS_betaetigt: base-type-encoding=NONE
    BT_VMM_02_BZ: base-type-encoding=NONE
    BT_VMM_02_CRC: base-type-encoding=NONE
    BT_VMM_Bremslicht_defekt: base-type-encoding=NONE
    BT_VMM_Bremslicht_unplausibel: base-type-encoding=NONE
    BT_VMM_Fahrer_Bremskraft_bestimmend: base-type-encoding=NONE
    BT_VMM_Inkonsistenz_ACC: base-type-encoding=NONE
    BT_VMM_Inkonsistenz_AEB: base-type-encoding=NONE
    BT_VMM_Inkonsistenz_ARA: base-type-encoding=NONE
    BT_VMM_Inkonsistenz_AWV_PCF: base-type-encoding=NONE
    BT_VMM_Inkonsistenz_EA: base-type-encoding=NONE
    BT_VMM_Inkonsistenz_EBKV: base-type-encoding=NONE
    BT_VMM_Inkonsistenz_FAS_VK: base-type-encoding=NONE
    BT_VMM_Inkonsistenz_GE: base-type-encoding=NONE
    BT_VMM_Inkonsistenz_HVLM: base-type-encoding=NONE
    BT_VMM_Inkonsistenz_KAM: base-type-encoding=NONE
    BT_VMM_Inkonsistenz_KAS: base-type-encoding=NONE
    BT_VMM_Inkonsistenz_MO: base-type-encoding=NONE
    BT_VMM_Inkonsistenz_NV: base-type-encoding=NONE
    BT_VMM_Inkonsistenz_ParkAssist: base-type-encoding=NONE
    BT_VMM_Inkonsistenz_RCTA: base-type-encoding=NONE
    BT_VMM_Inkonsistenz_RHP: base-type-encoding=NONE
    BT_VMM_Inkonsistenz_TSK: base-type-encoding=NONE
    BT_VMM_Inkonsistenz_VLK: base-type-encoding=NONE
    BT_VMM_Inkonsistenz_VMC: base-type-encoding=NONE
    BT_VMM_MKB_codiert: base-type-encoding=NONE
    BT_VMM_Notstopp_Status: base-type-encoding=NONE
    BT_VZM_aktiver_Basisservice: base-type-encoding=NONE
    BT_VZM_aktives_System: base-type-encoding=NONE
    BT_VZM_Anhalteweg_nicht_verfuegbar: base-type-encoding=NONE
    BT_VZM_Bkd_nicht_verfuegbar: base-type-encoding=NONE
    BT_VZM_Fahrer_bremst: base-type-encoding=NONE
    BT_VZM_Fahrer_bremst_deutlich: base-type-encoding=NONE
    BT_VZM_int_Laengsverz: base-type-encoding=NONE
    BT_VZM_QBit_Fahrer_bremst: base-type-encoding=NONE
    BT_VZM_SRBM_Ist: base-type-encoding=NONE
    BT_VZM_SRBM_max_Gradient: base-type-encoding=NONE
    BT_VZM_SRBM_Soll: base-type-encoding=NONE
    BT_VZM_Status_Wegregelung: base-type-encoding=NONE
    BT_VZM_Systemstatus: base-type-encoding=NONE
    BT_VZM_TSK_SRBM_Anf: base-type-encoding=NONE
    BT_VZM_TSK_SRBM_nicht_verfuegbar: base-type-encoding=NONE
    BT_VZM_Unterdrueckung_Antriebsmom: base-type-encoding=NONE
    BT_VZM_Verz_ASIL_Verfuegbarkeit: base-type-encoding=NONE
    BT_VZM_Verz_Begrenzung: base-type-encoding=NONE
    BT_VZM_Verz_Reg_aktiv: base-type-encoding=NONE
    BT_VZM_Verz_Reg_nicht_verfuegbar: base-type-encoding=NONE
    BT_VZM_Warnruck_nicht_verfuegbar: base-type-encoding=NONE
    BT_VZM_Warnruckeln_nicht_verfuegbar: base-type-encoding=NONE
    BT_Waschen_vorne_aktiv: base-type-encoding=NONE
    BT_Wendelage_oben_Wischer: base-type-encoding=NONE
    BT_Wendelage_unten_Wischer: base-type-encoding=NONE
    BT_WFS_Betrieb_Lesespule: base-type-encoding=NONE
    BT_WFS_ELV_authorisiert: base-type-encoding=NONE
    BT_WFS_Fahrerhinweise: base-type-encoding=NONE
    BT_WFS_ID_Geb_autorisiert: base-type-encoding=NONE
    BT_WFS_ID_Geb_autorisiert_in_Kl15: base-type-encoding=NONE
    BT_WFS_ID_Geb_steckt: base-type-encoding=NONE
    BT_WFS_Klemmenfreigabe: base-type-encoding=NONE
    BT_WFS_Klemmenfreigabe_Signatur: base-type-encoding=NONE
    BT_WFS_LF_Aktiv: base-type-encoding=NONE
    BT_WFS_LZ: base-type-encoding=NONE
    BT_WFS_LZ_02: base-type-encoding=NONE
    BT_WFS_Parken_Status: base-type-encoding=NONE
    BT_WFS_Safe: base-type-encoding=NONE
    BT_WFS_Schluessel_Fahrberecht: base-type-encoding=NONE
    BT_WFS_Schluessel_Ist: base-type-encoding=NONE
    BT_WFS_Schluessel_Soll: base-type-encoding=NONE
    BT_WFS_Verbauinfo_ELV: base-type-encoding=NONE
    BT_WH_Frontwaschen: base-type-encoding=NONE
    BT_WH_Heckintervall: base-type-encoding=NONE
    BT_WH_Heckwaschen: base-type-encoding=NONE
    BT_WH_Intervall: base-type-encoding=NONE
    BT_WH_Intervallstufen: base-type-encoding=NONE
    BT_WH_MFA_Fehler: base-type-encoding=NONE
    BT_WH_SRA: base-type-encoding=NONE
    BT_WH_Tippwischen: base-type-encoding=NONE
    BT_WH_Tipwischen: base-type-encoding=NONE
    BT_WH_Tipwischen_lang: base-type-encoding=NONE
    BT_WH_Wischer_Fehler: base-type-encoding=NONE
    BT_WH_WischerStufe1: base-type-encoding=NONE
    BT_WH_WischerStufe1_invers: base-type-encoding=NONE
    BT_WH_WischerStufe2: base-type-encoding=NONE
    BT_WH_WischerStufe2_invers: base-type-encoding=NONE
    BT_Wischer1_Error: base-type-encoding=NONE
    BT_Wischer1_ErrorGueltigkeit: base-type-encoding=NONE
    BT_Wischer1_Ueberlast: base-type-encoding=NONE
    BT_Wischer1_Wischgeschwindigkeit: base-type-encoding=NONE
    BT_Wischer2_Error: base-type-encoding=NONE
    BT_Wischer2_ErrorGueltigkeit: base-type-encoding=NONE
    BT_Wischer2_Ueberlast: base-type-encoding=NONE
    BT_Wischer_aktiv: base-type-encoding=NONE
    BT_Wischer_Parklage: base-type-encoding=NONE
    BT_Wischer_ResponseError: base-type-encoding=NONE
    BT_Wischer_Servicestellung: base-type-encoding=NONE
    BT_Wischer_vorne_aktiv: base-type-encoding=NONE
    BT_Wischer_vorne_blockiert: base-type-encoding=NONE
    BT_Wischer_vorne_defekt: base-type-encoding=NONE
    BT_Wischer_vorne_Normal: base-type-encoding=NONE
    BT_Wischer_vorne_Parklage: base-type-encoding=NONE
    BT_Wischer_vorne_Schnell: base-type-encoding=NONE
    BT_Wischer_Wendelage: base-type-encoding=NONE
    BT_Wischer_WH_PopUp_Anf: base-type-encoding=NONE
    BT_Wischer_WH_Typ: base-type-encoding=NONE
    BT_Wischzykluszaehler: base-type-encoding=NONE
    BT_WWS2_aktiv: base-type-encoding=NONE
    BT_WWS2_Error: base-type-encoding=NONE
    BT_WWS2_ErrorGueltigkeit: base-type-encoding=NONE
    BT_WWS2_Parklage: base-type-encoding=NONE
    BT_WWS2_Position_Wischerarm: base-type-encoding=NONE
    BT_WWS2_ResponseError: base-type-encoding=NONE
    BT_WWS2_Servicestellung: base-type-encoding=NONE
    BT_WWS2_Ueberlast: base-type-encoding=NONE
    BT_WWS2_Wendelage: base-type-encoding=NONE
    BT_WWS_DebugData: base-type-encoding=NONE
    BT_WWS_Position_Wischerarm: base-type-encoding=NONE
    BT_WWS_Produktionsmodus: base-type-encoding=NONE
    BT_WWS_Produktionsmodus_Status: base-type-encoding=NONE
    BT_WWS_Wischgeschwindigkeit: base-type-encoding=NONE
    BT_WWSs_01_alt: base-type-encoding=NONE
    BT_ZAS_Kl_15: base-type-encoding=NONE
    BT_ZAS_Kl_50_Startanforderung: base-type-encoding=NONE
    BT_ZAS_Kl_Infotainment: base-type-encoding=NONE
    BT_ZAS_Kl_S: base-type-encoding=NONE
    BT_ZAS_Kl_X: base-type-encoding=NONE
    BT_ZFAS_Umfeldbeleuchtung_Anf: base-type-encoding=NONE
    BT_zFAS_Warnblinken: base-type-encoding=NONE
    BT_ZFH_BFS_AutoHoch: base-type-encoding=NONE
    BT_ZFH_BFS_AutoTief: base-type-encoding=NONE
    BT_ZFH_BFS_ManHoch: base-type-encoding=NONE
    BT_ZFH_BFS_ManTief: base-type-encoding=NONE
    BT_ZFH_FS_AutoHoch: base-type-encoding=NONE
    BT_ZFH_FS_AutoTief: base-type-encoding=NONE
    BT_ZFH_FS_ManHoch: base-type-encoding=NONE
    BT_ZFH_FS_ManTief: base-type-encoding=NONE
    BT_ZFH_HBFS_AutoHoch: base-type-encoding=NONE
    BT_ZFH_HBFS_AutoTief: base-type-encoding=NONE
    BT_ZFH_HBFS_ManHoch: base-type-encoding=NONE
    BT_ZFH_HBFS_ManTief: base-type-encoding=NONE
    BT_ZFH_HFS_AutoHoch: base-type-encoding=NONE
    BT_ZFH_HFS_AutoTief: base-type-encoding=NONE
    BT_ZFH_HFS_ManHoch: base-type-encoding=NONE
    BT_ZFH_HFS_ManTief: base-type-encoding=NONE
    BT_ZFH_zentral_auf: base-type-encoding=NONE
    BT_ZFH_zentral_zu: base-type-encoding=NONE
    BT_ZV_01_BZ: base-type-encoding=NONE
    BT_ZV_01_CRC: base-type-encoding=NONE
    BT_ZV_02_alt: base-type-encoding=NONE
    BT_ZV_04_BZ: base-type-encoding=NONE
    BT_ZV_04_CRC: base-type-encoding=NONE
    BT_ZV_Anf_Auffindbel_TE_hinten: base-type-encoding=NONE
    BT_ZV_Anf_Auffindbel_TE_vorne: base-type-encoding=NONE
    BT_ZV_Anf_Challenge_Auth: base-type-encoding=NONE
    BT_ZV_Anf_Fanghaken_Frontschloss: base-type-encoding=NONE
    BT_ZV_Anf_Frontschloss_ansteuern: base-type-encoding=NONE
    BT_ZV_Anf_Heckschloss_ansteuern: base-type-encoding=NONE
    BT_ZV_APP_Kundenwarnung_Funk: base-type-encoding=NONE
    BT_ZV_APP_Kundenwarnung_Notein: base-type-encoding=NONE
    BT_ZV_auf_BT: base-type-encoding=NONE
    BT_ZV_auf_FT: base-type-encoding=NONE
    BT_ZV_auf_Funk: base-type-encoding=NONE
    BT_ZV_auf_Kessy: base-type-encoding=NONE
    BT_ZV_auto_Ansteuerung: base-type-encoding=NONE
    BT_ZV_Bedienstelle_auf: base-type-encoding=NONE
    BT_ZV_Bedienstelle_zu: base-type-encoding=NONE
    BT_ZV_BT_entriegeln: base-type-encoding=NONE
    BT_ZV_BT_offen: base-type-encoding=NONE
    BT_ZV_BT_verriegeln: base-type-encoding=NONE
    BT_ZV_Crashfall_erkannt: base-type-encoding=NONE
    BT_ZV_DWA_Einfachhorn_Anf: base-type-encoding=NONE
    BT_ZV_DWA_Einfachhorn_Takt: base-type-encoding=NONE
    BT_ZV_Einfachhorn_Anf: base-type-encoding=NONE
    BT_ZV_Einfachhorn_Takt: base-type-encoding=NONE
    BT_ZV_Einzeltuerentriegelung: base-type-encoding=NONE
    BT_ZV_entriegeln_Anf: base-type-encoding=NONE
    BT_ZV_eRWK_Umfeld_Pruefung: base-type-encoding=NONE
    BT_ZV_FD_Taste_auf: base-type-encoding=NONE
    BT_ZV_Frontdeckel_offen: base-type-encoding=NONE
    BT_ZV_Frontdeckelzustand: base-type-encoding=NONE
    BT_ZV_Frontschloss_Hauptraste: base-type-encoding=NONE
    BT_ZV_Frontschloss_Sperrklinke: base-type-encoding=NONE
    BT_ZV_Frontschloss_Taste: base-type-encoding=NONE
    BT_ZV_Frontschloss_Vorraste: base-type-encoding=NONE
    BT_ZV_Frontschlossstatus: base-type-encoding=NONE
    BT_ZV_FT_entriegeln: base-type-encoding=NONE
    BT_ZV_FT_offen: base-type-encoding=NONE
    BT_ZV_FT_verriegeln: base-type-encoding=NONE
    BT_ZV_gesafet_extern_ist: base-type-encoding=NONE
    BT_ZV_gesafet_extern_ist_02: base-type-encoding=NONE
    BT_ZV_gesafet_extern_soll: base-type-encoding=NONE
    BT_ZV_gesafet_extern_soll_02: base-type-encoding=NONE
    BT_ZV_HBFS_entriegeln: base-type-encoding=NONE
    BT_ZV_HBFS_entriegeln_Auth: base-type-encoding=NONE
    BT_ZV_HBFS_entsafen_Auth: base-type-encoding=NONE
    BT_ZV_HBFS_offen: base-type-encoding=NONE
    BT_ZV_HBFS_Status_KiSi: base-type-encoding=NONE
    BT_ZV_HBFS_TAG_betaetigt: base-type-encoding=NONE
    BT_ZV_HBFS_TIG_oeffnen_betaetigt: base-type-encoding=NONE
    BT_ZV_HBFS_TIG_schliessen_betaetigt: base-type-encoding=NONE
    BT_ZV_HBFS_verriegeln: base-type-encoding=NONE
    BT_ZV_HD_offen: base-type-encoding=NONE
    BT_ZV_HD_Parkbremse_Hinweis: base-type-encoding=NONE
    BT_ZV_HD_Taste_zu: base-type-encoding=NONE
    BT_ZV_Heckeinzelentriegelung: base-type-encoding=NONE
    BT_ZV_Heckentriegelunsanforderung: base-type-encoding=NONE
    BT_ZV_Heckoeffnungsfreigabe: base-type-encoding=NONE
    BT_ZV_Heckschlossstatus: base-type-encoding=NONE
    BT_ZV_Heckschlosszustand: base-type-encoding=NONE
    BT_ZV_HFS_entriegeln: base-type-encoding=NONE
    BT_ZV_HFS_entriegeln_Auth: base-type-encoding=NONE
    BT_ZV_HFS_entsafen_Auth: base-type-encoding=NONE
    BT_ZV_HFS_offen: base-type-encoding=NONE
    BT_ZV_HFS_Status_KiSi: base-type-encoding=NONE
    BT_ZV_HFS_TAG_betaetigt: base-type-encoding=NONE
    BT_ZV_HFS_TIG_oeffnen_betaetigt: base-type-encoding=NONE
    BT_ZV_HFS_TIG_schliessen_betaetigt: base-type-encoding=NONE
    BT_ZV_HFS_verriegeln: base-type-encoding=NONE
    BT_ZV_HS_offen: base-type-encoding=NONE
    BT_ZV_HSK_entriegeln: base-type-encoding=NONE
    BT_ZV_HSK_Freigabe: base-type-encoding=NONE
    BT_ZV_HSK_verriegeln: base-type-encoding=NONE
    BT_ZV_Hupe_Anf: base-type-encoding=NONE
    BT_ZV_Hupe_Takt: base-type-encoding=NONE
    BT_ZV_HW_Motor_Lock_HK: base-type-encoding=NONE
    BT_ZV_HW_Motor_Lock_HK_Auth: base-type-encoding=NONE
    BT_ZV_HW_Motor_Safe_Hinten: base-type-encoding=NONE
    BT_ZV_HW_TKL_mot_entr: base-type-encoding=NONE
    BT_ZV_HW_TKL_mot_verr: base-type-encoding=NONE
    BT_ZV_ist_Zustand_verfuegbar: base-type-encoding=NONE
    BT_ZV_Ladeklappe_VerEntriegeln: base-type-encoding=NONE
    BT_ZV_LadeklappenStatus: base-type-encoding=NONE
    BT_ZV_Laderaumabd_elektr_aktiviert: base-type-encoding=NONE
    BT_ZV_LED_Steuerung: base-type-encoding=NONE
    BT_ZV_LED_Uebernahme: base-type-encoding=NONE
    BT_ZV_Oeffnungsmodus: base-type-encoding=NONE
    BT_ZV_Rollo_auf: base-type-encoding=NONE
    BT_ZV_Rollo_zu: base-type-encoding=NONE
    BT_ZV_SAD_auf: base-type-encoding=NONE
    BT_ZV_SAD_zu: base-type-encoding=NONE
    BT_ZV_SafeFunktion_aktiv: base-type-encoding=NONE
    BT_ZV_Schluessel_Zugang: base-type-encoding=NONE
    BT_ZV_Signatur: base-type-encoding=NONE
    BT_ZV_Softtouch_betaetigt: base-type-encoding=NONE
    BT_ZV_Spg_Anklappen: base-type-encoding=NONE
    BT_ZV_Status_Cargolock: base-type-encoding=NONE
    BT_ZV_Status_eTAG_ist: base-type-encoding=NONE
    BT_ZV_Status_eTAG_soll: base-type-encoding=NONE
    BT_ZV_Status_KiSi_CargoLock: base-type-encoding=NONE
    BT_ZV_STSG_HBFS_Anf: base-type-encoding=NONE
    BT_ZV_STSG_HFS_Anf: base-type-encoding=NONE
    BT_ZV_TAG_BT_verfahren: base-type-encoding=NONE
    BT_ZV_TAG_FT_verfahren: base-type-encoding=NONE
    BT_ZV_TAG_HBFS_verfahren: base-type-encoding=NONE
    BT_ZV_TAG_HFS_verfahren: base-type-encoding=NONE
    BT_ZV_Tankklappe_offen: base-type-encoding=NONE
    BT_ZV_Tasten_HMI_Anf: base-type-encoding=NONE
    BT_ZV_TxT_Frontschloss_Warnung: base-type-encoding=NONE
    BT_ZV_Txt_Handbremse_Hinweis: base-type-encoding=NONE
    BT_ZV_TxT_Heckschloss_Warnung: base-type-encoding=NONE
    BT_ZV_TxT_TE_Warnung_hinten: base-type-encoding=NONE
    BT_ZV_TxT_TE_Warnung_vorne: base-type-encoding=NONE
    BT_ZV_Txt_Waehlhebel_P_Hinweis: base-type-encoding=NONE
    BT_ZV_ValetTaster_Fkts_LED: base-type-encoding=NONE
    BT_ZV_Verdeck_auf: base-type-encoding=NONE
    BT_ZV_Verdeck_zu: base-type-encoding=NONE
    BT_ZV_verriegeln_Anf: base-type-encoding=NONE
    BT_ZV_verriegelt_extern_ist: base-type-encoding=NONE
    BT_ZV_verriegelt_extern_soll: base-type-encoding=NONE
    BT_ZV_verriegelt_extern_soll_03: base-type-encoding=NONE
    BT_ZV_verriegelt_intern_ist: base-type-encoding=NONE
    BT_ZV_verriegelt_intern_ist_02: base-type-encoding=NONE
    BT_ZV_verriegelt_intern_soll: base-type-encoding=NONE
    BT_ZV_verriegelt_intern_soll_02: base-type-encoding=NONE
    BT_ZV_verriegelt_soll: base-type-encoding=NONE
    BT_ZV_zentral_entsafen: base-type-encoding=NONE
    BT_ZV_zentral_safen: base-type-encoding=NONE
    BT_ZV_zu_BT: base-type-encoding=NONE
    BT_ZV_zu_FT: base-type-encoding=NONE
    BT_ZV_zu_Funk: base-type-encoding=NONE
    BT_ZV_zu_Kessy: base-type-encoding=NONE
    BT_ZV_zu_Zeitl_Nachverr: base-type-encoding=NONE
package /Signal
  51 x system signal:
    SignalVoid_ESC_50_0
    SignalVoid_ESC_50_1
    SignalVoid_ESC_50_{10..19}
    SignalVoid_ESC_50_2
    SignalVoid_ESC_50_{20..23}
    SignalVoid_ESC_50_{3..9}
    SignalVoid_Motor_51_Auth_0
    SignalVoid_Motor_51_Auth_1
    SignalVoid_Motor_51_Auth_{10..19}
    SignalVoid_Motor_51_Auth_2
    SignalVoid_Motor_51_Auth_{20..26}
    SignalVoid_Motor_51_Auth_{3..9}
  78 x system signal group:
    SG_ADecu1_01: system-signal=[ADecu1_01_BZ, ADecu1_01_CRC, ADecu1_ORUData, ADecu1_ORUDataIndex]  # Signal Group
    SG_ADecu2_01: system-signal=[ADecu2_01_BZ, ADecu2_01_CRC, ADecu2_ORUData, ADecu2_ORUDataIndex]  # Signal Group
    SG_Airbag_01: system-signal=[AB_Anzeige_Fussg, AB_Belegung_VF, AB_Crash_Int, AB_Deaktiviert, AB_Deaktivierung_HV, AB_Diagnose, AB_eCS_Error, AB_EDR_Trigger, AB_Erh_Auf_VB, AB_Front_Crash, AB_Gurtschloss_FA_ext, AB_Gurtschloss_FA_ext_aktiv, AB_Gurtwarn_VB, AB_Gurtwarn_VF, AB_Heck_Crash, AB_Lampe, AB_MKB_Anforderung, AB_MKB_gueltig, AB_PAO_Leuchte_Anf, AB_PSS_SollZustand, AB_RGS_Anst, AB_Rollover_Crash, AB_SB_Crash, AB_SF_Crash, AB_Stellgliedtest, AB_Systemfehler, AB_Texte_AKS, AB_VB_deaktiviert, AB_Versorgungsspannung, Airbag_01_BZ, Airbag_01_CRC, ASM_Masterzeit_02, SignalVoid_Airbag_01_0]  # Signal Group
    SG_Airbag_02: system-signal=[AB_Abschaltanf_SIH_BF, AB_Anforderung_eCall, AB_Anforderung_USM, AB_Anprall_FGS, AB_Anprall_Front_Beifahrer, AB_Anprall_Front_Fahrer, AB_Anprall_Seite_Beifahrer, AB_Anprall_Seite_Fahrer, AB_Belegung_VB, AB_Crashschwere, AB_Gurtschloss_BF, AB_Gurtschloss_FA, AB_Gurtschloss_Reihe2_BF, AB_Gurtschloss_Reihe2_FA, AB_Gurtschloss_Reihe2_MI, AB_Gurtschloss_Reihe3_BF, AB_Gurtschloss_Reihe3_FA, AB_Gurtschloss_Reihe3_MI, AB_Sitzpos_Sens_BF, AB_Sitzpos_Sens_FA, AB_Wickelklappung_Reihe2_BF, AB_Wickelklappung_Reihe2_FA, AB_Wickelklappung_Reihe2_MI, Airbag_02_BZ, Airbag_02_CRC, LoGeWa_Event_Kombiwarnung, SC_PAO_OFF_Anf, SC_PAO_ON_Anf, SC_PAO_Schriftzug_Anf, SignalVoid_Airbag_02_0, SignalVoid_Airbag_02_1]  # Signal Group
    SG_BCM_01: system-signal=[APS_Tongeber_defekt, BCM1_AFS_Lampe, BCM1_EasyEntry_Status, BCM1_Kl_15_HW_erkannt, BCM1_Kl_15_Sig_HW_erkannt, BCM1_Lenksaeule_aktiv, BCM1_MH_Schalter, BCM1_MH_WIV_Schalter, BCM1_NV_Taster, BCM1_Reisemodus_Texte, BCM1_Rueckfahrlicht_Schalter, BCM1_Spannungs_Anf, BCM1_Valet_Parking_Taster, BCM1_Warnblink_Taster, BCM_01_BZ, BCM_01_CRC, BCM_Anf_AAW_MoLaWa, BCM_Bremsbelag_Sensor, BCM_Bremsfluessigkeit_Sensor, BCM_Charisma_Taste2, BCM_Eco_Charisma_Taste, BCM_Handbremse_Hinweis, BCM_HDF_betaetigt, BCM_Hybrid_StartStopp_Taste, BCM_Hybrid_StSt_Taste_Fehler, BCM_Kuehlmittel_Sensor, BCM_Kuehlmittel_Sensor_02, BCM_Offroad_Taste, BCM_ValetTaster_Fkts_LED, BCM_Waschwasser_Sensor, Gong_TFL_Umschaltung, LRH_Taster, SignalVoid_BCM_01_0, SignalVoid_BCM_01_1, SignalVoid_BCM_01_2, SignalVoid_BCM_01_3, SignalVoid_BCM_01_4, SignalVoid_BCM_01_5, SignalVoid_BCM_01_6, SignalVoid_BCM_01_7]  # Signal Group
    SG_DRB1_01: system-signal=[DRB1_01_BZ, DRB1_01_CRC, DRB1_ORUData, DRB1_ORUDataIndex]  # Signal Group
    SG_DRB2_01: system-signal=[DRB2_01_BZ, DRB2_01_CRC, DRB2_ORUData, DRB2_ORUDataIndex]  # Signal Group
    SG_EM1_HYB_13: system-signal=[EM1_Abregelung_Temperatur, EM1_AnlernenElMotor_Anf, EM1_AR_aktiv, EM1_Eta_Sys, EM1_Fehler_ElAntriebFreilauf_Anf, EM1_Freigabe_Info_WFS, EM1_Freigabe_Verfallsinfo_WFS, EM1_HV_betriebsbereit, EM1_HYB_13_BZ, EM1_HYB_13_CRC, EM1_IstStrom, EM1_Moment_HVVerbraucher, EM1_Parken_WFS_Status, EM1_Sperr_Info_WFS, LE1_TorqueLockStatus, SignalVoid_EM1_HYB_13_0, SignalVoid_EM1_HYB_13_1, SignalVoid_EM1_HYB_13_2, SignalVoid_EM1_HYB_13_3]  # Signal Group
    SG_EM2_HYB_13: system-signal=[EM2_Abregelung_Temperatur, EM2_AnlernenElMotor_Anf, EM2_AR_aktiv, EM2_Eta_Sys, EM2_Fehler_ElAntriebFreilauf_Anf, EM2_Freigabe_Info_WFS, EM2_Freigabe_Verfallsinfo_WFS, EM2_HV_betriebsbereit, EM2_HYB_13_BZ, EM2_HYB_13_CRC, EM2_IstStrom, EM2_Parken_WFS_Status, EM2_Sperr_Info_WFS, LE2_TorqueLockStatus, SignalVoid_EM2_HYB_13_0, SignalVoid_EM2_HYB_13_1, SignalVoid_EM2_HYB_13_2, SignalVoid_EM2_HYB_13_3, SignalVoid_EM2_HYB_13_4]  # Signal Group
    SG_ESP_21: system-signal=[ABS_Bremsung, ASR_Anf, ASR_Schalteingriff, ASR_Tastung_passiv, BR_Eingriffsmoment, EBV_Eingriff, EDS_Eingriff, ESC_Reku_Freigabe, ESC_v_Signal_Qualifier_High_Low, ESP_21_BZ, ESP_21_CRC, ESP_Anhaltevorgang_ACC_aktiv, ESP_ASP, ESP_AWV3_Brems_aktiv, ESP_Diagnose, ESP_Eingriff, ESP_Haltebestaetigung, ESP_MKB_Abbruch_Geschw, ESP_PLA_Bremseingriff, ESP_QBit_v_Signal, ESP_Systemstatus, ESP_Tastung_passiv, ESP_v_Signal, ESP_Vorsteuerung, MSR_Anf, OBD_QBit_Schlechtweg, OBD_Schlechtweg]  # Signal Group
    SG_HVL_01: system-signal=[HVL_01_BZ, HVL_01_CRC, HVL_HVK_Fehler_DCAbschaltung, HVL_Kuehltemperatur, HVL_LadeAnforderung, HVL_OCC_IstModus, HVL_Status_EoHVL, HVL_Status_Spgfreiheit, HVL_Steckerstatus, SignalVoid_HVL_01_0, SignalVoid_HVL_01_1, SignalVoid_HVL_01_2, SignalVoid_HVL_01_3]  # Signal Group
    SG_Klemmen_Status_01: system-signal=[Klemmen_Status_01_BZ, Klemmen_Status_01_CRC, KST_Fahrerhinweis_4, KST_Warn_P1_ZST_def, KST_Warn_P2_ZST_def, RSt_Fahrerhinweise, SignalVoid_Klemmen_Status_01_0, SignalVoid_Klemmen_Status_01_1, SignalVoid_Klemmen_Status_01_2, SignalVoid_Klemmen_Status_01_3, ZAS_Kl_15, ZAS_Kl_50_Startanforderung, ZAS_Kl_Infotainment, ZAS_Kl_S, ZAS_Kl_X]  # Signal Group
    SG_Klemmen_Steuerung_01: system-signal=[Klemmen_Steuerung_01_BZ, Klemmen_Steuerung_01_CRC, KST_Anf_Klemme_15, KST_Anf_Klemme_50, KST_Anf_Klemme_S, KST_Anf_Klemmenfreigabe_ELV, KST_Anf_Klemmenfreigabe_WFS, KST_Anf_ZV_Verriegelung, KST_aut_Abschaltung_Zuendung, KST_Fahrer_Info_Text, KST_KL15LockStatus, KST_Txt_Komfortabschaltung, KST_Txt_P_Gang, KST_Txt_Panikabschaltung, KST_Txt_Werkstatt, KST_Unterdr_Zuendungsmeldung, KST_ZAT_betaetigt, KST_Zuendungswarnung, Relais_VoKo_angesteuert, RSt_Anforderung_HMS, SignalVoid_Klemmen_Steuerung_01_0, SignalVoid_Klemmen_Steuerung_01_1, SignalVoid_Klemmen_Steuerung_01_2, SignalVoid_Klemmen_Steuerung_01_3]  # Signal Group
    SG_LRL_L_01: system-signal=[LRL1_ORUData, LRL1_ORUDataIndex, LRL_L_01_BZ, LRL_L_01_CRC]  # Signal Group
    SG_LRL_M_01: system-signal=[LRL2_ORUData, LRL2_ORUDataIndex, LRL_M_01_BZ, LRL_M_01_CRC]  # Signal Group
    SG_LRL_R_01: system-signal=[LRL3_ORUData, LRL3_ORUDataIndex, LRL_R_01_BZ, LRL_R_01_CRC]  # Signal Group
    SG_MFG_01: system-signal=[MF_Abzugssperre, MF_Alarm_Blinker, MF_Alarm_Blinkertakt, MF_Anlassersperre, MF_Blk_li, MF_Blk_re, MF_BT_entriegeln, MF_BT_verriegeln, MF_Fahrlicht, MF_Fernbed_ein, MF_Fernlicht, MF_FH_BT_hoch, MF_FH_BT_tief, MF_FH_FT_hoch, MF_FH_FT_tief, MF_Frontintervall, MF_Frontwaschen, MF_FT_entriegeln, MF_FT_verriegeln, MF_Fussraumbel, MF_HBFS_entriegeln, MF_HBFS_verriegeln, MF_Heckintervall, MF_Heckwaschen, MF_HFS_entriegeln, MF_HFS_verriegeln, MF_Innenraumbel, MF_Innenraumbel_Unterdrueck, MF_interm_Fahrlicht, MF_interm_Fernlicht, MF_interm_Takt, MF_Laderelais, MF_Lichthupe, MF_Motorweiterlauf, MF_nachtr_Stopp_Anf, MF_Notstart, MF_Schluessel_scan, MF_Signalhorn, MF_Standlicht, MF_StartStopp_Info, MF_Summer, MF_TFL_Abschaltung, MF_Tippwischen, MF_Tuerentriegelung_hinten, MF_Variante, MF_Warnblinker, MF_Wischerstufe_1, MF_Wischerstufe_2, MF_ZV_Lock, MFG_01_BZ, MFG_01_CRC]  # Signal Group
    SG_ORU_0001: system-signal=[Motor_BEV_ORUData, Motor_BEV_ORUDataIndex, ORU_0001_BZ, ORU_0001_CRC]  # Signal Group
    SG_ORU_0003: system-signal=[ESC_ORUData, ESC_ORUDataIndex, ORU_0003_BZ, ORU_0003_CRC]  # Signal Group
    SG_ORU_0006: system-signal=[ORU_0006_BZ, ORU_0006_CRC, SitzMemo_BFS_ORUData, SitzMemo_BFS_ORUDataIndex]  # Signal Group
    SG_ORU_0009: system-signal=[ORU_0009_BZ, ORU_0009_CRC, SAM_ORUData, SAM_ORUDataIndex]  # Signal Group
    SG_ORU_0013: system-signal=[FASFrontradar_ORUData, FASFrontradar_ORUDataIndex, ORU_0013_BZ, ORU_0013_CRC]  # Signal Group
    SG_ORU_0015: system-signal=[Airbag_ORUData, Airbag_ORUDataIndex, ORU_0015_BZ, ORU_0015_CRC]  # Signal Group
    SG_ORU_0016: system-signal=[ORU_0016_BZ, ORU_0016_CRC, SMLS_ORUData, SMLS_ORUDataIndex]  # Signal Group
    SG_ORU_0019: system-signal=[ICAS1_X_ORUData, ICAS1_X_ORUDataIndex, ORU_0019_BZ, ORU_0019_CRC]  # Signal Group
    SG_ORU_0023: system-signal=[EBKV_2Box_ORUDataIndex, EBKV_ORUData, ORU_0023_BZ, ORU_0023_CRC]  # Signal Group
    SG_ORU_0036: system-signal=[ORU_0036_BZ, ORU_0036_CRC, SitzMemo_FS_ORUData, SitzMemo_FS_ORUDataIndex]  # Signal Group
    SG_ORU_003D: system-signal=[KFG_ORUData, KFG_ORUDataIndex, ORU_003D_BZ, ORU_003D_CRC]  # Signal Group
    SG_ORU_0042: system-signal=[ORU_0042_BZ, ORU_0042_CRC, TSG_FS_ORUData, TSG_FS_ORUDataIndex]  # Signal Group
    SG_ORU_0044: system-signal=[Lenkhilfe_EPS_ORUData, Lenkhilfe_EPS_ORUDataIndex, ORU_0044_BZ, ORU_0044_CRC]  # Signal Group
    SG_ORU_0048: system-signal=[ORU_0048_BZ, ORU_0048_CRC, SitzMem_HFS_ORUData, SitzMem_HFS_ORUDataIndex]  # Signal Group
    SG_ORU_0051: system-signal=[LE1_ORUData, LE1_ORUDataIndex, ORU_0051_BZ, ORU_0051_CRC]  # Signal Group
    SG_ORU_0052: system-signal=[ORU_0052_BZ, ORU_0052_CRC, TSG_BFS_ORUData, TSG_BFS_ORUDataIndex]  # Signal Group
    SG_ORU_005B: system-signal=[ORU_005B_BZ, ORU_005B_CRC, SitzMem_HBFS_ORUData, SitzMem_HBFS_ORUDataIndex]  # Signal Group
    SG_ORU_0069: system-signal=[AAG_ORUData, AAG_ORUDataIndex, ORU_0069_BZ, ORU_0069_CRC]  # Signal Group
    SG_ORU_006A: system-signal=[ORU_006A_BZ, ORU_006A_CRC, STSG_HFS_ORUData, STSG_HFS_ORUDataIndex]  # Signal Group
    SG_ORU_0076: system-signal=[EPH_ORUData, EPH_ORUDataIndex, ORU_0076_BZ, ORU_0076_CRC]  # Signal Group
    SG_ORU_007A: system-signal=[ORU_007A_BZ, ORU_007A_CRC, STSG_HBFS_ORUData, STSG_HBFS_ORUDataIndex]  # Signal Group
    SG_ORU_007E: system-signal=[Fahrerdisplay_Kombi_ORUData, Fahrerdisplay_Kombi_ORUDataIndex, ORU_007E_BZ, ORU_007E_CRC]  # Signal Group
    SG_ORU_0082: system-signal=[HUD_ORUData, HUD_ORUDataIndex, ORU_0082_BZ, ORU_0082_CRC]  # Signal Group
    SG_ORU_008C: system-signal=[BMCe_ORUData, BMCe_ORUDataIndex, ORU_008C_BZ, ORU_008C_CRC]  # Signal Group
    SG_ORU_00A5: system-signal=[MFK_ORUData, MFK_ORUDataIndex, ORU_00A5_BZ, ORU_00A5_CRC]  # Signal Group
    SG_ORU_00BB: system-signal=[ORU_00BB_BZ, ORU_00BB_CRC, TSG_HFS_ORUData, TSG_HFS_ORUDataIndex]  # Signal Group
    SG_ORU_00BC: system-signal=[ORU_00BC_BZ, ORU_00BC_CRC, TSG_HBFS_ORUData, TSG_HBFS_ORUDataIndex]  # Signal Group
    SG_ORU_00C6: system-signal=[OCC_ORUData, OCC_ORUDataIndex, ORU_00C6_BZ, ORU_00C6_CRC]  # Signal Group
    SG_ORU_00CE: system-signal=[LE2_ORUData, LE2_ORUDataIndex, ORU_00CE_BZ, ORU_00CE_CRC]  # Signal Group
    SG_ORU_00D6: system-signal=[LLP_L_ORUData, LLP_L_ORUDataIndex, ORU_00D6_BZ, ORU_00D6_CRC]  # Signal Group
    SG_ORU_00D7: system-signal=[LLP_R_ORUData, LLP_R_ORUDataIndex, ORU_00D7_BZ, ORU_00D7_CRC]  # Signal Group
    SG_ORU_0631: system-signal=[MFL_CAN_ORUData, MFL_CAN_ORUDataIndex, ORU_0631_BZ, ORU_0631_CRC]  # Signal Group
    SG_ORU_8105: system-signal=[DCDC_NV_ORUDataIndex, DCDC_ORUData, ORU_8105_BZ, ORU_8105_CRC]  # Signal Group
    SG_ORU_8109: system-signal=[NR1_ORUData, NR1_ORUDataIndex, ORU_8109_BZ, ORU_8109_CRC]  # Signal Group
    SG_ORU_810A: system-signal=[NR2_ORUData, NR2_ORUDataIndex, ORU_810A_BZ, ORU_810A_CRC]  # Signal Group
    SG_ORU_810B: system-signal=[NR3_ORUData, NR3_ORUDataIndex, ORU_810B_BZ, ORU_810B_CRC]  # Signal Group
    SG_ORU_810C: system-signal=[NR4_ORUData, NR4_ORUDataIndex, ORU_810C_BZ, ORU_810C_CRC]  # Signal Group
    SG_ORU_8133: system-signal=[eFuse1_ORUData, eFuse1_ORUDataIndex, ORU_8133_BZ, ORU_8133_CRC]  # Signal Group
    SG_ORU_8134: system-signal=[eFuse3_ORUData, eFuse3_ORUDataIndex, ORU_8134_BZ, ORU_8134_CRC]  # Signal Group
    SG_ORU_8179: system-signal=[DCDC_HR_ORUData, DCDC_HR_ORUDataIndex, ORU_8179_BZ, ORU_8179_CRC]  # Signal Group
    SG_ORU_817B: system-signal=[MainBlade_ORUData, MainBlade_ORUDataIndex, ORU_817B_BZ, ORU_817B_CRC]  # Signal Group
    SG_ORU_8181: system-signal=[MaaSBladeMyc_ORUData, MaaSBladeMyc_ORUDataIndex, ORU_8181_BZ, ORU_8181_CRC]  # Signal Group
    SG_ORUG01_01: system-signal=[ORUG01_01_BZ, ORUG01_01_CRC, ORUG1_ADEngagementLock, ORUG1_Anforderung_HMS, ORUG1_GuardInfo, ORUG1_GuardState, ORUG1_HVLock, ORUG1_HVReleased, ORUG1_Parken_beibehalten_HMS, ORUG1_TargetRelease, ORUG1_Warning, SignalVoid_ORUG01_01_0]  # Signal Group
    SG_ORUG02_01: system-signal=[ORUG02_01_BZ, ORUG02_01_CRC, ORUG2_GuardInfo, ORUG2_GuardState, ORUG2_TargetRelease, ORUG2_TorqueLock, SignalVoid_ORUG02_01_0, SignalVoid_ORUG02_01_1, SignalVoid_ORUG02_01_2]  # Signal Group
    SG_RLS_02: system-signal=[LS_Dunkel, LS_Error, LS_Helligkeit_FW, LS_Helligkeit_IR, LS_Licht_ein, LS_Licht_ein_invers, LS_TFL_mit_SL_ein, RLS_02_BZ, RLS_02_CRC, RLS_Qualifizierungsbit, RLS_ResponseError, RLS_Vorfeldhelligkeit_Boost, RS_AdaptierungError, RS_Error, RS_Regenfahrlicht, RS_Regenmenge, RS_Schwall, RS_Verglasung_schliessen, RS_versParklage_Wischer, RS_Wischergeschwindigkeit, SignalVoid_RLS_02_0, SignalVoid_RLS_02_1]  # Signal Group
    SG_RLSs_01: system-signal=[LS_Dunkel, LS_Error, LS_Helligkeit_FW, LS_Helligkeit_IR, LS_Licht_ein, LS_Licht_ein_invers, LS_TFL_mit_SL_ein, RLS_CRC, RLS_Qualifizierungsbit, RLS_ResponseError, RLS_Vorfeldhelligkeit_Boost, RLS_Zaehler, RS_AdaptierungError, RS_Error, RS_Regenfahrlicht, RS_Regenmenge, RS_Schwall, RS_Verglasung_schliessen, RS_versParklage_Wischer, RS_Wischergeschwindigkeit, SignalVoid_RLSs_01_0, SignalVoid_RLSs_01_1]  # Signal Group
    SG_SAL_01: system-signal=[AFS_Lampe, BCM2_Bremsl_durch_ECD, DLI_Ambex_RefStatus, LWR_Lampe, LWR_Reisemodus_Texte, LWR_SollDC, SAL_01_BZ, SAL_01_CRC, SAL_Aussenbeleuchtung_defekt, SAL_Blinkerzyklus_L, SAL_Blinkerzyklus_R, SAL_BLK_L_Anf, SAL_BLK_R_Anf, SAL_Bremszyklus, SAL_BRL_Anf, SAL_CH_Anf, SAL_HGB_Anf, SAL_Kl_15, SAL_Kl_15_vFzg, SAL_Kl_15_vFzg_S, SAL_KL_50, SAL_KL_50_5s, SAL_Kl_75, SAL_KL_75_vFzg, SAL_KL_75a, SAL_KL_75a_vFzg, SAL_KZL_Anf, SAL_LDS_Abblendlicht_Anf, SAL_LDS_Assistenzfahrlicht_Anf, SAL_LDS_Nullstellung_Anf, SAL_LDS_Standlicht_Anf, SAL_LH_Anf, SAL_NSL_Anf, SAL_PL_L_Anf, SAL_PL_R_Anf, SAL_RFL_Anf, SAL_SL_Anf, SAL_WBT_Bel, SBBR_SL_AnimDimm_Freigabe, SignalVoid_SAL_01_0, SignalVoid_SAL_01_1]  # Signal Group
    SG_SAM_01: system-signal=[BCM_Bremsbelag_Sensor_CND, BCM_Bremsbelag_Sensor_NAR, BCM_Bremsbelag_Sensor_Rdw, BCM_KiSi_Umschalt_gesperrt, BCM_Tankklappensteller_Fehler, BRL_Bremslicht_Schalter, Fronthaube_geoeffnet, HD_Hauptraste, HD_Vorraste, HW_Drehfalle_Tuer_HL, HW_Drehfalle_Tuer_HR, HW_HD_Taste_Innenraum, HW_HSB_erkannt, HW_Softtouch_betaetigt, HW_Status_Schloss_gesafet_HL, HW_Status_Schloss_gesafet_HR, HW_Status_Schloss_verriegelt_HL, HW_Status_Schloss_verriegelt_HR, HW_Tankdeckel_offen, KST_BSW_Fehlermode2, KST_BSW_Klemme_15_HW_Ist, KST_BSW_Klemmenhochschalten_Sper, KST_BSW_Not_Taster_betaetigt, KST_BSW_ZAT_betaetigt, SAL_li1_Blinker_Status, SAL_re1_Blinker_Status, SAM_01_BZ, SAM_01_CRC, SAM_Fehler_DC_LWR, SignalVoid_SAM_01_0, SignalVoid_SAM_01_1, SignalVoid_SAM_01_2, SignalVoid_SAM_01_3, SignalVoid_SAM_01_4, Wischer_aktiv, ZV_Ladeklappe_VerEntriegeln, ZV_LadeklappenStatus]  # Signal Group
    SG_SMLS_01: system-signal=[BH_Blinker_Fehler, BH_Blinker_li, BH_Blinker_re, BH_Fernlicht, BH_Lichthupe, FAS_Taster, FAS_Taster_Fehler, LRH_aktiv, LRH_On_Off, LSS_Tastencode, SignalVoid_SMLS_01_0, SignalVoid_SMLS_01_1, SMLS_01_BZ, SMLS_01_CRC, SMLS_Hupe, SMLS_P_verriegelt, SMLS_P_verriegelt_plausibel, SMLS_PTT, WH_Frontwaschen, WH_Heckintervall, WH_Heckwaschen, WH_Intervall, WH_Intervallstufen, WH_SRA, WH_Tipwischen, WH_Tipwischen_lang, WH_Wischer_Fehler, WH_WischerStufe1, WH_WischerStufe2]  # Signal Group
    SG_SOK_ZV_Rueck_HW_Gateway_Resp_01: system-signal=[HD_Hauptraste_Auth, HD_Vorraste_Auth, HW_Drehfalle_Tuer_HL_Auth, HW_Drehfalle_Tuer_HR_Auth, HW_Status_Schloss_safed_HL_Auth, HW_Status_Schloss_safed_HR_Auth, HW_Status_Schloss_verr_HL_Auth, HW_Status_Schloss_verr_HR_Auth]  # custom ECU specified signal group
    SG_SRL_HL_01: system-signal=[SRL5_ORUData, SRL5_ORUDataIndex, SRL_HL_01_BZ, SRL_HL_01_CRC]  # Signal Group
    SG_SRL_HR_01: system-signal=[SRL6_ORUData, SRL6_ORUDataIndex, SRL_HR_01_BZ, SRL_HR_01_CRC]  # Signal Group
    SG_SRL_SL_01: system-signal=[SRL3_ORUData, SRL3_ORUDataIndex, SRL_SL_01_BZ, SRL_SL_01_CRC]  # Signal Group
    SG_SRL_SR_01: system-signal=[SRL4_ORUData, SRL4_ORUDataIndex, SRL_SR_01_BZ, SRL_SR_01_CRC]  # Signal Group
    SG_SRL_VL_01: system-signal=[SRL1_ORUData, SRL1_ORUDataIndex, SRL_VL_01_BZ, SRL_VL_01_CRC]  # Signal Group
    SG_SRL_VR_01: system-signal=[SRL2_ORUData, SRL2_ORUDataIndex, SRL_VR_01_BZ, SRL_VR_01_CRC]  # Signal Group
    SG_TSG_FT_02: system-signal=[FS_Push_Tuergriff, FS_Status_eTAG_ext, FT_ASW_Warnton, FT_BFS_Tuer_Status, FT_Cargolock_bet, FT_HBFS_Tuer_Status, FT_HFS_Tuer_Status, FT_kisi_asynchron, FT_KiSi_Status_Soll_HBFS, FT_KiSi_Status_Soll_HFS, FT_Kisi_Taster_li_02, FT_Kisi_Taster_re_02, FT_Lock_Taster_02, FT_Schluesselschalter_zu_02, FT_SP_Heizung_ein, FT_TCR_Mode_aktiv, FT_TD_Taste_Status, FT_Tuer_Status, FT_Tuer_Status_QBit, FT_Tueroeffnen_Warnung, SignalVoid_TSG_FT_02_0, SignalVoid_TSG_FT_02_1, SignalVoid_TSG_FT_02_2, SignalVoid_TSG_FT_02_3, SSA_FT_ASW_Status, TBF_FS_Touch_Event, TSG_FS_Spiegel_angeklappt, TSG_FT_02_BZ, TSG_FT_02_CRC]  # Signal Group
    SG_TSG_HBFS_02: system-signal=[HBFS_ASW_HMI_defekt, HBFS_ASW_Warnton, HBFS_KiSi_Fehler, HBFS_Push_Tuergriff, HBFS_Status_eTAG_ext, HBFS_Status_KiSi, HBFS_TCR_Mode_aktiv, SignalVoid_TSG_HBFS_02_0, SignalVoid_TSG_HBFS_02_1, SignalVoid_TSG_HBFS_02_2, SignalVoid_TSG_HBFS_02_3, SLS_Helligkeit_IR, SSA_HBFT_ASW_Status, TSG_HBFS_02_BZ, TSG_HBFS_02_CRC]  # Signal Group
    SG_TSG_HFS_02: system-signal=[HFS_ASW_HMI_defekt, HFS_ASW_Warnton, HFS_KiSi_Fehler, HFS_Push_Tuergriff, HFS_Status_eTAG_ext, HFS_Status_KiSi, SignalVoid_TSG_HFS_02_0, SignalVoid_TSG_HFS_02_1, SignalVoid_TSG_HFS_02_2, SignalVoid_TSG_HFS_02_3, SignalVoid_TSG_HFS_02_4, SignalVoid_TSG_HFS_02_5, SSA_HFT_ASW_Status, TSG_HFS_02_BZ, TSG_HFS_02_CRC]  # Signal Group
    SG_VMM_02_Auth: system-signal=[HMS_aktives_System, HMS_Anforderung_GE, HMS_Fehlerstatus, HMS_Haltemoment, HMS_halten_nicht_verfuegbar, HMS_halten_nicht_verfuegbar_02, HMS_Index_Haltemoment, HMS_P_beibehalten_GE, HMS_parken_nicht_verfuegbar, HMS_Stillstand, HMS_Systemstatus, SignalVoid_VMM_02_Auth_0, SignalVoid_VMM_02_Auth_1, SignalVoid_VMM_02_Auth_10, SignalVoid_VMM_02_Auth_11, SignalVoid_VMM_02_Auth_2, SignalVoid_VMM_02_Auth_3, SignalVoid_VMM_02_Auth_4, SignalVoid_VMM_02_Auth_5, SignalVoid_VMM_02_Auth_6, SignalVoid_VMM_02_Auth_7, SignalVoid_VMM_02_Auth_8, SignalVoid_VMM_02_Auth_9, VMM_02_BZ, VMM_02_CRC, VMM_Bremslicht_defekt, VMM_Bremslicht_unplausibel, VMM_Fahrer_Bremskraft_bestimmend, VMM_Inkonsistenz_ACC, VMM_Inkonsistenz_AEB, VMM_Inkonsistenz_ARA, VMM_Inkonsistenz_AWV_PCF, VMM_Inkonsistenz_EA, VMM_Inkonsistenz_EBKV, VMM_Inkonsistenz_FAS_VK, VMM_Inkonsistenz_GE, VMM_Inkonsistenz_HVLM, VMM_Inkonsistenz_KAM, VMM_Inkonsistenz_KAS, VMM_Inkonsistenz_MO, VMM_Inkonsistenz_NV, VMM_Inkonsistenz_ParkAssist, VMM_Inkonsistenz_RCTA, VMM_Inkonsistenz_RHP, VMM_Inkonsistenz_TSK, VMM_Inkonsistenz_VLK, VMM_Inkonsistenz_VMC, VMM_MKB_codiert, VMM_Notstopp_Status, VZM_aktiver_Basisservice, VZM_aktives_System, VZM_Anhalteweg_nicht_verfuegbar, VZM_Bkd_nicht_verfuegbar, VZM_Fahrer_bremst, VZM_Fahrer_bremst_deutlich, VZM_int_Laengsverz, VZM_QBit_Fahrer_bremst, VZM_SRBM_Ist, VZM_SRBM_max_Gradient, VZM_SRBM_Soll, VZM_Status_Wegregelung, VZM_Systemstatus, VZM_TSK_SRBM_Anf, VZM_TSK_SRBM_nicht_verfuegbar, VZM_Unterdrueckung_Antriebsmom, VZM_Verz_ASIL_Verfuegbarkeit, VZM_Verz_Begrenzung, VZM_Verz_Reg_aktiv, VZM_Verz_Reg_nicht_verfuegbar, VZM_Warnruck_nicht_verfuegbar, VZM_Warnruckeln_nicht_verfuegbar]  # Signal Group
    SG_ZV_04: system-signal=[BCM_Waehlhebel_P_Hinweis, SignalVoid_ZV_04_0, SignalVoid_ZV_04_1, UHF_FFB_Funkschluesseltyp, UHF_FFB_SKC_anlernen, ZV_04_BZ, ZV_04_CRC, ZV_Crashfall_erkannt, ZV_DWA_Einfachhorn_Anf, ZV_DWA_Einfachhorn_Takt, ZV_Einfachhorn_Anf, ZV_Einfachhorn_Takt, ZV_HBFS_Status_KiSi, ZV_HBFS_TAG_betaetigt, ZV_HBFS_TIG_oeffnen_betaetigt, ZV_HBFS_TIG_schliessen_betaetigt, ZV_HD_Parkbremse_Hinweis, ZV_HFS_Status_KiSi, ZV_HFS_TAG_betaetigt, ZV_HFS_TIG_oeffnen_betaetigt, ZV_HFS_TIG_schliessen_betaetigt, ZV_Hupe_Anf, ZV_Hupe_Takt, ZV_HW_Motor_Lock_HK, ZV_HW_Motor_Safe_Hinten, ZV_HW_TKL_mot_entr, ZV_HW_TKL_mot_verr, ZV_Laderaumabd_elektr_aktiviert, ZV_Status_Cargolock, ZV_Status_KiSi_CargoLock, ZV_TAG_BT_verfahren, ZV_TAG_FT_verfahren, ZV_TAG_HBFS_verfahren, ZV_TAG_HFS_verfahren, ZV_verriegelt_extern_soll_03]  # Signal Group
package /Unit
  38 x unit:
    Unit_Unit_Amper: display-name=Unit_Amper, factor-si-to-unit=1.0, physical-dimension=PD_siAmpere
    Unit_Unit_Bar: display-name=Unit_Bar, factor-si-to-unit=1.0E-5, physical-dimension=PD_siPascal
    Unit_Unit_BarPerSecon: display-name=Unit_BarPerSecon, factor-si-to-unit=1.0E-5, physical-dimension=PD_siKiloGrammPerMeterSecondCubic
    Unit_Unit_Bit: display-name=Unit_Bit, factor-si-to-unit=1.0, physical-dimension=PD_siNone
    Unit_Unit_Day: display-name=Unit_Day, factor-si-to-unit=1.157E-5, physical-dimension=PD_siSecond
    Unit_Unit_DegreCelsi: display-name=Unit_DegreCelsi, factor-si-to-unit=1.0, offset-si-to-unit=-273.2, physical-dimension=PD_siKelvin
    Unit_Unit_DegreOfArc: display-name=Unit_DegreOfArc, factor-si-to-unit=57.3, physical-dimension=PD_siRadiant
    Unit_Unit_DegreOfArcPerSecon: display-name=Unit_DegreOfArcPerSecon, factor-si-to-unit=57.3, physical-dimension=PD_siRadiantPerSecond
    Unit_Unit_ForceOfGravi: display-name=Unit_ForceOfGravi, factor-si-to-unit=0.102, physical-dimension=PD_siMeterPerSecondSquare
    Unit_Unit_Hertz: display-name=Unit_Hertz, factor-si-to-unit=1.0, physical-dimension=PD_siPerSecond
    Unit_Unit_Hours: display-name=Unit_Hours, factor-si-to-unit=2.778E-4, physical-dimension=PD_siSecond
    Unit_Unit_KiloMeter: display-name=Unit_KiloMeter, factor-si-to-unit=0.001, physical-dimension=PD_siMeter
    Unit_Unit_KiloMeterPerHour: display-name=Unit_KiloMeterPerHour, factor-si-to-unit=3.6, physical-dimension=PD_siMeterPerSecond
    Unit_Unit_KiloNewto: display-name=Unit_KiloNewto, factor-si-to-unit=0.001, physical-dimension=PD_siKiloGrammMeterPerSecondSquare
    Unit_Unit_KiloOhm: display-name=Unit_KiloOhm, factor-si-to-unit=0.001, physical-dimension=PD_siOhm
    Unit_Unit_Lux: display-name=Unit_Lux, factor-si-to-unit=1.0, physical-dimension=PD_siLux
    Unit_Unit_Meter: display-name=Unit_Meter, factor-si-to-unit=1.0, physical-dimension=PD_siMeter
    Unit_Unit_MeterInver: display-name=Unit_MeterInver, factor-si-to-unit=1.0, physical-dimension=PD_siPerMeter
    Unit_Unit_MeterPerCubicSecon: display-name=Unit_MeterPerCubicSecon, factor-si-to-unit=1.0, physical-dimension=PD_siMeterPerCubicSecond
    Unit_Unit_MeterPerSeconSquar: display-name=Unit_MeterPerSeconSquar, factor-si-to-unit=1.0, physical-dimension=PD_siMeterPerSecondSquare
    Unit_Unit_MilliAmper: display-name=Unit_MilliAmper, factor-si-to-unit=0.001, physical-dimension=PD_siAmpere
    Unit_Unit_MilliBar: display-name=Unit_MilliBar, factor-si-to-unit=0.01, physical-dimension=PD_siPascal
    Unit_Unit_MilliMeter: display-name=Unit_MilliMeter, factor-si-to-unit=1000.0, physical-dimension=PD_siMeter
    Unit_Unit_MilliSecon: display-name=Unit_MilliSecon, factor-si-to-unit=1000.0, physical-dimension=PD_siSecond
    Unit_Unit_Minut: display-name=Unit_Minut, factor-si-to-unit=60.0, physical-dimension=PD_siSecond
    Unit_Unit_MinutInver: display-name=Unit_MinutInver, factor-si-to-unit=60.0, physical-dimension=PD_siPerSecond
    Unit_Unit_Month: display-name=Unit_Month, factor-si-to-unit=3.805E-7, physical-dimension=PD_siSecond
    Unit_Unit_NewtoMeter: display-name=Unit_NewtoMeter, factor-si-to-unit=1.0, physical-dimension=PD_siNewtonMeter
    Unit_Unit_NewtoMeterPerSecon: display-name=Unit_NewtoMeterPerSecon, factor-si-to-unit=1.0, physical-dimension=PD_siNewtonMeterPerSecond
    Unit_Unit_None: display-name=Unit_None, factor-si-to-unit=1.0, physical-dimension=PD_siNone
    Unit_Unit_PerCent: display-name=Unit_PerCent, factor-si-to-unit=1.0, physical-dimension=PD_siNone
    Unit_Unit_PerCentPerSecon: display-name=Unit_PerCentPerSecon, factor-si-to-unit=1.0, physical-dimension=PD_siPerSecond
    Unit_Unit_Secon: display-name=Unit_Secon, factor-si-to-unit=1.0, physical-dimension=PD_siSecond
    Unit_Unit_Volt: display-name=Unit_Volt, factor-si-to-unit=1.0, physical-dimension=PD_siVolt
    Unit_Unit_Watt: display-name=Unit_Watt, factor-si-to-unit=1.0, physical-dimension=PD_siWatt
    Unit_Unit_WattHour: display-name=Unit_WattHour, factor-si-to-unit=2.7778E-4, physical-dimension=PD_siWattSecond
    Unit_Unit_WattPerMeterSquar: display-name=Unit_WattPerMeterSquar, factor-si-to-unit=1.0, physical-dimension=PD_siWattPerMeterSquare
    Unit_Unit_Year: display-name=Unit_Year, factor-si-to-unit=3.16887646E-8, physical-dimension=PD_siSecond
package /PhysicalDimension
  23 x physical dimension:
    PD_siAmpere: current-exp=1
    PD_siKelvin: temperature-exp=1
    PD_siKiloGrammMeterPerSecondSquare: length-exp=1, mass-exp=1, time-exp=-2
    PD_siKiloGrammPerMeterSecondCubic: length-exp=-1, mass-exp=1, time-exp=-3
    PD_siLux: length-exp=-2, luminous-intensity-exp=1
    PD_siMeter: length-exp=1
    PD_siMeterPerCubicSecond: length-exp=1, time-exp=-3
    PD_siMeterPerSecond: length-exp=1, time-exp=-1
    PD_siMeterPerSecondSquare: length-exp=1, time-exp=-2
    PD_siNewtonMeter: length-exp=2, mass-exp=1, time-exp=-2
    PD_siNewtonMeterPerSecond: length-exp=2, mass-exp=1, time-exp=-3
    PD_siNone
    PD_siOhm: length-exp=2, mass-exp=1, time-exp=-3, current-exp=-2
    PD_siPascal: length-exp=-1, mass-exp=1, time-exp=-2
    PD_siPerMeter: length-exp=-1
    PD_siPerSecond: time-exp=-1
    PD_siRadiant: length-exp=0
    PD_siRadiantPerSecond: length-exp=0, time-exp=-1
    PD_siSecond: time-exp=1
    PD_siVolt: length-exp=2, mass-exp=1, time-exp=-1, current-exp=-1
    PD_siWatt: length-exp=2, mass-exp=1, time-exp=-3
    PD_siWattPerMeterSquare: mass-exp=1, time-exp=-3
    PD_siWattSecond: length-exp=2, mass-exp=1, time-exp=-2
