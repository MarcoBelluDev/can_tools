[part 21 of 22: package /ComponentTypes]
AUTOSAR XML (schema 4-3-0)
package /ComponentTypes  (continued)
  composition sw component type Geltungsbereich_E3_1_1_UNECE_Gen2  (continued)
    delegate Grundumfang_XIX_SAM.RP_IF_MFK_ORUData_XIX_Grundumfang_XIX_SAM <-> outer port RP_IF_MFK_ORUData_XIX_SAM
    delegate Grundumfang_XIX_SAM.RP_IF_MFK_ORUDataIndex_XIX_Grundumfang_XIX_SAM <-> outer port RP_IF_MFK_ORUDataIndex_XIX_SAM
    delegate Grundumfang_XIX_SAM.RP_IF_MFL_CAN_ORUData_XIX_Grundumfang_XIX_SAM <-> outer port RP_IF_MFL_CAN_ORUData_XIX_SAM
    delegate Grundumfang_XIX_SAM.RP_IF_MFL_CAN_ORUDataIndex_XIX_Grundumfang_XIX_SAM <-> outer port RP_IF_MFL_CAN_ORUDataIndex_XIX_SAM
    delegate Grundumfang_XIX_SAM.RP_IF_MFL_Signalhorn_XIX_Grundumfang_XIX_SAM <-> outer port RP_IF_MFL_Signalhorn_XIX_SAM
    delegate Grundumfang_XIX_SAM.RP_IF_MO_Fahrbereitschaft_XIX_Grundumfang_XIX_SAM <-> outer port RP_IF_MO_Fahrbereitschaft_XIX_SAM
    delegate Grundumfang_XIX_SAM.RP_IF_MO_Fahrpedalrohwert_01_XIX_Grundumfang_XIX_SAM <-> outer port RP_IF_MO_Fahrpedalrohwert_01_XIX_SAM
    delegate Grundumfang_XIX_SAM.RP_IF_MO_HYB_Fahrbereitschaft_XIX_Grundumfang_XIX_SAM <-> outer port RP_IF_MO_HYB_Fahrbereitschaft_XIX_SAM
    delegate Grundumfang_XIX_SAM.RP_IF_Motor_BEV_ORUData_XIX_Grundumfang_XIX_SAM <-> outer port RP_IF_Motor_BEV_ORUData_XIX_SAM
    delegate Grundumfang_XIX_SAM.RP_IF_Motor_BEV_ORUDataIndex_XIX_Grundumfang_XIX_SAM <-> outer port RP_IF_Motor_BEV_ORUDataIndex_XIX_SAM
    delegate Grundumfang_XIX_SAM.RP_IF_NM_eCall_NM_State_XIX_Grundumfang_XIX_SAM <-> outer port RP_IF_NM_eCall_NM_State_XIX_SAM
    delegate Grundumfang_XIX_SAM.RP_IF_NM_ELV_NM_State_XIX_Grundumfang_XIX_SAM <-> outer port RP_IF_NM_ELV_NM_State_XIX_SAM
    delegate Grundumfang_XIX_SAM.RP_IF_NM_Gateway_NM_State_XIX_Grundumfang_XIX_SAM <-> outer port RP_IF_NM_Gateway_NM_State_XIX_SAM
    delegate Grundumfang_XIX_SAM.RP_IF_NM_Kessy2_NM_State_XIX_Grundumfang_XIX_SAM <-> outer port RP_IF_NM_Kessy2_NM_State_XIX_SAM
    delegate Grundumfang_XIX_SAM.RP_IF_NM_Kessy_NM_State_XIX_Grundumfang_XIX_SAM <-> outer port RP_IF_NM_Kessy_NM_State_XIX_SAM
    delegate Grundumfang_XIX_SAM.RP_IF_NM_MFG_NM_State_XIX_Grundumfang_XIX_SAM <-> outer port RP_IF_NM_MFG_NM_State_XIX_SAM
    delegate Grundumfang_XIX_SAM.RP_IF_NM_NFC_TGS_NM_State_XIX_Grundumfang_XIX_SAM <-> outer port RP_IF_NM_NFC_TGS_NM_State_XIX_SAM
    delegate Grundumfang_XIX_SAM.RP_IF_NM_RSAD_HL_NM_State_XIX_Grundumfang_XIX_SAM <-> outer port RP_IF_NM_RSAD_HL_NM_State_XIX_SAM
    delegate Grundumfang_XIX_SAM.RP_IF_NM_RSAD_HR_NM_State_XIX_Grundumfang_XIX_SAM <-> outer port RP_IF_NM_RSAD_HR_NM_State_XIX_SAM
    delegate Grundumfang_XIX_SAM.RP_IF_NM_RSAD_IN_NM_State_XIX_Grundumfang_XIX_SAM <-> outer port RP_IF_NM_RSAD_IN_NM_State_XIX_SAM
    delegate Grundumfang_XIX_SAM.RP_IF_NM_RSAD_VL_NM_State_XIX_Grundumfang_XIX_SAM <-> outer port RP_IF_NM_RSAD_VL_NM_State_XIX_SAM
    delegate Grundumfang_XIX_SAM.RP_IF_NM_RSAD_VR_NM_State_XIX_Grundumfang_XIX_SAM <-> outer port RP_IF_NM_RSAD_VR_NM_State_XIX_SAM
    delegate Grundumfang_XIX_SAM.RP_IF_NM_WLC1_NM_State_XIX_Grundumfang_XIX_SAM <-> outer port RP_IF_NM_WLC1_NM_State_XIX_SAM
    delegate Grundumfang_XIX_SAM.RP_IF_NR1_ORUData_XIX_Grundumfang_XIX_SAM <-> outer port RP_IF_NR1_ORUData_XIX_SAM
    delegate Grundumfang_XIX_SAM.RP_IF_NR1_ORUDataIndex_XIX_Grundumfang_XIX_SAM <-> outer port RP_IF_NR1_ORUDataIndex_XIX_SAM
    delegate Grundumfang_XIX_SAM.RP_IF_NR2_ORUData_XIX_Grundumfang_XIX_SAM <-> outer port RP_IF_NR2_ORUData_XIX_SAM
    delegate Grundumfang_XIX_SAM.RP_IF_NR2_ORUDataIndex_XIX_Grundumfang_XIX_SAM <-> outer port RP_IF_NR2_ORUDataIndex_XIX_SAM
    delegate Grundumfang_XIX_SAM.RP_IF_NR3_ORUData_XIX_Grundumfang_XIX_SAM <-> outer port RP_IF_NR3_ORUData_XIX_SAM
    delegate Grundumfang_XIX_SAM.RP_IF_NR3_ORUDataIndex_XIX_Grundumfang_XIX_SAM <-> outer port RP_IF_NR3_ORUDataIndex_XIX_SAM
    delegate Grundumfang_XIX_SAM.RP_IF_NR4_ORUData_XIX_Grundumfang_XIX_SAM <-> outer port RP_IF_NR4_ORUData_XIX_SAM
    delegate Grundumfang_XIX_SAM.RP_IF_NR4_ORUDataIndex_XIX_Grundumfang_XIX_SAM <-> outer port RP_IF_NR4_ORUDataIndex_XIX_SAM
    delegate Druckpunktmassage_fuer_Beifahrersitz_Lehnenmassage_SAM_XIX_DPMBFSLM_XIX_SAM.RP_IF_NVEM_Abschaltstufe_XIX_Druckpunktmassage_fuer_Beifahrersitz_Lehnenmassage_SAM_XIX_DPMBFSLM_XIX_SAM <-> outer port RP_IF_NVEM_Abschaltstufe_XIX_SAM  # _XIX_SC_47_EMHLR_XIX_Softwareblock_XIX_ICAS1_X_Gateway_XIX_Druckpunktmassage_fuer_Beifahrersitz_Lehnenmassage_SAM_XIX_DPMBFSLM_XIX_SAM_XIX_NVEM_Abschaltstufe
    delegate Druckpunktmassage_fuer_Fahrersitz_Lehnenmassage_SAM_XIX_DPMFSLM_XIX_SAM.RP_IF_NVEM_Abschaltstufe_XIX_Druckpunktmassage_fuer_Fahrersitz_Lehnenmassage_SAM_XIX_DPMFSLM_XIX_SAM <-> outer port RP_IF_NVEM_Abschaltstufe_XIX_SAM  # _XIX_SC_47_EMHLR_XIX_Softwareblock_XIX_ICAS1_X_Gateway_XIX_Druckpunktmassage_fuer_Fahrersitz_Lehnenmassage_SAM_XIX_DPMFSLM_XIX_SAM_XIX_NVEM_Abschaltstufe
    delegate Grundumfang_XIX_SAM.RP_IF_NVEM_Abschaltstufe_XIX_Grundumfang_XIX_SAM <-> outer port RP_IF_NVEM_Abschaltstufe_XIX_SAM
    delegate Grundumfang_XIX_SAM.RP_IF_OBD_Driving_Cycle_XIX_Grundumfang_XIX_SAM <-> outer port RP_IF_OBD_Driving_Cycle_XIX_SAM
    delegate Grundumfang_XIX_SAM.RP_IF_OBD_Warm_Up_Cycle_XIX_Grundumfang_XIX_SAM <-> outer port RP_IF_OBD_Warm_Up_Cycle_XIX_SAM
    delegate Grundumfang_XIX_SAM.RP_IF_OCC_ORUData_XIX_Grundumfang_XIX_SAM <-> outer port RP_IF_OCC_ORUData_XIX_SAM
    delegate Grundumfang_XIX_SAM.RP_IF_OCC_ORUDataIndex_XIX_Grundumfang_XIX_SAM <-> outer port RP_IF_OCC_ORUDataIndex_XIX_SAM
    delegate Basis_Klima_XIX_SAM.RP_IF_OPS_ComfortReadyStatus_XIX_Basis_Klima_XIX_SAM <-> outer port RP_IF_OPS_ComfortReadyStatus_XIX_SAM
    delegate Grundumfang_XIX_SAM.RP_IF_OPS_ComfortReadyStatus_XIX_Grundumfang_XIX_SAM <-> outer port RP_IF_OPS_ComfortReadyStatus_XIX_SAM
    delegate Grundumfang_XIX_SAM.RP_IF_OPS_DriverPresenceStatus_XIX_Grundumfang_XIX_SAM <-> outer port RP_IF_OPS_DriverPresenceStatus_XIX_SAM
    delegate Grundumfang_XIX_SAM.RP_IF_ORU_0001_BZ_XIX_Grundumfang_XIX_SAM <-> outer port RP_IF_ORU_0001_BZ_XIX_SAM
    delegate Grundumfang_XIX_SAM.RP_IF_ORU_0001_CRC_XIX_Grundumfang_XIX_SAM <-> outer port RP_IF_ORU_0001_CRC_XIX_SAM
    delegate Grundumfang_XIX_SAM.RP_IF_ORU_0003_BZ_XIX_Grundumfang_XIX_SAM <-> outer port RP_IF_ORU_0003_BZ_XIX_SAM
    delegate Grundumfang_XIX_SAM.RP_IF_ORU_0003_CRC_XIX_Grundumfang_XIX_SAM <-> outer port RP_IF_ORU_0003_CRC_XIX_SAM
    delegate Grundumfang_XIX_SAM.RP_IF_ORU_0006_BZ_XIX_Grundumfang_XIX_SAM <-> outer port RP_IF_ORU_0006_BZ_XIX_SAM
    delegate Grundumfang_XIX_SAM.RP_IF_ORU_0006_CRC_XIX_Grundumfang_XIX_SAM <-> outer port RP_IF_ORU_0006_CRC_XIX_SAM
    delegate Grundumfang_XIX_SAM.RP_IF_ORU_0013_BZ_XIX_Grundumfang_XIX_SAM <-> outer port RP_IF_ORU_0013_BZ_XIX_SAM
    delegate Grundumfang_XIX_SAM.RP_IF_ORU_0013_CRC_XIX_Grundumfang_XIX_SAM <-> outer port RP_IF_ORU_0013_CRC_XIX_SAM
    delegate Grundumfang_XIX_SAM.RP_IF_ORU_0015_BZ_XIX_Grundumfang_XIX_SAM <-> outer port RP_IF_ORU_0015_BZ_XIX_SAM
    delegate Grundumfang_XIX_SAM.RP_IF_ORU_0015_CRC_XIX_Grundumfang_XIX_SAM <-> outer port RP_IF_ORU_0015_CRC_XIX_SAM
    delegate Grundumfang_XIX_SAM.RP_IF_ORU_0016_BZ_XIX_Grundumfang_XIX_SAM <-> outer port RP_IF_ORU_0016_BZ_XIX_SAM
    delegate Grundumfang_XIX_SAM.RP_IF_ORU_0016_CRC_XIX_Grundumfang_XIX_SAM <-> outer port RP_IF_ORU_0016_CRC_XIX_SAM
    delegate Grundumfang_XIX_SAM.RP_IF_ORU_0019_BZ_XIX_Grundumfang_XIX_SAM <-> outer port RP_IF_ORU_0019_BZ_XIX_SAM
    delegate Grundumfang_XIX_SAM.RP_IF_ORU_0019_CRC_XIX_Grundumfang_XIX_SAM <-> outer port RP_IF_ORU_0019_CRC_XIX_SAM
    delegate Grundumfang_XIX_SAM.RP_IF_ORU_0023_BZ_XIX_Grundumfang_XIX_SAM <-> outer port RP_IF_ORU_0023_BZ_XIX_SAM
    delegate Grundumfang_XIX_SAM.RP_IF_ORU_0023_CRC_XIX_Grundumfang_XIX_SAM <-> outer port RP_IF_ORU_0023_CRC_XIX_SAM
    delegate Grundumfang_XIX_SAM.RP_IF_ORU_0036_BZ_XIX_Grundumfang_XIX_SAM <-> outer port RP_IF_ORU_0036_BZ_XIX_SAM
    delegate Grundumfang_XIX_SAM.RP_IF_ORU_0036_CRC_XIX_Grundumfang_XIX_SAM <-> outer port RP_IF_ORU_0036_CRC_XIX_SAM
    delegate Grundumfang_XIX_SAM.RP_IF_ORU_003D_BZ_XIX_Grundumfang_XIX_SAM <-> outer port RP_IF_ORU_003D_BZ_XIX_SAM
    delegate Grundumfang_XIX_SAM.RP_IF_ORU_003D_CRC_XIX_Grundumfang_XIX_SAM <-> outer port RP_IF_ORU_003D_CRC_XIX_SAM
    delegate Grundumfang_XIX_SAM.RP_IF_ORU_0042_BZ_XIX_Grundumfang_XIX_SAM <-> outer port RP_IF_ORU_0042_BZ_XIX_SAM
    delegate Grundumfang_XIX_SAM.RP_IF_ORU_0042_CRC_XIX_Grundumfang_XIX_SAM <-> outer port RP_IF_ORU_0042_CRC_XIX_SAM
    delegate Grundumfang_XIX_SAM.RP_IF_ORU_0044_BZ_XIX_Grundumfang_XIX_SAM <-> outer port RP_IF_ORU_0044_BZ_XIX_SAM
    delegate Grundumfang_XIX_SAM.RP_IF_ORU_0044_CRC_XIX_Grundumfang_XIX_SAM <-> outer port RP_IF_ORU_0044_CRC_XIX_SAM
    delegate Grundumfang_XIX_SAM.RP_IF_ORU_0048_BZ_XIX_Grundumfang_XIX_SAM <-> outer port RP_IF_ORU_0048_BZ_XIX_SAM
    delegate Grundumfang_XIX_SAM.RP_IF_ORU_0048_CRC_XIX_Grundumfang_XIX_SAM <-> outer port RP_IF_ORU_0048_CRC_XIX_SAM
    delegate Grundumfang_XIX_SAM.RP_IF_ORU_0051_BZ_XIX_Grundumfang_XIX_SAM <-> outer port RP_IF_ORU_0051_BZ_XIX_SAM
    delegate Grundumfang_XIX_SAM.RP_IF_ORU_0051_CRC_XIX_Grundumfang_XIX_SAM <-> outer port RP_IF_ORU_0051_CRC_XIX_SAM
    delegate Grundumfang_XIX_SAM.RP_IF_ORU_0052_BZ_XIX_Grundumfang_XIX_SAM <-> outer port RP_IF_ORU_0052_BZ_XIX_SAM
    delegate Grundumfang_XIX_SAM.RP_IF_ORU_0052_CRC_XIX_Grundumfang_XIX_SAM <-> outer port RP_IF_ORU_0052_CRC_XIX_SAM
    delegate Grundumfang_XIX_SAM.RP_IF_ORU_005B_BZ_XIX_Grundumfang_XIX_SAM <-> outer port RP_IF_ORU_005B_BZ_XIX_SAM
    delegate Grundumfang_XIX_SAM.RP_IF_ORU_005B_CRC_XIX_Grundumfang_XIX_SAM <-> outer port RP_IF_ORU_005B_CRC_XIX_SAM
    delegate Grundumfang_XIX_SAM.RP_IF_ORU_0069_BZ_XIX_Grundumfang_XIX_SAM <-> outer port RP_IF_ORU_0069_BZ_XIX_SAM
    delegate Grundumfang_XIX_SAM.RP_IF_ORU_0069_CRC_XIX_Grundumfang_XIX_SAM <-> outer port RP_IF_ORU_0069_CRC_XIX_SAM
    delegate Grundumfang_XIX_SAM.RP_IF_ORU_006A_BZ_XIX_Grundumfang_XIX_SAM <-> outer port RP_IF_ORU_006A_BZ_XIX_SAM
    delegate Grundumfang_XIX_SAM.RP_IF_ORU_006A_CRC_XIX_Grundumfang_XIX_SAM <-> outer port RP_IF_ORU_006A_CRC_XIX_SAM
    delegate Grundumfang_XIX_SAM.RP_IF_ORU_0076_BZ_XIX_Grundumfang_XIX_SAM <-> outer port RP_IF_ORU_0076_BZ_XIX_SAM
    delegate Grundumfang_XIX_SAM.RP_IF_ORU_0076_CRC_XIX_Grundumfang_XIX_SAM <-> outer port RP_IF_ORU_0076_CRC_XIX_SAM
    delegate Grundumfang_XIX_SAM.RP_IF_ORU_007A_BZ_XIX_Grundumfang_XIX_SAM <-> outer port RP_IF_ORU_007A_BZ_XIX_SAM
    delegate Grundumfang_XIX_SAM.RP_IF_ORU_007A_CRC_XIX_Grundumfang_XIX_SAM <-> outer port RP_IF_ORU_007A_CRC_XIX_SAM
    delegate Grundumfang_XIX_SAM.RP_IF_ORU_007E_BZ_XIX_Grundumfang_XIX_SAM <-> outer port RP_IF_ORU_007E_BZ_XIX_SAM
    delegate Grundumfang_XIX_SAM.RP_IF_ORU_007E_CRC_XIX_Grundumfang_XIX_SAM <-> outer port RP_IF_ORU_007E_CRC_XIX_SAM
    delegate Grundumfang_XIX_SAM.RP_IF_ORU_0082_BZ_XIX_Grundumfang_XIX_SAM <-> outer port RP_IF_ORU_0082_BZ_XIX_SAM
    delegate Grundumfang_XIX_SAM.RP_IF_ORU_0082_CRC_XIX_Grundumfang_XIX_SAM <-> outer port RP_IF_ORU_0082_CRC_XIX_SAM
    delegate Grundumfang_XIX_SAM.RP_IF_ORU_008C_BZ_XIX_Grundumfang_XIX_SAM <-> outer port RP_IF_ORU_008C_BZ_XIX_SAM
    delegate Grundumfang_XIX_SAM.RP_IF_ORU_008C_CRC_XIX_Grundumfang_XIX_SAM <-> outer port RP_IF_ORU_008C_CRC_XIX_SAM
    delegate Grundumfang_XIX_SAM.RP_IF_ORU_00A5_BZ_XIX_Grundumfang_XIX_SAM <-> outer port RP_IF_ORU_00A5_BZ_XIX_SAM
    delegate Grundumfang_XIX_SAM.RP_IF_ORU_00A5_CRC_XIX_Grundumfang_XIX_SAM <-> outer port RP_IF_ORU_00A5_CRC_XIX_SAM
    delegate Grundumfang_XIX_SAM.RP_IF_ORU_00BB_BZ_XIX_Grundumfang_XIX_SAM <-> outer port RP_IF_ORU_00BB_BZ_XIX_SAM
    delegate Grundumfang_XIX_SAM.RP_IF_ORU_00BB_CRC_XIX_Grundumfang_XIX_SAM <-> outer port RP_IF_ORU_00BB_CRC_XIX_SAM
    delegate Grundumfang_XIX_SAM.RP_IF_ORU_00BC_BZ_XIX_Grundumfang_XIX_SAM <-> outer port RP_IF_ORU_00BC_BZ_XIX_SAM
    delegate Grundumfang_XIX_SAM.RP_IF_ORU_00BC_CRC_XIX_Grundumfang_XIX_SAM <-> outer port RP_IF_ORU_00BC_CRC_XIX_SAM
    delegate Grundumfang_XIX_SAM.RP_IF_ORU_00C6_BZ_XIX_Grundumfang_XIX_SAM <-> outer port RP_IF_ORU_00C6_BZ_XIX_SAM
    delegate Grundumfang_XIX_SAM.RP_IF_ORU_00C6_CRC_XIX_Grundumfang_XIX_SAM <-> outer port RP_IF_ORU_00C6_CRC_XIX_SAM
    delegate Grundumfang_XIX_SAM.RP_IF_ORU_00CE_BZ_XIX_Grundumfang_XIX_SAM <-> outer port RP_IF_ORU_00CE_BZ_XIX_SAM
    delegate Grundumfang_XIX_SAM.RP_IF_ORU_00CE_CRC_XIX_Grundumfang_XIX_SAM <-> outer port RP_IF_ORU_00CE_CRC_XIX_SAM
    delegate Grundumfang_XIX_SAM.RP_IF_ORU_00D6_BZ_XIX_Grundumfang_XIX_SAM <-> outer port RP_IF_ORU_00D6_BZ_XIX_SAM
    delegate Grundumfang_XIX_SAM.RP_IF_ORU_00D6_CRC_XIX_Grundumfang_XIX_SAM <-> outer port RP_IF_ORU_00D6_CRC_XIX_SAM
    delegate Grundumfang_XIX_SAM.RP_IF_ORU_00D7_BZ_XIX_Grundumfang_XIX_SAM <-> outer port RP_IF_ORU_00D7_BZ_XIX_SAM
    delegate Grundumfang_XIX_SAM.RP_IF_ORU_00D7_CRC_XIX_Grundumfang_XIX_SAM <-> outer port RP_IF_ORU_00D7_CRC_XIX_SAM
    delegate Grundumfang_XIX_SAM.RP_IF_ORU_0631_BZ_XIX_Grundumfang_XIX_SAM <-> outer port RP_IF_ORU_0631_BZ_XIX_SAM
    delegate Grundumfang_XIX_SAM.RP_IF_ORU_0631_CRC_XIX_Grundumfang_XIX_SAM <-> outer port RP_IF_ORU_0631_CRC_XIX_SAM
    delegate Grundumfang_XIX_SAM.RP_IF_ORU_8105_BZ_XIX_Grundumfang_XIX_SAM <-> outer port RP_IF_ORU_8105_BZ_XIX_SAM
    delegate Grundumfang_XIX_SAM.RP_IF_ORU_8105_CRC_XIX_Grundumfang_XIX_SAM <-> outer port RP_IF_ORU_8105_CRC_XIX_SAM
    delegate Grundumfang_XIX_SAM.RP_IF_ORU_8109_BZ_XIX_Grundumfang_XIX_SAM <-> outer port RP_IF_ORU_8109_BZ_XIX_SAM
    delegate Grundumfang_XIX_SAM.RP_IF_ORU_8109_CRC_XIX_Grundumfang_XIX_SAM <-> outer port RP_IF_ORU_8109_CRC_XIX_SAM
    delegate Grundumfang_XIX_SAM.RP_IF_ORU_810A_BZ_XIX_Grundumfang_XIX_SAM <-> outer port RP_IF_ORU_810A_BZ_XIX_SAM
    delegate Grundumfang_XIX_SAM.RP_IF_ORU_810A_CRC_XIX_Grundumfang_XIX_SAM <-> outer port RP_IF_ORU_810A_CRC_XIX_SAM
    delegate Grundumfang_XIX_SAM.RP_IF_ORU_810B_BZ_XIX_Grundumfang_XIX_SAM <-> outer port RP_IF_ORU_810B_BZ_XIX_SAM
    delegate Grundumfang_XIX_SAM.RP_IF_ORU_810B_CRC_XIX_Grundumfang_XIX_SAM <-> outer port RP_IF_ORU_810B_CRC_XIX_SAM
    delegate Grundumfang_XIX_SAM.RP_IF_ORU_810C_BZ_XIX_Grundumfang_XIX_SAM <-> outer port RP_IF_ORU_810C_BZ_XIX_SAM
    delegate Grundumfang_XIX_SAM.RP_IF_ORU_810C_CRC_XIX_Grundumfang_XIX_SAM <-> outer port RP_IF_ORU_810C_CRC_XIX_SAM
    delegate Grundumfang_XIX_SAM.RP_IF_ORU_8133_BZ_XIX_Grundumfang_XIX_SAM <-> outer port RP_IF_ORU_8133_BZ_XIX_SAM
    delegate Grundumfang_XIX_SAM.RP_IF_ORU_8133_CRC_XIX_Grundumfang_XIX_SAM <-> outer port RP_IF_ORU_8133_CRC_XIX_SAM
    delegate Grundumfang_XIX_SAM.RP_IF_ORU_8134_BZ_XIX_Grundumfang_XIX_SAM <-> outer port RP_IF_ORU_8134_BZ_XIX_SAM
    delegate Grundumfang_XIX_SAM.RP_IF_ORU_8134_CRC_XIX_Grundumfang_XIX_SAM <-> outer port RP_IF_ORU_8134_CRC_XIX_SAM
    delegate Grundumfang_XIX_SAM.RP_IF_ORU_8179_BZ_XIX_Grundumfang_XIX_SAM <-> outer port RP_IF_ORU_8179_BZ_XIX_SAM
    delegate Grundumfang_XIX_SAM.RP_IF_ORU_8179_CRC_XIX_Grundumfang_XIX_SAM <-> outer port RP_IF_ORU_8179_CRC_XIX_SAM
    delegate Grundumfang_XIX_SAM.RP_IF_ORU_817B_BZ_XIX_Grundumfang_XIX_SAM <-> outer port RP_IF_ORU_817B_BZ_XIX_SAM
    delegate Grundumfang_XIX_SAM.RP_IF_ORU_817B_CRC_XIX_Grundumfang_XIX_SAM <-> outer port RP_IF_ORU_817B_CRC_XIX_SAM
    delegate Grundumfang_XIX_SAM.RP_IF_ORU_8181_BZ_XIX_Grundumfang_XIX_SAM <-> outer port RP_IF_ORU_8181_BZ_XIX_SAM
    delegate Grundumfang_XIX_SAM.RP_IF_ORU_8181_CRC_XIX_Grundumfang_XIX_SAM <-> outer port RP_IF_ORU_8181_CRC_XIX_SAM
    delegate Grundumfang_XIX_SAM.RP_IF_ORU_AP_Mode_XIX_Grundumfang_XIX_SAM <-> outer port RP_IF_ORU_AP_Mode_XIX_SAM
    delegate Grundumfang_XIX_SAM.RP_IF_ORU_DiagAddress_XIX_Grundumfang_XIX_SAM <-> outer port RP_IF_ORU_DiagAddress_XIX_SAM
    delegate Grundumfang_XIX_SAM.RP_IF_ORU_Status_XIX_Grundumfang_XIX_SAM <-> outer port RP_IF_ORU_Status_XIX_SAM
    delegate Grundumfang_XIX_SAM.RP_IF_ORUG01_01_BZ_XIX_Grundumfang_XIX_SAM <-> outer port RP_IF_ORUG01_01_BZ_XIX_SAM
    delegate Grundumfang_XIX_SAM.RP_IF_ORUG01_01_CRC_XIX_Grundumfang_XIX_SAM <-> outer port RP_IF_ORUG01_01_CRC_XIX_SAM
    delegate Grundumfang_XIX_SAM.RP_IF_ORUG1_HVReleased_XIX_Grundumfang_XIX_SAM <-> outer port RP_IF_ORUG1_HVReleased_XIX_SAM
    delegate Grundumfang_XIX_SAM.RP_IF_ORUG1_TargetRelease_XIX_Grundumfang_XIX_SAM <-> outer port RP_IF_ORUG1_TargetRelease_XIX_SAM
    delegate Grundumfang_XIX_SAM.RP_IF_Parken_aktives_System_02_XIX_Grundumfang_XIX_SAM <-> outer port RP_IF_Parken_aktives_System_02_XIX_SAM
    delegate Grundumfang_XIX_SAM.RP_IF_Perso_Kontonummer_XIX_Grundumfang_XIX_SAM <-> outer port RP_IF_Perso_Kontonummer_XIX_SAM
    delegate Grundumfang_XIX_SAM.RP_IF_Perso_Status_XIX_Grundumfang_XIX_SAM <-> outer port RP_IF_Perso_Status_XIX_SAM
    delegate Grundumfang_XIX_SAM.RP_IF_Perso_Steuerung_XIX_Grundumfang_XIX_SAM <-> outer port RP_IF_Perso_Steuerung_XIX_SAM
    delegate Grundumfang_XIX_SAM.RP_IF_Perso_Steuerungsparameter_XIX_Grundumfang_XIX_SAM <-> outer port RP_IF_Perso_Steuerungsparameter_XIX_SAM
    delegate Druckpunktmassage_fuer_Beifahrersitz_Lehnenmassage_SAM_XIX_DPMBFSLM_XIX_SAM.RP_IF_PreCrash_BFS_Pneumatik_ansteuern_XIX_Druckpunktmassage_fuer_Beifahrersitz_Lehnenmassage_SAM_XIX_DPMBFSLM_XIX_SAM <-> outer port RP_IF_PreCrash_BFS_Pneumatik_ansteuern_XIX_SAM  # _XIX_Grundumfang_XIX_Airbag_XIX_Druckpunktmassage_fuer_Beifahrersitz_Lehnenmassage_SAM_XIX_DPMBFSLM_XIX_SAM_XIX_PreCrash_BFS_Pneumatik_ansteuern
    delegate Druckpunktmassage_fuer_Fahrersitz_Lehnenmassage_SAM_XIX_DPMFSLM_XIX_SAM.RP_IF_PreCrash_BFS_Pneumatik_ansteuern_XIX_Druckpunktmassage_fuer_Fahrersitz_Lehnenmassage_SAM_XIX_DPMFSLM_XIX_SAM <-> outer port RP_IF_PreCrash_BFS_Pneumatik_ansteuern_XIX_SAM  # _XIX_Grundumfang_XIX_Airbag_XIX_Druckpunktmassage_fuer_Fahrersitz_Lehnenmassage_SAM_XIX_DPMFSLM_XIX_SAM_XIX_PreCrash_BFS_Pneumatik_ansteuern
    delegate Grundumfang_XIX_SAM.RP_IF_PreCrash_BFS_Pneumatik_ansteuern_XIX_Grundumfang_XIX_SAM <-> outer port RP_IF_PreCrash_BFS_Pneumatik_ansteuern_XIX_SAM
    delegate Grundumfang_XIX_SAM.RP_IF_PreCrash_Fenster_schliessen_XIX_Grundumfang_XIX_SAM <-> outer port RP_IF_PreCrash_Fenster_schliessen_XIX_SAM
    delegate Druckpunktmassage_fuer_Beifahrersitz_Lehnenmassage_SAM_XIX_DPMBFSLM_XIX_SAM.RP_IF_PreCrash_FS_Pneumatik_ansteuern_XIX_Druckpunktmassage_fuer_Beifahrersitz_Lehnenmassage_SAM_XIX_DPMBFSLM_XIX_SAM <-> outer port RP_IF_PreCrash_FS_Pneumatik_ansteuern_XIX_SAM  # _XIX_Grundumfang_XIX_Airbag_XIX_Druckpunktmassage_fuer_Beifahrersitz_Lehnenmassage_SAM_XIX_DPMBFSLM_XIX_SAM_XIX_PreCrash_FS_Pneumatik_ansteuern
    delegate Druckpunktmassage_fuer_Fahrersitz_Lehnenmassage_SAM_XIX_DPMFSLM_XIX_SAM.RP_IF_PreCrash_FS_Pneumatik_ansteuern_XIX_Druckpunktmassage_fuer_Fahrersitz_Lehnenmassage_SAM_XIX_DPMFSLM_XIX_SAM <-> outer port RP_IF_PreCrash_FS_Pneumatik_ansteuern_XIX_SAM  # _XIX_Grundumfang_XIX_Airbag_XIX_Druckpunktmassage_fuer_Fahrersitz_Lehnenmassage_SAM_XIX_DPMFSLM_XIX_SAM_XIX_PreCrash_FS_Pneumatik_ansteuern
    delegate Grundumfang_XIX_SAM.RP_IF_PreCrash_FS_Pneumatik_ansteuern_XIX_Grundumfang_XIX_SAM <-> outer port RP_IF_PreCrash_FS_Pneumatik_ansteuern_XIX_SAM
    delegate Grundumfang_XIX_SAM.RP_IF_RCTA_Kritikalitaetslevel_links_XIX_Grundumfang_XIX_SAM <-> outer port RP_IF_RCTA_Kritikalitaetslevel_links_XIX_SAM
    delegate Grundumfang_XIX_SAM.RP_IF_RCTA_Kritikalitaetslevel_rechts_XIX_Grundumfang_XIX_SAM <-> outer port RP_IF_RCTA_Kritikalitaetslevel_rechts_XIX_SAM
    delegate Grundumfang_XIX_SAM.RP_IF_RGB_Slave_01_IntErrorNvm_XIX_Grundumfang_XIX_SAM <-> outer port RP_IF_RGB_Slave_01_IntErrorNvm_XIX_SAM
    delegate Grundumfang_XIX_SAM.RP_IF_RGB_Slave_01_IntErrorRam_XIX_Grundumfang_XIX_SAM <-> outer port RP_IF_RGB_Slave_01_IntErrorRam_XIX_SAM
    delegate Grundumfang_XIX_SAM.RP_IF_RGB_Slave_01_IntErrorRom_XIX_Grundumfang_XIX_SAM <-> outer port RP_IF_RGB_Slave_01_IntErrorRom_XIX_SAM
    delegate Grundumfang_XIX_SAM.RP_IF_RGB_Slave_01_LedBlauOl_XIX_Grundumfang_XIX_SAM <-> outer port RP_IF_RGB_Slave_01_LedBlauOl_XIX_SAM
    delegate Grundumfang_XIX_SAM.RP_IF_RGB_Slave_01_LedBlauStg_XIX_Grundumfang_XIX_SAM <-> outer port RP_IF_RGB_Slave_01_LedBlauStg_XIX_SAM
    delegate Grundumfang_XIX_SAM.RP_IF_RGB_Slave_01_LedGruenOl_XIX_Grundumfang_XIX_SAM <-> outer port RP_IF_RGB_Slave_01_LedGruenOl_XIX_SAM
    delegate Grundumfang_XIX_SAM.RP_IF_RGB_Slave_01_LedGruenStg_XIX_Grundumfang_XIX_SAM <-> outer port RP_IF_RGB_Slave_01_LedGruenStg_XIX_SAM
    delegate Grundumfang_XIX_SAM.RP_IF_RGB_Slave_01_LedRotOl_XIX_Grundumfang_XIX_SAM <-> outer port RP_IF_RGB_Slave_01_LedRotOl_XIX_SAM
    delegate Grundumfang_XIX_SAM.RP_IF_RGB_Slave_01_LedRotStg_XIX_Grundumfang_XIX_SAM <-> outer port RP_IF_RGB_Slave_01_LedRotStg_XIX_SAM
    delegate Grundumfang_XIX_SAM.RP_IF_RGB_Slave_01_ResponseError_XIX_Grundumfang_XIX_SAM <-> outer port RP_IF_RGB_Slave_01_ResponseError_XIX_SAM
    delegate Grundumfang_XIX_SAM.RP_IF_RGB_Slave_01_TempState_XIX_Grundumfang_XIX_SAM <-> outer port RP_IF_RGB_Slave_01_TempState_XIX_SAM
    delegate Grundumfang_XIX_SAM.RP_IF_RGB_Slave_02_IntErrorNvm_XIX_Grundumfang_XIX_SAM <-> outer port RP_IF_RGB_Slave_02_IntErrorNvm_XIX_SAM
    delegate Grundumfang_XIX_SAM.RP_IF_RGB_Slave_02_IntErrorRam_XIX_Grundumfang_XIX_SAM <-> outer port RP_IF_RGB_Slave_02_IntErrorRam_XIX_SAM
    delegate Grundumfang_XIX_SAM.RP_IF_RGB_Slave_02_IntErrorRom_XIX_Grundumfang_XIX_SAM <-> outer port RP_IF_RGB_Slave_02_IntErrorRom_XIX_SAM
    delegate Grundumfang_XIX_SAM.RP_IF_RGB_Slave_02_LedBlauOl_XIX_Grundumfang_XIX_SAM <-> outer port RP_IF_RGB_Slave_02_LedBlauOl_XIX_SAM
    delegate Grundumfang_XIX_SAM.RP_IF_RGB_Slave_02_LedBlauStg_XIX_Grundumfang_XIX_SAM <-> outer port RP_IF_RGB_Slave_02_LedBlauStg_XIX_SAM
    delegate Grundumfang_XIX_SAM.RP_IF_RGB_Slave_02_LedGruenOl_XIX_Grundumfang_XIX_SAM <-> outer port RP_IF_RGB_Slave_02_LedGruenOl_XIX_SAM
    delegate Grundumfang_XIX_SAM.RP_IF_RGB_Slave_02_LedGruenStg_XIX_Grundumfang_XIX_SAM <-> outer port RP_IF_RGB_Slave_02_LedGruenStg_XIX_SAM
    delegate Grundumfang_XIX_SAM.RP_IF_RGB_Slave_02_LedRotOl_XIX_Grundumfang_XIX_SAM <-> outer port RP_IF_RGB_Slave_02_LedRotOl_XIX_SAM
    delegate Grundumfang_XIX_SAM.RP_IF_RGB_Slave_02_LedRotStg_XIX_Grundumfang_XIX_SAM <-> outer port RP_IF_RGB_Slave_02_LedRotStg_XIX_SAM
    delegate Grundumfang_XIX_SAM.RP_IF_RGB_Slave_02_ResponseError_XIX_Grundumfang_XIX_SAM <-> outer port RP_IF_RGB_Slave_02_ResponseError_XIX_SAM
    delegate Grundumfang_XIX_SAM.RP_IF_RGB_Slave_02_TempState_XIX_Grundumfang_XIX_SAM <-> outer port RP_IF_RGB_Slave_02_TempState_XIX_SAM
    delegate Grundumfang_XIX_SAM.RP_IF_RGB_Slave_03_IntErrorNvm_XIX_Grundumfang_XIX_SAM <-> outer port RP_IF_RGB_Slave_03_IntErrorNvm_XIX_SAM
    delegate Grundumfang_XIX_SAM.RP_IF_RGB_Slave_03_IntErrorRam_XIX_Grundumfang_XIX_SAM <-> outer port RP_IF_RGB_Slave_03_IntErrorRam_XIX_SAM
    delegate Grundumfang_XIX_SAM.RP_IF_RGB_Slave_03_IntErrorRom_XIX_Grundumfang_XIX_SAM <-> outer port RP_IF_RGB_Slave_03_IntErrorRom_XIX_SAM
    delegate Grundumfang_XIX_SAM.RP_IF_RGB_Slave_03_LedBlauOl_XIX_Grundumfang_XIX_SAM <-> outer port RP_IF_RGB_Slave_03_LedBlauOl_XIX_SAM
    delegate Grundumfang_XIX_SAM.RP_IF_RGB_Slave_03_LedBlauStg_XIX_Grundumfang_XIX_SAM <-> outer port RP_IF_RGB_Slave_03_LedBlauStg_XIX_SAM
    delegate Grundumfang_XIX_SAM.RP_IF_RGB_Slave_03_LedGruenOl_XIX_Grundumfang_XIX_SAM <-> outer port RP_IF_RGB_Slave_03_LedGruenOl_XIX_SAM
    delegate Grundumfang_XIX_SAM.RP_IF_RGB_Slave_03_LedGruenStg_XIX_Grundumfang_XIX_SAM <-> outer port RP_IF_RGB_Slave_03_LedGruenStg_XIX_SAM
    delegate Grundumfang_XIX_SAM.RP_IF_RGB_Slave_03_LedRotOl_XIX_Grundumfang_XIX_SAM <-> outer port RP_IF_RGB_Slave_03_LedRotOl_XIX_SAM
    delegate Grundumfang_XIX_SAM.RP_IF_RGB_Slave_03_LedRotStg_XIX_Grundumfang_XIX_SAM <-> outer port RP_IF_RGB_Slave_03_LedRotStg_XIX_SAM
    delegate Grundumfang_XIX_SAM.RP_IF_RGB_Slave_03_ResponseError_XIX_Grundumfang_XIX_SAM <-> outer port RP_IF_RGB_Slave_03_ResponseError_XIX_SAM
    delegate Grundumfang_XIX_SAM.RP_IF_RGB_Slave_03_TempState_XIX_Grundumfang_XIX_SAM <-> outer port RP_IF_RGB_Slave_03_TempState_XIX_SAM
    delegate Grundumfang_XIX_SAM.RP_IF_RGB_Slave_04_IntErrorNvm_XIX_Grundumfang_XIX_SAM <-> outer port RP_IF_RGB_Slave_04_IntErrorNvm_XIX_SAM
    delegate Grundumfang_XIX_SAM.RP_IF_RGB_Slave_04_IntErrorRam_XIX_Grundumfang_XIX_SAM <-> outer port RP_IF_RGB_Slave_04_IntErrorRam_XIX_SAM
    delegate Grundumfang_XIX_SAM.RP_IF_RGB_Slave_04_IntErrorRom_XIX_Grundumfang_XIX_SAM <-> outer port RP_IF_RGB_Slave_04_IntErrorRom_XIX_SAM
    delegate Grundumfang_XIX_SAM.RP_IF_RGB_Slave_04_LedBlauOl_XIX_Grundumfang_XIX_SAM <-> outer port RP_IF_RGB_Slave_04_LedBlauOl_XIX_SAM
    delegate Grundumfang_XIX_SAM.RP_IF_RGB_Slave_04_LedBlauStg_XIX_Grundumfang_XIX_SAM <-> outer port RP_IF_RGB_Slave_04_LedBlauStg_XIX_SAM
    delegate Grundumfang_XIX_SAM.RP_IF_RGB_Slave_04_LedGruenOl_XIX_Grundumfang_XIX_SAM <-> outer port RP_IF_RGB_Slave_04_LedGruenOl_XIX_SAM
    delegate Grundumfang_XIX_SAM.RP_IF_RGB_Slave_04_LedGruenStg_XIX_Grundumfang_XIX_SAM <-> outer port RP_IF_RGB_Slave_04_LedGruenStg_XIX_SAM
    delegate Grundumfang_XIX_SAM.RP_IF_RGB_Slave_04_LedRotOl_XIX_Grundumfang_XIX_SAM <-> outer port RP_IF_RGB_Slave_04_LedRotOl_XIX_SAM
    delegate Grundumfang_XIX_SAM.RP_IF_RGB_Slave_04_LedRotStg_XIX_Grundumfang_XIX_SAM <-> outer port RP_IF_RGB_Slave_04_LedRotStg_XIX_SAM
    delegate Grundumfang_XIX_SAM.RP_IF_RGB_Slave_04_ResponseError_XIX_Grundumfang_XIX_SAM <-> outer port RP_IF_RGB_Slave_04_ResponseError_XIX_SAM
    delegate Grundumfang_XIX_SAM.RP_IF_RGB_Slave_04_TempState_XIX_Grundumfang_XIX_SAM <-> outer port RP_IF_RGB_Slave_04_TempState_XIX_SAM
    delegate Grundumfang_XIX_SAM.RP_IF_RGB_Slave_05_IntErrorNvm_XIX_Grundumfang_XIX_SAM <-> outer port RP_IF_RGB_Slave_05_IntErrorNvm_XIX_SAM
    delegate Grundumfang_XIX_SAM.RP_IF_RGB_Slave_05_IntErrorRam_XIX_Grundumfang_XIX_SAM <-> outer port RP_IF_RGB_Slave_05_IntErrorRam_XIX_SAM
    delegate Grundumfang_XIX_SAM.RP_IF_RGB_Slave_05_IntErrorRom_XIX_Grundumfang_XIX_SAM <-> outer port RP_IF_RGB_Slave_05_IntErrorRom_XIX_SAM
    delegate Grundumfang_XIX_SAM.RP_IF_RGB_Slave_05_LedBlauOl_XIX_Grundumfang_XIX_SAM <-> outer port RP_IF_RGB_Slave_05_LedBlauOl_XIX_SAM
    delegate Grundumfang_XIX_SAM.RP_IF_RGB_Slave_05_LedBlauStg_XIX_Grundumfang_XIX_SAM <-> outer port RP_IF_RGB_Slave_05_LedBlauStg_XIX_SAM
    delegate Grundumfang_XIX_SAM.RP_IF_RGB_Slave_05_LedGruenOl_XIX_Grundumfang_XIX_SAM <-> outer port RP_IF_RGB_Slave_05_LedGruenOl_XIX_SAM
    delegate Grundumfang_XIX_SAM.RP_IF_RGB_Slave_05_LedGruenStg_XIX_Grundumfang_XIX_SAM <-> outer port RP_IF_RGB_Slave_05_LedGruenStg_XIX_SAM
    delegate Grundumfang_XIX_SAM.RP_IF_RGB_Slave_05_LedRotOl_XIX_Grundumfang_XIX_SAM <-> outer port RP_IF_RGB_Slave_05_LedRotOl_XIX_SAM
    delegate Grundumfang_XIX_SAM.RP_IF_RGB_Slave_05_LedRotStg_XIX_Grundumfang_XIX_SAM <-> outer port RP_IF_RGB_Slave_05_LedRotStg_XIX_SAM
    delegate Grundumfang_XIX_SAM.RP_IF_RGB_Slave_05_ResponseError_XIX_Grundumfang_XIX_SAM <-> outer port RP_IF_RGB_Slave_05_ResponseError_XIX_SAM
    delegate Grundumfang_XIX_SAM.RP_IF_RGB_Slave_05_TempState_XIX_Grundumfang_XIX_SAM <-> outer port RP_IF_RGB_Slave_05_TempState_XIX_SAM
    delegate Grundumfang_XIX_SAM.RP_IF_RGB_Slave_06_IntErrorNvm_XIX_Grundumfang_XIX_SAM <-> outer port RP_IF_RGB_Slave_06_IntErrorNvm_XIX_SAM
    delegate Grundumfang_XIX_SAM.RP_IF_RGB_Slave_06_IntErrorRam_XIX_Grundumfang_XIX_SAM <-> outer port RP_IF_RGB_Slave_06_IntErrorRam_XIX_SAM
    delegate Grundumfang_XIX_SAM.RP_IF_RGB_Slave_06_IntErrorRom_XIX_Grundumfang_XIX_SAM <-> outer port RP_IF_RGB_Slave_06_IntErrorRom_XIX_SAM
    delegate Grundumfang_XIX_SAM.RP_IF_RGB_Slave_06_LedBlauOl_XIX_Grundumfang_XIX_SAM <-> outer port RP_IF_RGB_Slave_06_LedBlauOl_XIX_SAM
    delegate Grundumfang_XIX_SAM.RP_IF_RGB_Slave_06_LedBlauStg_XIX_Grundumfang_XIX_SAM <-> outer port RP_IF_RGB_Slave_06_LedBlauStg_XIX_SAM
    delegate Grundumfang_XIX_SAM.RP_IF_RGB_Slave_06_LedGruenOl_XIX_Grundumfang_XIX_SAM <-> outer port RP_IF_RGB_Slave_06_LedGruenOl_XIX_SAM
    delegate Grundumfang_XIX_SAM.RP_IF_RGB_Slave_06_LedGruenStg_XIX_Grundumfang_XIX_SAM <-> outer port RP_IF_RGB_Slave_06_LedGruenStg_XIX_SAM
    delegate Grundumfang_XIX_SAM.RP_IF_RGB_Slave_06_LedRotOl_XIX_Grundumfang_XIX_SAM <-> outer port RP_IF_RGB_Slave_06_LedRotOl_XIX_SAM
    delegate Grundumfang_XIX_SAM.RP_IF_RGB_Slave_06_LedRotStg_XIX_Grundumfang_XIX_SAM <-> outer port RP_IF_RGB_Slave_06_LedRotStg_XIX_SAM
    delegate Grundumfang_XIX_SAM.RP_IF_RGB_Slave_06_ResponseError_XIX_Grundumfang_XIX_SAM <-> outer port RP_IF_RGB_Slave_06_ResponseError_XIX_SAM
    delegate Grundumfang_XIX_SAM.RP_IF_RGB_Slave_06_TempState_XIX_Grundumfang_XIX_SAM <-> outer port RP_IF_RGB_Slave_06_TempState_XIX_SAM
    delegate Grundumfang_XIX_SAM.RP_IF_RGB_Slave_07_IntErrorNvm_XIX_Grundumfang_XIX_SAM <-> outer port RP_IF_RGB_Slave_07_IntErrorNvm_XIX_SAM
    delegate Grundumfang_XIX_SAM.RP_IF_RGB_Slave_07_IntErrorRam_XIX_Grundumfang_XIX_SAM <-> outer port RP_IF_RGB_Slave_07_IntErrorRam_XIX_SAM
    delegate Grundumfang_XIX_SAM.RP_IF_RGB_Slave_07_IntErrorRom_XIX_Grundumfang_XIX_SAM <-> outer port RP_IF_RGB_Slave_07_IntErrorRom_XIX_SAM
    delegate Grundumfang_XIX_SAM.RP_IF_RGB_Slave_07_LedBlauOl_XIX_Grundumfang_XIX_SAM <-> outer port RP_IF_RGB_Slave_07_LedBlauOl_XIX_SAM
    delegate Grundumfang_XIX_SAM.RP_IF_RGB_Slave_07_LedBlauStg_XIX_Grundumfang_XIX_SAM <-> outer port RP_IF_RGB_Slave_07_LedBlauStg_XIX_SAM
    delegate Grundumfang_XIX_SAM.RP_IF_RGB_Slave_07_LedGruenOl_XIX_Grundumfang_XIX_SAM <-> outer port RP_IF_RGB_Slave_07_LedGruenOl_XIX_SAM
    delegate Grundumfang_XIX_SAM.RP_IF_RGB_Slave_07_LedGruenStg_XIX_Grundumfang_XIX_SAM <-> outer port RP_IF_RGB_Slave_07_LedGruenStg_XIX_SAM
    delegate Grundumfang_XIX_SAM.RP_IF_RGB_Slave_07_LedRotOl_XIX_Grundumfang_XIX_SAM <-> outer port RP_IF_RGB_Slave_07_LedRotOl_XIX_SAM
    delegate Grundumfang_XIX_SAM.RP_IF_RGB_Slave_07_LedRotStg_XIX_Grundumfang_XIX_SAM <-> outer port RP_IF_RGB_Slave_07_LedRotStg_XIX_SAM
    delegate Grundumfang_XIX_SAM.RP_IF_RGB_Slave_07_ResponseError_XIX_Grundumfang_XIX_SAM <-> outer port RP_IF_RGB_Slave_07_ResponseError_XIX_SAM
    delegate Grundumfang_XIX_SAM.RP_IF_RGB_Slave_07_TempState_XIX_Grundumfang_XIX_SAM <-> outer port RP_IF_RGB_Slave_07_TempState_XIX_SAM
    delegate Grundumfang_XIX_SAM.RP_IF_RGB_Slave_08_IntErrorNvm_XIX_Grundumfang_XIX_SAM <-> outer port RP_IF_RGB_Slave_08_IntErrorNvm_XIX_SAM
    delegate Grundumfang_XIX_SAM.RP_IF_RGB_Slave_08_IntErrorRam_XIX_Grundumfang_XIX_SAM <-> outer port RP_IF_RGB_Slave_08_IntErrorRam_XIX_SAM
    delegate Grundumfang_XIX_SAM.RP_IF_RGB_Slave_08_IntErrorRom_XIX_Grundumfang_XIX_SAM <-> outer port RP_IF_RGB_Slave_08_IntErrorRom_XIX_SAM
    delegate Grundumfang_XIX_SAM.RP_IF_RGB_Slave_08_LedBlauOl_XIX_Grundumfang_XIX_SAM <-> outer port RP_IF_RGB_Slave_08_LedBlauOl_XIX_SAM
    delegate Grundumfang_XIX_SAM.RP_IF_RGB_Slave_08_LedBlauStg_XIX_Grundumfang_XIX_SAM <-> outer port RP_IF_RGB_Slave_08_LedBlauStg_XIX_SAM
    delegate Grundumfang_XIX_SAM.RP_IF_RGB_Slave_08_LedGruenOl_XIX_Grundumfang_XIX_SAM <-> outer port RP_IF_RGB_Slave_08_LedGruenOl_XIX_SAM
    delegate Grundumfang_XIX_SAM.RP_IF_RGB_Slave_08_LedGruenStg_XIX_Grundumfang_XIX_SAM <-> outer port RP_IF_RGB_Slave_08_LedGruenStg_XIX_SAM
    delegate Grundumfang_XIX_SAM.RP_IF_RGB_Slave_08_LedRotOl_XIX_Grundumfang_XIX_SAM <-> outer port RP_IF_RGB_Slave_08_LedRotOl_XIX_SAM
    delegate Grundumfang_XIX_SAM.RP_IF_RGB_Slave_08_LedRotStg_XIX_Grundumfang_XIX_SAM <-> outer port RP_IF_RGB_Slave_08_LedRotStg_XIX_SAM
    delegate Grundumfang_XIX_SAM.RP_IF_RGB_Slave_08_ResponseError_XIX_Grundumfang_XIX_SAM <-> outer port RP_IF_RGB_Slave_08_ResponseError_XIX_SAM
    delegate Grundumfang_XIX_SAM.RP_IF_RGB_Slave_08_TempState_XIX_Grundumfang_XIX_SAM <-> outer port RP_IF_RGB_Slave_08_TempState_XIX_SAM
    delegate Grundumfang_XIX_SAM.RP_IF_RGB_Slave_09_IntErrorNvm_XIX_Grundumfang_XIX_SAM <-> outer port RP_IF_RGB_Slave_09_IntErrorNvm_XIX_SAM
    delegate Grundumfang_XIX_SAM.RP_IF_RGB_Slave_09_IntErrorRam_XIX_Grundumfang_XIX_SAM <-> outer port RP_IF_RGB_Slave_09_IntErrorRam_XIX_SAM
    delegate Grundumfang_XIX_SAM.RP_IF_RGB_Slave_09_IntErrorRom_XIX_Grundumfang_XIX_SAM <-> outer port RP_IF_RGB_Slave_09_IntErrorRom_XIX_SAM
    delegate Grundumfang_XIX_SAM.RP_IF_RGB_Slave_09_LedBlauOl_XIX_Grundumfang_XIX_SAM <-> outer port RP_IF_RGB_Slave_09_LedBlauOl_XIX_SAM
    delegate Grundumfang_XIX_SAM.RP_IF_RGB_Slave_09_LedBlauStg_XIX_Grundumfang_XIX_SAM <-> outer port RP_IF_RGB_Slave_09_LedBlauStg_XIX_SAM
    delegate Grundumfang_XIX_SAM.RP_IF_RGB_Slave_09_LedGruenOl_XIX_Grundumfang_XIX_SAM <-> outer port RP_IF_RGB_Slave_09_LedGruenOl_XIX_SAM
    delegate Grundumfang_XIX_SAM.RP_IF_RGB_Slave_09_LedGruenStg_XIX_Grundumfang_XIX_SAM <-> outer port RP_IF_RGB_Slave_09_LedGruenStg_XIX_SAM
    delegate Grundumfang_XIX_SAM.RP_IF_RGB_Slave_09_LedRotOl_XIX_Grundumfang_XIX_SAM <-> outer port RP_IF_RGB_Slave_09_LedRotOl_XIX_SAM
    delegate Grundumfang_XIX_SAM.RP_IF_RGB_Slave_09_LedRotStg_XIX_Grundumfang_XIX_SAM <-> outer port RP_IF_RGB_Slave_09_LedRotStg_XIX_SAM
    delegate Grundumfang_XIX_SAM.RP_IF_RGB_Slave_09_ResponseError_XIX_Grundumfang_XIX_SAM <-> outer port RP_IF_RGB_Slave_09_ResponseError_XIX_SAM
    delegate Grundumfang_XIX_SAM.RP_IF_RGB_Slave_09_TempState_XIX_Grundumfang_XIX_SAM <-> outer port RP_IF_RGB_Slave_09_TempState_XIX_SAM
    delegate Grundumfang_XIX_SAM.RP_IF_RGB_Slave_10_IntErrorNvm_XIX_Grundumfang_XIX_SAM <-> outer port RP_IF_RGB_Slave_10_IntErrorNvm_XIX_SAM
    delegate Grundumfang_XIX_SAM.RP_IF_RGB_Slave_10_IntErrorRam_XIX_Grundumfang_XIX_SAM <-> outer port RP_IF_RGB_Slave_10_IntErrorRam_XIX_SAM
    delegate Grundumfang_XIX_SAM.RP_IF_RGB_Slave_10_IntErrorRom_XIX_Grundumfang_XIX_SAM <-> outer port RP_IF_RGB_Slave_10_IntErrorRom_XIX_SAM
    delegate Grundumfang_XIX_SAM.RP_IF_RGB_Slave_10_LedBlauOl_XIX_Grundumfang_XIX_SAM <-> outer port RP_IF_RGB_Slave_10_LedBlauOl_XIX_SAM
    delegate Grundumfang_XIX_SAM.RP_IF_RGB_Slave_10_LedBlauStg_XIX_Grundumfang_XIX_SAM <-> outer port RP_IF_RGB_Slave_10_LedBlauStg_XIX_SAM
    delegate Grundumfang_XIX_SAM.RP_IF_RGB_Slave_10_LedGruenOl_XIX_Grundumfang_XIX_SAM <-> outer port RP_IF_RGB_Slave_10_LedGruenOl_XIX_SAM
    delegate Grundumfang_XIX_SAM.RP_IF_RGB_Slave_10_LedGruenStg_XIX_Grundumfang_XIX_SAM <-> outer port RP_IF_RGB_Slave_10_LedGruenStg_XIX_SAM
    delegate Grundumfang_XIX_SAM.RP_IF_RGB_Slave_10_LedRotOl_XIX_Grundumfang_XIX_SAM <-> outer port RP_IF_RGB_Slave_10_LedRotOl_XIX_SAM
    delegate Grundumfang_XIX_SAM.RP_IF_RGB_Slave_10_LedRotStg_XIX_Grundumfang_XIX_SAM <-> outer port RP_IF_RGB_Slave_10_LedRotStg_XIX_SAM
    delegate Grundumfang_XIX_SAM.RP_IF_RGB_Slave_10_ResponseError_XIX_Grundumfang_XIX_SAM <-> outer port RP_IF_RGB_Slave_10_ResponseError_XIX_SAM
    delegate Grundumfang_XIX_SAM.RP_IF_RGB_Slave_10_TempState_XIX_Grundumfang_XIX_SAM <-> outer port RP_IF_RGB_Slave_10_TempState_XIX_SAM
    delegate Grundumfang_XIX_SAM.RP_IF_RGB_Slave_11_IntErrorNvm_XIX_Grundumfang_XIX_SAM <-> outer port RP_IF_RGB_Slave_11_IntErrorNvm_XIX_SAM
    delegate Grundumfang_XIX_SAM.RP_IF_RGB_Slave_11_IntErrorRam_XIX_Grundumfang_XIX_SAM <-> outer port RP_IF_RGB_Slave_11_IntErrorRam_XIX_SAM
    delegate Grundumfang_XIX_SAM.RP_IF_RGB_Slave_11_IntErrorRom_XIX_Grundumfang_XIX_SAM <-> outer port RP_IF_RGB_Slave_11_IntErrorRom_XIX_SAM
    delegate Grundumfang_XIX_SAM.RP_IF_RGB_Slave_11_LedBlauOl_XIX_Grundumfang_XIX_SAM <-> outer port RP_IF_RGB_Slave_11_LedBlauOl_XIX_SAM
    delegate Grundumfang_XIX_SAM.RP_IF_RGB_Slave_11_LedBlauStg_XIX_Grundumfang_XIX_SAM <-> outer port RP_IF_RGB_Slave_11_LedBlauStg_XIX_SAM
    delegate Grundumfang_XIX_SAM.RP_IF_RGB_Slave_11_LedGruenOl_XIX_Grundumfang_XIX_SAM <-> outer port RP_IF_RGB_Slave_11_LedGruenOl_XIX_SAM
    delegate Grundumfang_XIX_SAM.RP_IF_RGB_Slave_11_LedGruenStg_XIX_Grundumfang_XIX_SAM <-> outer port RP_IF_RGB_Slave_11_LedGruenStg_XIX_SAM
    delegate Grundumfang_XIX_SAM.RP_IF_RGB_Slave_11_LedRotOl_XIX_Grundumfang_XIX_SAM <-> outer port RP_IF_RGB_Slave_11_LedRotOl_XIX_SAM
    delegate Grundumfang_XIX_SAM.RP_IF_RGB_Slave_11_LedRotStg_XIX_Grundumfang_XIX_SAM <-> outer port RP_IF_RGB_Slave_11_LedRotStg_XIX_SAM
    delegate Grundumfang_XIX_SAM.RP_IF_RGB_Slave_11_ResponseError_XIX_Grundumfang_XIX_SAM <-> outer port RP_IF_RGB_Slave_11_ResponseError_XIX_SAM
    delegate Grundumfang_XIX_SAM.RP_IF_RGB_Slave_11_TempState_XIX_Grundumfang_XIX_SAM <-> outer port RP_IF_RGB_Slave_11_TempState_XIX_SAM
    delegate Grundumfang_XIX_SAM.RP_IF_RGB_Slave_12_IntErrorNvm_XIX_Grundumfang_XIX_SAM <-> outer port RP_IF_RGB_Slave_12_IntErrorNvm_XIX_SAM
    delegate Grundumfang_XIX_SAM.RP_IF_RGB_Slave_12_IntErrorRam_XIX_Grundumfang_XIX_SAM <-> outer port RP_IF_RGB_Slave_12_IntErrorRam_XIX_SAM
    delegate Grundumfang_XIX_SAM.RP_IF_RGB_Slave_12_IntErrorRom_XIX_Grundumfang_XIX_SAM <-> outer port RP_IF_RGB_Slave_12_IntErrorRom_XIX_SAM
    delegate Grundumfang_XIX_SAM.RP_IF_RGB_Slave_12_LedBlauOl_XIX_Grundumfang_XIX_SAM <-> outer port RP_IF_RGB_Slave_12_LedBlauOl_XIX_SAM
    delegate Grundumfang_XIX_SAM.RP_IF_RGB_Slave_12_LedBlauStg_XIX_Grundumfang_XIX_SAM <-> outer port RP_IF_RGB_Slave_12_LedBlauStg_XIX_SAM
    delegate Grundumfang_XIX_SAM.RP_IF_RGB_Slave_12_LedGruenOl_XIX_Grundumfang_XIX_SAM <-> outer port RP_IF_RGB_Slave_12_LedGruenOl_XIX_SAM
    delegate Grundumfang_XIX_SAM.RP_IF_RGB_Slave_12_LedGruenStg_XIX_Grundumfang_XIX_SAM <-> outer port RP_IF_RGB_Slave_12_LedGruenStg_XIX_SAM
    delegate Grundumfang_XIX_SAM.RP_IF_RGB_Slave_12_LedRotOl_XIX_Grundumfang_XIX_SAM <-> outer port RP_IF_RGB_Slave_12_LedRotOl_XIX_SAM
    delegate Grundumfang_XIX_SAM.RP_IF_RGB_Slave_12_LedRotStg_XIX_Grundumfang_XIX_SAM <-> outer port RP_IF_RGB_Slave_12_LedRotStg_XIX_SAM
    delegate Grundumfang_XIX_SAM.RP_IF_RGB_Slave_12_ResponseError_XIX_Grundumfang_XIX_SAM <-> outer port RP_IF_RGB_Slave_12_ResponseError_XIX_SAM
    delegate Grundumfang_XIX_SAM.RP_IF_RGB_Slave_12_TempState_XIX_Grundumfang_XIX_SAM <-> outer port RP_IF_RGB_Slave_12_TempState_XIX_SAM
    delegate Grundumfang_XIX_SAM.RP_IF_RGB_Slave_13_IntErrorNvm_XIX_Grundumfang_XIX_SAM <-> outer port RP_IF_RGB_Slave_13_IntErrorNvm_XIX_SAM
    delegate Grundumfang_XIX_SAM.RP_IF_RGB_Slave_13_IntErrorRam_XIX_Grundumfang_XIX_SAM <-> outer port RP_IF_RGB_Slave_13_IntErrorRam_XIX_SAM
    delegate Grundumfang_XIX_SAM.RP_IF_RGB_Slave_13_IntErrorRom_XIX_Grundumfang_XIX_SAM <-> outer port RP_IF_RGB_Slave_13_IntErrorRom_XIX_SAM
    delegate Grundumfang_XIX_SAM.RP_IF_RGB_Slave_13_LedBlauOl_XIX_Grundumfang_XIX_SAM <-> outer port RP_IF_RGB_Slave_13_LedBlauOl_XIX_SAM
    delegate Grundumfang_XIX_SAM.RP_IF_RGB_Slave_13_LedBlauStg_XIX_Grundumfang_XIX_SAM <-> outer port RP_IF_RGB_Slave_13_LedBlauStg_XIX_SAM
    delegate Grundumfang_XIX_SAM.RP_IF_RGB_Slave_13_LedGruenOl_XIX_Grundumfang_XIX_SAM <-> outer port RP_IF_RGB_Slave_13_LedGruenOl_XIX_SAM
    delegate Grundumfang_XIX_SAM.RP_IF_RGB_Slave_13_LedGruenStg_XIX_Grundumfang_XIX_SAM <-> outer port RP_IF_RGB_Slave_13_LedGruenStg_XIX_SAM
    delegate Grundumfang_XIX_SAM.RP_IF_RGB_Slave_13_LedRotOl_XIX_Grundumfang_XIX_SAM <-> outer port RP_IF_RGB_Slave_13_LedRotOl_XIX_SAM
    delegate Grundumfang_XIX_SAM.RP_IF_RGB_Slave_13_LedRotStg_XIX_Grundumfang_XIX_SAM <-> outer port RP_IF_RGB_Slave_13_LedRotStg_XIX_SAM
    delegate Grundumfang_XIX_SAM.RP_IF_RGB_Slave_13_ResponseError_XIX_Grundumfang_XIX_SAM <-> outer port RP_IF_RGB_Slave_13_ResponseError_XIX_SAM
    delegate Grundumfang_XIX_SAM.RP_IF_RGB_Slave_13_TempState_XIX_Grundumfang_XIX_SAM <-> outer port RP_IF_RGB_Slave_13_TempState_XIX_SAM
    delegate Grundumfang_XIX_SAM.RP_IF_RGB_Slave_14_IntErrorNvm_XIX_Grundumfang_XIX_SAM <-> outer port RP_IF_RGB_Slave_14_IntErrorNvm_XIX_SAM
    delegate Grundumfang_XIX_SAM.RP_IF_RGB_Slave_14_IntErrorRam_XIX_Grundumfang_XIX_SAM <-> outer port RP_IF_RGB_Slave_14_IntErrorRam_XIX_SAM
    delegate Grundumfang_XIX_SAM.RP_IF_RGB_Slave_14_IntErrorRom_XIX_Grundumfang_XIX_SAM <-> outer port RP_IF_RGB_Slave_14_IntErrorRom_XIX_SAM
    delegate Grundumfang_XIX_SAM.RP_IF_RGB_Slave_14_LedBlauOl_XIX_Grundumfang_XIX_SAM <-> outer port RP_IF_RGB_Slave_14_LedBlauOl_XIX_SAM
    delegate Grundumfang_XIX_SAM.RP_IF_RGB_Slave_14_LedBlauStg_XIX_Grundumfang_XIX_SAM <-> outer port RP_IF_RGB_Slave_14_LedBlauStg_XIX_SAM
    delegate Grundumfang_XIX_SAM.RP_IF_RGB_Slave_14_LedGruenOl_XIX_Grundumfang_XIX_SAM <-> outer port RP_IF_RGB_Slave_14_LedGruenOl_XIX_SAM
    delegate Grundumfang_XIX_SAM.RP_IF_RGB_Slave_14_LedGruenStg_XIX_Grundumfang_XIX_SAM <-> outer port RP_IF_RGB_Slave_14_LedGruenStg_XIX_SAM
    delegate Grundumfang_XIX_SAM.RP_IF_RGB_Slave_14_LedRotOl_XIX_Grundumfang_XIX_SAM <-> outer port RP_IF_RGB_Slave_14_LedRotOl_XIX_SAM
    delegate Grundumfang_XIX_SAM.RP_IF_RGB_Slave_14_LedRotStg_XIX_Grundumfang_XIX_SAM <-> outer port RP_IF_RGB_Slave_14_LedRotStg_XIX_SAM
    delegate Grundumfang_XIX_SAM.RP_IF_RGB_Slave_14_ResponseError_XIX_Grundumfang_XIX_SAM <-> outer port RP_IF_RGB_Slave_14_ResponseError_XIX_SAM
    delegate Grundumfang_XIX_SAM.RP_IF_RGB_Slave_14_TempState_XIX_Grundumfang_XIX_SAM <-> outer port RP_IF_RGB_Slave_14_TempState_XIX_SAM
    delegate Grundumfang_XIX_SAM.RP_IF_RGB_Slave_15_IntErrorNvm_XIX_Grundumfang_XIX_SAM <-> outer port RP_IF_RGB_Slave_15_IntErrorNvm_XIX_SAM
    delegate Grundumfang_XIX_SAM.RP_IF_RGB_Slave_15_IntErrorRam_XIX_Grundumfang_XIX_SAM <-> outer port RP_IF_RGB_Slave_15_IntErrorRam_XIX_SAM
    delegate Grundumfang_XIX_SAM.RP_IF_RGB_Slave_15_IntErrorRom_XIX_Grundumfang_XIX_SAM <-> outer port RP_IF_RGB_Slave_15_IntErrorRom_XIX_SAM
    delegate Grundumfang_XIX_SAM.RP_IF_RGB_Slave_15_LedBlauOl_XIX_Grundumfang_XIX_SAM <-> outer port RP_IF_RGB_Slave_15_LedBlauOl_XIX_SAM
    delegate Grundumfang_XIX_SAM.RP_IF_RGB_Slave_15_LedBlauStg_XIX_Grundumfang_XIX_SAM <-> outer port RP_IF_RGB_Slave_15_LedBlauStg_XIX_SAM
    delegate Grundumfang_XIX_SAM.RP_IF_RGB_Slave_15_LedGruenOl_XIX_Grundumfang_XIX_SAM <-> outer port RP_IF_RGB_Slave_15_LedGruenOl_XIX_SAM
    delegate Grundumfang_XIX_SAM.RP_IF_RGB_Slave_15_LedGruenStg_XIX_Grundumfang_XIX_SAM <-> outer port RP_IF_RGB_Slave_15_LedGruenStg_XIX_SAM
    delegate Grundumfang_XIX_SAM.RP_IF_RGB_Slave_15_LedRotOl_XIX_Grundumfang_XIX_SAM <-> outer port RP_IF_RGB_Slave_15_LedRotOl_XIX_SAM
    delegate Grundumfang_XIX_SAM.RP_IF_RGB_Slave_15_LedRotStg_XIX_Grundumfang_XIX_SAM <-> outer port RP_IF_RGB_Slave_15_LedRotStg_XIX_SAM
    delegate Grundumfang_XIX_SAM.RP_IF_RGB_Slave_15_ResponseError_XIX_Grundumfang_XIX_SAM <-> outer port RP_IF_RGB_Slave_15_ResponseError_XIX_SAM
    delegate Grundumfang_XIX_SAM.RP_IF_RGB_Slave_15_TempState_XIX_Grundumfang_XIX_SAM <-> outer port RP_IF_RGB_Slave_15_TempState_XIX_SAM
    delegate Grundumfang_XIX_SAM.RP_IF_RHP_Fahrzeughupe_Anf_XIX_Grundumfang_XIX_SAM <-> outer port RP_IF_RHP_Fahrzeughupe_Anf_XIX_SAM
    delegate Grundumfang_XIX_SAM.RP_IF_RLS_CRC_XIX_Grundumfang_XIX_SAM <-> outer port RP_IF_RLS_CRC_XIX_SAM
    delegate ABL_XIX_SAM.RP_IF_RLS_Qualifizierungsbit_XIX_ABL_XIX_SAM <-> outer port RP_IF_RLS_Qualifizierungsbit_XIX_SAM
    delegate Grundumfang_XIX_SAM.RP_IF_RLS_Qualifizierungsbit_XIX_Grundumfang_XIX_SAM <-> outer port RP_IF_RLS_Qualifizierungsbit_XIX_SAM
    delegate ABL_XIX_SAM.RP_IF_RLS_ResponseError_XIX_ABL_XIX_SAM <-> outer port RP_IF_RLS_ResponseError_XIX_SAM
    delegate Grundumfang_XIX_SAM.RP_IF_RLS_ResponseError_XIX_Grundumfang_XIX_SAM <-> outer port RP_IF_RLS_ResponseError_XIX_SAM
    delegate Grundumfang_XIX_SAM.RP_IF_RLS_Vorfeldhelligkeit_Boost_XIX_Grundumfang_XIX_SAM <-> outer port RP_IF_RLS_Vorfeldhelligkeit_Boost_XIX_SAM
    delegate ABL_XIX_SAM.RP_IF_RLS_Zaehler_XIX_ABL_XIX_SAM <-> outer port RP_IF_RLS_Zaehler_XIX_SAM
    delegate Grundumfang_XIX_SAM.RP_IF_RLS_Zaehler_XIX_Grundumfang_XIX_SAM <-> outer port RP_IF_RLS_Zaehler_XIX_SAM
    delegate Grundumfang_XIX_SAM.RP_IF_RS_AdaptierungError_XIX_Grundumfang_XIX_SAM <-> outer port RP_IF_RS_AdaptierungError_XIX_SAM
    delegate Grundumfang_XIX_SAM.RP_IF_RS_Error_XIX_Grundumfang_XIX_SAM <-> outer port RP_IF_RS_Error_XIX_SAM
    delegate ABL_XIX_SAM.RP_IF_RS_Regenfahrlicht_XIX_ABL_XIX_SAM <-> outer port RP_IF_RS_Regenfahrlicht_XIX_SAM
    delegate Grundumfang_XIX_SAM.RP_IF_RS_Regenfahrlicht_XIX_Grundumfang_XIX_SAM <-> outer port RP_IF_RS_Regenfahrlicht_XIX_SAM
    delegate Grundumfang_XIX_SAM.RP_IF_RS_Regenmenge_XIX_Grundumfang_XIX_SAM <-> outer port RP_IF_RS_Regenmenge_XIX_SAM
    delegate Grundumfang_XIX_SAM.RP_IF_RS_Schwall_XIX_Grundumfang_XIX_SAM <-> outer port RP_IF_RS_Schwall_XIX_SAM
    delegate Grundumfang_XIX_SAM.RP_IF_RS_Verglasung_schliessen_XIX_Grundumfang_XIX_SAM <-> outer port RP_IF_RS_Verglasung_schliessen_XIX_SAM
    delegate Grundumfang_XIX_SAM.RP_IF_RS_versParklage_Wischer_XIX_Grundumfang_XIX_SAM <-> outer port RP_IF_RS_versParklage_Wischer_XIX_SAM
    delegate Grundumfang_XIX_SAM.RP_IF_RS_Wischergeschwindigkeit_XIX_Grundumfang_XIX_SAM <-> outer port RP_IF_RS_Wischergeschwindigkeit_XIX_SAM
    delegate Grundumfang_XIX_SAM.RP_IF_RV_Reinigung_Anf_XIX_Grundumfang_XIX_SAM <-> outer port RP_IF_RV_Reinigung_Anf_XIX_SAM
    delegate ABL_XIX_SAM.RP_IF_SAL_01_BZ_XIX_ABL_XIX_SAM <-> outer port RP_IF_SAL_01_BZ_XIX_SAM
    delegate Grundumfang_XIX_SAM.RP_IF_SAL_01_BZ_XIX_Grundumfang_XIX_SAM <-> outer port RP_IF_SAL_01_BZ_XIX_SAM
    delegate ABL_XIX_SAM.RP_IF_SAL_01_CRC_XIX_ABL_XIX_SAM <-> outer port RP_IF_SAL_01_CRC_XIX_SAM
    delegate Grundumfang_XIX_SAM.RP_IF_SAL_01_CRC_XIX_Grundumfang_XIX_SAM <-> outer port RP_IF_SAL_01_CRC_XIX_SAM
    delegate Grundumfang_XIX_SAM.RP_IF_SAL_Ambex_CH_state_XIX_Grundumfang_XIX_SAM <-> outer port RP_IF_SAL_Ambex_CH_state_XIX_SAM
    delegate Grundumfang_XIX_SAM.RP_IF_SAL_Ambex_CH_time_XIX_Grundumfang_XIX_SAM <-> outer port RP_IF_SAL_Ambex_CH_time_XIX_SAM
    delegate Grundumfang_XIX_SAM.RP_IF_SAL_Ambex_LH_state_XIX_Grundumfang_XIX_SAM <-> outer port RP_IF_SAL_Ambex_LH_state_XIX_SAM
    delegate Grundumfang_XIX_SAM.RP_IF_SAL_Ambex_LH_time_XIX_Grundumfang_XIX_SAM <-> outer port RP_IF_SAL_Ambex_LH_time_XIX_SAM
    delegate Grundumfang_XIX_SAM.RP_IF_SAL_Ambex_Lichtsensor_ch_lh_ein_XIX_Grundumfang_XIX_SAM <-> outer port RP_IF_SAL_Ambex_Lichtsensor_ch_lh_ein_XIX_SAM
    delegate ABL_XIX_SAM.RP_IF_SAL_Blinkerzyklus_L_XIX_ABL_XIX_SAM <-> outer port RP_IF_SAL_Blinkerzyklus_L_XIX_SAM
    delegate Grundumfang_XIX_SAM.RP_IF_SAL_Blinkerzyklus_L_XIX_Grundumfang_XIX_SAM <-> outer port RP_IF_SAL_Blinkerzyklus_L_XIX_SAM
    delegate ABL_XIX_SAM.RP_IF_SAL_Blinkerzyklus_R_XIX_ABL_XIX_SAM <-> outer port RP_IF_SAL_Blinkerzyklus_R_XIX_SAM
    delegate Grundumfang_XIX_SAM.RP_IF_SAL_Blinkerzyklus_R_XIX_Grundumfang_XIX_SAM <-> outer port RP_IF_SAL_Blinkerzyklus_R_XIX_SAM
    delegate ABL_XIX_SAM.RP_IF_SAL_BLK_L_Anf_XIX_ABL_XIX_SAM <-> outer port RP_IF_SAL_BLK_L_Anf_XIX_SAM
    delegate Grundumfang_XIX_SAM.RP_IF_SAL_BLK_L_Anf_XIX_Grundumfang_XIX_SAM <-> outer port RP_IF_SAL_BLK_L_Anf_XIX_SAM
    delegate ABL_XIX_SAM.RP_IF_SAL_BLK_R_Anf_XIX_ABL_XIX_SAM <-> outer port RP_IF_SAL_BLK_R_Anf_XIX_SAM
    delegate Grundumfang_XIX_SAM.RP_IF_SAL_BLK_R_Anf_XIX_Grundumfang_XIX_SAM <-> outer port RP_IF_SAL_BLK_R_Anf_XIX_SAM
    delegate ABL_XIX_SAM.RP_IF_SAL_Bremszyklus_XIX_ABL_XIX_SAM <-> outer port RP_IF_SAL_Bremszyklus_XIX_SAM
    delegate Grundumfang_XIX_SAM.RP_IF_SAL_Bremszyklus_XIX_Grundumfang_XIX_SAM <-> outer port RP_IF_SAL_Bremszyklus_XIX_SAM
    delegate ABL_XIX_SAM.RP_IF_SAL_BRL_Anf_XIX_ABL_XIX_SAM <-> outer port RP_IF_SAL_BRL_Anf_XIX_SAM
    delegate Grundumfang_XIX_SAM.RP_IF_SAL_BRL_Anf_XIX_Grundumfang_XIX_SAM <-> outer port RP_IF_SAL_BRL_Anf_XIX_SAM
    delegate ABL_XIX_SAM.RP_IF_SAL_CH_Anf_XIX_ABL_XIX_SAM <-> outer port RP_IF_SAL_CH_Anf_XIX_SAM
    delegate Grundumfang_XIX_SAM.RP_IF_SAL_CH_Anf_XIX_Grundumfang_XIX_SAM <-> outer port RP_IF_SAL_CH_Anf_XIX_SAM
    delegate ABL_XIX_SAM.RP_IF_SAL_HGB_Anf_XIX_ABL_XIX_SAM <-> outer port RP_IF_SAL_HGB_Anf_XIX_SAM
    delegate Grundumfang_XIX_SAM.RP_IF_SAL_HGB_Anf_XIX_Grundumfang_XIX_SAM <-> outer port RP_IF_SAL_HGB_Anf_XIX_SAM
    delegate ABL_XIX_SAM.RP_IF_SAL_Kl_15_vFzg_S_XIX_ABL_XIX_SAM <-> outer port RP_IF_SAL_Kl_15_vFzg_S_XIX_SAM
    delegate Grundumfang_XIX_SAM.RP_IF_SAL_Kl_15_vFzg_S_XIX_Grundumfang_XIX_SAM <-> outer port RP_IF_SAL_Kl_15_vFzg_S_XIX_SAM
    delegate ABL_XIX_SAM.RP_IF_SAL_Kl_15_vFzg_XIX_ABL_XIX_SAM <-> outer port RP_IF_SAL_Kl_15_vFzg_XIX_SAM
    delegate Grundumfang_XIX_SAM.RP_IF_SAL_Kl_15_vFzg_XIX_Grundumfang_XIX_SAM <-> outer port RP_IF_SAL_Kl_15_vFzg_XIX_SAM
    delegate ABL_XIX_SAM.RP_IF_SAL_Kl_15_XIX_ABL_XIX_SAM <-> outer port RP_IF_SAL_Kl_15_XIX_SAM
    delegate Grundumfang_XIX_SAM.RP_IF_SAL_Kl_15_XIX_Grundumfang_XIX_SAM <-> outer port RP_IF_SAL_Kl_15_XIX_SAM
    delegate ABL_XIX_SAM.RP_IF_SAL_KL_50_5s_XIX_ABL_XIX_SAM <-> outer port RP_IF_SAL_KL_50_5s_XIX_SAM
    delegate Grundumfang_XIX_SAM.RP_IF_SAL_KL_50_5s_XIX_Grundumfang_XIX_SAM <-> outer port RP_IF_SAL_KL_50_5s_XIX_SAM
    delegate ABL_XIX_SAM.RP_IF_SAL_KL_50_XIX_ABL_XIX_SAM <-> outer port RP_IF_SAL_KL_50_XIX_SAM
    delegate Grundumfang_XIX_SAM.RP_IF_SAL_KL_50_XIX_Grundumfang_XIX_SAM <-> outer port RP_IF_SAL_KL_50_XIX_SAM
    delegate ABL_XIX_SAM.RP_IF_SAL_KL_75_vFzg_XIX_ABL_XIX_SAM <-> outer port RP_IF_SAL_KL_75_vFzg_XIX_SAM
    delegate Grundumfang_XIX_SAM.RP_IF_SAL_KL_75_vFzg_XIX_Grundumfang_XIX_SAM <-> outer port RP_IF_SAL_KL_75_vFzg_XIX_SAM
    delegate ABL_XIX_SAM.RP_IF_SAL_Kl_75_XIX_ABL_XIX_SAM <-> outer port RP_IF_SAL_Kl_75_XIX_SAM
    delegate Grundumfang_XIX_SAM.RP_IF_SAL_Kl_75_XIX_Grundumfang_XIX_SAM <-> outer port RP_IF_SAL_Kl_75_XIX_SAM
    delegate ABL_XIX_SAM.RP_IF_SAL_KL_75a_vFzg_XIX_ABL_XIX_SAM <-> outer port RP_IF_SAL_KL_75a_vFzg_XIX_SAM
    delegate Grundumfang_XIX_SAM.RP_IF_SAL_KL_75a_vFzg_XIX_Grundumfang_XIX_SAM <-> outer port RP_IF_SAL_KL_75a_vFzg_XIX_SAM
    delegate ABL_XIX_SAM.RP_IF_SAL_KL_75a_XIX_ABL_XIX_SAM <-> outer port RP_IF_SAL_KL_75a_XIX_SAM
    delegate Grundumfang_XIX_SAM.RP_IF_SAL_KL_75a_XIX_Grundumfang_XIX_SAM <-> outer port RP_IF_SAL_KL_75a_XIX_SAM
    delegate ABL_XIX_SAM.RP_IF_SAL_KZL_Anf_XIX_ABL_XIX_SAM <-> outer port RP_IF_SAL_KZL_Anf_XIX_SAM
    delegate Grundumfang_XIX_SAM.RP_IF_SAL_KZL_Anf_XIX_Grundumfang_XIX_SAM <-> outer port RP_IF_SAL_KZL_Anf_XIX_SAM
    delegate ABL_XIX_SAM.RP_IF_SAL_LDS_Abblendlicht_Anf_XIX_ABL_XIX_SAM <-> outer port RP_IF_SAL_LDS_Abblendlicht_Anf_XIX_SAM
    delegate Grundumfang_XIX_SAM.RP_IF_SAL_LDS_Abblendlicht_Anf_XIX_Grundumfang_XIX_SAM <-> outer port RP_IF_SAL_LDS_Abblendlicht_Anf_XIX_SAM
    delegate ABL_XIX_SAM.RP_IF_SAL_LDS_Assistenzfahrlicht_Anf_XIX_ABL_XIX_SAM <-> outer port RP_IF_SAL_LDS_Assistenzfahrlicht_Anf_XIX_SAM
    delegate Grundumfang_XIX_SAM.RP_IF_SAL_LDS_Assistenzfahrlicht_Anf_XIX_Grundumfang_XIX_SAM <-> outer port RP_IF_SAL_LDS_Assistenzfahrlicht_Anf_XIX_SAM
    delegate ABL_XIX_SAM.RP_IF_SAL_LDS_Nullstellung_Anf_XIX_ABL_XIX_SAM <-> outer port RP_IF_SAL_LDS_Nullstellung_Anf_XIX_SAM
    delegate Grundumfang_XIX_SAM.RP_IF_SAL_LDS_Nullstellung_Anf_XIX_Grundumfang_XIX_SAM <-> outer port RP_IF_SAL_LDS_Nullstellung_Anf_XIX_SAM
    delegate ABL_XIX_SAM.RP_IF_SAL_LDS_Standlicht_Anf_XIX_ABL_XIX_SAM <-> outer port RP_IF_SAL_LDS_Standlicht_Anf_XIX_SAM
    delegate Grundumfang_XIX_SAM.RP_IF_SAL_LDS_Standlicht_Anf_XIX_Grundumfang_XIX_SAM <-> outer port RP_IF_SAL_LDS_Standlicht_Anf_XIX_SAM
    delegate ABL_XIX_SAM.RP_IF_SAL_LH_Anf_XIX_ABL_XIX_SAM <-> outer port RP_IF_SAL_LH_Anf_XIX_SAM
    delegate Grundumfang_XIX_SAM.RP_IF_SAL_LH_Anf_XIX_Grundumfang_XIX_SAM <-> outer port RP_IF_SAL_LH_Anf_XIX_SAM
    delegate ABL_XIX_SAM.RP_IF_SAL_NSL_Anf_XIX_ABL_XIX_SAM <-> outer port RP_IF_SAL_NSL_Anf_XIX_SAM
    delegate Grundumfang_XIX_SAM.RP_IF_SAL_NSL_Anf_XIX_Grundumfang_XIX_SAM <-> outer port RP_IF_SAL_NSL_Anf_XIX_SAM
    delegate ABL_XIX_SAM.RP_IF_SAL_PL_L_Anf_XIX_ABL_XIX_SAM <-> outer port RP_IF_SAL_PL_L_Anf_XIX_SAM
    delegate Grundumfang_XIX_SAM.RP_IF_SAL_PL_L_Anf_XIX_Grundumfang_XIX_SAM <-> outer port RP_IF_SAL_PL_L_Anf_XIX_SAM
    delegate ABL_XIX_SAM.RP_IF_SAL_PL_R_Anf_XIX_ABL_XIX_SAM <-> outer port RP_IF_SAL_PL_R_Anf_XIX_SAM
    delegate Grundumfang_XIX_SAM.RP_IF_SAL_PL_R_Anf_XIX_Grundumfang_XIX_SAM <-> outer port RP_IF_SAL_PL_R_Anf_XIX_SAM
    delegate ABL_XIX_SAM.RP_IF_SAL_RFL_Anf_XIX_ABL_XIX_SAM <-> outer port RP_IF_SAL_RFL_Anf_XIX_SAM
    delegate Grundumfang_XIX_SAM.RP_IF_SAL_RFL_Anf_XIX_Grundumfang_XIX_SAM <-> outer port RP_IF_SAL_RFL_Anf_XIX_SAM
    delegate ABL_XIX_SAM.RP_IF_SAL_SL_Anf_XIX_ABL_XIX_SAM <-> outer port RP_IF_SAL_SL_Anf_XIX_SAM
    delegate Grundumfang_XIX_SAM.RP_IF_SAL_SL_Anf_XIX_Grundumfang_XIX_SAM <-> outer port RP_IF_SAL_SL_Anf_XIX_SAM
    delegate ABL_XIX_SAM.RP_IF_SAL_WBT_Bel_XIX_ABL_XIX_SAM <-> outer port RP_IF_SAL_WBT_Bel_XIX_SAM
    delegate Grundumfang_XIX_SAM.RP_IF_SAL_WBT_Bel_XIX_Grundumfang_XIX_SAM <-> outer port RP_IF_SAL_WBT_Bel_XIX_SAM
    delegate Grundumfang_XIX_SAM.RP_IF_SC_PAO_OFF_Anf_XIX_Grundumfang_XIX_SAM <-> outer port RP_IF_SC_PAO_OFF_Anf_XIX_SAM
    delegate Grundumfang_XIX_SAM.RP_IF_SC_PAO_ON_Anf_XIX_Grundumfang_XIX_SAM <-> outer port RP_IF_SC_PAO_ON_Anf_XIX_SAM
    delegate Grundumfang_XIX_SAM.RP_IF_SI_BUS_{01..03}_XIX_Grundumfang_XIX_SAM <-> outer port RP_IF_SI_BUS_{01..03}_XIX_SAM
    delegate Grundumfang_XIX_SAM.RP_IF_SI_BUS_05_XIX_Grundumfang_XIX_SAM <-> outer port RP_IF_SI_BUS_05_XIX_SAM
    delegate Grundumfang_XIX_SAM.RP_IF_SI_BUS_06_XIX_Grundumfang_XIX_SAM <-> outer port RP_IF_SI_BUS_06_XIX_SAM
    delegate ABL_XIX_SAM.RP_IF_SI_BUS_09_XIX_ABL_XIX_SAM <-> outer port RP_IF_SI_BUS_09_XIX_SAM
    delegate Grundumfang_XIX_SAM.RP_IF_SI_BUS_10_XIX_Grundumfang_XIX_SAM <-> outer port RP_IF_SI_BUS_10_XIX_SAM
    delegate Grundumfang_XIX_SAM.RP_IF_SI_BUS_13_XIX_Grundumfang_XIX_SAM <-> outer port RP_IF_SI_BUS_13_XIX_SAM
    delegate Grundumfang_XIX_SAM.RP_IF_SI_BUS_14_XIX_Grundumfang_XIX_SAM <-> outer port RP_IF_SI_BUS_14_XIX_SAM
    delegate Grundumfang_XIX_SAM.RP_IF_SI_Bus_Identifikation_XIX_Grundumfang_XIX_SAM <-> outer port RP_IF_SI_Bus_Identifikation_XIX_SAM  # _XIX_SC_738_ClassicAUTOSARBasicSoftwareICAS1Gateway_XIX_Softwareblock_XIX_ICAS1_X_Gateway_XIX_Grundumfang_XIX_SAM_XIX_SI_Bus_Identifikation
    delegate Grundumfang_XIX_SAM.RP_IF_SI_NWDF_gueltig_XIX_Grundumfang_XIX_SAM <-> outer port RP_IF_SI_NWDF_gueltig_XIX_SAM  # _XIX_SC_738_ClassicAUTOSARBasicSoftwareICAS1Gateway_XIX_Softwareblock_XIX_ICAS1_X_Gateway_XIX_Grundumfang_XIX_SAM_XIX_SI_NWDF_gueltig
    delegate Grundumfang_XIX_SAM.RP_IF_SI_NWDF_XIX_Grundumfang_XIX_SAM <-> outer port RP_IF_SI_NWDF_XIX_SAM
    delegate Grundumfang_XIX_SAM.RP_IF_SI_P_Mode_gueltig_XIX_Grundumfang_XIX_SAM <-> outer port RP_IF_SI_P_Mode_gueltig_XIX_SAM  # _XIX_SC_738_ClassicAUTOSARBasicSoftwareICAS1Gateway_XIX_Softwareblock_XIX_ICAS1_X_Gateway_XIX_Grundumfang_XIX_SAM_XIX_SI_P_Mode_gueltig
    delegate Grundumfang_XIX_SAM.RP_IF_SI_P_Mode_XIX_Grundumfang_XIX_SAM <-> outer port RP_IF_SI_P_Mode_XIX_SAM
    delegate Druckpunktmassage_fuer_Beifahrersitz_Lehnenmassage_SAM_XIX_DPMBFSLM_XIX_SAM.RP_IF_SI_QRS_Mode_XIX_Druckpunktmassage_fuer_Beifahrersitz_Lehnenmassage_SAM_XIX_DPMBFSLM_XIX_SAM <-> outer port RP_IF_SI_QRS_Mode_XIX_SAM  # _XIX_SC_47_EMHLR_XIX_Softwareblock_XIX_ICAS1_X_Gateway_XIX_Druckpunktmassage_fuer_Beifahrersitz_Lehnenmassage_SAM_XIX_DPMBFSLM_XIX_SAM_XIX_SI_QRS_Mode
    delegate Druckpunktmassage_fuer_Fahrersitz_Lehnenmassage_SAM_XIX_DPMFSLM_XIX_SAM.RP_IF_SI_QRS_Mode_XIX_Druckpunktmassage_fuer_Fahrersitz_Lehnenmassage_SAM_XIX_DPMFSLM_XIX_SAM <-> outer port RP_IF_SI_QRS_Mode_XIX_SAM  # _XIX_SC_47_EMHLR_XIX_Softwareblock_XIX_ICAS1_X_Gateway_XIX_Druckpunktmassage_fuer_Fahrersitz_Lehnenmassage_SAM_XIX_DPMFSLM_XIX_SAM_XIX_SI_QRS_Mode
    delegate Grundumfang_XIX_SAM.RP_IF_SI_QRS_Mode_XIX_Grundumfang_XIX_SAM <-> outer port RP_IF_SI_QRS_Mode_XIX_SAM
    delegate Druckpunktmassage_fuer_Beifahrersitz_Lehnenmassage_SAM_XIX_DPMBFSLM_XIX_SAM.RP_IF_SI_T_Mode_XIX_Druckpunktmassage_fuer_Beifahrersitz_Lehnenmassage_SAM_XIX_DPMBFSLM_XIX_SAM <-> outer port RP_IF_SI_T_Mode_XIX_SAM  # _XIX_SC_47_EMHLR_XIX_Softwareblock_XIX_ICAS1_X_Gateway_XIX_Druckpunktmassage_fuer_Beifahrersitz_Lehnenmassage_SAM_XIX_DPMBFSLM_XIX_SAM_XIX_SI_T_Mode
    delegate Druckpunktmassage_fuer_Fahrersitz_Lehnenmassage_SAM_XIX_DPMFSLM_XIX_SAM.RP_IF_SI_T_Mode_XIX_Druckpunktmassage_fuer_Fahrersitz_Lehnenmassage_SAM_XIX_DPMFSLM_XIX_SAM <-> outer port RP_IF_SI_T_Mode_XIX_SAM  # _XIX_SC_47_EMHLR_XIX_Softwareblock_XIX_ICAS1_X_Gateway_XIX_Druckpunktmassage_fuer_Fahrersitz_Lehnenmassage_SAM_XIX_DPMFSLM_XIX_SAM_XIX_SI_T_Mode
    delegate Grundumfang_XIX_SAM.RP_IF_SI_T_Mode_XIX_Grundumfang_XIX_SAM <-> outer port RP_IF_SI_T_Mode_XIX_SAM
    delegate Grundumfang_XIX_SAM.RP_IF_SI_T_Schutz_XIX_Grundumfang_XIX_SAM <-> outer port RP_IF_SI_T_Schutz_XIX_SAM
    delegate Grundumfang_XIX_SAM.RP_IF_SitzMem_HBFS_ORUData_XIX_Grundumfang_XIX_SAM <-> outer port RP_IF_SitzMem_HBFS_ORUData_XIX_SAM
    delegate Grundumfang_XIX_SAM.RP_IF_SitzMem_HBFS_ORUDataIndex_XIX_Grundumfang_XIX_SAM <-> outer port RP_IF_SitzMem_HBFS_ORUDataIndex_XIX_SAM
    delegate Grundumfang_XIX_SAM.RP_IF_SitzMem_HFS_ORUData_XIX_Grundumfang_XIX_SAM <-> outer port RP_IF_SitzMem_HFS_ORUData_XIX_SAM
    delegate Grundumfang_XIX_SAM.RP_IF_SitzMem_HFS_ORUDataIndex_XIX_Grundumfang_XIX_SAM <-> outer port RP_IF_SitzMem_HFS_ORUDataIndex_XIX_SAM
    delegate Grundumfang_XIX_SAM.RP_IF_SitzMemo_BFS_ORUData_XIX_Grundumfang_XIX_SAM <-> outer port RP_IF_SitzMemo_BFS_ORUData_XIX_SAM
    delegate Grundumfang_XIX_SAM.RP_IF_SitzMemo_BFS_ORUDataIndex_XIX_Grundumfang_XIX_SAM <-> outer port RP_IF_SitzMemo_BFS_ORUDataIndex_XIX_SAM
    delegate Grundumfang_XIX_SAM.RP_IF_SitzMemo_FS_ORUData_XIX_Grundumfang_XIX_SAM <-> outer port RP_IF_SitzMemo_FS_ORUData_XIX_SAM
    delegate Grundumfang_XIX_SAM.RP_IF_SitzMemo_FS_ORUDataIndex_XIX_Grundumfang_XIX_SAM <-> outer port RP_IF_SitzMemo_FS_ORUDataIndex_XIX_SAM
    delegate Grundumfang_XIX_SAM.RP_IF_SL2_APS_Taster_XIX_Grundumfang_XIX_SAM <-> outer port RP_IF_SL2_APS_Taster_XIX_SAM
    delegate Grundumfang_XIX_SAM.RP_IF_SL2_FAS_Profile_Taster_XIX_Grundumfang_XIX_SAM <-> outer port RP_IF_SL2_FAS_Profile_Taster_XIX_SAM
    delegate Grundumfang_XIX_SAM.RP_IF_SL2_ResponseError_XIX_Grundumfang_XIX_SAM <-> outer port RP_IF_SL2_ResponseError_XIX_SAM
    delegate Grundumfang_XIX_SAM.RP_IF_SL2_StatusSchalterleiste_XIX_Grundumfang_XIX_SAM <-> outer port RP_IF_SL2_StatusSchalterleiste_XIX_SAM
    delegate Grundumfang_XIX_SAM.RP_IF_SMLS_01_BZ_XIX_Grundumfang_XIX_SAM <-> outer port RP_IF_SMLS_01_BZ_XIX_SAM
    delegate Grundumfang_XIX_SAM.RP_IF_SMLS_01_CRC_XIX_Grundumfang_XIX_SAM <-> outer port RP_IF_SMLS_01_CRC_XIX_SAM
    delegate Grundumfang_XIX_SAM.RP_IF_SMLS_Hupe_XIX_Grundumfang_XIX_SAM <-> outer port RP_IF_SMLS_Hupe_XIX_SAM
    delegate Grundumfang_XIX_SAM.RP_IF_SMLS_ORUData_XIX_Grundumfang_XIX_SAM <-> outer port RP_IF_SMLS_ORUData_XIX_SAM
    delegate Grundumfang_XIX_SAM.RP_IF_SMLS_ORUDataIndex_XIX_Grundumfang_XIX_SAM <-> outer port RP_IF_SMLS_ORUDataIndex_XIX_SAM
    delegate Grundumfang_XIX_SAM.RP_IF_SOK_FoD_BCM1_Resp_Challenge_XIX_Grundumfang_XIX_SAM <-> outer port RP_IF_SOK_FoD_BCM1_Resp_Challenge_XIX_SAM
    delegate Grundumfang_XIX_SAM.RP_IF_SOK_ungeschuetzte_Zeit_XIX_Grundumfang_XIX_SAM <-> outer port RP_IF_SOK_ungeschuetzte_Zeit_XIX_SAM
    delegate Grundumfang_XIX_SAM.RP_IF_SOK_ZV_Rueck_HW_Challenge_XIX_Grundumfang_XIX_SAM <-> outer port RP_IF_SOK_ZV_Rueck_HW_Challenge_XIX_SAM
    delegate Grundumfang_XIX_SAM.RP_IF_SoSe_SunInt_2D_Li_XIX_Grundumfang_XIX_SAM <-> outer port RP_IF_SoSe_SunInt_2D_Li_XIX_SAM
    delegate Grundumfang_XIX_SAM.RP_IF_SoSe_SunInt_2D_Re_XIX_Grundumfang_XIX_SAM <-> outer port RP_IF_SoSe_SunInt_2D_Re_XIX_SAM
    delegate Grundumfang_XIX_SAM.RP_IF_SPR_BFS_CodierPinError_XIX_Grundumfang_XIX_SAM <-> outer port RP_IF_SPR_BFS_CodierPinError_XIX_SAM
    delegate Grundumfang_XIX_SAM.RP_IF_SPR_BFS_Kompressor_elFehler_XIX_Grundumfang_XIX_SAM <-> outer port RP_IF_SPR_BFS_Kompressor_elFehler_XIX_SAM
    delegate Grundumfang_XIX_SAM.RP_IF_SPR_BFS_Leck_erkannt_XIX_Grundumfang_XIX_SAM <-> outer port RP_IF_SPR_BFS_Leck_erkannt_XIX_SAM
    delegate Grundumfang_XIX_SAM.RP_IF_SPR_BFS_Lokal_aktiv_XIX_Grundumfang_XIX_SAM <-> outer port RP_IF_SPR_BFS_Lokal_aktiv_XIX_SAM
    delegate Grundumfang_XIX_SAM.RP_IF_SPR_BFS_Lordose_hoch_XIX_Grundumfang_XIX_SAM <-> outer port RP_IF_SPR_BFS_Lordose_hoch_XIX_SAM
    delegate Grundumfang_XIX_SAM.RP_IF_SPR_BFS_Lordose_runter_XIX_Grundumfang_XIX_SAM <-> outer port RP_IF_SPR_BFS_Lordose_runter_XIX_SAM
    delegate Grundumfang_XIX_SAM.RP_IF_SPR_BFS_Lordose_vor_XIX_Grundumfang_XIX_SAM <-> outer port RP_IF_SPR_BFS_Lordose_vor_XIX_SAM
    delegate Grundumfang_XIX_SAM.RP_IF_SPR_BFS_Lordose_zurueck_XIX_Grundumfang_XIX_SAM <-> outer port RP_IF_SPR_BFS_Lordose_zurueck_XIX_SAM
    delegate Druckpunktmassage_fuer_Beifahrersitz_Lehnenmassage_SAM_XIX_DPMBFSLM_XIX_SAM.RP_IF_SPR_BFS_Massage_Dauer_XIX_Druckpunktmassage_fuer_Beifahrersitz_Lehnenmassage_SAM_XIX_DPMBFSLM_XIX_SAM <-> outer port RP_IF_SPR_BFS_Massage_Dauer_XIX_SAM  # _XIX_Grundumfang_XIX_SPR_BFS_XIX_Druckpunktmassage_fuer_Beifahrersitz_Lehnenmassage_SAM_XIX_DPMBFSLM_XIX_SAM_XIX_SPR_BFS_Massage_Dauer
    delegate Grundumfang_XIX_SAM.RP_IF_SPR_BFS_Massage_Int_XIX_Grundumfang_XIX_SAM <-> outer port RP_IF_SPR_BFS_Massage_Int_XIX_SAM
    delegate Druckpunktmassage_fuer_Beifahrersitz_Lehnenmassage_SAM_XIX_DPMBFSLM_XIX_SAM.RP_IF_SPR_BFS_Massage_Intens_Lehne_XIX_Druckpunktmassage_fuer_Beifahrersitz_Lehnenmassage_SAM_XIX_DPMBFSLM_XIX_SAM <-> outer port RP_IF_SPR_BFS_Massage_Intens_Lehne_XIX_SAM  # _XIX_Grundumfang_XIX_SPR_BFS_XIX_Druckpunktmassage_fuer_Beifahrersitz_Lehnenmassage_SAM_XIX_DPMBFSLM_XIX_SAM_XIX_SPR_BFS_Massage_Intens_Lehne
    delegate Druckpunktmassage_fuer_Beifahrersitz_Lehnenmassage_SAM_XIX_DPMBFSLM_XIX_SAM.RP_IF_SPR_BFS_Massage_Intens_Sitz_XIX_Druckpunktmassage_fuer_Beifahrersitz_Lehnenmassage_SAM_XIX_DPMBFSLM_XIX_SAM <-> outer port RP_IF_SPR_BFS_Massage_Intens_Sitz_XIX_SAM  # _XIX_Grundumfang_XIX_SPR_BFS_XIX_Druckpunktmassage_fuer_Beifahrersitz_Lehnenmassage_SAM_XIX_DPMBFSLM_XIX_SAM_XIX_SPR_BFS_Massage_Intens_Sitz
    delegate Druckpunktmassage_fuer_Beifahrersitz_Lehnenmassage_SAM_XIX_DPMBFSLM_XIX_SAM.RP_IF_SPR_BFS_Massage_Prg_erweitert_XIX_Druckpunktmassage_fuer_Beifahrersitz_Lehnenmassage_SAM_XIX_DPMBFSLM_XIX_SAM <-> outer port RP_IF_SPR_BFS_Massage_Prg_erweitert_XIX_SAM  # _XIX_Grundumfang_XIX_SPR_BFS_XIX_Druckpunktmassage_fuer_Beifahrersitz_Lehnenmassage_SAM_XIX_DPMBFSLM_XIX_SAM_XIX_SPR_BFS_Massage_Prg_erweitert
    delegate Grundumfang_XIX_SAM.RP_IF_SPR_BFS_Massage_Prg_XIX_Grundumfang_XIX_SAM <-> outer port RP_IF_SPR_BFS_Massage_Prg_XIX_SAM
    delegate Grundumfang_XIX_SAM.RP_IF_SPR_BFS_MassageStatus_XIX_Grundumfang_XIX_SAM <-> outer port RP_IF_SPR_BFS_MassageStatus_XIX_SAM
    delegate Druckpunktmassage_fuer_Beifahrersitz_Lehnenmassage_SAM_XIX_DPMBFSLM_XIX_SAM.RP_IF_SPR_BFS_Massagetaster_inv_XIX_Druckpunktmassage_fuer_Beifahrersitz_Lehnenmassage_SAM_XIX_DPMBFSLM_XIX_SAM <-> outer port RP_IF_SPR_BFS_Massagetaster_inv_XIX_SAM  # _XIX_Grundumfang_XIX_SPR_BFS_XIX_Druckpunktmassage_fuer_Beifahrersitz_Lehnenmassage_SAM_XIX_DPMBFSLM_XIX_SAM_XIX_SPR_BFS_Massagetaster_inv
    delegate Grundumfang_XIX_SAM.RP_IF_SPR_BFS_MuFu_Fkt_vor_XIX_Grundumfang_XIX_SAM <-> outer port RP_IF_SPR_BFS_MuFu_Fkt_vor_XIX_SAM
    delegate Grundumfang_XIX_SAM.RP_IF_SPR_BFS_MuFu_Fkt_zurueck_XIX_Grundumfang_XIX_SAM <-> outer port RP_IF_SPR_BFS_MuFu_Fkt_zurueck_XIX_SAM
    delegate Grundumfang_XIX_SAM.RP_IF_SPR_BFS_PopUp_Request_XIX_Grundumfang_XIX_SAM <-> outer port RP_IF_SPR_BFS_PopUp_Request_XIX_SAM
    delegate Grundumfang_XIX_SAM.RP_IF_SPR_BFS_ResponseError_XIX_Grundumfang_XIX_SAM <-> outer port RP_IF_SPR_BFS_ResponseError_XIX_SAM
    delegate Grundumfang_XIX_SAM.RP_IF_SPR_BFS_SG_defekt_XIX_Grundumfang_XIX_SAM <-> outer port RP_IF_SPR_BFS_SG_defekt_XIX_SAM
    delegate Grundumfang_XIX_SAM.RP_IF_SPR_BFS_SWL_vor_XIX_Grundumfang_XIX_SAM <-> outer port RP_IF_SPR_BFS_SWL_vor_XIX_SAM
    delegate Grundumfang_XIX_SAM.RP_IF_SPR_BFS_SWL_zurueck_XIX_Grundumfang_XIX_SAM <-> outer port RP_IF_SPR_BFS_SWL_zurueck_XIX_SAM
    delegate Grundumfang_XIX_SAM.RP_IF_SPR_BFS_Systemtest_Status_XIX_Grundumfang_XIX_SAM <-> outer port RP_IF_SPR_BFS_Systemtest_Status_XIX_SAM
    delegate Grundumfang_XIX_SAM.RP_IF_SPR_BFS_Tasterfehler_Massage_XIX_Grundumfang_XIX_SAM <-> outer port RP_IF_SPR_BFS_Tasterfehler_Massage_XIX_SAM
    delegate Grundumfang_XIX_SAM.RP_IF_SPR_BFS_Tasterfehler_Mufu_auf_ab_XIX_Grundumfang_XIX_SAM <-> outer port RP_IF_SPR_BFS_Tasterfehler_Mufu_auf_ab_XIX_SAM
    delegate Grundumfang_XIX_SAM.RP_IF_SPR_BFS_Tasterfehler_Mufu_Ring_XIX_Grundumfang_XIX_SAM <-> outer port RP_IF_SPR_BFS_Tasterfehler_Mufu_Ring_XIX_SAM
    delegate Grundumfang_XIX_SAM.RP_IF_SPR_BFS_Tasterfehler_Mufu_v_z_XIX_Grundumfang_XIX_SAM <-> outer port RP_IF_SPR_BFS_Tasterfehler_Mufu_v_z_XIX_SAM
    delegate Druckpunktmassage_fuer_Beifahrersitz_Lehnenmassage_SAM_XIX_DPMBFSLM_XIX_SAM.RP_IF_SPR_BFS_Teller_inv_XIX_Druckpunktmassage_fuer_Beifahrersitz_Lehnenmassage_SAM_XIX_DPMBFSLM_XIX_SAM <-> outer port RP_IF_SPR_BFS_Teller_inv_XIX_SAM  # _XIX_Grundumfang_XIX_SPR_BFS_XIX_Druckpunktmassage_fuer_Beifahrersitz_Lehnenmassage_SAM_XIX_DPMBFSLM_XIX_SAM_XIX_SPR_BFS_Teller_inv
    delegate Grundumfang_XIX_SAM.RP_IF_SPR_BFS_Ueberspannung_XIX_Grundumfang_XIX_SAM <-> outer port RP_IF_SPR_BFS_Ueberspannung_XIX_SAM
    delegate Grundumfang_XIX_SAM.RP_IF_SPR_BFS_Unterspannung_XIX_Grundumfang_XIX_SAM <-> outer port RP_IF_SPR_BFS_Unterspannung_XIX_SAM
    delegate Druckpunktmassage_fuer_Beifahrersitz_Lehnenmassage_SAM_XIX_DPMBFSLM_XIX_SAM.RP_IF_SPR_BFS_Verstellung_aktiv_XIX_Druckpunktmassage_fuer_Beifahrersitz_Lehnenmassage_SAM_XIX_DPMBFSLM_XIX_SAM <-> outer port RP_IF_SPR_BFS_Verstellung_aktiv_XIX_SAM  # _XIX_Grundumfang_XIX_SPR_BFS_XIX_Druckpunktmassage_fuer_Beifahrersitz_Lehnenmassage_SAM_XIX_DPMBFSLM_XIX_SAM_XIX_SPR_BFS_Verstellung_aktiv
    delegate Grundumfang_XIX_SAM.RP_IF_SPR_BFS_Verstellung_aktiv_XIX_Grundumfang_XIX_SAM <-> outer port RP_IF_SPR_BFS_Verstellung_aktiv_XIX_SAM
    delegate Druckpunktmassage_fuer_Beifahrersitz_Lehnenmassage_SAM_XIX_DPMBFSLM_XIX_SAM.RP_IF_SPR_BFS_Wellness_Status_XIX_Druckpunktmassage_fuer_Beifahrersitz_Lehnenmassage_SAM_XIX_DPMBFSLM_XIX_SAM <-> outer port RP_IF_SPR_BFS_Wellness_Status_XIX_SAM  # _XIX_Grundumfang_XIX_SPR_BFS_XIX_Druckpunktmassage_fuer_Beifahrersitz_Lehnenmassage_SAM_XIX_DPMBFSLM_XIX_SAM_XIX_SPR_BFS_Wellness_Status
    delegate Druckpunktmassage_fuer_Beifahrersitz_Lehnenmassage_SAM_XIX_DPMBFSLM_XIX_SAM.RP_IF_SPR_BFS_Wippe_inv_XIX_Druckpunktmassage_fuer_Beifahrersitz_Lehnenmassage_SAM_XIX_DPMBFSLM_XIX_SAM <-> outer port RP_IF_SPR_BFS_Wippe_inv_XIX_SAM  # _XIX_Grundumfang_XIX_SPR_BFS_XIX_Druckpunktmassage_fuer_Beifahrersitz_Lehnenmassage_SAM_XIX_DPMBFSLM_XIX_SAM_XIX_SPR_BFS_Wippe_inv
    delegate Grundumfang_XIX_SAM.RP_IF_SPR_FS_CodierPinError_XIX_Grundumfang_XIX_SAM <-> outer port RP_IF_SPR_FS_CodierPinError_XIX_SAM
    delegate Grundumfang_XIX_SAM.RP_IF_SPR_FS_Kompressor_elFehler_XIX_Grundumfang_XIX_SAM <-> outer port RP_IF_SPR_FS_Kompressor_elFehler_XIX_SAM
    delegate Grundumfang_XIX_SAM.RP_IF_SPR_FS_Leck_erkannt_XIX_Grundumfang_XIX_SAM <-> outer port RP_IF_SPR_FS_Leck_erkannt_XIX_SAM
    delegate Grundumfang_XIX_SAM.RP_IF_SPR_FS_Lokal_aktiv_XIX_Grundumfang_XIX_SAM <-> outer port RP_IF_SPR_FS_Lokal_aktiv_XIX_SAM
    delegate Grundumfang_XIX_SAM.RP_IF_SPR_FS_Lordose_hoch_XIX_Grundumfang_XIX_SAM <-> outer port RP_IF_SPR_FS_Lordose_hoch_XIX_SAM
    delegate Grundumfang_XIX_SAM.RP_IF_SPR_FS_Lordose_runter_XIX_Grundumfang_XIX_SAM <-> outer port RP_IF_SPR_FS_Lordose_runter_XIX_SAM
    delegate Grundumfang_XIX_SAM.RP_IF_SPR_FS_Lordose_vor_XIX_Grundumfang_XIX_SAM <-> outer port RP_IF_SPR_FS_Lordose_vor_XIX_SAM
    delegate Grundumfang_XIX_SAM.RP_IF_SPR_FS_Lordose_zurueck_XIX_Grundumfang_XIX_SAM <-> outer port RP_IF_SPR_FS_Lordose_zurueck_XIX_SAM
    delegate Druckpunktmassage_fuer_Fahrersitz_Lehnenmassage_SAM_XIX_DPMFSLM_XIX_SAM.RP_IF_SPR_FS_Massage_Dauer_XIX_Druckpunktmassage_fuer_Fahrersitz_Lehnenmassage_SAM_XIX_DPMFSLM_XIX_SAM <-> outer port RP_IF_SPR_FS_Massage_Dauer_XIX_SAM
    delegate Grundumfang_XIX_SAM.RP_IF_SPR_FS_Massage_Int_XIX_Grundumfang_XIX_SAM <-> outer port RP_IF_SPR_FS_Massage_Int_XIX_SAM
    delegate Druckpunktmassage_fuer_Fahrersitz_Lehnenmassage_SAM_XIX_DPMFSLM_XIX_SAM.RP_IF_SPR_FS_Massage_Intens_Lehne_XIX_Druckpunktmassage_fuer_Fahrersitz_Lehnenmassage_SAM_XIX_DPMFSLM_XIX_SAM <-> outer port RP_IF_SPR_FS_Massage_Intens_Lehne_XIX_SAM  # _XIX_Grundumfang_XIX_SPR_FS_XIX_Druckpunktmassage_fuer_Fahrersitz_Lehnenmassage_SAM_XIX_DPMFSLM_XIX_SAM_XIX_SPR_FS_Massage_Intens_Lehne
    delegate Druckpunktmassage_fuer_Fahrersitz_Lehnenmassage_SAM_XIX_DPMFSLM_XIX_SAM.RP_IF_SPR_FS_Massage_Intens_Sitz_XIX_Druckpunktmassage_fuer_Fahrersitz_Lehnenmassage_SAM_XIX_DPMFSLM_XIX_SAM <-> outer port RP_IF_SPR_FS_Massage_Intens_Sitz_XIX_SAM  # _XIX_Grundumfang_XIX_SPR_FS_XIX_Druckpunktmassage_fuer_Fahrersitz_Lehnenmassage_SAM_XIX_DPMFSLM_XIX_SAM_XIX_SPR_FS_Massage_Intens_Sitz
    delegate Druckpunktmassage_fuer_Fahrersitz_Lehnenmassage_SAM_XIX_DPMFSLM_XIX_SAM.RP_IF_SPR_FS_Massage_Prg_erweitert_XIX_Druckpunktmassage_fuer_Fahrersitz_Lehnenmassage_SAM_XIX_DPMFSLM_XIX_SAM <-> outer port RP_IF_SPR_FS_Massage_Prg_erweitert_XIX_SAM  # _XIX_Grundumfang_XIX_SPR_FS_XIX_Druckpunktmassage_fuer_Fahrersitz_Lehnenmassage_SAM_XIX_DPMFSLM_XIX_SAM_XIX_SPR_FS_Massage_Prg_erweitert
    delegate Grundumfang_XIX_SAM.RP_IF_SPR_FS_Massage_Prg_XIX_Grundumfang_XIX_SAM <-> outer port RP_IF_SPR_FS_Massage_Prg_XIX_SAM
    delegate Grundumfang_XIX_SAM.RP_IF_SPR_FS_MassageStatus_XIX_Grundumfang_XIX_SAM <-> outer port RP_IF_SPR_FS_MassageStatus_XIX_SAM
    delegate Druckpunktmassage_fuer_Fahrersitz_Lehnenmassage_SAM_XIX_DPMFSLM_XIX_SAM.RP_IF_SPR_FS_Massagetaster_inv_XIX_Druckpunktmassage_fuer_Fahrersitz_Lehnenmassage_SAM_XIX_DPMFSLM_XIX_SAM <-> outer port RP_IF_SPR_FS_Massagetaster_inv_XIX_SAM  # _XIX_Grundumfang_XIX_SPR_FS_XIX_Druckpunktmassage_fuer_Fahrersitz_Lehnenmassage_SAM_XIX_DPMFSLM_XIX_SAM_XIX_SPR_FS_Massagetaster_inv
    delegate Grundumfang_XIX_SAM.RP_IF_SPR_FS_MuFu_Fkt_vor_XIX_Grundumfang_XIX_SAM <-> outer port RP_IF_SPR_FS_MuFu_Fkt_vor_XIX_SAM
    delegate Grundumfang_XIX_SAM.RP_IF_SPR_FS_MuFu_Fkt_zurueck_XIX_Grundumfang_XIX_SAM <-> outer port RP_IF_SPR_FS_MuFu_Fkt_zurueck_XIX_SAM
    delegate Grundumfang_XIX_SAM.RP_IF_SPR_FS_PopUp_Request_XIX_Grundumfang_XIX_SAM <-> outer port RP_IF_SPR_FS_PopUp_Request_XIX_SAM
    delegate Grundumfang_XIX_SAM.RP_IF_SPR_FS_ResponseError_XIX_Grundumfang_XIX_SAM <-> outer port RP_IF_SPR_FS_ResponseError_XIX_SAM
    delegate Grundumfang_XIX_SAM.RP_IF_SPR_FS_SG_defekt_XIX_Grundumfang_XIX_SAM <-> outer port RP_IF_SPR_FS_SG_defekt_XIX_SAM
    delegate Grundumfang_XIX_SAM.RP_IF_SPR_FS_SWL_vor_XIX_Grundumfang_XIX_SAM <-> outer port RP_IF_SPR_FS_SWL_vor_XIX_SAM
    delegate Grundumfang_XIX_SAM.RP_IF_SPR_FS_SWL_zurueck_XIX_Grundumfang_XIX_SAM <-> outer port RP_IF_SPR_FS_SWL_zurueck_XIX_SAM
    delegate Grundumfang_XIX_SAM.RP_IF_SPR_FS_Systemtest_Status_XIX_Grundumfang_XIX_SAM <-> outer port RP_IF_SPR_FS_Systemtest_Status_XIX_SAM
    delegate Grundumfang_XIX_SAM.RP_IF_SPR_FS_Tasterfehler_Massage_XIX_Grundumfang_XIX_SAM <-> outer port RP_IF_SPR_FS_Tasterfehler_Massage_XIX_SAM
    delegate Grundumfang_XIX_SAM.RP_IF_SPR_FS_Tasterfehler_Mufu_auf_ab_XIX_Grundumfang_XIX_SAM <-> outer port RP_IF_SPR_FS_Tasterfehler_Mufu_auf_ab_XIX_SAM
    delegate Grundumfang_XIX_SAM.RP_IF_SPR_FS_Tasterfehler_Mufu_Ring_XIX_Grundumfang_XIX_SAM <-> outer port RP_IF_SPR_FS_Tasterfehler_Mufu_Ring_XIX_SAM
    delegate Grundumfang_XIX_SAM.RP_IF_SPR_FS_Tasterfehler_Mufu_v_z_XIX_Grundumfang_XIX_SAM <-> outer port RP_IF_SPR_FS_Tasterfehler_Mufu_v_z_XIX_SAM
    delegate Druckpunktmassage_fuer_Fahrersitz_Lehnenmassage_SAM_XIX_DPMFSLM_XIX_SAM.RP_IF_SPR_FS_Teller_inv_XIX_Druckpunktmassage_fuer_Fahrersitz_Lehnenmassage_SAM_XIX_DPMFSLM_XIX_SAM <-> outer port RP_IF_SPR_FS_Teller_inv_XIX_SAM
    delegate Grundumfang_XIX_SAM.RP_IF_SPR_FS_Ueberspannung_XIX_Grundumfang_XIX_SAM <-> outer port RP_IF_SPR_FS_Ueberspannung_XIX_SAM
    delegate Grundumfang_XIX_SAM.RP_IF_SPR_FS_Unterspannung_XIX_Grundumfang_XIX_SAM <-> outer port RP_IF_SPR_FS_Unterspannung_XIX_SAM
    delegate Druckpunktmassage_fuer_Fahrersitz_Lehnenmassage_SAM_XIX_DPMFSLM_XIX_SAM.RP_IF_SPR_FS_Verstellung_aktiv_XIX_Druckpunktmassage_fuer_Fahrersitz_Lehnenmassage_SAM_XIX_DPMFSLM_XIX_SAM <-> outer port RP_IF_SPR_FS_Verstellung_aktiv_XIX_SAM  # _XIX_Grundumfang_XIX_SPR_FS_XIX_Druckpunktmassage_fuer_Fahrersitz_Lehnenmassage_SAM_XIX_DPMFSLM_XIX_SAM_XIX_SPR_FS_Verstellung_aktiv
    delegate Grundumfang_XIX_SAM.RP_IF_SPR_FS_Verstellung_aktiv_XIX_Grundumfang_XIX_SAM <-> outer port RP_IF_SPR_FS_Verstellung_aktiv_XIX_SAM
    delegate Druckpunktmassage_fuer_Fahrersitz_Lehnenmassage_SAM_XIX_DPMFSLM_XIX_SAM.RP_IF_SPR_FS_Wellness_Status_XIX_Druckpunktmassage_fuer_Fahrersitz_Lehnenmassage_SAM_XIX_DPMFSLM_XIX_SAM <-> outer port RP_IF_SPR_FS_Wellness_Status_XIX_SAM  # _XIX_Grundumfang_XIX_SPR_FS_XIX_Druckpunktmassage_fuer_Fahrersitz_Lehnenmassage_SAM_XIX_DPMFSLM_XIX_SAM_XIX_SPR_FS_Wellness_Status
    delegate Druckpunktmassage_fuer_Fahrersitz_Lehnenmassage_SAM_XIX_DPMFSLM_XIX_SAM.RP_IF_SPR_FS_Wippe_inv_XIX_Druckpunktmassage_fuer_Fahrersitz_Lehnenmassage_SAM_XIX_DPMFSLM_XIX_SAM <-> outer port RP_IF_SPR_FS_Wippe_inv_XIX_SAM
    delegate Grundumfang_XIX_SAM.RP_IF_SRL1_ORUData_XIX_Grundumfang_XIX_SAM <-> outer port RP_IF_SRL1_ORUData_XIX_SAM
    delegate Grundumfang_XIX_SAM.RP_IF_SRL1_ORUDataIndex_XIX_Grundumfang_XIX_SAM <-> outer port RP_IF_SRL1_ORUDataIndex_XIX_SAM
    delegate Grundumfang_XIX_SAM.RP_IF_SRL2_ORUData_XIX_Grundumfang_XIX_SAM <-> outer port RP_IF_SRL2_ORUData_XIX_SAM
    delegate Grundumfang_XIX_SAM.RP_IF_SRL2_ORUDataIndex_XIX_Grundumfang_XIX_SAM <-> outer port RP_IF_SRL2_ORUDataIndex_XIX_SAM
    delegate Grundumfang_XIX_SAM.RP_IF_SRL3_ORUData_XIX_Grundumfang_XIX_SAM <-> outer port RP_IF_SRL3_ORUData_XIX_SAM
    delegate Grundumfang_XIX_SAM.RP_IF_SRL3_ORUDataIndex_XIX_Grundumfang_XIX_SAM <-> outer port RP_IF_SRL3_ORUDataIndex_XIX_SAM
    delegate Grundumfang_XIX_SAM.RP_IF_SRL4_ORUData_XIX_Grundumfang_XIX_SAM <-> outer port RP_IF_SRL4_ORUData_XIX_SAM
    delegate Grundumfang_XIX_SAM.RP_IF_SRL4_ORUDataIndex_XIX_Grundumfang_XIX_SAM <-> outer port RP_IF_SRL4_ORUDataIndex_XIX_SAM
    delegate Grundumfang_XIX_SAM.RP_IF_SRL5_ORUData_XIX_Grundumfang_XIX_SAM <-> outer port RP_IF_SRL5_ORUData_XIX_SAM
    delegate Grundumfang_XIX_SAM.RP_IF_SRL5_ORUDataIndex_XIX_Grundumfang_XIX_SAM <-> outer port RP_IF_SRL5_ORUDataIndex_XIX_SAM
    delegate Grundumfang_XIX_SAM.RP_IF_SRL6_ORUData_XIX_Grundumfang_XIX_SAM <-> outer port RP_IF_SRL6_ORUData_XIX_SAM
    delegate Grundumfang_XIX_SAM.RP_IF_SRL6_ORUDataIndex_XIX_Grundumfang_XIX_SAM <-> outer port RP_IF_SRL6_ORUDataIndex_XIX_SAM
    delegate Grundumfang_XIX_SAM.RP_IF_SRL_HL_01_BZ_XIX_Grundumfang_XIX_SAM <-> outer port RP_IF_SRL_HL_01_BZ_XIX_SAM
    delegate Grundumfang_XIX_SAM.RP_IF_SRL_HL_01_CRC_XIX_Grundumfang_XIX_SAM <-> outer port RP_IF_SRL_HL_01_CRC_XIX_SAM
    delegate Grundumfang_XIX_SAM.RP_IF_SRL_HR_01_BZ_XIX_Grundumfang_XIX_SAM <-> outer port RP_IF_SRL_HR_01_BZ_XIX_SAM
    delegate Grundumfang_XIX_SAM.RP_IF_SRL_HR_01_CRC_XIX_Grundumfang_XIX_SAM <-> outer port RP_IF_SRL_HR_01_CRC_XIX_SAM
    delegate Grundumfang_XIX_SAM.RP_IF_SRL_SL_01_BZ_XIX_Grundumfang_XIX_SAM <-> outer port RP_IF_SRL_SL_01_BZ_XIX_SAM
    delegate Grundumfang_XIX_SAM.RP_IF_SRL_SL_01_CRC_XIX_Grundumfang_XIX_SAM <-> outer port RP_IF_SRL_SL_01_CRC_XIX_SAM
    delegate Grundumfang_XIX_SAM.RP_IF_SRL_SR_01_BZ_XIX_Grundumfang_XIX_SAM <-> outer port RP_IF_SRL_SR_01_BZ_XIX_SAM
    delegate Grundumfang_XIX_SAM.RP_IF_SRL_SR_01_CRC_XIX_Grundumfang_XIX_SAM <-> outer port RP_IF_SRL_SR_01_CRC_XIX_SAM
    delegate Grundumfang_XIX_SAM.RP_IF_SRL_VL_01_BZ_XIX_Grundumfang_XIX_SAM <-> outer port RP_IF_SRL_VL_01_BZ_XIX_SAM
    delegate Grundumfang_XIX_SAM.RP_IF_SRL_VL_01_CRC_XIX_Grundumfang_XIX_SAM <-> outer port RP_IF_SRL_VL_01_CRC_XIX_SAM
    delegate Grundumfang_XIX_SAM.RP_IF_SRL_VR_01_BZ_XIX_Grundumfang_XIX_SAM <-> outer port RP_IF_SRL_VR_01_BZ_XIX_SAM
    delegate Grundumfang_XIX_SAM.RP_IF_SRL_VR_01_CRC_XIX_Grundumfang_XIX_SAM <-> outer port RP_IF_SRL_VR_01_CRC_XIX_SAM
    delegate Grundumfang_XIX_SAM.RP_IF_STSG_HBFS_AD_oeffnen_Anf_XIX_Grundumfang_XIX_SAM <-> outer port RP_IF_STSG_HBFS_AD_oeffnen_Anf_XIX_SAM
    delegate Grundumfang_XIX_SAM.RP_IF_STSG_HBFS_Bew_auf_XIX_Grundumfang_XIX_SAM <-> outer port RP_IF_STSG_HBFS_Bew_auf_XIX_SAM
    delegate Grundumfang_XIX_SAM.RP_IF_STSG_HBFS_Bew_zu_XIX_Grundumfang_XIX_SAM <-> outer port RP_IF_STSG_HBFS_Bew_zu_XIX_SAM
    delegate ZV_XIX_SAM.RP_IF_STSG_HBFS_BTF_XIX_ZV_XIX_SAM <-> outer port RP_IF_STSG_HBFS_BTF_XIX_SAM
    delegate ZV_XIX_SAM.RP_IF_STSG_HBFS_entriegeln_anfordern_XIX_ZV_XIX_SAM <-> outer port RP_IF_STSG_HBFS_entriegeln_anfordern_XIX_SAM
    delegate Grundumfang_XIX_SAM.RP_IF_STSG_HBFS_LKKS_Bereich_XIX_Grundumfang_XIX_SAM <-> outer port RP_IF_STSG_HBFS_LKKS_Bereich_XIX_SAM
    delegate Grundumfang_XIX_SAM.RP_IF_STSG_HBFS_ORUData_XIX_Grundumfang_XIX_SAM <-> outer port RP_IF_STSG_HBFS_ORUData_XIX_SAM
    delegate Grundumfang_XIX_SAM.RP_IF_STSG_HBFS_ORUDataIndex_XIX_Grundumfang_XIX_SAM <-> outer port RP_IF_STSG_HBFS_ORUDataIndex_XIX_SAM
    delegate Grundumfang_XIX_SAM.RP_IF_STSG_HBFS_ST_deaktivieren_XIX_Grundumfang_XIX_SAM <-> outer port RP_IF_STSG_HBFS_ST_deaktivieren_XIX_SAM
    delegate ZV_XIX_SAM.RP_IF_STSG_HBFS_TAT_XIX_ZV_XIX_SAM <-> outer port RP_IF_STSG_HBFS_TAT_XIX_SAM
    delegate Grundumfang_XIX_SAM.RP_IF_STSG_HFS_AD_oeffnen_Anf_XIX_Grundumfang_XIX_SAM <-> outer port RP_IF_STSG_HFS_AD_oeffnen_Anf_XIX_SAM
    delegate Grundumfang_XIX_SAM.RP_IF_STSG_HFS_Bew_auf_XIX_Grundumfang_XIX_SAM <-> outer port RP_IF_STSG_HFS_Bew_auf_XIX_SAM
    delegate Grundumfang_XIX_SAM.RP_IF_STSG_HFS_Bew_zu_XIX_Grundumfang_XIX_SAM <-> outer port RP_IF_STSG_HFS_Bew_zu_XIX_SAM
    delegate ZV_XIX_SAM.RP_IF_STSG_HFS_BTF_XIX_ZV_XIX_SAM <-> outer port RP_IF_STSG_HFS_BTF_XIX_SAM
    delegate ZV_XIX_SAM.RP_IF_STSG_HFS_entriegeln_anforderen_XIX_ZV_XIX_SAM <-> outer port RP_IF_STSG_HFS_entriegeln_anforderen_XIX_SAM
    delegate Grundumfang_XIX_SAM.RP_IF_STSG_HFS_LKKS_Bereich_XIX_Grundumfang_XIX_SAM <-> outer port RP_IF_STSG_HFS_LKKS_Bereich_XIX_SAM
    delegate Grundumfang_XIX_SAM.RP_IF_STSG_HFS_ORUData_XIX_Grundumfang_XIX_SAM <-> outer port RP_IF_STSG_HFS_ORUData_XIX_SAM
    delegate Grundumfang_XIX_SAM.RP_IF_STSG_HFS_ORUDataIndex_XIX_Grundumfang_XIX_SAM <-> outer port RP_IF_STSG_HFS_ORUDataIndex_XIX_SAM
    delegate Grundumfang_XIX_SAM.RP_IF_STSG_HFS_ST_deaktivieren_XIX_Grundumfang_XIX_SAM <-> outer port RP_IF_STSG_HFS_ST_deaktivieren_XIX_SAM
    delegate ZV_XIX_SAM.RP_IF_STSG_HFS_TAT_XIX_ZV_XIX_SAM <-> outer port RP_IF_STSG_HFS_TAT_XIX_SAM
    delegate Grundumfang_XIX_SAM.RP_IF_TSG_BFS_ORUData_XIX_Grundumfang_XIX_SAM <-> outer port RP_IF_TSG_BFS_ORUData_XIX_SAM
    delegate Grundumfang_XIX_SAM.RP_IF_TSG_BFS_ORUDataIndex_XIX_Grundumfang_XIX_SAM <-> outer port RP_IF_TSG_BFS_ORUDataIndex_XIX_SAM
    delegate Grundumfang_XIX_SAM.RP_IF_TSG_FS_ORUData_XIX_Grundumfang_XIX_SAM <-> outer port RP_IF_TSG_FS_ORUData_XIX_SAM
    delegate Grundumfang_XIX_SAM.RP_IF_TSG_FS_ORUDataIndex_XIX_Grundumfang_XIX_SAM <-> outer port RP_IF_TSG_FS_ORUDataIndex_XIX_SAM
    delegate ZV_XIX_SAM.RP_IF_TSG_FT_02_BZ_XIX_ZV_XIX_SAM <-> outer port RP_IF_TSG_FT_02_BZ_XIX_SAM
    delegate ZV_XIX_SAM.RP_IF_TSG_FT_02_CRC_XIX_ZV_XIX_SAM <-> outer port RP_IF_TSG_FT_02_CRC_XIX_SAM
    delegate Grundumfang_XIX_SAM.RP_IF_TSG_HBFS_ORUData_XIX_Grundumfang_XIX_SAM <-> outer port RP_IF_TSG_HBFS_ORUData_XIX_SAM
    delegate Grundumfang_XIX_SAM.RP_IF_TSG_HBFS_ORUDataIndex_XIX_Grundumfang_XIX_SAM <-> outer port RP_IF_TSG_HBFS_ORUDataIndex_XIX_SAM
    delegate Grundumfang_XIX_SAM.RP_IF_TSG_HFS_ORUData_XIX_Grundumfang_XIX_SAM <-> outer port RP_IF_TSG_HFS_ORUData_XIX_SAM
    delegate Grundumfang_XIX_SAM.RP_IF_TSG_HFS_ORUDataIndex_XIX_Grundumfang_XIX_SAM <-> outer port RP_IF_TSG_HFS_ORUDataIndex_XIX_SAM
    delegate Grundumfang_XIX_SAM.RP_IF_Tuerkontakt_Innenlicht_Taste_XIX_Grundumfang_XIX_SAM <-> outer port RP_IF_Tuerkontakt_Innenlicht_Taste_XIX_SAM
    delegate Grundumfang_XIX_SAM.RP_IF_UGDO_Failure_Antenne_XIX_Grundumfang_XIX_SAM <-> outer port RP_IF_UGDO_Failure_Antenne_XIX_SAM
    delegate Grundumfang_XIX_SAM.RP_IF_UGDO_Failure_Codierung_XIX_Grundumfang_XIX_SAM <-> outer port RP_IF_UGDO_Failure_Codierung_XIX_SAM
    delegate Grundumfang_XIX_SAM.RP_IF_UGDO_Failure_Hardware_XIX_Grundumfang_XIX_SAM <-> outer port RP_IF_UGDO_Failure_Hardware_XIX_SAM
    delegate Grundumfang_XIX_SAM.RP_IF_UGDO_Function_01_XIX_Grundumfang_XIX_SAM <-> outer port RP_IF_UGDO_Function_01_XIX_SAM
    delegate Grundumfang_XIX_SAM.RP_IF_UGDO_LED_Code_01_XIX_Grundumfang_XIX_SAM <-> outer port RP_IF_UGDO_LED_Code_01_XIX_SAM
    delegate Grundumfang_XIX_SAM.RP_IF_UGDO_ResponseError_XIX_Grundumfang_XIX_SAM <-> outer port RP_IF_UGDO_ResponseError_XIX_SAM
    delegate Grundumfang_XIX_SAM.RP_IF_UH_Jahr_XIX_Grundumfang_XIX_SAM <-> outer port RP_IF_UH_Jahr_XIX_SAM
    delegate Grundumfang_XIX_SAM.RP_IF_UH_Minute_XIX_Grundumfang_XIX_SAM <-> outer port RP_IF_UH_Minute_XIX_SAM
    delegate Grundumfang_XIX_SAM.RP_IF_UH_Monat_XIX_Grundumfang_XIX_SAM <-> outer port RP_IF_UH_Monat_XIX_SAM
    delegate Grundumfang_XIX_SAM.RP_IF_UH_Sekunde_XIX_Grundumfang_XIX_SAM <-> outer port RP_IF_UH_Sekunde_XIX_SAM
    delegate Grundumfang_XIX_SAM.RP_IF_UH_Stunde_XIX_Grundumfang_XIX_SAM <-> outer port RP_IF_UH_Stunde_XIX_SAM
    delegate Grundumfang_XIX_SAM.RP_IF_UH_Tag_XIX_Grundumfang_XIX_SAM <-> outer port RP_IF_UH_Tag_XIX_SAM
    delegate Grundumfang_XIX_SAM.RP_IF_UHF_01_Data_XIX_Grundumfang_XIX_SAM <-> outer port RP_IF_UHF_01_Data_XIX_SAM
    delegate Grundumfang_XIX_SAM.RP_IF_UHF_01_Datenlaenge_XIX_Grundumfang_XIX_SAM <-> outer port RP_IF_UHF_01_Datenlaenge_XIX_SAM
    delegate Grundumfang_XIX_SAM.RP_IF_UHF_01_Status_XIX_Grundumfang_XIX_SAM <-> outer port RP_IF_UHF_01_Status_XIX_SAM
    delegate Grundumfang_XIX_SAM.RP_IF_UHF_01_Typ_XIX_Grundumfang_XIX_SAM <-> outer port RP_IF_UHF_01_Typ_XIX_SAM
    delegate Grundumfang_XIX_SAM.RP_IF_UHF_01_Zaehler_XIX_Grundumfang_XIX_SAM <-> outer port RP_IF_UHF_01_Zaehler_XIX_SAM
    delegate Grundumfang_XIX_SAM.RP_IF_UHF_02_Data_XIX_Grundumfang_XIX_SAM <-> outer port RP_IF_UHF_02_Data_XIX_SAM
    delegate Grundumfang_XIX_SAM.RP_IF_UHF_02_Zaehler_XIX_Grundumfang_XIX_SAM <-> outer port RP_IF_UHF_02_Zaehler_XIX_SAM
    delegate Grundumfang_XIX_SAM.RP_IF_UHF_03_Data_XIX_Grundumfang_XIX_SAM <-> outer port RP_IF_UHF_03_Data_XIX_SAM
    delegate Grundumfang_XIX_SAM.RP_IF_UHF_03_Zaehler_XIX_Grundumfang_XIX_SAM <-> outer port RP_IF_UHF_03_Zaehler_XIX_SAM
    delegate Grundumfang_XIX_SAM.RP_IF_UHF_04_Data_XIX_Grundumfang_XIX_SAM <-> outer port RP_IF_UHF_04_Data_XIX_SAM
    delegate Grundumfang_XIX_SAM.RP_IF_UHF_04_Zaehler_XIX_Grundumfang_XIX_SAM <-> outer port RP_IF_UHF_04_Zaehler_XIX_SAM
    delegate Grundumfang_XIX_SAM.RP_IF_UHF_05_Data_XIX_Grundumfang_XIX_SAM <-> outer port RP_IF_UHF_05_Data_XIX_SAM
    delegate Grundumfang_XIX_SAM.RP_IF_UHF_05_Zaehler_XIX_Grundumfang_XIX_SAM <-> outer port RP_IF_UHF_05_Zaehler_XIX_SAM
    delegate Grundumfang_XIX_SAM.RP_IF_UHF_06_Data_XIX_Grundumfang_XIX_SAM <-> outer port RP_IF_UHF_06_Data_XIX_SAM
    delegate Grundumfang_XIX_SAM.RP_IF_UHF_06_Zaehler_XIX_Grundumfang_XIX_SAM <-> outer port RP_IF_UHF_06_Zaehler_XIX_SAM
    delegate Grundumfang_XIX_SAM.RP_IF_UHF_07_Data_XIX_Grundumfang_XIX_SAM <-> outer port RP_IF_UHF_07_Data_XIX_SAM
    delegate Grundumfang_XIX_SAM.RP_IF_UHF_07_Zaehler_XIX_Grundumfang_XIX_SAM <-> outer port RP_IF_UHF_07_Zaehler_XIX_SAM
    delegate Grundumfang_XIX_SAM.RP_IF_UHF_08_Data_XIX_Grundumfang_XIX_SAM <-> outer port RP_IF_UHF_08_Data_XIX_SAM
    delegate Grundumfang_XIX_SAM.RP_IF_UHF_08_Zaehler_XIX_Grundumfang_XIX_SAM <-> outer port RP_IF_UHF_08_Zaehler_XIX_SAM
    delegate Grundumfang_XIX_SAM.RP_IF_UHF_FFB_Funkschluesseltyp_XIX_Grundumfang_XIX_SAM <-> outer port RP_IF_UHF_FFB_Funkschluesseltyp_XIX_SAM
    delegate Grundumfang_XIX_SAM.RP_IF_UHF_FFB_SKC_anlernen_XIX_Grundumfang_XIX_SAM <-> outer port RP_IF_UHF_FFB_SKC_anlernen_XIX_SAM
    delegate Grundumfang_XIX_SAM.RP_IF_UHF_Konfig_Auswahl_Kanal_XIX_Grundumfang_XIX_SAM <-> outer port RP_IF_UHF_Konfig_Auswahl_Kanal_XIX_SAM
    delegate Grundumfang_XIX_SAM.RP_IF_UHF_Konfig_Auswahl_Kessymodus_XIX_Grundumfang_XIX_SAM <-> outer port RP_IF_UHF_Konfig_Auswahl_Kessymodus_XIX_SAM
    delegate Grundumfang_XIX_SAM.RP_IF_UHF_Konfig_Auswahl_naechst_Kanal_XIX_Grundumfang_XIX_SAM <-> outer port RP_IF_UHF_Konfig_Auswahl_naechst_Kanal_XIX_SAM
    delegate Grundumfang_XIX_SAM.RP_IF_UHF_Konfig_FFB_Freigabe_XIX_Grundumfang_XIX_SAM <-> outer port RP_IF_UHF_Konfig_FFB_Freigabe_XIX_SAM
    delegate Grundumfang_XIX_SAM.RP_IF_UHF_Konfig_Kanal_Umschaltzeit_XIX_Grundumfang_XIX_SAM <-> outer port RP_IF_UHF_Konfig_Kanal_Umschaltzeit_XIX_SAM
    delegate Grundumfang_XIX_SAM.RP_IF_UHF_Konfig_Praeambellaenge_XIX_Grundumfang_XIX_SAM <-> outer port RP_IF_UHF_Konfig_Praeambellaenge_XIX_SAM
    delegate Grundumfang_XIX_SAM.RP_IF_UHF_Konfig_Zaehler_XIX_Grundumfang_XIX_SAM <-> outer port RP_IF_UHF_Konfig_Zaehler_XIX_SAM
    delegate Grundumfang_XIX_SAM.RP_IF_UHF_TranspID_{01..08}_XIX_Grundumfang_XIX_SAM <-> outer port RP_IF_UHF_TranspID_{01..08}_XIX_SAM
    delegate VKMS_XIX_SAM.RP_IF_VIN_01_MUX_XIX_VKMS_XIX_SAM <-> outer port RP_IF_VIN_01_MUX_XIX_SAM
    delegate VKMS_XIX_SAM.RP_IF_VIN_{10..17}_XIX_VKMS_XIX_SAM <-> outer port RP_IF_VIN_{10..17}_XIX_SAM
    delegate VKMS_XIX_SAM.RP_IF_VIN_{1..9}_XIX_VKMS_XIX_SAM <-> outer port RP_IF_VIN_{1..9}_XIX_SAM
    delegate Grundumfang_XIX_SAM.RP_IF_VIP_Sensor_betaetigt_XIX_Grundumfang_XIX_SAM <-> outer port RP_IF_VIP_Sensor_betaetigt_XIX_SAM
    delegate ZV_XIX_SAM.RP_IF_VIP_Sensor_betaetigt_XIX_ZV_XIX_SAM <-> outer port RP_IF_VIP_Sensor_betaetigt_XIX_SAM
    delegate VIP_XIX_SAM.RP_IF_VIP_Sensor_STSG_HBFS_betaetigt_XIX_VIP_XIX_SAM <-> outer port RP_IF_VIP_Sensor_STSG_HBFS_betaetigt_XIX_SAM
    delegate ZV_XIX_SAM.RP_IF_VIP_Sensor_STSG_HBFS_betaetigt_XIX_ZV_XIX_SAM <-> outer port RP_IF_VIP_Sensor_STSG_HBFS_betaetigt_XIX_SAM
    delegate VIP_XIX_SAM.RP_IF_VIP_Sensor_STSG_HFS_betaetigt_XIX_VIP_XIX_SAM <-> outer port RP_IF_VIP_Sensor_STSG_HFS_betaetigt_XIX_SAM
    delegate ZV_XIX_SAM.RP_IF_VIP_Sensor_STSG_HFS_betaetigt_XIX_ZV_XIX_SAM <-> outer port RP_IF_VIP_Sensor_STSG_HFS_betaetigt_XIX_SAM
    delegate Grundumfang_XIX_SAM.RP_IF_VMM_02_BZ_XIX_Grundumfang_XIX_SAM <-> outer port RP_IF_VMM_02_BZ_XIX_SAM
    delegate Grundumfang_XIX_SAM.RP_IF_VMM_02_CRC_XIX_Grundumfang_XIX_SAM <-> outer port RP_IF_VMM_02_CRC_XIX_SAM
    delegate ZV_XIX_SAM.RP_IF_WFS_ID_Geb_autorisiert_in_Kl15_XIX_ZV_XIX_SAM <-> outer port RP_IF_WFS_ID_Geb_autorisiert_in_Kl15_XIX_SAM
    delegate Druckpunktmassage_fuer_Beifahrersitz_Lehnenmassage_SAM_XIX_DPMBFSLM_XIX_SAM.RP_IF_WFS_Schluessel_Fahrberecht_XIX_Druckpunktmassage_fuer_Beifahrersitz_Lehnenmassage_SAM_XIX_DPMBFSLM_XIX_SAM <-> outer port RP_IF_WFS_Schluessel_Fahrberecht_XIX_SAM  # _XIX_SC_21_WFS_XIX_Softwareblock_XIX_ICAS1_X_Gateway_XIX_Druckpunktmassage_fuer_Beifahrersitz_Lehnenmassage_SAM_XIX_DPMBFSLM_XIX_SAM_XIX_WFS_Schluessel_Fahrberecht
    delegate Druckpunktmassage_fuer_Fahrersitz_Lehnenmassage_SAM_XIX_DPMFSLM_XIX_SAM.RP_IF_WFS_Schluessel_Fahrberecht_XIX_Druckpunktmassage_fuer_Fahrersitz_Lehnenmassage_SAM_XIX_DPMFSLM_XIX_SAM <-> outer port RP_IF_WFS_Schluessel_Fahrberecht_XIX_SAM  # _XIX_SC_21_WFS_XIX_Softwareblock_XIX_ICAS1_X_Gateway_XIX_Druckpunktmassage_fuer_Fahrersitz_Lehnenmassage_SAM_XIX_DPMFSLM_XIX_SAM_XIX_WFS_Schluessel_Fahrberecht
    delegate Grundumfang_XIX_SAM.RP_IF_WFS_Schluessel_Fahrberecht_XIX_Grundumfang_XIX_SAM <-> outer port RP_IF_WFS_Schluessel_Fahrberecht_XIX_SAM
    delegate Grundumfang_XIX_SAM.RP_IF_WH_Frontwaschen_XIX_Grundumfang_XIX_SAM <-> outer port RP_IF_WH_Frontwaschen_XIX_SAM
    delegate Grundumfang_XIX_SAM.RP_IF_WH_Heckintervall_XIX_Grundumfang_XIX_SAM <-> outer port RP_IF_WH_Heckintervall_XIX_SAM
    delegate Grundumfang_XIX_SAM.RP_IF_WH_Heckwaschen_XIX_Grundumfang_XIX_SAM <-> outer port RP_IF_WH_Heckwaschen_XIX_SAM
    delegate Grundumfang_XIX_SAM.RP_IF_WH_Intervall_XIX_Grundumfang_XIX_SAM <-> outer port RP_IF_WH_Intervall_XIX_SAM
    delegate Grundumfang_XIX_SAM.RP_IF_WH_Intervallstufen_XIX_Grundumfang_XIX_SAM <-> outer port RP_IF_WH_Intervallstufen_XIX_SAM
    delegate Grundumfang_XIX_SAM.RP_IF_WH_MFA_Fehler_XIX_Grundumfang_XIX_SAM <-> outer port RP_IF_WH_MFA_Fehler_XIX_SAM
    delegate Grundumfang_XIX_SAM.RP_IF_WH_Tipwischen_XIX_Grundumfang_XIX_SAM <-> outer port RP_IF_WH_Tipwischen_XIX_SAM
    delegate Grundumfang_XIX_SAM.RP_IF_WH_Wischer_Fehler_XIX_Grundumfang_XIX_SAM <-> outer port RP_IF_WH_Wischer_Fehler_XIX_SAM
    delegate Grundumfang_XIX_SAM.RP_IF_WH_WischerStufe1_invers_XIX_Grundumfang_XIX_SAM <-> outer port RP_IF_WH_WischerStufe1_invers_XIX_SAM
    delegate Grundumfang_XIX_SAM.RP_IF_WH_WischerStufe1_XIX_Grundumfang_XIX_SAM <-> outer port RP_IF_WH_WischerStufe1_XIX_SAM
    delegate Grundumfang_XIX_SAM.RP_IF_WH_WischerStufe2_invers_XIX_Grundumfang_XIX_SAM <-> outer port RP_IF_WH_WischerStufe2_invers_XIX_SAM
    delegate Grundumfang_XIX_SAM.RP_IF_WH_WischerStufe2_XIX_Grundumfang_XIX_SAM <-> outer port RP_IF_WH_WischerStufe2_XIX_SAM
    delegate Grundumfang_XIX_SAM.RP_IF_Wischer1_Error_XIX_Grundumfang_XIX_SAM <-> outer port RP_IF_Wischer1_Error_XIX_SAM
    delegate Grundumfang_XIX_SAM.RP_IF_Wischer1_ErrorGueltigkeit_XIX_Grundumfang_XIX_SAM <-> outer port RP_IF_Wischer1_ErrorGueltigkeit_XIX_SAM
    delegate Grundumfang_XIX_SAM.RP_IF_Wischer1_Ueberlast_XIX_Grundumfang_XIX_SAM <-> outer port RP_IF_Wischer1_Ueberlast_XIX_SAM
    delegate Grundumfang_XIX_SAM.RP_IF_Wischer2_Error_XIX_Grundumfang_XIX_SAM <-> outer port RP_IF_Wischer2_Error_XIX_SAM
    delegate Grundumfang_XIX_SAM.RP_IF_Wischer2_ErrorGueltigkeit_XIX_Grundumfang_XIX_SAM <-> outer port RP_IF_Wischer2_ErrorGueltigkeit_XIX_SAM
    delegate Grundumfang_XIX_SAM.RP_IF_Wischer2_Ueberlast_XIX_Grundumfang_XIX_SAM <-> outer port RP_IF_Wischer2_Ueberlast_XIX_SAM
    delegate Grundumfang_XIX_SAM.RP_IF_Wischer_aktiv_XIX_Grundumfang_XIX_SAM <-> outer port RP_IF_Wischer_aktiv_XIX_SAM
    delegate Grundumfang_XIX_SAM.RP_IF_Wischer_Parklage_XIX_Grundumfang_XIX_SAM <-> outer port RP_IF_Wischer_Parklage_XIX_SAM
    delegate Grundumfang_XIX_SAM.RP_IF_Wischer_ResponseError_XIX_Grundumfang_XIX_SAM <-> outer port RP_IF_Wischer_ResponseError_XIX_SAM
    delegate Grundumfang_XIX_SAM.RP_IF_Wischer_Servicestellung_XIX_Grundumfang_XIX_SAM <-> outer port RP_IF_Wischer_Servicestellung_XIX_SAM
    delegate Grundumfang_XIX_SAM.RP_IF_Wischer_Wendelage_XIX_Grundumfang_XIX_SAM <-> outer port RP_IF_Wischer_Wendelage_XIX_SAM
    delegate Grundumfang_XIX_SAM.RP_IF_Wischzykluszaehler_XIX_Grundumfang_XIX_SAM <-> outer port RP_IF_Wischzykluszaehler_XIX_SAM
    delegate Grundumfang_XIX_SAM.RP_IF_WWS2_aktiv_XIX_Grundumfang_XIX_SAM <-> outer port RP_IF_WWS2_aktiv_XIX_SAM
    delegate Grundumfang_XIX_SAM.RP_IF_WWS2_Error_XIX_Grundumfang_XIX_SAM <-> outer port RP_IF_WWS2_Error_XIX_SAM
    delegate Grundumfang_XIX_SAM.RP_IF_WWS2_ErrorGueltigkeit_XIX_Grundumfang_XIX_SAM <-> outer port RP_IF_WWS2_ErrorGueltigkeit_XIX_SAM
    delegate Grundumfang_XIX_SAM.RP_IF_WWS2_Parklage_XIX_Grundumfang_XIX_SAM <-> outer port RP_IF_WWS2_Parklage_XIX_SAM
    delegate Grundumfang_XIX_SAM.RP_IF_WWS2_Position_Wischerarm_XIX_Grundumfang_XIX_SAM <-> outer port RP_IF_WWS2_Position_Wischerarm_XIX_SAM
    delegate Grundumfang_XIX_SAM.RP_IF_WWS2_ResponseError_XIX_Grundumfang_XIX_SAM <-> outer port RP_IF_WWS2_ResponseError_XIX_SAM
    delegate Grundumfang_XIX_SAM.RP_IF_WWS2_Servicestellung_XIX_Grundumfang_XIX_SAM <-> outer port RP_IF_WWS2_Servicestellung_XIX_SAM
    delegate Grundumfang_XIX_SAM.RP_IF_WWS2_Ueberlast_XIX_Grundumfang_XIX_SAM <-> outer port RP_IF_WWS2_Ueberlast_XIX_SAM
    delegate Grundumfang_XIX_SAM.RP_IF_WWS2_Wendelage_XIX_Grundumfang_XIX_SAM <-> outer port RP_IF_WWS2_Wendelage_XIX_SAM
    delegate Grundumfang_XIX_SAM.RP_IF_WWS_DebugData_XIX_Grundumfang_XIX_SAM <-> outer port RP_IF_WWS_DebugData_XIX_SAM
    delegate Grundumfang_XIX_SAM.RP_IF_WWS_Position_Wischerarm_XIX_Grundumfang_XIX_SAM <-> outer port RP_IF_WWS_Position_Wischerarm_XIX_SAM
    delegate Grundumfang_XIX_SAM.RP_IF_WWS_Produktionsmodus_Status_XIX_Grundumfang_XIX_SAM <-> outer port RP_IF_WWS_Produktionsmodus_Status_XIX_SAM
    delegate Grundumfang_XIX_SAM.RP_IF_WWS_Wischgeschwindigkeit_XIX_Grundumfang_XIX_SAM <-> outer port RP_IF_WWS_Wischgeschwindigkeit_XIX_SAM
    delegate Grundumfang_XIX_SAM.RP_IF_ZAS_Kl_15_XIX_Grundumfang_XIX_SAM <-> outer port RP_IF_ZAS_Kl_15_XIX_SAM
    delegate SC_708_IuALicht_MEB_XIX_Softwareblock_XIX_SAM.RP_IF_ZAS_Kl_15_XIX_SC_708_IuALicht_MEB_XIX_Softwareblock_XIX_SAM <-> outer port RP_IF_ZAS_Kl_15_XIX_SAM
    delegate Grundumfang_XIX_SAM.RP_IF_ZAS_Kl_S_XIX_Grundumfang_XIX_SAM <-> outer port RP_IF_ZAS_Kl_S_XIX_SAM
    delegate SC_708_IuALicht_MEB_XIX_Softwareblock_XIX_SAM.RP_IF_ZAS_Kl_S_XIX_SC_708_IuALicht_MEB_XIX_Softwareblock_XIX_SAM <-> outer port RP_IF_ZAS_Kl_S_XIX_SAM
    delegate Grundumfang_XIX_SAM.RP_IF_ZFH_HBFS_AutoHoch_XIX_Grundumfang_XIX_SAM <-> outer port RP_IF_ZFH_HBFS_AutoHoch_XIX_SAM
    delegate Grundumfang_XIX_SAM.RP_IF_ZFH_HBFS_AutoTief_XIX_Grundumfang_XIX_SAM <-> outer port RP_IF_ZFH_HBFS_AutoTief_XIX_SAM
    delegate Grundumfang_XIX_SAM.RP_IF_ZFH_HBFS_ManHoch_XIX_Grundumfang_XIX_SAM <-> outer port RP_IF_ZFH_HBFS_ManHoch_XIX_SAM
    delegate Grundumfang_XIX_SAM.RP_IF_ZFH_HBFS_ManTief_XIX_Grundumfang_XIX_SAM <-> outer port RP_IF_ZFH_HBFS_ManTief_XIX_SAM
    delegate Grundumfang_XIX_SAM.RP_IF_ZFH_HFS_AutoHoch_XIX_Grundumfang_XIX_SAM <-> outer port RP_IF_ZFH_HFS_AutoHoch_XIX_SAM
    delegate Grundumfang_XIX_SAM.RP_IF_ZFH_HFS_AutoTief_XIX_Grundumfang_XIX_SAM <-> outer port RP_IF_ZFH_HFS_AutoTief_XIX_SAM
    delegate Grundumfang_XIX_SAM.RP_IF_ZFH_HFS_ManHoch_XIX_Grundumfang_XIX_SAM <-> outer port RP_IF_ZFH_HFS_ManHoch_XIX_SAM
    delegate Grundumfang_XIX_SAM.RP_IF_ZFH_HFS_ManTief_XIX_Grundumfang_XIX_SAM <-> outer port RP_IF_ZFH_HFS_ManTief_XIX_SAM
    delegate Grundumfang_XIX_SAM.RP_IF_ZFH_zentral_auf_XIX_Grundumfang_XIX_SAM <-> outer port RP_IF_ZFH_zentral_auf_XIX_SAM
    delegate Grundumfang_XIX_SAM.RP_IF_ZFH_zentral_zu_XIX_Grundumfang_XIX_SAM <-> outer port RP_IF_ZFH_zentral_zu_XIX_SAM
    delegate Grundumfang_XIX_SAM.RP_IF_ZV_04_BZ_XIX_Grundumfang_XIX_SAM <-> outer port RP_IF_ZV_04_BZ_XIX_SAM
    delegate Grundumfang_XIX_SAM.RP_IF_ZV_04_CRC_XIX_Grundumfang_XIX_SAM <-> outer port RP_IF_ZV_04_CRC_XIX_SAM
    delegate Grundumfang_XIX_SAM.RP_IF_ZV_Anf_Challenge_Auth_XIX_Grundumfang_XIX_SAM <-> outer port RP_IF_ZV_Anf_Challenge_Auth_XIX_SAM
    delegate Grundumfang_XIX_SAM.RP_IF_ZV_auf_BT_XIX_Grundumfang_XIX_SAM <-> outer port RP_IF_ZV_auf_BT_XIX_SAM
    delegate Grundumfang_XIX_SAM.RP_IF_ZV_auf_FT_XIX_Grundumfang_XIX_SAM <-> outer port RP_IF_ZV_auf_FT_XIX_SAM
    delegate Grundumfang_XIX_SAM.RP_IF_ZV_auf_Funk_XIX_Grundumfang_XIX_SAM <-> outer port RP_IF_ZV_auf_Funk_XIX_SAM
    delegate Grundumfang_XIX_SAM.RP_IF_ZV_auf_Kessy_XIX_Grundumfang_XIX_SAM <-> outer port RP_IF_ZV_auf_Kessy_XIX_SAM
    delegate Grundumfang_XIX_SAM.RP_IF_ZV_Bedienstelle_auf_XIX_Grundumfang_XIX_SAM <-> outer port RP_IF_ZV_Bedienstelle_auf_XIX_SAM
    delegate Grundumfang_XIX_SAM.RP_IF_ZV_BT_offen_XIX_Grundumfang_XIX_SAM <-> outer port RP_IF_ZV_BT_offen_XIX_SAM
    delegate Grundumfang_XIX_SAM.RP_IF_ZV_DWA_Einfachhorn_Anf_XIX_Grundumfang_XIX_SAM <-> outer port RP_IF_ZV_DWA_Einfachhorn_Anf_XIX_SAM
    delegate Grundumfang_XIX_SAM.RP_IF_ZV_DWA_Einfachhorn_Takt_XIX_Grundumfang_XIX_SAM <-> outer port RP_IF_ZV_DWA_Einfachhorn_Takt_XIX_SAM
    delegate Grundumfang_XIX_SAM.RP_IF_ZV_Einfachhorn_Anf_XIX_Grundumfang_XIX_SAM <-> outer port RP_IF_ZV_Einfachhorn_Anf_XIX_SAM
    delegate Grundumfang_XIX_SAM.RP_IF_ZV_Einfachhorn_Takt_XIX_Grundumfang_XIX_SAM <-> outer port RP_IF_ZV_Einfachhorn_Takt_XIX_SAM
    delegate Grundumfang_XIX_SAM.RP_IF_ZV_FT_offen_XIX_Grundumfang_XIX_SAM <-> outer port RP_IF_ZV_FT_offen_XIX_SAM
    delegate Grundumfang_XIX_SAM.RP_IF_ZV_gesafet_extern_ist_XIX_Grundumfang_XIX_SAM <-> outer port RP_IF_ZV_gesafet_extern_ist_XIX_SAM
    delegate ZV_XIX_SAM.RP_IF_ZV_gesafet_extern_soll_XIX_ZV_XIX_SAM <-> outer port RP_IF_ZV_gesafet_extern_soll_XIX_SAM
    delegate Grundumfang_XIX_SAM.RP_IF_ZV_HBFS_entriegeln_Auth_XIX_Grundumfang_XIX_SAM <-> outer port RP_IF_ZV_HBFS_entriegeln_Auth_XIX_SAM
    delegate Grundumfang_XIX_SAM.RP_IF_ZV_HBFS_entriegeln_XIX_Grundumfang_XIX_SAM <-> outer port RP_IF_ZV_HBFS_entriegeln_XIX_SAM
    delegate Grundumfang_XIX_SAM.RP_IF_ZV_HBFS_entsafen_Auth_XIX_Grundumfang_XIX_SAM <-> outer port RP_IF_ZV_HBFS_entsafen_Auth_XIX_SAM
    delegate Grundumfang_XIX_SAM.RP_IF_ZV_HBFS_offen_XIX_Grundumfang_XIX_SAM <-> outer port RP_IF_ZV_HBFS_offen_XIX_SAM
    delegate Grundumfang_XIX_SAM.RP_IF_ZV_HBFS_verriegeln_XIX_Grundumfang_XIX_SAM <-> outer port RP_IF_ZV_HBFS_verriegeln_XIX_SAM
    delegate Grundumfang_XIX_SAM.RP_IF_ZV_HD_offen_XIX_Grundumfang_XIX_SAM <-> outer port RP_IF_ZV_HD_offen_XIX_SAM
    delegate Grundumfang_XIX_SAM.RP_IF_ZV_Heckeinzelentriegelung_XIX_Grundumfang_XIX_SAM <-> outer port RP_IF_ZV_Heckeinzelentriegelung_XIX_SAM
    delegate Grundumfang_XIX_SAM.RP_IF_ZV_HFS_entriegeln_Auth_XIX_Grundumfang_XIX_SAM <-> outer port RP_IF_ZV_HFS_entriegeln_Auth_XIX_SAM
    delegate Grundumfang_XIX_SAM.RP_IF_ZV_HFS_entriegeln_XIX_Grundumfang_XIX_SAM <-> outer port RP_IF_ZV_HFS_entriegeln_XIX_SAM
    delegate Grundumfang_XIX_SAM.RP_IF_ZV_HFS_entsafen_Auth_XIX_Grundumfang_XIX_SAM <-> outer port RP_IF_ZV_HFS_entsafen_Auth_XIX_SAM
    delegate Grundumfang_XIX_SAM.RP_IF_ZV_HFS_offen_XIX_Grundumfang_XIX_SAM <-> outer port RP_IF_ZV_HFS_offen_XIX_SAM
    delegate Grundumfang_XIX_SAM.RP_IF_ZV_HFS_verriegeln_XIX_Grundumfang_XIX_SAM <-> outer port RP_IF_ZV_HFS_verriegeln_XIX_SAM
    delegate Grundumfang_XIX_SAM.RP_IF_ZV_Hupe_Anf_XIX_Grundumfang_XIX_SAM <-> outer port RP_IF_ZV_Hupe_Anf_XIX_SAM
    delegate Grundumfang_XIX_SAM.RP_IF_ZV_Hupe_Takt_XIX_Grundumfang_XIX_SAM <-> outer port RP_IF_ZV_Hupe_Takt_XIX_SAM
    delegate Grundumfang_XIX_SAM.RP_IF_ZV_HW_Motor_Lock_HK_Auth_XIX_Grundumfang_XIX_SAM <-> outer port RP_IF_ZV_HW_Motor_Lock_HK_Auth_XIX_SAM
    delegate Grundumfang_XIX_SAM.RP_IF_ZV_HW_Motor_Lock_HK_XIX_Grundumfang_XIX_SAM <-> outer port RP_IF_ZV_HW_Motor_Lock_HK_XIX_SAM
    delegate Grundumfang_XIX_SAM.RP_IF_ZV_HW_Motor_Safe_Hinten_XIX_Grundumfang_XIX_SAM <-> outer port RP_IF_ZV_HW_Motor_Safe_Hinten_XIX_SAM
    delegate Grundumfang_XIX_SAM.RP_IF_ZV_ist_Zustand_verfuegbar_XIX_Grundumfang_XIX_SAM <-> outer port RP_IF_ZV_ist_Zustand_verfuegbar_XIX_SAM
    delegate ZV_XIX_SAM.RP_IF_ZV_Laderaumabd_elektr_aktiviert_XIX_ZV_XIX_SAM <-> outer port RP_IF_ZV_Laderaumabd_elektr_aktiviert_XIX_SAM
    delegate Druckpunktmassage_fuer_Beifahrersitz_Lehnenmassage_SAM_XIX_DPMBFSLM_XIX_SAM.RP_IF_ZV_Schluessel_Zugang_XIX_Druckpunktmassage_fuer_Beifahrersitz_Lehnenmassage_SAM_XIX_DPMBFSLM_XIX_SAM <-> outer port RP_IF_ZV_Schluessel_Zugang_XIX_SAM  # _XIX_SC_70_ZV_Lib_XIX_Softwareblock_XIX_ICAS1_X_Gateway_XIX_Druckpunktmassage_fuer_Beifahrersitz_Lehnenmassage_SAM_XIX_DPMBFSLM_XIX_SAM_XIX_ZV_Schluessel_Zugang
    delegate Druckpunktmassage_fuer_Fahrersitz_Lehnenmassage_SAM_XIX_DPMFSLM_XIX_SAM.RP_IF_ZV_Schluessel_Zugang_XIX_Druckpunktmassage_fuer_Fahrersitz_Lehnenmassage_SAM_XIX_DPMFSLM_XIX_SAM <-> outer port RP_IF_ZV_Schluessel_Zugang_XIX_SAM  # _XIX_SC_70_ZV_Lib_XIX_Softwareblock_XIX_ICAS1_X_Gateway_XIX_Druckpunktmassage_fuer_Fahrersitz_Lehnenmassage_SAM_XIX_DPMFSLM_XIX_SAM_XIX_ZV_Schluessel_Zugang
    delegate Grundumfang_XIX_SAM.RP_IF_ZV_Schluessel_Zugang_XIX_Grundumfang_XIX_SAM <-> outer port RP_IF_ZV_Schluessel_Zugang_XIX_SAM
    delegate ZV_XIX_SAM.RP_IF_ZV_Status_Cargolock_XIX_ZV_XIX_SAM <-> outer port RP_IF_ZV_Status_Cargolock_XIX_SAM
    delegate ZV_XIX_SAM.RP_IF_ZV_STSG_HBFS_Anf_XIX_ZV_XIX_SAM <-> outer port RP_IF_ZV_STSG_HBFS_Anf_XIX_SAM
    delegate ZV_XIX_SAM.RP_IF_ZV_STSG_HFS_Anf_XIX_ZV_XIX_SAM <-> outer port RP_IF_ZV_STSG_HFS_Anf_XIX_SAM
    delegate Grundumfang_XIX_SAM.RP_IF_ZV_verriegelt_extern_ist_XIX_Grundumfang_XIX_SAM <-> outer port RP_IF_ZV_verriegelt_extern_ist_XIX_SAM
    delegate SC_708_IuALicht_MEB_XIX_Softwareblock_XIX_SAM.RP_IF_ZV_verriegelt_extern_ist_XIX_SC_708_IuALicht_MEB_XIX_Softwareblock_XIX_SAM <-> outer port RP_IF_ZV_verriegelt_extern_ist_XIX_SAM  # _XIX_SC_70_ZV_Lib_XIX_Softwareblock_XIX_ICAS1_X_Gateway_XIX_SC_708_IuALicht_MEB_XIX_Softwareblock_XIX_SAM_XIX_ZV_verriegelt_extern_ist
    delegate SC_708_IuALicht_MEB_XIX_Softwareblock_XIX_SAM.RP_IF_ZV_verriegelt_extern_soll_XIX_SC_708_IuALicht_MEB_XIX_Softwareblock_XIX_SAM <-> outer port RP_IF_ZV_verriegelt_extern_soll_XIX_SAM  # _XIX_SC_70_ZV_Lib_XIX_Softwareblock_XIX_ICAS1_X_Gateway_XIX_SC_708_IuALicht_MEB_XIX_Softwareblock_XIX_SAM_XIX_ZV_verriegelt_extern_soll
    delegate Grundumfang_XIX_SAM.RP_IF_ZV_verriegelt_intern_ist_XIX_Grundumfang_XIX_SAM <-> outer port RP_IF_ZV_verriegelt_intern_ist_XIX_SAM
    delegate ZV_XIX_SAM.RP_IF_ZV_verriegelt_intern_soll_XIX_ZV_XIX_SAM <-> outer port RP_IF_ZV_verriegelt_intern_soll_XIX_SAM
    delegate Grundumfang_XIX_SAM.RP_IF_ZV_zentral_entsafen_XIX_Grundumfang_XIX_SAM <-> outer port RP_IF_ZV_zentral_entsafen_XIX_SAM
    delegate Grundumfang_XIX_SAM.RP_IF_ZV_zentral_safen_XIX_Grundumfang_XIX_SAM <-> outer port RP_IF_ZV_zentral_safen_XIX_SAM
    delegate Grundumfang_XIX_SAM.RP_IF_ZV_zu_Funk_XIX_Grundumfang_XIX_SAM <-> outer port RP_IF_ZV_zu_Funk_XIX_SAM
    delegate Grundumfang_XIX_SAM.RP_IF_ZV_zu_Kessy_XIX_Grundumfang_XIX_SAM <-> outer port RP_IF_ZV_zu_Kessy_XIX_SAM
    delegate Grundumfang_XIX_SAM.SP_IF_Airbag_02_alt_XIX_Grundumfang_XIX_SAM <-> outer port SP_IF_Airbag_02_alt_XIX_SAM
    delegate SC_789_ExAmb_MEB_XIX_Softwareblock_XIX_SAM.SP_IF_AMBEX_CH_aktiv_XIX_SC_789_ExAmb_MEB_XIX_Softwareblock_XIX_SAM <-> outer port SP_IF_AMBEX_CH_aktiv_XIX_SAM
    delegate SC_789_ExAmb_MEB_XIX_Softwareblock_XIX_SAM.SP_IF_AMBEX_CH_Trigger_XIX_SC_789_ExAmb_MEB_XIX_Softwareblock_XIX_SAM <-> outer port SP_IF_AMBEX_CH_Trigger_XIX_SAM
    delegate Grundumfang_XIX_SAM.SP_IF_Ambex_DLI_InszStatus_XIX_Grundumfang_XIX_SAM <-> outer port SP_IF_Ambex_DLI_InszStatus_XIX_SAM
    delegate Grundumfang_XIX_SAM.SP_IF_Ambex_DLI_Soll_Horizontal_L_XIX_Grundumfang_XIX_SAM <-> outer port SP_IF_Ambex_DLI_Soll_Horizontal_L_XIX_SAM
    delegate Grundumfang_XIX_SAM.SP_IF_Ambex_DLI_Soll_Horizontal_R_XIX_Grundumfang_XIX_SAM <-> outer port SP_IF_Ambex_DLI_Soll_Horizontal_R_XIX_SAM
    delegate Grundumfang_XIX_SAM.SP_IF_Ambex_DLI_Soll_Vertikal_L_XIX_Grundumfang_XIX_SAM <-> outer port SP_IF_Ambex_DLI_Soll_Vertikal_L_XIX_SAM
    delegate Grundumfang_XIX_SAM.SP_IF_Ambex_DLI_Soll_Vertikal_R_XIX_Grundumfang_XIX_SAM <-> outer port SP_IF_Ambex_DLI_Soll_Vertikal_R_XIX_SAM
    delegate Grundumfang_XIX_SAM.SP_IF_Ambex_KY_Anforderung_Zonenortung_XIX_Grundumfang_XIX_SAM <-> outer port SP_IF_Ambex_KY_Anforderung_Zonenortung_XIX_SAM
    delegate SC_789_ExAmb_MEB_XIX_Softwareblock_XIX_SAM.SP_IF_AMBEX_LH_aktiv_XIX_SC_789_ExAmb_MEB_XIX_Softwareblock_XIX_SAM <-> outer port SP_IF_AMBEX_LH_aktiv_XIX_SAM
    delegate SC_789_ExAmb_MEB_XIX_Softwareblock_XIX_SAM.SP_IF_AMBEX_LH_Trigger_XIX_SC_789_ExAmb_MEB_XIX_Softwareblock_XIX_SAM <-> outer port SP_IF_AMBEX_LH_Trigger_XIX_SAM
    delegate Grundumfang_XIX_SAM.SP_IF_Ambex_SAL_Abl_Vorne_XIX_Grundumfang_XIX_SAM <-> outer port SP_IF_Ambex_SAL_Abl_Vorne_XIX_SAM
    delegate Grundumfang_XIX_SAM.SP_IF_Ambex_SAL_animprofil_XIX_Grundumfang_XIX_SAM <-> outer port SP_IF_Ambex_SAL_animprofil_XIX_SAM
    delegate Grundumfang_XIX_SAM.SP_IF_Ambex_SAL_Bgr_Vorne_XIX_Grundumfang_XIX_SAM <-> outer port SP_IF_Ambex_SAL_Bgr_Vorne_XIX_SAM
    delegate SC_789_ExAmb_MEB_XIX_Softwareblock_XIX_SAM.SP_IF_AMBEX_SAL_Design10_L_XIX_SC_789_ExAmb_MEB_XIX_Softwareblock_XIX_SAM <-> outer port SP_IF_AMBEX_SAL_Design10_L_XIX_SAM
    delegate SC_789_ExAmb_MEB_XIX_Softwareblock_XIX_SAM.SP_IF_AMBEX_SAL_Design10_R_XIX_SC_789_ExAmb_MEB_XIX_Softwareblock_XIX_SAM <-> outer port SP_IF_AMBEX_SAL_Design10_R_XIX_SAM
    delegate SC_789_ExAmb_MEB_XIX_Softwareblock_XIX_SAM.SP_IF_AMBEX_SAL_Design11_L_XIX_SC_789_ExAmb_MEB_XIX_Softwareblock_XIX_SAM <-> outer port SP_IF_AMBEX_SAL_Design11_L_XIX_SAM
    delegate SC_789_ExAmb_MEB_XIX_Softwareblock_XIX_SAM.SP_IF_AMBEX_SAL_Design11_R_XIX_SC_789_ExAmb_MEB_XIX_Softwareblock_XIX_SAM <-> outer port SP_IF_AMBEX_SAL_Design11_R_XIX_SAM
    delegate SC_789_ExAmb_MEB_XIX_Softwareblock_XIX_SAM.SP_IF_AMBEX_SAL_Design12_L_XIX_SC_789_ExAmb_MEB_XIX_Softwareblock_XIX_SAM <-> outer port SP_IF_AMBEX_SAL_Design12_L_XIX_SAM
    delegate SC_789_ExAmb_MEB_XIX_Softwareblock_XIX_SAM.SP_IF_AMBEX_SAL_Design12_R_XIX_SC_789_ExAmb_MEB_XIX_Softwareblock_XIX_SAM <-> outer port SP_IF_AMBEX_SAL_Design12_R_XIX_SAM
    delegate Grundumfang_XIX_SAM.SP_IF_Ambex_SAL_Design1_XIX_Grundumfang_XIX_SAM <-> outer port SP_IF_Ambex_SAL_Design1_XIX_SAM
    delegate Grundumfang_XIX_SAM.SP_IF_Ambex_SAL_Design2_XIX_Grundumfang_XIX_SAM <-> outer port SP_IF_Ambex_SAL_Design2_XIX_SAM
    delegate SC_789_ExAmb_MEB_XIX_Softwareblock_XIX_SAM.SP_IF_AMBEX_SAL_Design{3..9}_XIX_SC_789_ExAmb_MEB_XIX_Softwareblock_XIX_SAM <-> outer port SP_IF_AMBEX_SAL_Design{3..9}_XIX_SAM
    delegate Grundumfang_XIX_SAM.SP_IF_Ambex_SAL_Kzl_XIX_Grundumfang_XIX_SAM <-> outer port SP_IF_Ambex_SAL_Kzl_XIX_SAM
    delegate Grundumfang_XIX_SAM.SP_IF_Ambex_SAL_Schlusslicht_XIX_Grundumfang_XIX_SAM <-> outer port SP_IF_Ambex_SAL_Schlusslicht_XIX_SAM
    delegate Grundumfang_XIX_SAM.SP_IF_Anlernen_LLR_li_XIX_Grundumfang_XIX_SAM <-> outer port SP_IF_Anlernen_LLR_li_XIX_SAM
    delegate Grundumfang_XIX_SAM.SP_IF_Anlernen_LLR_re_XIX_Grundumfang_XIX_SAM <-> outer port SP_IF_Anlernen_LLR_re_XIX_SAM
    delegate Grundumfang_XIX_SAM.SP_IF_APS_Taster_XIX_Grundumfang_XIX_SAM <-> outer port SP_IF_APS_Taster_XIX_SAM
    delegate Grundumfang_XIX_SAM.SP_IF_Aussentemp_gef_XIX_Grundumfang_XIX_SAM <-> outer port SP_IF_Aussentemp_gef_XIX_SAM
    delegate Grundumfang_XIX_SAM.SP_IF_BAPe_Data_Byte_{1..6}_XIX_Grundumfang_XIX_SAM <-> outer port SP_IF_BAPe_Data_Byte_{1..6}_XIX_SAM
    delegate Grundumfang_XIX_SAM.SP_IF_BAPe_FCT_ID_XIX_Grundumfang_XIX_SAM <-> outer port SP_IF_BAPe_FCT_ID_XIX_SAM
    delegate Grundumfang_XIX_SAM.SP_IF_BAPe_LSG_ID1_XIX_Grundumfang_XIX_SAM <-> outer port SP_IF_BAPe_LSG_ID1_XIX_SAM
    delegate Grundumfang_XIX_SAM.SP_IF_BAPe_LSG_ID2_XIX_Grundumfang_XIX_SAM <-> outer port SP_IF_BAPe_LSG_ID2_XIX_SAM
    delegate Grundumfang_XIX_SAM.SP_IF_BAPe_Opcode_XIX_Grundumfang_XIX_SAM <-> outer port SP_IF_BAPe_Opcode_XIX_SAM
    delegate Grundumfang_XIX_SAM.SP_IF_BAPe_Segment_XIX_Grundumfang_XIX_SAM <-> outer port SP_IF_BAPe_Segment_XIX_SAM
    delegate Grundumfang_XIX_SAM.SP_IF_BCM1_Aussen_Temp_ungef_XIX_Grundumfang_XIX_SAM <-> outer port SP_IF_BCM1_Aussen_Temp_ungef_XIX_SAM
    delegate Grundumfang_XIX_SAM.SP_IF_BCM1_EasyEntry_Status_XIX_Grundumfang_XIX_SAM <-> outer port SP_IF_BCM1_EasyEntry_Status_XIX_SAM
    delegate Grundumfang_XIX_SAM.SP_IF_BCM1_FStatus_Aussentemp_ungef_XIX_Grundumfang_XIX_SAM <-> outer port SP_IF_BCM1_FStatus_Aussentemp_ungef_XIX_SAM
    delegate Grundumfang_XIX_SAM.SP_IF_BCM1_KD_Fehler_XIX_Grundumfang_XIX_SAM <-> outer port SP_IF_BCM1_KD_Fehler_XIX_SAM  # _XIX_Grundumfang_XIX_SAM_XIX_SC_738_ClassicAUTOSARBasicSoftwareICAS1Gateway_XIX_Softwareblock_XIX_ICAS1_X_Gateway_XIX_BCM1_KD_Fehler
    delegate Grundumfang_XIX_SAM.SP_IF_BCM1_MH_Schalter_XIX_Grundumfang_XIX_SAM <-> outer port SP_IF_BCM1_MH_Schalter_XIX_SAM
    delegate Grundumfang_XIX_SAM.SP_IF_BCM1_Nachlauftyp_XIX_Grundumfang_XIX_SAM <-> outer port SP_IF_BCM1_Nachlauftyp_XIX_SAM  # _XIX_Grundumfang_XIX_SAM_XIX_SC_738_ClassicAUTOSARBasicSoftwareICAS1Gateway_XIX_Softwareblock_XIX_ICAS1_X_Gateway_XIX_BCM1_Nachlauftyp
    delegate Grundumfang_XIX_SAM.SP_IF_BCM1_OBD_FStatus_ATemp_XIX_Grundumfang_XIX_SAM <-> outer port SP_IF_BCM1_OBD_FStatus_ATemp_XIX_SAM
    delegate Grundumfang_XIX_SAM.SP_IF_BCM1_SRA_aktiv_XIX_Grundumfang_XIX_SAM <-> outer port SP_IF_BCM1_SRA_aktiv_XIX_SAM
    delegate Grundumfang_XIX_SAM.SP_IF_BCM1_Warnblink_Taster_XIX_Grundumfang_XIX_SAM <-> outer port SP_IF_BCM1_Warnblink_Taster_XIX_SAM
    delegate Grundumfang_XIX_SAM.SP_IF_BCM_01_BZ_XIX_Grundumfang_XIX_SAM <-> outer port SP_IF_BCM_01_BZ_XIX_SAM
    delegate Grundumfang_XIX_SAM.SP_IF_BCM_01_CRC_XIX_Grundumfang_XIX_SAM <-> outer port SP_IF_BCM_01_CRC_XIX_SAM
    delegate Grundumfang_XIX_SAM.SP_IF_BCM_BFS_aktive_MuFu_Fkt_XIX_Grundumfang_XIX_SAM <-> outer port SP_IF_BCM_BFS_aktive_MuFu_Fkt_XIX_SAM
    delegate Grundumfang_XIX_SAM.SP_IF_BCM_BFS_Fernsteuerung_aktiv_XIX_Grundumfang_XIX_SAM <-> outer port SP_IF_BCM_BFS_Fernsteuerung_aktiv_XIX_SAM
    delegate Grundumfang_XIX_SAM.SP_IF_BCM_BFS_Lordose_ab_XIX_Grundumfang_XIX_SAM <-> outer port SP_IF_BCM_BFS_Lordose_ab_XIX_SAM
    delegate Grundumfang_XIX_SAM.SP_IF_BCM_BFS_Lordose_auf_XIX_Grundumfang_XIX_SAM <-> outer port SP_IF_BCM_BFS_Lordose_auf_XIX_SAM
    delegate Grundumfang_XIX_SAM.SP_IF_BCM_BFS_Lordose_vor_XIX_Grundumfang_XIX_SAM <-> outer port SP_IF_BCM_BFS_Lordose_vor_XIX_SAM
    delegate Grundumfang_XIX_SAM.SP_IF_BCM_BFS_Lordose_zurueck_XIX_Grundumfang_XIX_SAM <-> outer port SP_IF_BCM_BFS_Lordose_zurueck_XIX_SAM
    delegate Druckpunktmassage_fuer_Beifahrersitz_Lehnenmassage_SAM_XIX_DPMBFSLM_XIX_SAM.SP_IF_BCM_BFS_Massage_Dauer_XIX_Druckpunktmassage_fuer_Beifahrersitz_Lehnenmassage_SAM_XIX_DPMBFSLM_XIX_SAM <-> outer port SP_IF_BCM_BFS_Massage_Dauer_XIX_SAM  # _XIX_Druckpunktmassage_fuer_Beifahrersitz_Lehnenmassage_SAM_XIX_DPMBFSLM_XIX_SAM_XIX_Grundumfang_XIX_SPR_BFS_XIX_BCM_BFS_Massage_Dauer
    delegate Druckpunktmassage_fuer_Beifahrersitz_Lehnenmassage_SAM_XIX_DPMBFSLM_XIX_SAM.SP_IF_BCM_BFS_Massage_Intens_Lehne_XIX_Druckpunktmassage_fuer_Beifahrersitz_Lehnenmassage_SAM_XIX_DPMBFSLM_XIX_SAM <-> outer port SP_IF_BCM_BFS_Massage_Intens_Lehne_XIX_SAM  # _XIX_Druckpunktmassage_fuer_Beifahrersitz_Lehnenmassage_SAM_XIX_DPMBFSLM_XIX_SAM_XIX_Grundumfang_XIX_SPR_BFS_XIX_BCM_BFS_Massage_Intens_Lehne
    delegate Druckpunktmassage_fuer_Beifahrersitz_Lehnenmassage_SAM_XIX_DPMBFSLM_XIX_SAM.SP_IF_BCM_BFS_Massage_Intens_Sitz_XIX_Druckpunktmassage_fuer_Beifahrersitz_Lehnenmassage_SAM_XIX_DPMBFSLM_XIX_SAM <-> outer port SP_IF_BCM_BFS_Massage_Intens_Sitz_XIX_SAM  # _XIX_Druckpunktmassage_fuer_Beifahrersitz_Lehnenmassage_SAM_XIX_DPMBFSLM_XIX_SAM_XIX_Grundumfang_XIX_SPR_BFS_XIX_BCM_BFS_Massage_Intens_Sitz
    delegate Grundumfang_XIX_SAM.SP_IF_BCM_BFS_Massage_Intensitaet_XIX_Grundumfang_XIX_SAM <-> outer port SP_IF_BCM_BFS_Massage_Intensitaet_XIX_SAM
    delegate Druckpunktmassage_fuer_Beifahrersitz_Lehnenmassage_SAM_XIX_DPMBFSLM_XIX_SAM.SP_IF_BCM_BFS_Massage_Prg_erweitert_XIX_Druckpunktmassage_fuer_Beifahrersitz_Lehnenmassage_SAM_XIX_DPMBFSLM_XIX_SAM <-> outer port SP_IF_BCM_BFS_Massage_Prg_erweitert_XIX_SAM  # _XIX_Druckpunktmassage_fuer_Beifahrersitz_Lehnenmassage_SAM_XIX_DPMBFSLM_XIX_SAM_XIX_Grundumfang_XIX_SPR_BFS_XIX_BCM_BFS_Massage_Prg_erweitert
    delegate Grundumfang_XIX_SAM.SP_IF_BCM_BFS_Massage_Prg_XIX_Grundumfang_XIX_SAM <-> outer port SP_IF_BCM_BFS_Massage_Prg_XIX_SAM
    delegate Druckpunktmassage_fuer_Beifahrersitz_Lehnenmassage_SAM_XIX_DPMBFSLM_XIX_SAM.SP_IF_BCM_BFS_Massage_Taster_XIX_Druckpunktmassage_fuer_Beifahrersitz_Lehnenmassage_SAM_XIX_DPMBFSLM_XIX_SAM <-> outer port SP_IF_BCM_BFS_Massage_Taster_XIX_SAM  # _XIX_Druckpunktmassage_fuer_Beifahrersitz_Lehnenmassage_SAM_XIX_DPMBFSLM_XIX_SAM_XIX_SC_711_VC_IoT_XIX_Softwareblock_XIX_ICAS1_X_Sys_Java_02_XIX_BCM_BFS_Massage_Taster
    delegate Grundumfang_XIX_SAM.SP_IF_BCM_BFS_Memory_Abbruch_XIX_Grundumfang_XIX_SAM <-> outer port SP_IF_BCM_BFS_Memory_Abbruch_XIX_SAM
    delegate Grundumfang_XIX_SAM.SP_IF_BCM_BFS_Memory_Pos_XIX_Grundumfang_XIX_SAM <-> outer port SP_IF_BCM_BFS_Memory_Pos_XIX_SAM
    delegate Grundumfang_XIX_SAM.SP_IF_BCM_BFS_Memory_Save_Recall_XIX_Grundumfang_XIX_SAM <-> outer port SP_IF_BCM_BFS_Memory_Save_Recall_XIX_SAM
    delegate Grundumfang_XIX_SAM.SP_IF_BCM_BFS_MSG_Status_XIX_Grundumfang_XIX_SAM <-> outer port SP_IF_BCM_BFS_MSG_Status_XIX_SAM
    delegate Druckpunktmassage_fuer_Beifahrersitz_Lehnenmassage_SAM_XIX_DPMBFSLM_XIX_SAM.SP_IF_BCM_BFS_Multif_Taster_XIX_Druckpunktmassage_fuer_Beifahrersitz_Lehnenmassage_SAM_XIX_DPMBFSLM_XIX_SAM <-> outer port SP_IF_BCM_BFS_Multif_Taster_XIX_SAM  # _XIX_Druckpunktmassage_fuer_Beifahrersitz_Lehnenmassage_SAM_XIX_DPMBFSLM_XIX_SAM_XIX_SC_711_VC_IoT_XIX_Softwareblock_XIX_ICAS1_X_Sys_Java_02_XIX_BCM_BFS_Multif_Taster
    delegate Druckpunktmassage_fuer_Beifahrersitz_Lehnenmassage_SAM_XIX_DPMBFSLM_XIX_SAM.SP_IF_BCM_BFS_Pneumatik_Verstellung_XIX_Druckpunktmassage_fuer_Beifahrersitz_Lehnenmassage_SAM_XIX_DPMBFSLM_XIX_SAM <-> outer port SP_IF_BCM_BFS_Pneumatik_Verstellung_XIX_SAM  # _XIX_Druckpunktmassage_fuer_Beifahrersitz_Lehnenmassage_SAM_XIX_DPMBFSLM_XIX_SAM_XIX_SC_711_VC_IoT_XIX_Softwareblock_XIX_ICAS1_X_Sys_Java_02_XIX_BCM_BFS_Pneumatik_Verstellung
    delegate Grundumfang_XIX_SAM.SP_IF_BCM_BFS_PreCrash_XIX_Grundumfang_XIX_SAM <-> outer port SP_IF_BCM_BFS_PreCrash_XIX_SAM
    delegate Druckpunktmassage_fuer_Beifahrersitz_Lehnenmassage_SAM_XIX_DPMBFSLM_XIX_SAM.SP_IF_BCM_BFS_Programmwippe_XIX_Druckpunktmassage_fuer_Beifahrersitz_Lehnenmassage_SAM_XIX_DPMBFSLM_XIX_SAM <-> outer port SP_IF_BCM_BFS_Programmwippe_XIX_SAM  # _XIX_Druckpunktmassage_fuer_Beifahrersitz_Lehnenmassage_SAM_XIX_DPMBFSLM_XIX_SAM_XIX_SC_711_VC_IoT_XIX_Softwareblock_XIX_ICAS1_X_Sys_Java_02_XIX_BCM_BFS_Programmwippe
    delegate Grundumfang_XIX_SAM.SP_IF_BCM_BFS_SW_eng_XIX_Grundumfang_XIX_SAM <-> outer port SP_IF_BCM_BFS_SW_eng_XIX_SAM
    delegate Grundumfang_XIX_SAM.SP_IF_BCM_BFS_SW_weit_XIX_Grundumfang_XIX_SAM <-> outer port SP_IF_BCM_BFS_SW_weit_XIX_SAM
    delegate Druckpunktmassage_fuer_Beifahrersitz_Lehnenmassage_SAM_XIX_DPMBFSLM_XIX_SAM.SP_IF_BCM_BFS_Wellness_Status_XIX_Druckpunktmassage_fuer_Beifahrersitz_Lehnenmassage_SAM_XIX_DPMBFSLM_XIX_SAM <-> outer port SP_IF_BCM_BFS_Wellness_Status_XIX_SAM  # _XIX_Druckpunktmassage_fuer_Beifahrersitz_Lehnenmassage_SAM_XIX_DPMBFSLM_XIX_SAM_XIX_Grundumfang_XIX_SPR_BFS_XIX_BCM_BFS_Wellness_Status
    delegate Grundumfang_XIX_SAM.SP_IF_BCM_BFT_geoeffnet_plaus_XIX_Grundumfang_XIX_SAM <-> outer port SP_IF_BCM_BFT_geoeffnet_plaus_XIX_SAM
    delegate Grundumfang_XIX_SAM.SP_IF_BCM_Bremsbelag_Sensor_CND_XIX_Grundumfang_XIX_SAM <-> outer port SP_IF_BCM_Bremsbelag_Sensor_CND_XIX_SAM
    delegate Grundumfang_XIX_SAM.SP_IF_BCM_Bremsbelag_Sensor_NAR_XIX_Grundumfang_XIX_SAM <-> outer port SP_IF_BCM_Bremsbelag_Sensor_NAR_XIX_SAM
    delegate Grundumfang_XIX_SAM.SP_IF_BCM_Bremsbelag_Sensor_Rdw_XIX_Grundumfang_XIX_SAM <-> outer port SP_IF_BCM_Bremsbelag_Sensor_Rdw_XIX_SAM
    delegate Grundumfang_XIX_SAM.SP_IF_BCM_Bremsbelag_Sensor_XIX_Grundumfang_XIX_SAM <-> outer port SP_IF_BCM_Bremsbelag_Sensor_XIX_SAM
    delegate Grundumfang_XIX_SAM.SP_IF_BCM_Bremsfluessigkeit_Sensor_XIX_Grundumfang_XIX_SAM <-> outer port SP_IF_BCM_Bremsfluessigkeit_Sensor_XIX_SAM
    delegate Grundumfang_XIX_SAM.SP_IF_BCM_Drehwinkel_HL_XIX_Grundumfang_XIX_SAM <-> outer port SP_IF_BCM_Drehwinkel_HL_XIX_SAM
    delegate Grundumfang_XIX_SAM.SP_IF_BCM_Drehwinkel_VL_XIX_Grundumfang_XIX_SAM <-> outer port SP_IF_BCM_Drehwinkel_VL_XIX_SAM
    delegate Grundumfang_XIX_SAM.SP_IF_BCM_Drehwinkelsensortausch_HL_XIX_Grundumfang_XIX_SAM <-> outer port SP_IF_BCM_Drehwinkelsensortausch_HL_XIX_SAM
    delegate Grundumfang_XIX_SAM.SP_IF_BCM_Drehwinkelsensortausch_VL_XIX_Grundumfang_XIX_SAM <-> outer port SP_IF_BCM_Drehwinkelsensortausch_VL_XIX_SAM
    delegate Grundumfang_XIX_SAM.SP_IF_BCM_Eco_Charisma_Taste_XIX_Grundumfang_XIX_SAM <-> outer port SP_IF_BCM_Eco_Charisma_Taste_XIX_SAM
    delegate Grundumfang_XIX_SAM.SP_IF_BCM_Fehlerspeicher_loeschen_XIX_Grundumfang_XIX_SAM <-> outer port SP_IF_BCM_Fehlerspeicher_loeschen_XIX_SAM
    delegate Grundumfang_XIX_SAM.SP_IF_BCM_FH_Freigabe_XIX_Grundumfang_XIX_SAM <-> outer port SP_IF_BCM_FH_Freigabe_XIX_SAM
    delegate Grundumfang_XIX_SAM.SP_IF_BCM_FS_aktive_MuFu_Fkt_XIX_Grundumfang_XIX_SAM <-> outer port SP_IF_BCM_FS_aktive_MuFu_Fkt_XIX_SAM
    delegate Grundumfang_XIX_SAM.SP_IF_BCM_FS_Lordose_ab_XIX_Grundumfang_XIX_SAM <-> outer port SP_IF_BCM_FS_Lordose_ab_XIX_SAM
    delegate Grundumfang_XIX_SAM.SP_IF_BCM_FS_Lordose_auf_XIX_Grundumfang_XIX_SAM <-> outer port SP_IF_BCM_FS_Lordose_auf_XIX_SAM
    delegate Grundumfang_XIX_SAM.SP_IF_BCM_FS_Lordose_vor_XIX_Grundumfang_XIX_SAM <-> outer port SP_IF_BCM_FS_Lordose_vor_XIX_SAM
    delegate Grundumfang_XIX_SAM.SP_IF_BCM_FS_Lordose_zurueck_XIX_Grundumfang_XIX_SAM <-> outer port SP_IF_BCM_FS_Lordose_zurueck_XIX_SAM
    delegate Druckpunktmassage_fuer_Fahrersitz_Lehnenmassage_SAM_XIX_DPMFSLM_XIX_SAM.SP_IF_BCM_FS_Massage_Dauer_XIX_Druckpunktmassage_fuer_Fahrersitz_Lehnenmassage_SAM_XIX_DPMFSLM_XIX_SAM <-> outer port SP_IF_BCM_FS_Massage_Dauer_XIX_SAM  # _XIX_Druckpunktmassage_fuer_Fahrersitz_Lehnenmassage_SAM_XIX_DPMFSLM_XIX_SAM_XIX_Grundumfang_XIX_SPR_BFS_XIX_BCM_FS_Massage_Dauer
    delegate Druckpunktmassage_fuer_Fahrersitz_Lehnenmassage_SAM_XIX_DPMFSLM_XIX_SAM.SP_IF_BCM_FS_Massage_Intens_Lehne_XIX_Druckpunktmassage_fuer_Fahrersitz_Lehnenmassage_SAM_XIX_DPMFSLM_XIX_SAM <-> outer port SP_IF_BCM_FS_Massage_Intens_Lehne_XIX_SAM  # _XIX_Druckpunktmassage_fuer_Fahrersitz_Lehnenmassage_SAM_XIX_DPMFSLM_XIX_SAM_XIX_Grundumfang_XIX_SPR_BFS_XIX_BCM_FS_Massage_Intens_Lehne
    delegate Druckpunktmassage_fuer_Fahrersitz_Lehnenmassage_SAM_XIX_DPMFSLM_XIX_SAM.SP_IF_BCM_FS_Massage_Intens_Sitz_XIX_Druckpunktmassage_fuer_Fahrersitz_Lehnenmassage_SAM_XIX_DPMFSLM_XIX_SAM <-> outer port SP_IF_BCM_FS_Massage_Intens_Sitz_XIX_SAM  # _XIX_Druckpunktmassage_fuer_Fahrersitz_Lehnenmassage_SAM_XIX_DPMFSLM_XIX_SAM_XIX_Grundumfang_XIX_SPR_BFS_XIX_BCM_FS_Massage_Intens_Sitz
    delegate Grundumfang_XIX_SAM.SP_IF_BCM_FS_Massage_Intensitaet_XIX_Grundumfang_XIX_SAM <-> outer port SP_IF_BCM_FS_Massage_Intensitaet_XIX_SAM
    delegate Druckpunktmassage_fuer_Fahrersitz_Lehnenmassage_SAM_XIX_DPMFSLM_XIX_SAM.SP_IF_BCM_FS_Massage_Prg_erweitert_XIX_Druckpunktmassage_fuer_Fahrersitz_Lehnenmassage_SAM_XIX_DPMFSLM_XIX_SAM <-> outer port SP_IF_BCM_FS_Massage_Prg_erweitert_XIX_SAM  # _XIX_Druckpunktmassage_fuer_Fahrersitz_Lehnenmassage_SAM_XIX_DPMFSLM_XIX_SAM_XIX_Grundumfang_XIX_SPR_BFS_XIX_BCM_FS_Massage_Prg_erweitert
    delegate Grundumfang_XIX_SAM.SP_IF_BCM_FS_Massage_Prg_XIX_Grundumfang_XIX_SAM <-> outer port SP_IF_BCM_FS_Massage_Prg_XIX_SAM
    delegate Druckpunktmassage_fuer_Fahrersitz_Lehnenmassage_SAM_XIX_DPMFSLM_XIX_SAM.SP_IF_BCM_FS_Massage_Taster_XIX_Druckpunktmassage_fuer_Fahrersitz_Lehnenmassage_SAM_XIX_DPMFSLM_XIX_SAM <-> outer port SP_IF_BCM_FS_Massage_Taster_XIX_SAM  # _XIX_Druckpunktmassage_fuer_Fahrersitz_Lehnenmassage_SAM_XIX_DPMFSLM_XIX_SAM_XIX_SC_711_VC_IoT_XIX_Softwareblock_XIX_ICAS1_X_Sys_Java_02_XIX_BCM_FS_Massage_Taster
    delegate Grundumfang_XIX_SAM.SP_IF_BCM_FS_Memory_Abbruch_XIX_Grundumfang_XIX_SAM <-> outer port SP_IF_BCM_FS_Memory_Abbruch_XIX_SAM
    delegate Grundumfang_XIX_SAM.SP_IF_BCM_FS_Memory_Pos_XIX_Grundumfang_XIX_SAM <-> outer port SP_IF_BCM_FS_Memory_Pos_XIX_SAM
    delegate Grundumfang_XIX_SAM.SP_IF_BCM_FS_Memory_Save_Recall_XIX_Grundumfang_XIX_SAM <-> outer port SP_IF_BCM_FS_Memory_Save_Recall_XIX_SAM
    delegate Grundumfang_XIX_SAM.SP_IF_BCM_FS_MSG_Status_XIX_Grundumfang_XIX_SAM <-> outer port SP_IF_BCM_FS_MSG_Status_XIX_SAM
    delegate Druckpunktmassage_fuer_Fahrersitz_Lehnenmassage_SAM_XIX_DPMFSLM_XIX_SAM.SP_IF_BCM_FS_Multif_Taster_XIX_Druckpunktmassage_fuer_Fahrersitz_Lehnenmassage_SAM_XIX_DPMFSLM_XIX_SAM <-> outer port SP_IF_BCM_FS_Multif_Taster_XIX_SAM  # _XIX_Druckpunktmassage_fuer_Fahrersitz_Lehnenmassage_SAM_XIX_DPMFSLM_XIX_SAM_XIX_SC_711_VC_IoT_XIX_Softwareblock_XIX_ICAS1_X_Sys_Java_02_XIX_BCM_FS_Multif_Taster
    delegate Druckpunktmassage_fuer_Fahrersitz_Lehnenmassage_SAM_XIX_DPMFSLM_XIX_SAM.SP_IF_BCM_FS_Pneumatik_Verstellung_XIX_Druckpunktmassage_fuer_Fahrersitz_Lehnenmassage_SAM_XIX_DPMFSLM_XIX_SAM <-> outer port SP_IF_BCM_FS_Pneumatik_Verstellung_XIX_SAM  # _XIX_Druckpunktmassage_fuer_Fahrersitz_Lehnenmassage_SAM_XIX_DPMFSLM_XIX_SAM_XIX_SC_711_VC_IoT_XIX_Softwareblock_XIX_ICAS1_X_Sys_Java_02_XIX_BCM_FS_Pneumatik_Verstellung
    delegate Grundumfang_XIX_SAM.SP_IF_BCM_FS_PreCrash_XIX_Grundumfang_XIX_SAM <-> outer port SP_IF_BCM_FS_PreCrash_XIX_SAM
    delegate Druckpunktmassage_fuer_Fahrersitz_Lehnenmassage_SAM_XIX_DPMFSLM_XIX_SAM.SP_IF_BCM_FS_Programmwippe_XIX_Druckpunktmassage_fuer_Fahrersitz_Lehnenmassage_SAM_XIX_DPMFSLM_XIX_SAM <-> outer port SP_IF_BCM_FS_Programmwippe_XIX_SAM  # _XIX_Druckpunktmassage_fuer_Fahrersitz_Lehnenmassage_SAM_XIX_DPMFSLM_XIX_SAM_XIX_SC_711_VC_IoT_XIX_Softwareblock_XIX_ICAS1_X_Sys_Java_02_XIX_BCM_FS_Programmwippe
    delegate Grundumfang_XIX_SAM.SP_IF_BCM_FS_SW_eng_XIX_Grundumfang_XIX_SAM <-> outer port SP_IF_BCM_FS_SW_eng_XIX_SAM
    delegate Grundumfang_XIX_SAM.SP_IF_BCM_FS_SW_weit_XIX_Grundumfang_XIX_SAM <-> outer port SP_IF_BCM_FS_SW_weit_XIX_SAM
    delegate Druckpunktmassage_fuer_Fahrersitz_Lehnenmassage_SAM_XIX_DPMFSLM_XIX_SAM.SP_IF_BCM_FS_Wellness_Status_XIX_Druckpunktmassage_fuer_Fahrersitz_Lehnenmassage_SAM_XIX_DPMFSLM_XIX_SAM <-> outer port SP_IF_BCM_FS_Wellness_Status_XIX_SAM  # _XIX_Druckpunktmassage_fuer_Fahrersitz_Lehnenmassage_SAM_XIX_DPMFSLM_XIX_SAM_XIX_Grundumfang_XIX_SPR_FS_XIX_BCM_FS_Wellness_Status
    delegate Grundumfang_XIX_SAM.SP_IF_BCM_FT_geoeffnet_plaus_XIX_Grundumfang_XIX_SAM <-> outer port SP_IF_BCM_FT_geoeffnet_plaus_XIX_SAM
    delegate Grundumfang_XIX_SAM.SP_IF_BCM_Kennung_RL_Fzg_XIX_Grundumfang_XIX_SAM <-> outer port SP_IF_BCM_Kennung_RL_Fzg_XIX_SAM
    delegate ZV_XIX_SAM.SP_IF_BCM_KiSi_Umschalt_gesperrt_XIX_ZV_XIX_SAM <-> outer port SP_IF_BCM_KiSi_Umschalt_gesperrt_XIX_SAM
    delegate Grundumfang_XIX_SAM.SP_IF_BCM_Komfortfkt_Freigabe_XIX_Grundumfang_XIX_SAM <-> outer port SP_IF_BCM_Komfortfkt_Freigabe_XIX_SAM
    delegate Grundumfang_XIX_SAM.SP_IF_BCM_Kuehlmittel_Sensor_XIX_Grundumfang_XIX_SAM <-> outer port SP_IF_BCM_Kuehlmittel_Sensor_XIX_SAM
    delegate Grundumfang_XIX_SAM.SP_IF_BCM_LINDa_Toggle_XIX_Grundumfang_XIX_SAM <-> outer port SP_IF_BCM_LINDa_Toggle_XIX_SAM
    delegate Grundumfang_XIX_SAM.SP_IF_BCM_LRH_Taster_XIX_Grundumfang_XIX_SAM <-> outer port SP_IF_BCM_LRH_Taster_XIX_SAM
    delegate Grundumfang_XIX_SAM.SP_IF_BCM_P_Mode_aktiv_XIX_Grundumfang_XIX_SAM <-> outer port SP_IF_BCM_P_Mode_aktiv_XIX_SAM
    delegate Grundumfang_XIX_SAM.SP_IF_BCM_P_Mode_FH_Kl15_aus_aktiv_XIX_Grundumfang_XIX_SAM <-> outer port SP_IF_BCM_P_Mode_FH_Kl15_aus_aktiv_XIX_SAM
    delegate Grundumfang_XIX_SAM.SP_IF_BCM_P_Mode_FH_Reversierschwelle_XIX_Grundumfang_XIX_SAM <-> outer port SP_IF_BCM_P_Mode_FH_Reversierschwelle_XIX_SAM
    delegate Grundumfang_XIX_SAM.SP_IF_BCM_RACE_Mode_aktiv_XIX_Grundumfang_XIX_SAM <-> outer port SP_IF_BCM_RACE_Mode_aktiv_XIX_SAM
    delegate Grundumfang_XIX_SAM.SP_IF_BCM_RGB_Adressierungsart_XIX_Grundumfang_XIX_SAM <-> outer port SP_IF_BCM_RGB_Adressierungsart_XIX_SAM
    delegate Grundumfang_XIX_SAM.SP_IF_BCM_RGB_Bewertung_Dimmzeit_XIX_Grundumfang_XIX_SAM <-> outer port SP_IF_BCM_RGB_Bewertung_Dimmzeit_XIX_SAM
    delegate Grundumfang_XIX_SAM.SP_IF_BCM_RGB_Blau_XIX_Grundumfang_XIX_SAM <-> outer port SP_IF_BCM_RGB_Blau_XIX_SAM
    delegate Grundumfang_XIX_SAM.SP_IF_BCM_RGB_Dimmrampe_XIX_Grundumfang_XIX_SAM <-> outer port SP_IF_BCM_RGB_Dimmrampe_XIX_SAM
    delegate Grundumfang_XIX_SAM.SP_IF_BCM_RGB_Dimmzeit_Zeitbasis_XIX_Grundumfang_XIX_SAM <-> outer port SP_IF_BCM_RGB_Dimmzeit_Zeitbasis_XIX_SAM
    delegate Grundumfang_XIX_SAM.SP_IF_BCM_RGB_Gruen_XIX_Grundumfang_XIX_SAM <-> outer port SP_IF_BCM_RGB_Gruen_XIX_SAM
    delegate Grundumfang_XIX_SAM.SP_IF_BCM_RGB_Gueltigkeit_XIX_Grundumfang_XIX_SAM <-> outer port SP_IF_BCM_RGB_Gueltigkeit_XIX_SAM
    delegate Grundumfang_XIX_SAM.SP_IF_BCM_RGB_Intensitaet_XIX_Grundumfang_XIX_SAM <-> outer port SP_IF_BCM_RGB_Intensitaet_XIX_SAM
    delegate Grundumfang_XIX_SAM.SP_IF_BCM_RGB_Normierung_Intensitaet_XIX_Grundumfang_XIX_SAM <-> outer port SP_IF_BCM_RGB_Normierung_Intensitaet_XIX_SAM
    delegate Grundumfang_XIX_SAM.SP_IF_BCM_RGB_Rot_XIX_Grundumfang_XIX_SAM <-> outer port SP_IF_BCM_RGB_Rot_XIX_SAM
    delegate Grundumfang_XIX_SAM.SP_IF_BCM_RGB_Slave_Adresse_XIX_Grundumfang_XIX_SAM <-> outer port SP_IF_BCM_RGB_Slave_Adresse_XIX_SAM
    delegate Grundumfang_XIX_SAM.SP_IF_BCM_RGB_Sonderfunktion_XIX_Grundumfang_XIX_SAM <-> outer port SP_IF_BCM_RGB_Sonderfunktion_XIX_SAM
    delegate Grundumfang_XIX_SAM.SP_IF_BCM_SBE_XIX_Grundumfang_XIX_SAM <-> outer port SP_IF_BCM_SBE_XIX_SAM
    delegate Grundumfang_XIX_SAM.SP_IF_BCM_SGT_Pumpe_BFS_XIX_Grundumfang_XIX_SAM <-> outer port SP_IF_BCM_SGT_Pumpe_BFS_XIX_SAM
    delegate Grundumfang_XIX_SAM.SP_IF_BCM_SGT_Pumpe_FS_XIX_Grundumfang_XIX_SAM <-> outer port SP_IF_BCM_SGT_Pumpe_FS_XIX_SAM
    delegate Grundumfang_XIX_SAM.SP_IF_BCM_SPR_Nachregelung_Freigabe_XIX_Grundumfang_XIX_SAM <-> outer port SP_IF_BCM_SPR_Nachregelung_Freigabe_XIX_SAM
    delegate Grundumfang_XIX_SAM.SP_IF_BCM_Systemfunkionstest_BFS_XIX_Grundumfang_XIX_SAM <-> outer port SP_IF_BCM_Systemfunkionstest_BFS_XIX_SAM
    delegate Grundumfang_XIX_SAM.SP_IF_BCM_Systemfunkionstest_FS_XIX_Grundumfang_XIX_SAM <-> outer port SP_IF_BCM_Systemfunkionstest_FS_XIX_SAM
    delegate Grundumfang_XIX_SAM.SP_IF_BCM_Tankklappensteller_Fehler_XIX_Grundumfang_XIX_SAM <-> outer port SP_IF_BCM_Tankklappensteller_Fehler_XIX_SAM
    delegate Grundumfang_XIX_SAM.SP_IF_BCM_Waschwasser_Sensor_XIX_Grundumfang_XIX_SAM <-> outer port SP_IF_BCM_Waschwasser_Sensor_XIX_SAM  # _XIX_Grundumfang_XIX_SAM_XIX_SC_1488_SC_ComServFlex_HKeep_XIX_Softwareblock_XIX_ICAS1_X_SWCL_Housekeeping_XIX_BCM_Waschwasser_Sensor
    delegate Grundumfang_XIX_SAM.SP_IF_BCM_Wischer_Parklage_XIX_Grundumfang_XIX_SAM <-> outer port SP_IF_BCM_Wischer_Parklage_XIX_SAM
    delegate Grundumfang_XIX_SAM.SP_IF_Bel_DiETa_Car_XIX_Grundumfang_XIX_SAM <-> outer port SP_IF_Bel_DiETa_Car_XIX_SAM
    delegate Grundumfang_XIX_SAM.SP_IF_Bel_DiETa_Lock_Unlock_XIX_Grundumfang_XIX_SAM <-> outer port SP_IF_Bel_DiETa_Lock_Unlock_XIX_SAM
    delegate Grundumfang_XIX_SAM.SP_IF_Bel_LiSi_Defrost_XIX_Grundumfang_XIX_SAM <-> outer port SP_IF_Bel_LiSi_Defrost_XIX_SAM
    delegate Grundumfang_XIX_SAM.SP_IF_Bel_LiSi_FSH_XIX_Grundumfang_XIX_SAM <-> outer port SP_IF_Bel_LiSi_FSH_XIX_SAM
    delegate Grundumfang_XIX_SAM.SP_IF_Bel_LiSi_HSH_XIX_Grundumfang_XIX_SAM <-> outer port SP_IF_Bel_LiSi_HSH_XIX_SAM
    delegate ABL_XIX_SAM.SP_IF_BH_Blinker_Fehler_XIX_ABL_XIX_SAM <-> outer port SP_IF_BH_Blinker_Fehler_XIX_SAM
    delegate Grundumfang_XIX_SAM.SP_IF_BH_Blinker_Fehler_XIX_Grundumfang_XIX_SAM <-> outer port SP_IF_BH_Blinker_Fehler_XIX_SAM
    delegate ABL_XIX_SAM.SP_IF_BH_Blinker_li_XIX_ABL_XIX_SAM <-> outer port SP_IF_BH_Blinker_li_XIX_SAM
    delegate Grundumfang_XIX_SAM.SP_IF_BH_Blinker_li_XIX_Grundumfang_XIX_SAM <-> outer port SP_IF_BH_Blinker_li_XIX_SAM
    delegate ABL_XIX_SAM.SP_IF_BH_Blinker_re_XIX_ABL_XIX_SAM <-> outer port SP_IF_BH_Blinker_re_XIX_SAM
    delegate Grundumfang_XIX_SAM.SP_IF_BH_Blinker_re_XIX_Grundumfang_XIX_SAM <-> outer port SP_IF_BH_Blinker_re_XIX_SAM
    delegate ABL_XIX_SAM.SP_IF_BH_Fernlicht_XIX_ABL_XIX_SAM <-> outer port SP_IF_BH_Fernlicht_XIX_SAM
    delegate Grundumfang_XIX_SAM.SP_IF_BH_Fernlicht_XIX_Grundumfang_XIX_SAM <-> outer port SP_IF_BH_Fernlicht_XIX_SAM
    delegate ABL_XIX_SAM.SP_IF_BH_Lichthupe_XIX_ABL_XIX_SAM <-> outer port SP_IF_BH_Lichthupe_XIX_SAM
    delegate Grundumfang_XIX_SAM.SP_IF_BH_Lichthupe_XIX_Grundumfang_XIX_SAM <-> outer port SP_IF_BH_Lichthupe_XIX_SAM
    delegate ABL_XIX_SAM.SP_IF_BRL_Bremslicht_Schalter_XIX_ABL_XIX_SAM <-> outer port SP_IF_BRL_Bremslicht_Schalter_XIX_SAM
    delegate Grundumfang_XIX_SAM.SP_IF_BRL_Bremslicht_Schalter_XIX_Grundumfang_XIX_SAM <-> outer port SP_IF_BRL_Bremslicht_Schalter_XIX_SAM
    delegate Grundumfang_XIX_SAM.SP_IF_Deaktivierung_RS_XIX_Grundumfang_XIX_SAM <-> outer port SP_IF_Deaktivierung_RS_XIX_SAM
    delegate Grundumfang_XIX_SAM.SP_IF_DI_KL_58xd_XIX_Grundumfang_XIX_SAM <-> outer port SP_IF_DI_KL_58xd_XIX_SAM
    delegate Grundumfang_XIX_SAM.SP_IF_DI_KL_58xs_XIX_Grundumfang_XIX_SAM <-> outer port SP_IF_DI_KL_58xs_XIX_SAM
    delegate Grundumfang_XIX_SAM.SP_IF_Empfindlichkeit_LS_XIX_Grundumfang_XIX_SAM <-> outer port SP_IF_Empfindlichkeit_LS_XIX_SAM
    delegate Grundumfang_XIX_SAM.SP_IF_Empfindlichkeit_RS_XIX_Grundumfang_XIX_SAM <-> outer port SP_IF_Empfindlichkeit_RS_XIX_SAM
    delegate Grundumfang_XIX_SAM.SP_IF_ESP_v_Signal_8Bit_XIX_Grundumfang_XIX_SAM <-> outer port SP_IF_ESP_v_Signal_8Bit_XIX_SAM
    delegate Grundumfang_XIX_SAM.SP_IF_ESP_v_Signal_XIX_Grundumfang_XIX_SAM <-> outer port SP_IF_ESP_v_Signal_XIX_SAM
    delegate Grundumfang_XIX_SAM.SP_IF_FAS_Profile_Taster_XIX_Grundumfang_XIX_SAM <-> outer port SP_IF_FAS_Profile_Taster_XIX_SAM
    delegate Grundumfang_XIX_SAM.SP_IF_FAS_Taster_Fehler_XIX_Grundumfang_XIX_SAM <-> outer port SP_IF_FAS_Taster_Fehler_XIX_SAM
    delegate Grundumfang_XIX_SAM.SP_IF_FAS_Taster_XIX_Grundumfang_XIX_SAM <-> outer port SP_IF_FAS_Taster_XIX_SAM
    delegate Grundumfang_XIX_SAM.SP_IF_FHSG_MST_Architektur_XIX_Grundumfang_XIX_SAM <-> outer port SP_IF_FHSG_MST_Architektur_XIX_SAM
    delegate Grundumfang_XIX_SAM.SP_IF_FHSG_MST_Aussentemp_ungefiltert_XIX_Grundumfang_XIX_SAM <-> outer port SP_IF_FHSG_MST_Aussentemp_ungefiltert_XIX_SAM
    delegate Grundumfang_XIX_SAM.SP_IF_FHSG_MST_BT_Blockerwartung_XIX_Grundumfang_XIX_SAM <-> outer port SP_IF_FHSG_MST_BT_Blockerwartung_XIX_SAM
    delegate Grundumfang_XIX_SAM.SP_IF_FHSG_MST_Crashfall_erkannt_XIX_Grundumfang_XIX_SAM <-> outer port SP_IF_FHSG_MST_Crashfall_erkannt_XIX_SAM
    delegate Grundumfang_XIX_SAM.SP_IF_FHSG_MST_FH_HBFS_AutoHoch_XIX_Grundumfang_XIX_SAM <-> outer port SP_IF_FHSG_MST_FH_HBFS_AutoHoch_XIX_SAM
    delegate Grundumfang_XIX_SAM.SP_IF_FHSG_MST_FH_HBFS_AutoTief_XIX_Grundumfang_XIX_SAM <-> outer port SP_IF_FHSG_MST_FH_HBFS_AutoTief_XIX_SAM
    delegate Grundumfang_XIX_SAM.SP_IF_FHSG_MST_FH_HBFS_ManHoch_XIX_Grundumfang_XIX_SAM <-> outer port SP_IF_FHSG_MST_FH_HBFS_ManHoch_XIX_SAM
    delegate Grundumfang_XIX_SAM.SP_IF_FHSG_MST_FH_HBFS_ManTief_XIX_Grundumfang_XIX_SAM <-> outer port SP_IF_FHSG_MST_FH_HBFS_ManTief_XIX_SAM
    delegate Grundumfang_XIX_SAM.SP_IF_FHSG_MST_FH_HFS_AutoHoch_XIX_Grundumfang_XIX_SAM <-> outer port SP_IF_FHSG_MST_FH_HFS_AutoHoch_XIX_SAM
    delegate Grundumfang_XIX_SAM.SP_IF_FHSG_MST_FH_HFS_AutoTief_XIX_Grundumfang_XIX_SAM <-> outer port SP_IF_FHSG_MST_FH_HFS_AutoTief_XIX_SAM
    delegate Grundumfang_XIX_SAM.SP_IF_FHSG_MST_FH_HFS_ManHoch_XIX_Grundumfang_XIX_SAM <-> outer port SP_IF_FHSG_MST_FH_HFS_ManHoch_XIX_SAM
    delegate Grundumfang_XIX_SAM.SP_IF_FHSG_MST_FH_HFS_ManTief_XIX_Grundumfang_XIX_SAM <-> outer port SP_IF_FHSG_MST_FH_HFS_ManTief_XIX_SAM
    delegate Grundumfang_XIX_SAM.SP_IF_FHSG_MST_FH_KomfortHoch_XIX_Grundumfang_XIX_SAM <-> outer port SP_IF_FHSG_MST_FH_KomfortHoch_XIX_SAM
    delegate Grundumfang_XIX_SAM.SP_IF_FHSG_MST_FH_Komforttief_XIX_Grundumfang_XIX_SAM <-> outer port SP_IF_FHSG_MST_FH_Komforttief_XIX_SAM
    delegate Grundumfang_XIX_SAM.SP_IF_FHSG_MST_FT_Blockerwartung_XIX_Grundumfang_XIX_SAM <-> outer port SP_IF_FHSG_MST_FT_Blockerwartung_XIX_SAM
    delegate Grundumfang_XIX_SAM.SP_IF_FHSG_MST_FT_FH_H_Kisi_ein_XIX_Grundumfang_XIX_SAM <-> outer port SP_IF_FHSG_MST_FT_FH_H_Kisi_ein_XIX_SAM
    delegate Grundumfang_XIX_SAM.SP_IF_FHSG_MST_HBFS_Blockerwartung_XIX_Grundumfang_XIX_SAM <-> outer port SP_IF_FHSG_MST_HBFS_Blockerwartung_XIX_SAM
    delegate Grundumfang_XIX_SAM.SP_IF_FHSG_MST_HFS_Blockerwartung_XIX_Grundumfang_XIX_SAM <-> outer port SP_IF_FHSG_MST_HFS_Blockerwartung_XIX_SAM
    delegate Grundumfang_XIX_SAM.SP_IF_FHSG_MST_Lenkigkeit_XIX_Grundumfang_XIX_SAM <-> outer port SP_IF_FHSG_MST_Lenkigkeit_XIX_SAM
    delegate Grundumfang_XIX_SAM.SP_IF_FHSG_MST_Precrash_XIX_Grundumfang_XIX_SAM <-> outer port SP_IF_FHSG_MST_Precrash_XIX_SAM
    delegate Grundumfang_XIX_SAM.SP_IF_Fronthaube_geoeffnet_XIX_Grundumfang_XIX_SAM <-> outer port SP_IF_Fronthaube_geoeffnet_XIX_SAM
    delegate Grundumfang_XIX_SAM.SP_IF_FS_Luftfeuchte_rel_XIX_Grundumfang_XIX_SAM <-> outer port SP_IF_FS_Luftfeuchte_rel_XIX_SAM
    delegate Grundumfang_XIX_SAM.SP_IF_FS_ResponseError_XIX_Grundumfang_XIX_SAM <-> outer port SP_IF_FS_ResponseError_XIX_SAM
    delegate Grundumfang_XIX_SAM.SP_IF_FS_Taupunkt_XIX_Grundumfang_XIX_SAM <-> outer port SP_IF_FS_Taupunkt_XIX_SAM
    delegate Grundumfang_XIX_SAM.SP_IF_FS_Temp_Scheibe_XIX_Grundumfang_XIX_SAM <-> outer port SP_IF_FS_Temp_Scheibe_XIX_SAM
    delegate Grundumfang_XIX_SAM.SP_IF_FS_Temp_Sensor_XIX_Grundumfang_XIX_SAM <-> outer port SP_IF_FS_Temp_Sensor_XIX_SAM
    delegate Grundumfang_XIX_SAM.SP_IF_HBFS_FH_Bew_hoch_XIX_Grundumfang_XIX_SAM <-> outer port SP_IF_HBFS_FH_Bew_hoch_XIX_SAM
    delegate Grundumfang_XIX_SAM.SP_IF_HBFS_FH_Bew_tief_XIX_Grundumfang_XIX_SAM <-> outer port SP_IF_HBFS_FH_Bew_tief_XIX_SAM
    delegate Grundumfang_XIX_SAM.SP_IF_HBFS_FH_Block_XIX_Grundumfang_XIX_SAM <-> outer port SP_IF_HBFS_FH_Block_XIX_SAM
    delegate Grundumfang_XIX_SAM.SP_IF_HBFS_FH_Fang_XIX_Grundumfang_XIX_SAM <-> outer port SP_IF_HBFS_FH_Fang_XIX_SAM
    delegate Grundumfang_XIX_SAM.SP_IF_HBFS_FH_normiert_XIX_Grundumfang_XIX_SAM <-> outer port SP_IF_HBFS_FH_normiert_XIX_SAM
    delegate Grundumfang_XIX_SAM.SP_IF_HBFS_FH_Oeffnung_XIX_Grundumfang_XIX_SAM <-> outer port SP_IF_HBFS_FH_Oeffnung_XIX_SAM
    delegate Grundumfang_XIX_SAM.SP_IF_HBFS_FH_S_AutoHoch_XIX_Grundumfang_XIX_SAM <-> outer port SP_IF_HBFS_FH_S_AutoHoch_XIX_SAM
    delegate Grundumfang_XIX_SAM.SP_IF_HBFS_FH_S_AutoTief_XIX_Grundumfang_XIX_SAM <-> outer port SP_IF_HBFS_FH_S_AutoTief_XIX_SAM
    delegate Grundumfang_XIX_SAM.SP_IF_HBFS_FH_S_ManHoch_XIX_Grundumfang_XIX_SAM <-> outer port SP_IF_HBFS_FH_S_ManHoch_XIX_SAM
    delegate Grundumfang_XIX_SAM.SP_IF_HBFS_FH_S_ManTief_XIX_Grundumfang_XIX_SAM <-> outer port SP_IF_HBFS_FH_S_ManTief_XIX_SAM
    delegate Grundumfang_XIX_SAM.SP_IF_HBFS_FH_Thermo_XIX_Grundumfang_XIX_SAM <-> outer port SP_IF_HBFS_FH_Thermo_XIX_SAM
    delegate Grundumfang_XIX_SAM.SP_IF_HBFS_gesafet_XIX_Grundumfang_XIX_SAM <-> outer port SP_IF_HBFS_gesafet_XIX_SAM
    delegate Grundumfang_XIX_SAM.SP_IF_HBFS_KiSi_Fehler_XIX_Grundumfang_XIX_SAM <-> outer port SP_IF_HBFS_KiSi_Fehler_XIX_SAM
    delegate Grundumfang_XIX_SAM.SP_IF_HBFS_Lock_Taster_inv_XIX_Grundumfang_XIX_SAM <-> outer port SP_IF_HBFS_Lock_Taster_inv_XIX_SAM
    delegate Grundumfang_XIX_SAM.SP_IF_HBFS_Oben_Block_erw_XIX_Grundumfang_XIX_SAM <-> outer port SP_IF_HBFS_Oben_Block_erw_XIX_SAM
    delegate Grundumfang_XIX_SAM.SP_IF_HBFS_Seitenrollo_hoch_XIX_Grundumfang_XIX_SAM <-> outer port SP_IF_HBFS_Seitenrollo_hoch_XIX_SAM
    delegate Grundumfang_XIX_SAM.SP_IF_HBFS_Seitenrollo_tief_XIX_Grundumfang_XIX_SAM <-> outer port SP_IF_HBFS_Seitenrollo_tief_XIX_SAM
    delegate Grundumfang_XIX_SAM.SP_IF_HBFS_SK_betaetigt_XIX_Grundumfang_XIX_SAM <-> outer port SP_IF_HBFS_SK_betaetigt_XIX_SAM
    delegate Grundumfang_XIX_SAM.SP_IF_HBFS_Sperrklinke_XIX_Grundumfang_XIX_SAM <-> outer port SP_IF_HBFS_Sperrklinke_XIX_SAM
    delegate Grundumfang_XIX_SAM.SP_IF_HBFS_Status_KiSi_inv_XIX_Grundumfang_XIX_SAM <-> outer port SP_IF_HBFS_Status_KiSi_inv_XIX_SAM
    delegate Grundumfang_XIX_SAM.SP_IF_HBFS_Status_KiSi_XIX_Grundumfang_XIX_SAM <-> outer port SP_IF_HBFS_Status_KiSi_XIX_SAM
    delegate Grundumfang_XIX_SAM.SP_IF_HBFS_TAG_betaetigt_XIX_Grundumfang_XIX_SAM <-> outer port SP_IF_HBFS_TAG_betaetigt_XIX_SAM
    delegate Grundumfang_XIX_SAM.SP_IF_HBFS_TCR_Mode_aktiv_XIX_Grundumfang_XIX_SAM <-> outer port SP_IF_HBFS_TCR_Mode_aktiv_XIX_SAM
    delegate Grundumfang_XIX_SAM.SP_IF_HBFS_TIG_betaetigt_oeffnen_XIX_Grundumfang_XIX_SAM <-> outer port SP_IF_HBFS_TIG_betaetigt_oeffnen_XIX_SAM
    delegate Grundumfang_XIX_SAM.SP_IF_HBFS_TIG_betaetigt_schliessen_XIX_Grundumfang_XIX_SAM <-> outer port SP_IF_HBFS_TIG_betaetigt_schliessen_XIX_SAM
    delegate Grundumfang_XIX_SAM.SP_IF_HBFS_TIG_betaetigt_XIX_Grundumfang_XIX_SAM <-> outer port SP_IF_HBFS_TIG_betaetigt_XIX_SAM
    delegate Grundumfang_XIX_SAM.SP_IF_HBFS_Tuer_geoeffnet_XIX_Grundumfang_XIX_SAM <-> outer port SP_IF_HBFS_Tuer_geoeffnet_XIX_SAM
    delegate Grundumfang_XIX_SAM.SP_IF_HBFS_Tuer_Status_XIX_Grundumfang_XIX_SAM <-> outer port SP_IF_HBFS_Tuer_Status_XIX_SAM
    delegate Grundumfang_XIX_SAM.SP_IF_HBFS_Tuerschloss_defekt_XIX_Grundumfang_XIX_SAM <-> outer port SP_IF_HBFS_Tuerschloss_defekt_XIX_SAM
    delegate Grundumfang_XIX_SAM.SP_IF_HBFS_UEKB_aktiviert_XIX_Grundumfang_XIX_SAM <-> outer port SP_IF_HBFS_UEKB_aktiviert_XIX_SAM
    delegate Grundumfang_XIX_SAM.SP_IF_HBFS_Unten_Block_erw_XIX_Grundumfang_XIX_SAM <-> outer port SP_IF_HBFS_Unten_Block_erw_XIX_SAM
    delegate Grundumfang_XIX_SAM.SP_IF_HBFS_verriegelt_XIX_Grundumfang_XIX_SAM <-> outer port SP_IF_HBFS_verriegelt_XIX_SAM
    delegate Grundumfang_XIX_SAM.SP_IF_HBFS_Vorraste_betaetigt_XIX_Grundumfang_XIX_SAM <-> outer port SP_IF_HBFS_Vorraste_betaetigt_XIX_SAM
    delegate Grundumfang_XIX_SAM.SP_IF_HD_Hauptraste_Auth_XIX_Grundumfang_XIX_SAM <-> outer port SP_IF_HD_Hauptraste_Auth_XIX_SAM
    delegate Grundumfang_XIX_SAM.SP_IF_HD_Hauptraste_XIX_Grundumfang_XIX_SAM <-> outer port SP_IF_HD_Hauptraste_XIX_SAM
    delegate Grundumfang_XIX_SAM.SP_IF_HD_Vorraste_Auth_XIX_Grundumfang_XIX_SAM <-> outer port SP_IF_HD_Vorraste_Auth_XIX_SAM
    delegate Grundumfang_XIX_SAM.SP_IF_HD_Vorraste_XIX_Grundumfang_XIX_SAM <-> outer port SP_IF_HD_Vorraste_XIX_SAM
    delegate Grundumfang_XIX_SAM.SP_IF_HFS_FH_Bew_hoch_XIX_Grundumfang_XIX_SAM <-> outer port SP_IF_HFS_FH_Bew_hoch_XIX_SAM
    delegate Grundumfang_XIX_SAM.SP_IF_HFS_FH_Bew_tief_XIX_Grundumfang_XIX_SAM <-> outer port SP_IF_HFS_FH_Bew_tief_XIX_SAM
    delegate Grundumfang_XIX_SAM.SP_IF_HFS_FH_Block_XIX_Grundumfang_XIX_SAM <-> outer port SP_IF_HFS_FH_Block_XIX_SAM
    delegate Grundumfang_XIX_SAM.SP_IF_HFS_FH_Fang_XIX_Grundumfang_XIX_SAM <-> outer port SP_IF_HFS_FH_Fang_XIX_SAM
    delegate Grundumfang_XIX_SAM.SP_IF_HFS_FH_normiert_XIX_Grundumfang_XIX_SAM <-> outer port SP_IF_HFS_FH_normiert_XIX_SAM
    delegate Grundumfang_XIX_SAM.SP_IF_HFS_FH_Oeffnung_XIX_Grundumfang_XIX_SAM <-> outer port SP_IF_HFS_FH_Oeffnung_XIX_SAM
    delegate Grundumfang_XIX_SAM.SP_IF_HFS_FH_S_AutoHoch_XIX_Grundumfang_XIX_SAM <-> outer port SP_IF_HFS_FH_S_AutoHoch_XIX_SAM
    delegate Grundumfang_XIX_SAM.SP_IF_HFS_FH_S_AutoTief_XIX_Grundumfang_XIX_SAM <-> outer port SP_IF_HFS_FH_S_AutoTief_XIX_SAM
    delegate Grundumfang_XIX_SAM.SP_IF_HFS_FH_S_ManHoch_XIX_Grundumfang_XIX_SAM <-> outer port SP_IF_HFS_FH_S_ManHoch_XIX_SAM
    delegate Grundumfang_XIX_SAM.SP_IF_HFS_FH_S_ManTief_XIX_Grundumfang_XIX_SAM <-> outer port SP_IF_HFS_FH_S_ManTief_XIX_SAM
    delegate Grundumfang_XIX_SAM.SP_IF_HFS_FH_Thermo_XIX_Grundumfang_XIX_SAM <-> outer port SP_IF_HFS_FH_Thermo_XIX_SAM
    delegate Grundumfang_XIX_SAM.SP_IF_HFS_gesafet_XIX_Grundumfang_XIX_SAM <-> outer port SP_IF_HFS_gesafet_XIX_SAM
    delegate Grundumfang_XIX_SAM.SP_IF_HFS_Heckrollotaster_betaetigt_XIX_Grundumfang_XIX_SAM <-> outer port SP_IF_HFS_Heckrollotaster_betaetigt_XIX_SAM
    delegate Grundumfang_XIX_SAM.SP_IF_HFS_KiSi_Fehler_XIX_Grundumfang_XIX_SAM <-> outer port SP_IF_HFS_KiSi_Fehler_XIX_SAM
    delegate ZV_XIX_SAM.SP_IF_HFS_Lock_Taster_inv_XIX_ZV_XIX_SAM <-> outer port SP_IF_HFS_Lock_Taster_inv_XIX_SAM
    delegate Grundumfang_XIX_SAM.SP_IF_HFS_Oben_Block_erw_XIX_Grundumfang_XIX_SAM <-> outer port SP_IF_HFS_Oben_Block_erw_XIX_SAM
    delegate Grundumfang_XIX_SAM.SP_IF_HFS_Seitenrollo_hoch_XIX_Grundumfang_XIX_SAM <-> outer port SP_IF_HFS_Seitenrollo_hoch_XIX_SAM
    delegate Grundumfang_XIX_SAM.SP_IF_HFS_Seitenrollo_tief_XIX_Grundumfang_XIX_SAM <-> outer port SP_IF_HFS_Seitenrollo_tief_XIX_SAM
    delegate Grundumfang_XIX_SAM.SP_IF_HFS_SK_betaetigt_XIX_Grundumfang_XIX_SAM <-> outer port SP_IF_HFS_SK_betaetigt_XIX_SAM
    delegate Grundumfang_XIX_SAM.SP_IF_HFS_Status_KiSi_XIX_Grundumfang_XIX_SAM <-> outer port SP_IF_HFS_Status_KiSi_XIX_SAM
    delegate Grundumfang_XIX_SAM.SP_IF_HFS_TAG_betaetigt_XIX_Grundumfang_XIX_SAM <-> outer port SP_IF_HFS_TAG_betaetigt_XIX_SAM
    delegate Grundumfang_XIX_SAM.SP_IF_HFS_TCR_Mode_aktiv_XIX_Grundumfang_XIX_SAM <-> outer port SP_IF_HFS_TCR_Mode_aktiv_XIX_SAM
    delegate Grundumfang_XIX_SAM.SP_IF_HFS_TIG_betaetigt_oeffnen_XIX_Grundumfang_XIX_SAM <-> outer port SP_IF_HFS_TIG_betaetigt_oeffnen_XIX_SAM
    delegate Grundumfang_XIX_SAM.SP_IF_HFS_TIG_betaetigt_schliessen_XIX_Grundumfang_XIX_SAM <-> outer port SP_IF_HFS_TIG_betaetigt_schliessen_XIX_SAM
    delegate Grundumfang_XIX_SAM.SP_IF_HFS_TIG_betaetigt_XIX_Grundumfang_XIX_SAM <-> outer port SP_IF_HFS_TIG_betaetigt_XIX_SAM
    delegate Grundumfang_XIX_SAM.SP_IF_HFS_Tuer_geoeffnet_XIX_Grundumfang_XIX_SAM <-> outer port SP_IF_HFS_Tuer_geoeffnet_XIX_SAM
    delegate Grundumfang_XIX_SAM.SP_IF_HFS_Tuer_Status_QBit_XIX_Grundumfang_XIX_SAM <-> outer port SP_IF_HFS_Tuer_Status_QBit_XIX_SAM
    delegate Grundumfang_XIX_SAM.SP_IF_HFS_Tuer_Status_XIX_Grundumfang_XIX_SAM <-> outer port SP_IF_HFS_Tuer_Status_XIX_SAM
    delegate Grundumfang_XIX_SAM.SP_IF_HFS_Tueroeffnen_Warnung_XIX_Grundumfang_XIX_SAM <-> outer port SP_IF_HFS_Tueroeffnen_Warnung_XIX_SAM
    delegate Grundumfang_XIX_SAM.SP_IF_HFS_Tuerschloss_defekt_XIX_Grundumfang_XIX_SAM <-> outer port SP_IF_HFS_Tuerschloss_defekt_XIX_SAM
    delegate Grundumfang_XIX_SAM.SP_IF_HFS_UEKB_aktiviert_XIX_Grundumfang_XIX_SAM <-> outer port SP_IF_HFS_UEKB_aktiviert_XIX_SAM
    delegate Grundumfang_XIX_SAM.SP_IF_HFS_Unten_Block_erw_XIX_Grundumfang_XIX_SAM <-> outer port SP_IF_HFS_Unten_Block_erw_XIX_SAM
    delegate Grundumfang_XIX_SAM.SP_IF_HFS_verriegelt_XIX_Grundumfang_XIX_SAM <-> outer port SP_IF_HFS_verriegelt_XIX_SAM
    delegate Grundumfang_XIX_SAM.SP_IF_HFS_Vorraste_betaetigt_XIX_Grundumfang_XIX_SAM <-> outer port SP_IF_HFS_Vorraste_betaetigt_XIX_SAM
    delegate Grundumfang_XIX_SAM.SP_IF_HLR_LRH_Freigabe_XIX_Grundumfang_XIX_SAM <-> outer port SP_IF_HLR_LRH_Freigabe_XIX_SAM
    delegate Grundumfang_XIX_SAM.SP_IF_HSH_Status_XIX_Grundumfang_XIX_SAM <-> outer port SP_IF_HSH_Status_XIX_SAM
    delegate Grundumfang_XIX_SAM.SP_IF_HW_Drehfalle_Tuer_HL_Auth_XIX_Grundumfang_XIX_SAM <-> outer port SP_IF_HW_Drehfalle_Tuer_HL_Auth_XIX_SAM
    delegate Grundumfang_XIX_SAM.SP_IF_HW_Drehfalle_Tuer_HL_XIX_Grundumfang_XIX_SAM <-> outer port SP_IF_HW_Drehfalle_Tuer_HL_XIX_SAM
    delegate Grundumfang_XIX_SAM.SP_IF_HW_Drehfalle_Tuer_HR_Auth_XIX_Grundumfang_XIX_SAM <-> outer port SP_IF_HW_Drehfalle_Tuer_HR_Auth_XIX_SAM
    delegate Grundumfang_XIX_SAM.SP_IF_HW_Drehfalle_Tuer_HR_XIX_Grundumfang_XIX_SAM <-> outer port SP_IF_HW_Drehfalle_Tuer_HR_XIX_SAM
    delegate Grundumfang_XIX_SAM.SP_IF_HW_HD_Taste_Innenraum_XIX_Grundumfang_XIX_SAM <-> outer port SP_IF_HW_HD_Taste_Innenraum_XIX_SAM
    delegate ZV_XIX_SAM.SP_IF_HW_HSB_erkannt_XIX_ZV_XIX_SAM <-> outer port SP_IF_HW_HSB_erkannt_XIX_SAM
    delegate Grundumfang_XIX_SAM.SP_IF_HW_Softtouch_betaetigt_XIX_Grundumfang_XIX_SAM <-> outer port SP_IF_HW_Softtouch_betaetigt_XIX_SAM
    delegate Grundumfang_XIX_SAM.SP_IF_HW_Status_Schloss_gesafet_HL_XIX_Grundumfang_XIX_SAM <-> outer port SP_IF_HW_Status_Schloss_gesafet_HL_XIX_SAM
    delegate Grundumfang_XIX_SAM.SP_IF_HW_Status_Schloss_gesafet_HR_XIX_Grundumfang_XIX_SAM <-> outer port SP_IF_HW_Status_Schloss_gesafet_HR_XIX_SAM
    delegate Grundumfang_XIX_SAM.SP_IF_HW_Status_Schloss_safed_HL_Auth_XIX_Grundumfang_XIX_SAM <-> outer port SP_IF_HW_Status_Schloss_safed_HL_Auth_XIX_SAM
    delegate Grundumfang_XIX_SAM.SP_IF_HW_Status_Schloss_safed_HR_Auth_XIX_Grundumfang_XIX_SAM <-> outer port SP_IF_HW_Status_Schloss_safed_HR_Auth_XIX_SAM
    delegate Grundumfang_XIX_SAM.SP_IF_HW_Status_Schloss_verr_HL_Auth_XIX_Grundumfang_XIX_SAM <-> outer port SP_IF_HW_Status_Schloss_verr_HL_Auth_XIX_SAM
    delegate Grundumfang_XIX_SAM.SP_IF_HW_Status_Schloss_verr_HR_Auth_XIX_Grundumfang_XIX_SAM <-> outer port SP_IF_HW_Status_Schloss_verr_HR_Auth_XIX_SAM
    delegate Grundumfang_XIX_SAM.SP_IF_HW_Status_Schloss_verriegelt_HL_XIX_Grundumfang_XIX_SAM <-> outer port SP_IF_HW_Status_Schloss_verriegelt_HL_XIX_SAM
    delegate Grundumfang_XIX_SAM.SP_IF_HW_Status_Schloss_verriegelt_HR_XIX_Grundumfang_XIX_SAM <-> outer port SP_IF_HW_Status_Schloss_verriegelt_HR_XIX_SAM
    delegate ZV_XIX_SAM.SP_IF_HW_Tankdeckel_offen_XIX_ZV_XIX_SAM <-> outer port SP_IF_HW_Tankdeckel_offen_XIX_SAM
    delegate Grundumfang_XIX_SAM.SP_IF_IL_Dachkonsole_Adressat_XIX_Grundumfang_XIX_SAM <-> outer port SP_IF_IL_Dachkonsole_Adressat_XIX_SAM
    delegate SC_708_IuALicht_MEB_XIX_Softwareblock_XIX_SAM.SP_IF_IL_Dachkonsole_Adressat_XIX_SC_708_IuALicht_MEB_XIX_Softwareblock_XIX_SAM <-> outer port SP_IF_IL_Dachkonsole_Adressat_XIX_SAM
    delegate Grundumfang_XIX_SAM.SP_IF_IL_Dachkonsole_Dimmzeit_XIX_Grundumfang_XIX_SAM <-> outer port SP_IF_IL_Dachkonsole_Dimmzeit_XIX_SAM
    delegate SC_708_IuALicht_MEB_XIX_Softwareblock_XIX_SAM.SP_IF_IL_Dachkonsole_Dimmzeit_XIX_SC_708_IuALicht_MEB_XIX_Softwareblock_XIX_SAM <-> outer port SP_IF_IL_Dachkonsole_Dimmzeit_XIX_SAM
    delegate Grundumfang_XIX_SAM.SP_IF_IL_Dachkonsole_Zeitbasis_XIX_Grundumfang_XIX_SAM <-> outer port SP_IF_IL_Dachkonsole_Zeitbasis_XIX_SAM
    delegate SC_708_IuALicht_MEB_XIX_Softwareblock_XIX_SAM.SP_IF_IL_Dachkonsole_Zeitbasis_XIX_SC_708_IuALicht_MEB_XIX_Softwareblock_XIX_SAM <-> outer port SP_IF_IL_Dachkonsole_Zeitbasis_XIX_SAM
    delegate Grundumfang_XIX_SAM.SP_IF_IL_Dachkonsole_Zielhelligkeit_XIX_Grundumfang_XIX_SAM <-> outer port SP_IF_IL_Dachkonsole_Zielhelligkeit_XIX_SAM
    delegate SC_708_IuALicht_MEB_XIX_Softwareblock_XIX_SAM.SP_IF_IL_Dachkonsole_Zielhelligkeit_XIX_SC_708_IuALicht_MEB_XIX_Softwareblock_XIX_SAM <-> outer port SP_IF_IL_Dachkonsole_Zielhelligkeit_XIX_SAM
    delegate Dimmung_XIX_SAM.SP_IF_IL_Innenlicht_aktiv_XIX_Dimmung_XIX_SAM <-> outer port SP_IF_IL_Innenlicht_aktiv_XIX_SAM
    delegate Grundumfang_XIX_SAM.SP_IF_IL_Innenlicht_aktiv_XIX_Grundumfang_XIX_SAM <-> outer port SP_IF_IL_Innenlicht_aktiv_XIX_SAM
    delegate SC_708_IuALicht_MEB_XIX_Softwareblock_XIX_SAM.SP_IF_IL_Innenlicht_aktiv_XIX_SC_708_IuALicht_MEB_XIX_Softwareblock_XIX_SAM <-> outer port SP_IF_IL_Innenlicht_aktiv_XIX_SAM  # _XIX_SC_708_IuALicht_MEB_XIX_Softwareblock_XIX_SAM_XIX_SC_1428_VDCM_XIX_Softwareblock_XIX_Blade_Main_VM_MaaS_XIX_IL_Innenlicht_aktiv
    delegate Grundumfang_XIX_SAM.SP_IF_IL_Klemme_30G_aktiv_XIX_Grundumfang_XIX_SAM <-> outer port SP_IF_IL_Klemme_30G_aktiv_XIX_SAM
    delegate SC_708_IuALicht_MEB_XIX_Softwareblock_XIX_SAM.SP_IF_IL_Klemme_30G_aktiv_XIX_SC_708_IuALicht_MEB_XIX_Softwareblock_XIX_SAM <-> outer port SP_IF_IL_Klemme_30G_aktiv_XIX_SAM  # _XIX_SC_708_IuALicht_MEB_XIX_Softwareblock_XIX_SAM_XIX_SC_70_ZV_Lib_XIX_Softwareblock_XIX_ICAS1_X_Gateway_XIX_IL_Klemme_30G_aktiv
    delegate Grundumfang_XIX_SAM.SP_IF_IL_TSG_BFS_Dimmzeit_{1..4}_XIX_Grundumfang_XIX_SAM <-> outer port SP_IF_IL_TSG_BFS_Dimmzeit_{1..4}_XIX_SAM
    delegate Grundumfang_XIX_SAM.SP_IF_IL_TSG_BFS_Dimmzeit_Basis_{1..4}_XIX_Grundumfang_XIX_SAM <-> outer port SP_IF_IL_TSG_BFS_Dimmzeit_Basis_{1..4}_XIX_SAM
    delegate Grundumfang_XIX_SAM.SP_IF_IL_TSG_BFS_Zielhelligkeit_{1..4}_XIX_Grundumfang_XIX_SAM <-> outer port SP_IF_IL_TSG_BFS_Zielhelligkeit_{1..4}_XIX_SAM
    delegate Grundumfang_XIX_SAM.SP_IF_IL_TSG_FS_Dimmzeit_{1..4}_XIX_Grundumfang_XIX_SAM <-> outer port SP_IF_IL_TSG_FS_Dimmzeit_{1..4}_XIX_SAM
    delegate Grundumfang_XIX_SAM.SP_IF_IL_TSG_FS_Dimmzeit_Basis_{1..4}_XIX_Grundumfang_XIX_SAM <-> outer port SP_IF_IL_TSG_FS_Dimmzeit_Basis_{1..4}_XIX_SAM
    delegate Grundumfang_XIX_SAM.SP_IF_IL_TSG_FS_Zielhelligkeit_{1..4}_XIX_Grundumfang_XIX_SAM <-> outer port SP_IF_IL_TSG_FS_Zielhelligkeit_{1..4}_XIX_SAM
    delegate Grundumfang_XIX_SAM.SP_IF_IL_TSG_HBFS_Dimmzeit_{1..4}_XIX_Grundumfang_XIX_SAM <-> outer port SP_IF_IL_TSG_HBFS_Dimmzeit_{1..4}_XIX_SAM
    delegate Grundumfang_XIX_SAM.SP_IF_IL_TSG_HBFS_Dimmzeit_Basis_{1..4}_XIX_Grundumfang_XIX_SAM <-> outer port SP_IF_IL_TSG_HBFS_Dimmzeit_Basis_{1..4}_XIX_SAM
    delegate Grundumfang_XIX_SAM.SP_IF_IL_TSG_HBFS_Zielhelligkeit_{1..4}_XIX_Grundumfang_XIX_SAM <-> outer port SP_IF_IL_TSG_HBFS_Zielhelligkeit_{1..4}_XIX_SAM
    delegate Grundumfang_XIX_SAM.SP_IF_IL_TSG_HFS_Dimmzeit_{1..4}_XIX_Grundumfang_XIX_SAM <-> outer port SP_IF_IL_TSG_HFS_Dimmzeit_{1..4}_XIX_SAM
    delegate Grundumfang_XIX_SAM.SP_IF_IL_TSG_HFS_Dimmzeit_Basis_{1..4}_XIX_Grundumfang_XIX_SAM <-> outer port SP_IF_IL_TSG_HFS_Dimmzeit_Basis_{1..4}_XIX_SAM
    delegate Grundumfang_XIX_SAM.SP_IF_IL_TSG_HFS_Zielhelligkeit_{1..4}_XIX_Grundumfang_XIX_SAM <-> outer port SP_IF_IL_TSG_HFS_Zielhelligkeit_{1..4}_XIX_SAM
    delegate Grundumfang_XIX_SAM.SP_IF_KL_LRH_Stufe_XIX_Grundumfang_XIX_SAM <-> outer port SP_IF_KL_LRH_Stufe_XIX_SAM
    delegate Grundumfang_XIX_SAM.SP_IF_Klemme_15_XIX_Grundumfang_XIX_SAM <-> outer port SP_IF_Klemme_15_XIX_SAM
    delegate Grundumfang_XIX_SAM.SP_IF_Klemme_X_WWS_XIX_Grundumfang_XIX_SAM <-> outer port SP_IF_Klemme_X_WWS_XIX_SAM
    delegate Grundumfang_XIX_SAM.SP_IF_KN_BCM1_DiagPfad_XIX_Grundumfang_XIX_SAM <-> outer port SP_IF_KN_BCM1_DiagPfad_XIX_SAM  # _XIX_Grundumfang_XIX_SAM_XIX_SC_738_ClassicAUTOSARBasicSoftwareICAS1Gateway_XIX_Softwareblock_XIX_ICAS1_X_Gateway_XIX_KN_BCM1_DiagPfad
    delegate Grundumfang_XIX_SAM.SP_IF_KST_BSW_Fehlermode2_XIX_Grundumfang_XIX_SAM <-> outer port SP_IF_KST_BSW_Fehlermode2_XIX_SAM
    delegate Grundumfang_XIX_SAM.SP_IF_KST_BSW_Klemme_15_HW_Ist_XIX_Grundumfang_XIX_SAM <-> outer port SP_IF_KST_BSW_Klemme_15_HW_Ist_XIX_SAM
    delegate Grundumfang_XIX_SAM.SP_IF_KST_BSW_Klemmenhochschalten_Sper_XIX_Grundumfang_XIX_SAM <-> outer port SP_IF_KST_BSW_Klemmenhochschalten_Sper_XIX_SAM
    delegate Grundumfang_XIX_SAM.SP_IF_KST_BSW_Not_Taster_betaetigt_XIX_Grundumfang_XIX_SAM <-> outer port SP_IF_KST_BSW_Not_Taster_betaetigt_XIX_SAM
    delegate Grundumfang_XIX_SAM.SP_IF_KST_BSW_ZAT_betaetigt_XIX_Grundumfang_XIX_SAM <-> outer port SP_IF_KST_BSW_ZAT_betaetigt_XIX_SAM
    delegate Grundumfang_XIX_SAM.SP_IF_KY_UHF_aktiver_Scantyp_XIX_Grundumfang_XIX_SAM <-> outer port SP_IF_KY_UHF_aktiver_Scantyp_XIX_SAM
    delegate Grundumfang_XIX_SAM.SP_IF_KY_UHF_Bitrate_XIX_Grundumfang_XIX_SAM <-> outer port SP_IF_KY_UHF_Bitrate_XIX_SAM
    delegate Grundumfang_XIX_SAM.SP_IF_KY_UHF_Telegramm_CRCStatus_XIX_Grundumfang_XIX_SAM <-> outer port SP_IF_KY_UHF_Telegramm_CRCStatus_XIX_SAM
    delegate Grundumfang_XIX_SAM.SP_IF_KY_UHF_Transceiver_Modus_XIX_Grundumfang_XIX_SAM <-> outer port SP_IF_KY_UHF_Transceiver_Modus_XIX_SAM
    delegate ABL_XIX_SAM.SP_IF_LH_S_3_Bremsl_def_XIX_ABL_XIX_SAM <-> outer port SP_IF_LH_S_3_Bremsl_def_XIX_SAM
    delegate Grundumfang_XIX_SAM.SP_IF_LH_S_3_Bremsl_def_XIX_Grundumfang_XIX_SAM <-> outer port SP_IF_LH_S_3_Bremsl_def_XIX_SAM
    delegate ABL_XIX_SAM.SP_IF_LH_S_Aussenlicht_def_XIX_ABL_XIX_SAM <-> outer port SP_IF_LH_S_Aussenlicht_def_XIX_SAM
    delegate Grundumfang_XIX_SAM.SP_IF_LH_S_Aussenlicht_def_XIX_Grundumfang_XIX_SAM <-> outer port SP_IF_LH_S_Aussenlicht_def_XIX_SAM
    delegate ABL_XIX_SAM.SP_IF_LH_S_Blinker_li_def_XIX_ABL_XIX_SAM <-> outer port SP_IF_LH_S_Blinker_li_def_XIX_SAM
    delegate Grundumfang_XIX_SAM.SP_IF_LH_S_Blinker_li_def_XIX_Grundumfang_XIX_SAM <-> outer port SP_IF_LH_S_Blinker_li_def_XIX_SAM
    delegate ABL_XIX_SAM.SP_IF_LH_S_Blinker_re_def_XIX_ABL_XIX_SAM <-> outer port SP_IF_LH_S_Blinker_re_def_XIX_SAM
    delegate Grundumfang_XIX_SAM.SP_IF_LH_S_Blinker_re_def_XIX_Grundumfang_XIX_SAM <-> outer port SP_IF_LH_S_Blinker_re_def_XIX_SAM
    delegate ABL_XIX_SAM.SP_IF_LH_S_Brems_Blk_li_def_XIX_ABL_XIX_SAM <-> outer port SP_IF_LH_S_Brems_Blk_li_def_XIX_SAM
    delegate Grundumfang_XIX_SAM.SP_IF_LH_S_Brems_Blk_li_def_XIX_Grundumfang_XIX_SAM <-> outer port SP_IF_LH_S_Brems_Blk_li_def_XIX_SAM
    delegate ABL_XIX_SAM.SP_IF_LH_S_Brems_Blk_re_def_XIX_ABL_XIX_SAM <-> outer port SP_IF_LH_S_Brems_Blk_re_def_XIX_SAM
    delegate Grundumfang_XIX_SAM.SP_IF_LH_S_Brems_Blk_re_def_XIX_Grundumfang_XIX_SAM <-> outer port SP_IF_LH_S_Brems_Blk_re_def_XIX_SAM
    delegate ABL_XIX_SAM.SP_IF_LH_S_Bremsl_li_def_XIX_ABL_XIX_SAM <-> outer port SP_IF_LH_S_Bremsl_li_def_XIX_SAM
    delegate Grundumfang_XIX_SAM.SP_IF_LH_S_Bremsl_li_def_XIX_Grundumfang_XIX_SAM <-> outer port SP_IF_LH_S_Bremsl_li_def_XIX_SAM
    delegate ABL_XIX_SAM.SP_IF_LH_S_Bremsl_li_ges_def_XIX_ABL_XIX_SAM <-> outer port SP_IF_LH_S_Bremsl_li_ges_def_XIX_SAM
    delegate Grundumfang_XIX_SAM.SP_IF_LH_S_Bremsl_li_ges_def_XIX_Grundumfang_XIX_SAM <-> outer port SP_IF_LH_S_Bremsl_li_ges_def_XIX_SAM
    delegate ABL_XIX_SAM.SP_IF_LH_S_Bremsl_re_def_XIX_ABL_XIX_SAM <-> outer port SP_IF_LH_S_Bremsl_re_def_XIX_SAM
    delegate Grundumfang_XIX_SAM.SP_IF_LH_S_Bremsl_re_def_XIX_Grundumfang_XIX_SAM <-> outer port SP_IF_LH_S_Bremsl_re_def_XIX_SAM
    delegate ABL_XIX_SAM.SP_IF_LH_S_Bremsl_re_ges_def_XIX_ABL_XIX_SAM <-> outer port SP_IF_LH_S_Bremsl_re_ges_def_XIX_SAM
    delegate Grundumfang_XIX_SAM.SP_IF_LH_S_Bremsl_re_ges_def_XIX_Grundumfang_XIX_SAM <-> outer port SP_IF_LH_S_Bremsl_re_ges_def_XIX_SAM
    delegate ABL_XIX_SAM.SP_IF_LH_S_Bremslicht_H_aktiv_XIX_ABL_XIX_SAM <-> outer port SP_IF_LH_S_Bremslicht_H_aktiv_XIX_SAM
    delegate Grundumfang_XIX_SAM.SP_IF_LH_S_Bremslicht_H_aktiv_XIX_Grundumfang_XIX_SAM <-> outer port SP_IF_LH_S_Bremslicht_H_aktiv_XIX_SAM
    delegate ABL_XIX_SAM.SP_IF_LH_S_Kennzl_def_XIX_ABL_XIX_SAM <-> outer port SP_IF_LH_S_Kennzl_def_XIX_SAM
    delegate Grundumfang_XIX_SAM.SP_IF_LH_S_Kennzl_def_XIX_Grundumfang_XIX_SAM <-> outer port SP_IF_LH_S_Kennzl_def_XIX_SAM
    delegate ABL_XIX_SAM.SP_IF_LH_S_Nebel_li_def_XIX_ABL_XIX_SAM <-> outer port SP_IF_LH_S_Nebel_li_def_XIX_SAM
    delegate Grundumfang_XIX_SAM.SP_IF_LH_S_Nebel_li_def_XIX_Grundumfang_XIX_SAM <-> outer port SP_IF_LH_S_Nebel_li_def_XIX_SAM
    delegate ABL_XIX_SAM.SP_IF_LH_S_Nebel_mi_def_XIX_ABL_XIX_SAM <-> outer port SP_IF_LH_S_Nebel_mi_def_XIX_SAM
    delegate Grundumfang_XIX_SAM.SP_IF_LH_S_Nebel_mi_def_XIX_Grundumfang_XIX_SAM <-> outer port SP_IF_LH_S_Nebel_mi_def_XIX_SAM
    delegate ABL_XIX_SAM.SP_IF_LH_S_Nebel_re_def_XIX_ABL_XIX_SAM <-> outer port SP_IF_LH_S_Nebel_re_def_XIX_SAM
    delegate Grundumfang_XIX_SAM.SP_IF_LH_S_Nebel_re_def_XIX_Grundumfang_XIX_SAM <-> outer port SP_IF_LH_S_Nebel_re_def_XIX_SAM
    delegate ABL_XIX_SAM.SP_IF_LH_S_Rueckf_li_def_XIX_ABL_XIX_SAM <-> outer port SP_IF_LH_S_Rueckf_li_def_XIX_SAM
    delegate Grundumfang_XIX_SAM.SP_IF_LH_S_Rueckf_li_def_XIX_Grundumfang_XIX_SAM <-> outer port SP_IF_LH_S_Rueckf_li_def_XIX_SAM
    delegate ABL_XIX_SAM.SP_IF_LH_S_Rueckf_mi_def_XIX_ABL_XIX_SAM <-> outer port SP_IF_LH_S_Rueckf_mi_def_XIX_SAM
    delegate Grundumfang_XIX_SAM.SP_IF_LH_S_Rueckf_mi_def_XIX_Grundumfang_XIX_SAM <-> outer port SP_IF_LH_S_Rueckf_mi_def_XIX_SAM
    delegate ABL_XIX_SAM.SP_IF_LH_S_Rueckf_re_def_XIX_ABL_XIX_SAM <-> outer port SP_IF_LH_S_Rueckf_re_def_XIX_SAM
    delegate Grundumfang_XIX_SAM.SP_IF_LH_S_Rueckf_re_def_XIX_Grundumfang_XIX_SAM <-> outer port SP_IF_LH_S_Rueckf_re_def_XIX_SAM
    delegate ABL_XIX_SAM.SP_IF_LH_S_Schluss_Brems_li_def_XIX_ABL_XIX_SAM <-> outer port SP_IF_LH_S_Schluss_Brems_li_def_XIX_SAM
    delegate Grundumfang_XIX_SAM.SP_IF_LH_S_Schluss_Brems_li_def_XIX_Grundumfang_XIX_SAM <-> outer port SP_IF_LH_S_Schluss_Brems_li_def_XIX_SAM
    delegate ABL_XIX_SAM.SP_IF_LH_S_Schluss_Brems_mi_def_XIX_ABL_XIX_SAM <-> outer port SP_IF_LH_S_Schluss_Brems_mi_def_XIX_SAM
    delegate Grundumfang_XIX_SAM.SP_IF_LH_S_Schluss_Brems_mi_def_XIX_Grundumfang_XIX_SAM <-> outer port SP_IF_LH_S_Schluss_Brems_mi_def_XIX_SAM
    delegate ABL_XIX_SAM.SP_IF_LH_S_Schluss_Brems_Nebel_li_def_XIX_ABL_XIX_SAM <-> outer port SP_IF_LH_S_Schluss_Brems_Nebel_li_def_XIX_SAM
    delegate Grundumfang_XIX_SAM.SP_IF_LH_S_Schluss_Brems_Nebel_li_def_XIX_Grundumfang_XIX_SAM <-> outer port SP_IF_LH_S_Schluss_Brems_Nebel_li_def_XIX_SAM
    delegate ABL_XIX_SAM.SP_IF_LH_S_Schluss_Brems_Nebel_re_def_XIX_ABL_XIX_SAM <-> outer port SP_IF_LH_S_Schluss_Brems_Nebel_re_def_XIX_SAM
    delegate Grundumfang_XIX_SAM.SP_IF_LH_S_Schluss_Brems_Nebel_re_def_XIX_Grundumfang_XIX_SAM <-> outer port SP_IF_LH_S_Schluss_Brems_Nebel_re_def_XIX_SAM
    delegate ABL_XIX_SAM.SP_IF_LH_S_Schluss_Brems_re_def_XIX_ABL_XIX_SAM <-> outer port SP_IF_LH_S_Schluss_Brems_re_def_XIX_SAM
    delegate Grundumfang_XIX_SAM.SP_IF_LH_S_Schluss_Brems_re_def_XIX_Grundumfang_XIX_SAM <-> outer port SP_IF_LH_S_Schluss_Brems_re_def_XIX_SAM
    delegate ABL_XIX_SAM.SP_IF_LH_S_Schluss_Nebel_li_def_XIX_ABL_XIX_SAM <-> outer port SP_IF_LH_S_Schluss_Nebel_li_def_XIX_SAM
    delegate Grundumfang_XIX_SAM.SP_IF_LH_S_Schluss_Nebel_li_def_XIX_Grundumfang_XIX_SAM <-> outer port SP_IF_LH_S_Schluss_Nebel_li_def_XIX_SAM
    delegate ABL_XIX_SAM.SP_IF_LH_S_Schluss_Nebel_re_def_XIX_ABL_XIX_SAM <-> outer port SP_IF_LH_S_Schluss_Nebel_re_def_XIX_SAM
    delegate Grundumfang_XIX_SAM.SP_IF_LH_S_Schluss_Nebel_re_def_XIX_Grundumfang_XIX_SAM <-> outer port SP_IF_LH_S_Schluss_Nebel_re_def_XIX_SAM
    delegate ABL_XIX_SAM.SP_IF_LH_S_Schlusslicht_li_def_XIX_ABL_XIX_SAM <-> outer port SP_IF_LH_S_Schlusslicht_li_def_XIX_SAM
    delegate Grundumfang_XIX_SAM.SP_IF_LH_S_Schlusslicht_li_def_XIX_Grundumfang_XIX_SAM <-> outer port SP_IF_LH_S_Schlusslicht_li_def_XIX_SAM
    delegate ABL_XIX_SAM.SP_IF_LH_S_Schlusslicht_mi_def_XIX_ABL_XIX_SAM <-> outer port SP_IF_LH_S_Schlusslicht_mi_def_XIX_SAM
    delegate Grundumfang_XIX_SAM.SP_IF_LH_S_Schlusslicht_mi_def_XIX_Grundumfang_XIX_SAM <-> outer port SP_IF_LH_S_Schlusslicht_mi_def_XIX_SAM
    delegate ABL_XIX_SAM.SP_IF_LH_S_Schlusslicht_re_def_XIX_ABL_XIX_SAM <-> outer port SP_IF_LH_S_Schlusslicht_re_def_XIX_SAM
    delegate Grundumfang_XIX_SAM.SP_IF_LH_S_Schlusslicht_re_def_XIX_Grundumfang_XIX_SAM <-> outer port SP_IF_LH_S_Schlusslicht_re_def_XIX_SAM
    delegate ABL_XIX_SAM.SP_IF_LH_S_SL_BRL_BLK_li_def_XIX_ABL_XIX_SAM <-> outer port SP_IF_LH_S_SL_BRL_BLK_li_def_XIX_SAM
    delegate Grundumfang_XIX_SAM.SP_IF_LH_S_SL_BRL_BLK_li_def_XIX_Grundumfang_XIX_SAM <-> outer port SP_IF_LH_S_SL_BRL_BLK_li_def_XIX_SAM
    delegate ABL_XIX_SAM.SP_IF_LH_S_SL_BRL_BLK_re_def_XIX_ABL_XIX_SAM <-> outer port SP_IF_LH_S_SL_BRL_BLK_re_def_XIX_SAM
    delegate Grundumfang_XIX_SAM.SP_IF_LH_S_SL_BRL_BLK_re_def_XIX_Grundumfang_XIX_SAM <-> outer port SP_IF_LH_S_SL_BRL_BLK_re_def_XIX_SAM
    delegate Grundumfang_XIX_SAM.SP_IF_LIM_P_Mode_XIX_Grundumfang_XIX_SAM <-> outer port SP_IF_LIM_P_Mode_XIX_SAM
    delegate Grundumfang_XIX_SAM.SP_IF_LIM_S_Rollo_vo_XIX_Grundumfang_XIX_SAM <-> outer port SP_IF_LIM_S_Rollo_vo_XIX_SAM
    delegate Grundumfang_XIX_SAM.SP_IF_LR_HZG_01_alt_XIX_Grundumfang_XIX_SAM <-> outer port SP_IF_LR_HZG_01_alt_XIX_SAM
    delegate Grundumfang_XIX_SAM.SP_IF_LR_HZG_Konfiguration_XIX_Grundumfang_XIX_SAM <-> outer port SP_IF_LR_HZG_Konfiguration_XIX_SAM
    delegate Grundumfang_XIX_SAM.SP_IF_LR_HZG_Temp_Sensor_XIX_Grundumfang_XIX_SAM <-> outer port SP_IF_LR_HZG_Temp_Sensor_XIX_SAM
    delegate Grundumfang_XIX_SAM.SP_IF_LRH_aktiv_XIX_Grundumfang_XIX_SAM <-> outer port SP_IF_LRH_aktiv_XIX_SAM
    delegate Grundumfang_XIX_SAM.SP_IF_LRH_On_Off_XIX_Grundumfang_XIX_SAM <-> outer port SP_IF_LRH_On_Off_XIX_SAM
    delegate Grundumfang_XIX_SAM.SP_IF_LS_defekt_XIX_Grundumfang_XIX_SAM <-> outer port SP_IF_LS_defekt_XIX_SAM
    delegate Grundumfang_XIX_SAM.SP_IF_LS_Dunkel_XIX_Grundumfang_XIX_SAM <-> outer port SP_IF_LS_Dunkel_XIX_SAM
    delegate Grundumfang_XIX_SAM.SP_IF_LS_Error_XIX_Grundumfang_XIX_SAM <-> outer port SP_IF_LS_Error_XIX_SAM
    delegate Grundumfang_XIX_SAM.SP_IF_LS_Helligkeit_FW_XIX_Grundumfang_XIX_SAM <-> outer port SP_IF_LS_Helligkeit_FW_XIX_SAM
    delegate Grundumfang_XIX_SAM.SP_IF_LS_Helligkeit_IR_XIX_Grundumfang_XIX_SAM <-> outer port SP_IF_LS_Helligkeit_IR_XIX_SAM
    delegate Grundumfang_XIX_SAM.SP_IF_LS_Licht_ein_invers_XIX_Grundumfang_XIX_SAM <-> outer port SP_IF_LS_Licht_ein_invers_XIX_SAM
    delegate Grundumfang_XIX_SAM.SP_IF_LS_Licht_ein_XIX_Grundumfang_XIX_SAM <-> outer port SP_IF_LS_Licht_ein_XIX_SAM
    delegate Grundumfang_XIX_SAM.SP_IF_LS_TFL_mit_SL_ein_XIX_Grundumfang_XIX_SAM <-> outer port SP_IF_LS_TFL_mit_SL_ein_XIX_SAM
    delegate Grundumfang_XIX_SAM.SP_IF_LS_Verbau_XIX_Grundumfang_XIX_SAM <-> outer port SP_IF_LS_Verbau_XIX_SAM
    delegate Grundumfang_XIX_SAM.SP_IF_LSS_Tastencode_XIX_Grundumfang_XIX_SAM <-> outer port SP_IF_LSS_Tastencode_XIX_SAM
    delegate Grundumfang_XIX_SAM.SP_IF_Master_Zaehler_XIX_Grundumfang_XIX_SAM <-> outer port SP_IF_Master_Zaehler_XIX_SAM
    delegate Grundumfang_XIX_SAM.SP_IF_MO_Kl_75_XIX_Grundumfang_XIX_SAM <-> outer port SP_IF_MO_Kl_75_XIX_SAM
    delegate Grundumfang_XIX_SAM.SP_IF_NM_BCM1_CAB_V15_XIX_Grundumfang_XIX_SAM <-> outer port SP_IF_NM_BCM1_CAB_V15_XIX_SAM  # _XIX_Grundumfang_XIX_SAM_XIX_SC_738_ClassicAUTOSARBasicSoftwareICAS1Gateway_XIX_Softwareblock_XIX_ICAS1_X_Gateway_XIX_NM_BCM1_CAB_V15
    delegate Grundumfang_XIX_SAM.SP_IF_NM_BCM1_Car_Wakeup_XIX_Grundumfang_XIX_SAM <-> outer port SP_IF_NM_BCM1_Car_Wakeup_XIX_SAM  # _XIX_Grundumfang_XIX_SAM_XIX_SC_738_ClassicAUTOSARBasicSoftwareICAS1Gateway_XIX_Softwareblock_XIX_ICAS1_X_Gateway_XIX_NM_BCM1_Car_Wakeup
    delegate Grundumfang_XIX_SAM.SP_IF_NM_BCM1_CBV_AWB_XIX_Grundumfang_XIX_SAM <-> outer port SP_IF_NM_BCM1_CBV_AWB_XIX_SAM  # _XIX_Grundumfang_XIX_SAM_XIX_SC_738_ClassicAUTOSARBasicSoftwareICAS1Gateway_XIX_Softwareblock_XIX_ICAS1_X_Gateway_XIX_NM_BCM1_CBV_AWB
    delegate Grundumfang_XIX_SAM.SP_IF_NM_BCM1_CBV_CRI_XIX_Grundumfang_XIX_SAM <-> outer port SP_IF_NM_BCM1_CBV_CRI_XIX_SAM  # _XIX_Grundumfang_XIX_SAM_XIX_SC_738_ClassicAUTOSARBasicSoftwareICAS1Gateway_XIX_Softwareblock_XIX_ICAS1_X_Gateway_XIX_NM_BCM1_CBV_CRI
    delegate Grundumfang_XIX_SAM.SP_IF_NM_BCM1_NM_State_XIX_Grundumfang_XIX_SAM <-> outer port SP_IF_NM_BCM1_NM_State_XIX_SAM
    delegate Grundumfang_XIX_SAM.SP_IF_ORU_0009_BZ_XIX_Grundumfang_XIX_SAM <-> outer port SP_IF_ORU_0009_BZ_XIX_SAM
    delegate Grundumfang_XIX_SAM.SP_IF_ORU_0009_CRC_XIX_Grundumfang_XIX_SAM <-> outer port SP_IF_ORU_0009_CRC_XIX_SAM
    delegate Grundumfang_XIX_SAM.SP_IF_ORUG02_01_BZ_XIX_Grundumfang_XIX_SAM <-> outer port SP_IF_ORUG02_01_BZ_XIX_SAM
    delegate Grundumfang_XIX_SAM.SP_IF_ORUG02_01_CRC_XIX_Grundumfang_XIX_SAM <-> outer port SP_IF_ORUG02_01_CRC_XIX_SAM
    delegate Grundumfang_XIX_SAM.SP_IF_ORUG2_GuardInfo_XIX_Grundumfang_XIX_SAM <-> outer port SP_IF_ORUG2_GuardInfo_XIX_SAM
    delegate Grundumfang_XIX_SAM.SP_IF_ORUG2_GuardState_XIX_Grundumfang_XIX_SAM <-> outer port SP_IF_ORUG2_GuardState_XIX_SAM
    delegate Grundumfang_XIX_SAM.SP_IF_ORUG2_TargetRelease_XIX_Grundumfang_XIX_SAM <-> outer port SP_IF_ORUG2_TargetRelease_XIX_SAM
    delegate Grundumfang_XIX_SAM.SP_IF_ORUG2_TorqueLock_XIX_Grundumfang_XIX_SAM <-> outer port SP_IF_ORUG2_TorqueLock_XIX_SAM
    delegate Grundumfang_XIX_SAM.SP_IF_PAO_OFF_Anf_invers_XIX_Grundumfang_XIX_SAM <-> outer port SP_IF_PAO_OFF_Anf_invers_XIX_SAM
    delegate Grundumfang_XIX_SAM.SP_IF_PAO_ON_Anf_invers_XIX_Grundumfang_XIX_SAM <-> outer port SP_IF_PAO_ON_Anf_invers_XIX_SAM
    delegate Grundumfang_XIX_SAM.SP_IF_RLS_02_BZ_XIX_Grundumfang_XIX_SAM <-> outer port SP_IF_RLS_02_BZ_XIX_SAM
    delegate Grundumfang_XIX_SAM.SP_IF_RLS_02_CRC_XIX_Grundumfang_XIX_SAM <-> outer port SP_IF_RLS_02_CRC_XIX_SAM
    delegate Grundumfang_XIX_SAM.SP_IF_RLS_Qualifizierungsbit_XIX_Grundumfang_XIX_SAM <-> outer port SP_IF_RLS_Qualifizierungsbit_XIX_SAM
    delegate Grundumfang_XIX_SAM.SP_IF_RLS_ResponseError_XIX_Grundumfang_XIX_SAM <-> outer port SP_IF_RLS_ResponseError_XIX_SAM
    delegate Grundumfang_XIX_SAM.SP_IF_RLS_Vorfeldhelligkeit_Boost_XIX_Grundumfang_XIX_SAM <-> outer port SP_IF_RLS_Vorfeldhelligkeit_Boost_XIX_SAM
    delegate Grundumfang_XIX_SAM.SP_IF_RS_AdaptierungError_XIX_Grundumfang_XIX_SAM <-> outer port SP_IF_RS_AdaptierungError_XIX_SAM
    delegate Grundumfang_XIX_SAM.SP_IF_RS_defekt_XIX_Grundumfang_XIX_SAM <-> outer port SP_IF_RS_defekt_XIX_SAM
    delegate Grundumfang_XIX_SAM.SP_IF_RS_Error_XIX_Grundumfang_XIX_SAM <-> outer port SP_IF_RS_Error_XIX_SAM
    delegate Grundumfang_XIX_SAM.SP_IF_RS_Regenfahrlicht_XIX_Grundumfang_XIX_SAM <-> outer port SP_IF_RS_Regenfahrlicht_XIX_SAM
    delegate Grundumfang_XIX_SAM.SP_IF_RS_Regenmenge_XIX_Grundumfang_XIX_SAM <-> outer port SP_IF_RS_Regenmenge_XIX_SAM
    delegate Grundumfang_XIX_SAM.SP_IF_RS_Schwall_XIX_Grundumfang_XIX_SAM <-> outer port SP_IF_RS_Schwall_XIX_SAM
    delegate Grundumfang_XIX_SAM.SP_IF_RS_Verbau_XIX_Grundumfang_XIX_SAM <-> outer port SP_IF_RS_Verbau_XIX_SAM
    delegate Grundumfang_XIX_SAM.SP_IF_RS_Verglasung_schliessen_XIX_Grundumfang_XIX_SAM <-> outer port SP_IF_RS_Verglasung_schliessen_XIX_SAM
    delegate Grundumfang_XIX_SAM.SP_IF_RS_versParklage_Wischer_XIX_Grundumfang_XIX_SAM <-> outer port SP_IF_RS_versParklage_Wischer_XIX_SAM
    delegate Grundumfang_XIX_SAM.SP_IF_RS_Wischergeschwindigkeit_XIX_Grundumfang_XIX_SAM <-> outer port SP_IF_RS_Wischergeschwindigkeit_XIX_SAM
    delegate ABL_XIX_SAM.SP_IF_SAL_li1_Blinker_Status_XIX_ABL_XIX_SAM <-> outer port SP_IF_SAL_li1_Blinker_Status_XIX_SAM
    delegate Grundumfang_XIX_SAM.SP_IF_SAL_li1_Blinker_Status_XIX_Grundumfang_XIX_SAM <-> outer port SP_IF_SAL_li1_Blinker_Status_XIX_SAM
    delegate ABL_XIX_SAM.SP_IF_SAL_re1_Blinker_Status_XIX_ABL_XIX_SAM <-> outer port SP_IF_SAL_re1_Blinker_Status_XIX_SAM
    delegate Grundumfang_XIX_SAM.SP_IF_SAL_re1_Blinker_Status_XIX_Grundumfang_XIX_SAM <-> outer port SP_IF_SAL_re1_Blinker_Status_XIX_SAM
    delegate Grundumfang_XIX_SAM.SP_IF_SAM_01_BZ_XIX_Grundumfang_XIX_SAM <-> outer port SP_IF_SAM_01_BZ_XIX_SAM
    delegate Grundumfang_XIX_SAM.SP_IF_SAM_01_CRC_XIX_Grundumfang_XIX_SAM <-> outer port SP_IF_SAM_01_CRC_XIX_SAM
    delegate Grundumfang_XIX_SAM.SP_IF_SAM_Fehler_DC_LWR_XIX_Grundumfang_XIX_SAM <-> outer port SP_IF_SAM_Fehler_DC_LWR_XIX_SAM
    delegate LWR_Auto_XIX_SAM.SP_IF_SAM_Fehler_DC_LWR_XIX_LWR_Auto_XIX_SAM <-> outer port SP_IF_SAM_Fehler_DC_LWR_XIX_SAM
    delegate Grundumfang_XIX_SAM.SP_IF_SAM_ORUData_XIX_Grundumfang_XIX_SAM <-> outer port SP_IF_SAM_ORUData_XIX_SAM
    delegate Grundumfang_XIX_SAM.SP_IF_SAM_ORUDataIndex_XIX_Grundumfang_XIX_SAM <-> outer port SP_IF_SAM_ORUDataIndex_XIX_SAM
    delegate Grundumfang_XIX_SAM.SP_IF_SC_PAO_OFF_Anf_XIX_Grundumfang_XIX_SAM <-> outer port SP_IF_SC_PAO_OFF_Anf_XIX_SAM
    delegate Grundumfang_XIX_SAM.SP_IF_SC_PAO_ON_Anf_XIX_Grundumfang_XIX_SAM <-> outer port SP_IF_SC_PAO_ON_Anf_XIX_SAM
    delegate Grundumfang_XIX_SAM.SP_IF_Schluesselnr_Personalisierung_XIX_Grundumfang_XIX_SAM <-> outer port SP_IF_Schluesselnr_Personalisierung_XIX_SAM
    delegate Grundumfang_XIX_SAM.SP_IF_Servicestellung_Wischer_XIX_Grundumfang_XIX_SAM <-> outer port SP_IF_Servicestellung_Wischer_XIX_SAM
    delegate Grundumfang_XIX_SAM.SP_IF_SIL_Stufe_LED_li_XIX_Grundumfang_XIX_SAM <-> outer port SP_IF_SIL_Stufe_LED_li_XIX_SAM
    delegate Grundumfang_XIX_SAM.SP_IF_SIL_Stufe_LED_re_XIX_Grundumfang_XIX_SAM <-> outer port SP_IF_SIL_Stufe_LED_re_XIX_SAM
    delegate ABL_XIX_SAM.SP_IF_SMLS_01_BZ_XIX_ABL_XIX_SAM <-> outer port SP_IF_SMLS_01_BZ_XIX_SAM
    delegate Grundumfang_XIX_SAM.SP_IF_SMLS_01_BZ_XIX_Grundumfang_XIX_SAM <-> outer port SP_IF_SMLS_01_BZ_XIX_SAM
    delegate ABL_XIX_SAM.SP_IF_SMLS_01_CRC_XIX_ABL_XIX_SAM <-> outer port SP_IF_SMLS_01_CRC_XIX_SAM
    delegate Grundumfang_XIX_SAM.SP_IF_SMLS_01_CRC_XIX_Grundumfang_XIX_SAM <-> outer port SP_IF_SMLS_01_CRC_XIX_SAM
    delegate Grundumfang_XIX_SAM.SP_IF_SMLS_alt_XIX_Grundumfang_XIX_SAM <-> outer port SP_IF_SMLS_alt_XIX_SAM
    delegate Grundumfang_XIX_SAM.SP_IF_SMLS_Hupe_XIX_Grundumfang_XIX_SAM <-> outer port SP_IF_SMLS_Hupe_XIX_SAM
    delegate Grundumfang_XIX_SAM.SP_IF_SOK_FoD_BCM1_Req_Challenge_XIX_Grundumfang_XIX_SAM <-> outer port SP_IF_SOK_FoD_BCM1_Req_Challenge_XIX_SAM
    delegate Grundumfang_XIX_SAM.SP_IF_SOK_KST_Challenge_XIX_Grundumfang_XIX_SAM <-> outer port SP_IF_SOK_KST_Challenge_XIX_SAM
    delegate Grundumfang_XIX_SAM.SP_IF_SOK_ZV_HBFS_Challenge_XIX_Grundumfang_XIX_SAM <-> outer port SP_IF_SOK_ZV_HBFS_Challenge_XIX_SAM
    delegate Grundumfang_XIX_SAM.SP_IF_SOK_ZV_HFS_Challenge_XIX_Grundumfang_XIX_SAM <-> outer port SP_IF_SOK_ZV_HFS_Challenge_XIX_SAM
    delegate Grundumfang_XIX_SAM.SP_IF_SOK_ZV_HW_Challenge_XIX_Grundumfang_XIX_SAM <-> outer port SP_IF_SOK_ZV_HW_Challenge_XIX_SAM
    delegate Grundumfang_XIX_SAM.SP_IF_Soll_Lehne_LLR_li_1_XIX_Grundumfang_XIX_SAM <-> outer port SP_IF_Soll_Lehne_LLR_li_1_XIX_SAM
    delegate Grundumfang_XIX_SAM.SP_IF_Soll_Lehne_LLR_li_2_XIX_Grundumfang_XIX_SAM <-> outer port SP_IF_Soll_Lehne_LLR_li_2_XIX_SAM
    delegate Grundumfang_XIX_SAM.SP_IF_Soll_Lehne_LLR_re_1_XIX_Grundumfang_XIX_SAM <-> outer port SP_IF_Soll_Lehne_LLR_re_1_XIX_SAM
    delegate Grundumfang_XIX_SAM.SP_IF_Soll_Lehne_LLR_re_2_XIX_Grundumfang_XIX_SAM <-> outer port SP_IF_Soll_Lehne_LLR_re_2_XIX_SAM
    delegate Grundumfang_XIX_SAM.SP_IF_Soll_Sitz_LLR_li_1_XIX_Grundumfang_XIX_SAM <-> outer port SP_IF_Soll_Sitz_LLR_li_1_XIX_SAM
    delegate Grundumfang_XIX_SAM.SP_IF_Soll_Sitz_LLR_li_2_XIX_Grundumfang_XIX_SAM <-> outer port SP_IF_Soll_Sitz_LLR_li_2_XIX_SAM
    delegate Grundumfang_XIX_SAM.SP_IF_Soll_Sitz_LLR_re_1_XIX_Grundumfang_XIX_SAM <-> outer port SP_IF_Soll_Sitz_LLR_re_1_XIX_SAM
    delegate Grundumfang_XIX_SAM.SP_IF_Soll_Sitz_LLR_re_2_XIX_Grundumfang_XIX_SAM <-> outer port SP_IF_Soll_Sitz_LLR_re_2_XIX_SAM
    delegate Grundumfang_XIX_SAM.SP_IF_SPR_Abschaltstufe_XIX_Grundumfang_XIX_SAM <-> outer port SP_IF_SPR_Abschaltstufe_XIX_SAM
    delegate Grundumfang_XIX_SAM.SP_IF_SRA_Sequenz_Status_XIX_Grundumfang_XIX_SAM <-> outer port SP_IF_SRA_Sequenz_Status_XIX_SAM
    delegate Grundumfang_XIX_SAM.SP_IF_Stellgliedtest_LRH_XIX_Grundumfang_XIX_SAM <-> outer port SP_IF_Stellgliedtest_LRH_XIX_SAM
    delegate Grundumfang_XIX_SAM.SP_IF_TSG_FHSG_MST_Jahr_k_XIX_Grundumfang_XIX_SAM <-> outer port SP_IF_TSG_FHSG_MST_Jahr_k_XIX_SAM
    delegate Grundumfang_XIX_SAM.SP_IF_TSG_FHSG_MST_KM_Stand_1_XIX_Grundumfang_XIX_SAM <-> outer port SP_IF_TSG_FHSG_MST_KM_Stand_1_XIX_SAM
    delegate Grundumfang_XIX_SAM.SP_IF_TSG_FHSG_MST_KM_Stand_2_XIX_Grundumfang_XIX_SAM <-> outer port SP_IF_TSG_FHSG_MST_KM_Stand_2_XIX_SAM
    delegate Grundumfang_XIX_SAM.SP_IF_TSG_FHSG_MST_Minute_k_XIX_Grundumfang_XIX_SAM <-> outer port SP_IF_TSG_FHSG_MST_Minute_k_XIX_SAM
    delegate Grundumfang_XIX_SAM.SP_IF_TSG_FHSG_MST_Monat_k_XIX_Grundumfang_XIX_SAM <-> outer port SP_IF_TSG_FHSG_MST_Monat_k_XIX_SAM
    delegate Grundumfang_XIX_SAM.SP_IF_TSG_FHSG_MST_Sekunde_k_XIX_Grundumfang_XIX_SAM <-> outer port SP_IF_TSG_FHSG_MST_Sekunde_k_XIX_SAM
    delegate Grundumfang_XIX_SAM.SP_IF_TSG_FHSG_MST_Stunde_k_XIX_Grundumfang_XIX_SAM <-> outer port SP_IF_TSG_FHSG_MST_Stunde_k_XIX_SAM
    delegate Grundumfang_XIX_SAM.SP_IF_TSG_FHSG_MST_Tag_k_XIX_Grundumfang_XIX_SAM <-> outer port SP_IF_TSG_FHSG_MST_Tag_k_XIX_SAM
    delegate Grundumfang_XIX_SAM.SP_IF_TSG_FHSG_MST_Time_Indication_Bit_XIX_Grundumfang_XIX_SAM <-> outer port SP_IF_TSG_FHSG_MST_Time_Indication_Bit_XIX_SAM
    delegate Grundumfang_XIX_SAM.SP_IF_TSG_FHSG_MST_TSG_Seite_XIX_Grundumfang_XIX_SAM <-> outer port SP_IF_TSG_FHSG_MST_TSG_Seite_XIX_SAM
    delegate Grundumfang_XIX_SAM.SP_IF_TSG_FHSG_MST_Verlernzaehler_k_XIX_Grundumfang_XIX_SAM <-> outer port SP_IF_TSG_FHSG_MST_Verlernzaehler_k_XIX_SAM
    delegate Grundumfang_XIX_SAM.SP_IF_TSG_HBFS_02_BZ_XIX_Grundumfang_XIX_SAM <-> outer port SP_IF_TSG_HBFS_02_BZ_XIX_SAM
    delegate Grundumfang_XIX_SAM.SP_IF_TSG_HBFS_02_CRC_XIX_Grundumfang_XIX_SAM <-> outer port SP_IF_TSG_HBFS_02_CRC_XIX_SAM
    delegate Grundumfang_XIX_SAM.SP_IF_TSG_HFS_02_BZ_XIX_Grundumfang_XIX_SAM <-> outer port SP_IF_TSG_HFS_02_BZ_XIX_SAM
    delegate Grundumfang_XIX_SAM.SP_IF_TSG_HFS_02_CRC_XIX_Grundumfang_XIX_SAM <-> outer port SP_IF_TSG_HFS_02_CRC_XIX_SAM
    delegate Grundumfang_XIX_SAM.SP_IF_Tuerkontakt_Innenlicht_Status_XIX_Grundumfang_XIX_SAM <-> outer port SP_IF_Tuerkontakt_Innenlicht_Status_XIX_SAM
    delegate SC_708_IuALicht_MEB_XIX_Softwareblock_XIX_SAM.SP_IF_Tuerkontakt_Innenlicht_Status_XIX_SC_708_IuALicht_MEB_XIX_Softwareblock_XIX_SAM <-> outer port SP_IF_Tuerkontakt_Innenlicht_Status_XIX_SAM
    delegate Grundumfang_XIX_SAM.SP_IF_UGDO_Buttons_XIX_Grundumfang_XIX_SAM <-> outer port SP_IF_UGDO_Buttons_XIX_SAM
    delegate Grundumfang_XIX_SAM.SP_IF_UGDO_Switchboard_XIX_Grundumfang_XIX_SAM <-> outer port SP_IF_UGDO_Switchboard_XIX_SAM
    delegate Grundumfang_XIX_SAM.SP_IF_UHF_Sensor_01_Data_XIX_Grundumfang_XIX_SAM <-> outer port SP_IF_UHF_Sensor_01_Data_XIX_SAM
    delegate Grundumfang_XIX_SAM.SP_IF_UHF_Sensor_01_Datenlaenge_XIX_Grundumfang_XIX_SAM <-> outer port SP_IF_UHF_Sensor_01_Datenlaenge_XIX_SAM
    delegate Grundumfang_XIX_SAM.SP_IF_UHF_Sensor_01_Status_XIX_Grundumfang_XIX_SAM <-> outer port SP_IF_UHF_Sensor_01_Status_XIX_SAM
    delegate Grundumfang_XIX_SAM.SP_IF_UHF_Sensor_01_Typ_XIX_Grundumfang_XIX_SAM <-> outer port SP_IF_UHF_Sensor_01_Typ_XIX_SAM
    delegate Grundumfang_XIX_SAM.SP_IF_UHF_Sensor_01_Zaehler_XIX_Grundumfang_XIX_SAM <-> outer port SP_IF_UHF_Sensor_01_Zaehler_XIX_SAM
    delegate Grundumfang_XIX_SAM.SP_IF_UHF_Sensor_02_Data_XIX_Grundumfang_XIX_SAM <-> outer port SP_IF_UHF_Sensor_02_Data_XIX_SAM
    delegate Grundumfang_XIX_SAM.SP_IF_UHF_Sensor_02_Zaehler_XIX_Grundumfang_XIX_SAM <-> outer port SP_IF_UHF_Sensor_02_Zaehler_XIX_SAM
    delegate Grundumfang_XIX_SAM.SP_IF_UHF_Sensor_03_Data_XIX_Grundumfang_XIX_SAM <-> outer port SP_IF_UHF_Sensor_03_Data_XIX_SAM
    delegate Grundumfang_XIX_SAM.SP_IF_UHF_Sensor_03_Zaehler_XIX_Grundumfang_XIX_SAM <-> outer port SP_IF_UHF_Sensor_03_Zaehler_XIX_SAM
    delegate Grundumfang_XIX_SAM.SP_IF_UHF_Sensor_04_Data_XIX_Grundumfang_XIX_SAM <-> outer port SP_IF_UHF_Sensor_04_Data_XIX_SAM
    delegate Grundumfang_XIX_SAM.SP_IF_UHF_Sensor_04_Zaehler_XIX_Grundumfang_XIX_SAM <-> outer port SP_IF_UHF_Sensor_04_Zaehler_XIX_SAM
    delegate Grundumfang_XIX_SAM.SP_IF_UHF_Sensor_05_Data_XIX_Grundumfang_XIX_SAM <-> outer port SP_IF_UHF_Sensor_05_Data_XIX_SAM
    delegate Grundumfang_XIX_SAM.SP_IF_UHF_Sensor_05_Zaehler_XIX_Grundumfang_XIX_SAM <-> outer port SP_IF_UHF_Sensor_05_Zaehler_XIX_SAM
    delegate Grundumfang_XIX_SAM.SP_IF_UHF_Sensor_06_Data_XIX_Grundumfang_XIX_SAM <-> outer port SP_IF_UHF_Sensor_06_Data_XIX_SAM
    delegate Grundumfang_XIX_SAM.SP_IF_UHF_Sensor_06_Zaehler_XIX_Grundumfang_XIX_SAM <-> outer port SP_IF_UHF_Sensor_06_Zaehler_XIX_SAM
    delegate Grundumfang_XIX_SAM.SP_IF_UHF_Sensor_07_Data_XIX_Grundumfang_XIX_SAM <-> outer port SP_IF_UHF_Sensor_07_Data_XIX_SAM
    delegate Grundumfang_XIX_SAM.SP_IF_UHF_Sensor_07_Zaehler_XIX_Grundumfang_XIX_SAM <-> outer port SP_IF_UHF_Sensor_07_Zaehler_XIX_SAM
    delegate Grundumfang_XIX_SAM.SP_IF_UHF_Sensor_08_Data_XIX_Grundumfang_XIX_SAM <-> outer port SP_IF_UHF_Sensor_08_Data_XIX_SAM
    delegate Grundumfang_XIX_SAM.SP_IF_UHF_Sensor_08_Zaehler_XIX_Grundumfang_XIX_SAM <-> outer port SP_IF_UHF_Sensor_08_Zaehler_XIX_SAM
    delegate Grundumfang_XIX_SAM.SP_IF_UHF_Sensor_RSSI_Wert_IDGeber{1..8}_XIX_Grundumfang_XIX_SAM <-> outer port SP_IF_UHF_Sensor_RSSI_Wert_IDGeber{1..8}_XIX_SAM
    delegate Grundumfang_XIX_SAM.SP_IF_Verbauposition_LLR_li_XIX_Grundumfang_XIX_SAM <-> outer port SP_IF_Verbauposition_LLR_li_XIX_SAM
    delegate Grundumfang_XIX_SAM.SP_IF_Verbauposition_LLR_re_XIX_Grundumfang_XIX_SAM <-> outer port SP_IF_Verbauposition_LLR_re_XIX_SAM
    delegate Grundumfang_XIX_SAM.SP_IF_Verglasung_offen_XIX_Grundumfang_XIX_SAM <-> outer port SP_IF_Verglasung_offen_XIX_SAM
    delegate Grundumfang_XIX_SAM.SP_IF_Waschen_vorne_aktiv_XIX_Grundumfang_XIX_SAM <-> outer port SP_IF_Waschen_vorne_aktiv_XIX_SAM
    delegate Grundumfang_XIX_SAM.SP_IF_Wendelage_oben_Wischer_XIX_Grundumfang_XIX_SAM <-> outer port SP_IF_Wendelage_oben_Wischer_XIX_SAM
    delegate Grundumfang_XIX_SAM.SP_IF_Wendelage_unten_Wischer_XIX_Grundumfang_XIX_SAM <-> outer port SP_IF_Wendelage_unten_Wischer_XIX_SAM
    delegate Grundumfang_XIX_SAM.SP_IF_WH_Frontwaschen_XIX_Grundumfang_XIX_SAM <-> outer port SP_IF_WH_Frontwaschen_XIX_SAM
    delegate Grundumfang_XIX_SAM.SP_IF_WH_Heckintervall_XIX_Grundumfang_XIX_SAM <-> outer port SP_IF_WH_Heckintervall_XIX_SAM
    delegate Grundumfang_XIX_SAM.SP_IF_WH_Heckwaschen_XIX_Grundumfang_XIX_SAM <-> outer port SP_IF_WH_Heckwaschen_XIX_SAM
    delegate Grundumfang_XIX_SAM.SP_IF_WH_Intervall_XIX_Grundumfang_XIX_SAM <-> outer port SP_IF_WH_Intervall_XIX_SAM
    delegate Grundumfang_XIX_SAM.SP_IF_WH_Intervallstufen_XIX_Grundumfang_XIX_SAM <-> outer port SP_IF_WH_Intervallstufen_XIX_SAM
    delegate Grundumfang_XIX_SAM.SP_IF_WH_Tippwischen_XIX_Grundumfang_XIX_SAM <-> outer port SP_IF_WH_Tippwischen_XIX_SAM
    delegate Grundumfang_XIX_SAM.SP_IF_WH_Tipwischen_XIX_Grundumfang_XIX_SAM <-> outer port SP_IF_WH_Tipwischen_XIX_SAM
    delegate Grundumfang_XIX_SAM.SP_IF_WH_Wischer_Fehler_XIX_Grundumfang_XIX_SAM <-> outer port SP_IF_WH_Wischer_Fehler_XIX_SAM
    delegate Grundumfang_XIX_SAM.SP_IF_WH_WischerStufe1_XIX_Grundumfang_XIX_SAM <-> outer port SP_IF_WH_WischerStufe1_XIX_SAM
    delegate Grundumfang_XIX_SAM.SP_IF_WH_WischerStufe2_XIX_Grundumfang_XIX_SAM <-> outer port SP_IF_WH_WischerStufe2_XIX_SAM
    delegate Grundumfang_XIX_SAM.SP_IF_Wischer1_Wischgeschwindigkeit_XIX_Grundumfang_XIX_SAM <-> outer port SP_IF_Wischer1_Wischgeschwindigkeit_XIX_SAM
    delegate Grundumfang_XIX_SAM.SP_IF_Wischer_vorne_aktiv_XIX_Grundumfang_XIX_SAM <-> outer port SP_IF_Wischer_vorne_aktiv_XIX_SAM
    delegate Grundumfang_XIX_SAM.SP_IF_Wischer_vorne_blockiert_XIX_Grundumfang_XIX_SAM <-> outer port SP_IF_Wischer_vorne_blockiert_XIX_SAM
    delegate Grundumfang_XIX_SAM.SP_IF_Wischer_vorne_defekt_XIX_Grundumfang_XIX_SAM <-> outer port SP_IF_Wischer_vorne_defekt_XIX_SAM
    delegate Grundumfang_XIX_SAM.SP_IF_Wischer_vorne_Normal_XIX_Grundumfang_XIX_SAM <-> outer port SP_IF_Wischer_vorne_Normal_XIX_SAM
    delegate Grundumfang_XIX_SAM.SP_IF_Wischer_vorne_Parklage_XIX_Grundumfang_XIX_SAM <-> outer port SP_IF_Wischer_vorne_Parklage_XIX_SAM
    delegate Grundumfang_XIX_SAM.SP_IF_Wischer_vorne_Schnell_XIX_Grundumfang_XIX_SAM <-> outer port SP_IF_Wischer_vorne_Schnell_XIX_SAM
    delegate Grundumfang_XIX_SAM.SP_IF_Wischer_WH_PopUp_Anf_XIX_Grundumfang_XIX_SAM <-> outer port SP_IF_Wischer_WH_PopUp_Anf_XIX_SAM
    delegate Grundumfang_XIX_SAM.SP_IF_Wischer_WH_Typ_XIX_Grundumfang_XIX_SAM <-> outer port SP_IF_Wischer_WH_Typ_XIX_SAM
    delegate Grundumfang_XIX_SAM.SP_IF_WWS_Produktionsmodus_XIX_Grundumfang_XIX_SAM <-> outer port SP_IF_WWS_Produktionsmodus_XIX_SAM
    delegate Grundumfang_XIX_SAM.SP_IF_WWSs_01_alt_XIX_Grundumfang_XIX_SAM <-> outer port SP_IF_WWSs_01_alt_XIX_SAM
    delegate Grundumfang_XIX_SAM.SP_IF_ZAS_Kl_15_XIX_Grundumfang_XIX_SAM <-> outer port SP_IF_ZAS_Kl_15_XIX_SAM
    delegate Grundumfang_XIX_SAM.SP_IF_ZAS_Kl_S_XIX_Grundumfang_XIX_SAM <-> outer port SP_IF_ZAS_Kl_S_XIX_SAM
    delegate Grundumfang_XIX_SAM.SP_IF_ZV_Ladeklappe_VerEntriegeln_XIX_Grundumfang_XIX_SAM <-> outer port SP_IF_ZV_Ladeklappe_VerEntriegeln_XIX_SAM
    delegate ZV_XIX_SAM.SP_IF_ZV_Ladeklappe_VerEntriegeln_XIX_ZV_XIX_SAM <-> outer port SP_IF_ZV_Ladeklappe_VerEntriegeln_XIX_SAM
    delegate Grundumfang_XIX_SAM.SP_IF_ZV_LadeklappenStatus_XIX_Grundumfang_XIX_SAM <-> outer port SP_IF_ZV_LadeklappenStatus_XIX_SAM
    connect ABL_XIX_SAM.SP_IF_BH_Blinker_Fehler_XIX_ABL_XIX_SAM -> ABL_XIX_SAM.RP_IF_BH_Blinker_Fehler_XIX_ABL_XIX_SAM
    connect ABL_XIX_SAM.SP_IF_BH_Blinker_li_XIX_ABL_XIX_SAM -> ABL_XIX_SAM.RP_IF_BH_Blinker_li_XIX_ABL_XIX_SAM
    connect ABL_XIX_SAM.SP_IF_BH_Blinker_re_XIX_ABL_XIX_SAM -> ABL_XIX_SAM.RP_IF_BH_Blinker_re_XIX_ABL_XIX_SAM
    connect ABL_XIX_SAM.SP_IF_BH_Fernlicht_XIX_ABL_XIX_SAM -> ABL_XIX_SAM.RP_IF_BH_Fernlicht_XIX_ABL_XIX_SAM
    connect ABL_XIX_SAM.SP_IF_BH_Lichthupe_XIX_ABL_XIX_SAM -> ABL_XIX_SAM.RP_IF_BH_Lichthupe_XIX_ABL_XIX_SAM
    connect ABL_XIX_SAM.SP_IF_BH_Blinker_Fehler_XIX_ABL_XIX_SAM -> Grundumfang_XIX_SAM.RP_IF_BH_Blinker_Fehler_XIX_Grundumfang_XIX_SAM
    connect ABL_XIX_SAM.SP_IF_BH_Blinker_li_XIX_ABL_XIX_SAM -> Grundumfang_XIX_SAM.RP_IF_BH_Blinker_li_XIX_Grundumfang_XIX_SAM
    connect ABL_XIX_SAM.SP_IF_BH_Blinker_re_XIX_ABL_XIX_SAM -> Grundumfang_XIX_SAM.RP_IF_BH_Blinker_re_XIX_Grundumfang_XIX_SAM
    connect ABL_XIX_SAM.SP_IF_BH_Fernlicht_XIX_ABL_XIX_SAM -> Grundumfang_XIX_SAM.RP_IF_BH_Fernlicht_XIX_Grundumfang_XIX_SAM
    connect ABL_XIX_SAM.SP_IF_BH_Lichthupe_XIX_ABL_XIX_SAM -> Grundumfang_XIX_SAM.RP_IF_BH_Lichthupe_XIX_Grundumfang_XIX_SAM
    connect ABL_XIX_SAM.SP_IF_SMLS_01_BZ_XIX_ABL_XIX_SAM -> Grundumfang_XIX_SAM.RP_IF_SMLS_01_BZ_XIX_Grundumfang_XIX_SAM
    connect ABL_XIX_SAM.SP_IF_SMLS_01_CRC_XIX_ABL_XIX_SAM -> Grundumfang_XIX_SAM.RP_IF_SMLS_01_CRC_XIX_Grundumfang_XIX_SAM
    connect Grundumfang_XIX_SAM.SP_IF_BH_Blinker_Fehler_XIX_Grundumfang_XIX_SAM -> ABL_XIX_SAM.RP_IF_BH_Blinker_Fehler_XIX_ABL_XIX_SAM
    connect Grundumfang_XIX_SAM.SP_IF_BH_Blinker_li_XIX_Grundumfang_XIX_SAM -> ABL_XIX_SAM.RP_IF_BH_Blinker_li_XIX_ABL_XIX_SAM
    connect Grundumfang_XIX_SAM.SP_IF_BH_Blinker_re_XIX_Grundumfang_XIX_SAM -> ABL_XIX_SAM.RP_IF_BH_Blinker_re_XIX_ABL_XIX_SAM
    connect Grundumfang_XIX_SAM.SP_IF_BH_Fernlicht_XIX_Grundumfang_XIX_SAM -> ABL_XIX_SAM.RP_IF_BH_Fernlicht_XIX_ABL_XIX_SAM
    connect Grundumfang_XIX_SAM.SP_IF_BH_Lichthupe_XIX_Grundumfang_XIX_SAM -> ABL_XIX_SAM.RP_IF_BH_Lichthupe_XIX_ABL_XIX_SAM
    connect Grundumfang_XIX_SAM.SP_IF_BH_Blinker_Fehler_XIX_Grundumfang_XIX_SAM -> Grundumfang_XIX_SAM.RP_IF_BH_Blinker_Fehler_XIX_Grundumfang_XIX_SAM
    connect Grundumfang_XIX_SAM.SP_IF_BH_Blinker_li_XIX_Grundumfang_XIX_SAM -> Grundumfang_XIX_SAM.RP_IF_BH_Blinker_li_XIX_Grundumfang_XIX_SAM
    connect Grundumfang_XIX_SAM.SP_IF_BH_Blinker_re_XIX_Grundumfang_XIX_SAM -> Grundumfang_XIX_SAM.RP_IF_BH_Blinker_re_XIX_Grundumfang_XIX_SAM
    connect Grundumfang_XIX_SAM.SP_IF_BH_Fernlicht_XIX_Grundumfang_XIX_SAM -> Grundumfang_XIX_SAM.RP_IF_BH_Fernlicht_XIX_Grundumfang_XIX_SAM
    connect Grundumfang_XIX_SAM.SP_IF_BH_Lichthupe_XIX_Grundumfang_XIX_SAM -> Grundumfang_XIX_SAM.RP_IF_BH_Lichthupe_XIX_Grundumfang_XIX_SAM
    connect Grundumfang_XIX_SAM.SP_IF_Bel_DiETa_Parken_XIX_Grundumfang_XIX_SAM -> Grundumfang_XIX_SAM.RP_IF_Bel_DiETa_Parken_XIX_Grundumfang_XIX_SAM
    connect Grundumfang_XIX_SAM.SP_IF_FAS_Taster_XIX_Grundumfang_XIX_SAM -> Grundumfang_XIX_SAM.RP_IF_FAS_Taster_XIX_Grundumfang_XIX_SAM
    connect Grundumfang_XIX_SAM.SP_IF_HBFS_FH_S_AutoHoch_XIX_Grundumfang_XIX_SAM -> Grundumfang_XIX_SAM.RP_IF_HBFS_FH_S_AutoHoch_XIX_Grundumfang_XIX_SAM
    connect Grundumfang_XIX_SAM.SP_IF_HBFS_FH_S_AutoTief_XIX_Grundumfang_XIX_SAM -> Grundumfang_XIX_SAM.RP_IF_HBFS_FH_S_AutoTief_XIX_Grundumfang_XIX_SAM
    connect Grundumfang_XIX_SAM.SP_IF_HBFS_FH_S_ManHoch_XIX_Grundumfang_XIX_SAM -> Grundumfang_XIX_SAM.RP_IF_HBFS_FH_S_ManHoch_XIX_Grundumfang_XIX_SAM
    connect Grundumfang_XIX_SAM.SP_IF_HBFS_FH_S_ManTief_XIX_Grundumfang_XIX_SAM -> Grundumfang_XIX_SAM.RP_IF_HBFS_FH_S_ManTief_XIX_Grundumfang_XIX_SAM
    connect Grundumfang_XIX_SAM.SP_IF_HBFS_Status_KiSi_XIX_Grundumfang_XIX_SAM -> Grundumfang_XIX_SAM.RP_IF_HBFS_Status_KiSi_XIX_Grundumfang_XIX_SAM
    connect Grundumfang_XIX_SAM.SP_IF_HBFS_TIG_betaetigt_XIX_Grundumfang_XIX_SAM -> Grundumfang_XIX_SAM.RP_IF_HBFS_TIG_betaetigt_XIX_Grundumfang_XIX_SAM
    connect Grundumfang_XIX_SAM.SP_IF_HBFS_Tuer_geoeffnet_XIX_Grundumfang_XIX_SAM -> Grundumfang_XIX_SAM.RP_IF_HBFS_Tuer_geoeffnet_XIX_Grundumfang_XIX_SAM
    connect Grundumfang_XIX_SAM.SP_IF_HFS_FH_S_AutoHoch_XIX_Grundumfang_XIX_SAM -> Grundumfang_XIX_SAM.RP_IF_HFS_FH_S_AutoHoch_XIX_Grundumfang_XIX_SAM
    connect Grundumfang_XIX_SAM.SP_IF_HFS_FH_S_AutoTief_XIX_Grundumfang_XIX_SAM -> Grundumfang_XIX_SAM.RP_IF_HFS_FH_S_AutoTief_XIX_Grundumfang_XIX_SAM
    connect Grundumfang_XIX_SAM.SP_IF_HFS_FH_S_ManHoch_XIX_Grundumfang_XIX_SAM -> Grundumfang_XIX_SAM.RP_IF_HFS_FH_S_ManHoch_XIX_Grundumfang_XIX_SAM
    connect Grundumfang_XIX_SAM.SP_IF_HFS_FH_S_ManTief_XIX_Grundumfang_XIX_SAM -> Grundumfang_XIX_SAM.RP_IF_HFS_FH_S_ManTief_XIX_Grundumfang_XIX_SAM
    connect Grundumfang_XIX_SAM.SP_IF_HFS_Status_KiSi_XIX_Grundumfang_XIX_SAM -> Grundumfang_XIX_SAM.RP_IF_HFS_Status_KiSi_XIX_Grundumfang_XIX_SAM
    connect Grundumfang_XIX_SAM.SP_IF_HFS_TIG_betaetigt_XIX_Grundumfang_XIX_SAM -> Grundumfang_XIX_SAM.RP_IF_HFS_TIG_betaetigt_XIX_Grundumfang_XIX_SAM
    connect Grundumfang_XIX_SAM.SP_IF_HFS_Tuer_geoeffnet_XIX_Grundumfang_XIX_SAM -> Grundumfang_XIX_SAM.RP_IF_HFS_Tuer_geoeffnet_XIX_Grundumfang_XIX_SAM
    connect Grundumfang_XIX_SAM.SP_IF_LRH_On_Off_XIX_Grundumfang_XIX_SAM -> Grundumfang_XIX_SAM.RP_IF_LRH_On_Off_XIX_Grundumfang_XIX_SAM
    connect Grundumfang_XIX_SAM.SP_IF_LRH_aktiv_XIX_Grundumfang_XIX_SAM -> Grundumfang_XIX_SAM.RP_IF_LRH_aktiv_XIX_Grundumfang_XIX_SAM
    connect Grundumfang_XIX_SAM.SP_IF_LSS_Tastencode_XIX_Grundumfang_XIX_SAM -> Grundumfang_XIX_SAM.RP_IF_LSS_Tastencode_XIX_Grundumfang_XIX_SAM
    connect Grundumfang_XIX_SAM.SP_IF_SMLS_01_BZ_XIX_Grundumfang_XIX_SAM -> Grundumfang_XIX_SAM.RP_IF_SMLS_01_BZ_XIX_Grundumfang_XIX_SAM
    connect Grundumfang_XIX_SAM.SP_IF_SMLS_01_CRC_XIX_Grundumfang_XIX_SAM -> Grundumfang_XIX_SAM.RP_IF_SMLS_01_CRC_XIX_Grundumfang_XIX_SAM
    connect Grundumfang_XIX_SAM.SP_IF_SMLS_Hupe_XIX_Grundumfang_XIX_SAM -> Grundumfang_XIX_SAM.RP_IF_SMLS_Hupe_XIX_Grundumfang_XIX_SAM
    connect Grundumfang_XIX_SAM.SP_IF_WH_Frontwaschen_XIX_Grundumfang_XIX_SAM -> Grundumfang_XIX_SAM.RP_IF_WH_Frontwaschen_XIX_Grundumfang_XIX_SAM
    connect Grundumfang_XIX_SAM.SP_IF_WH_Heckintervall_XIX_Grundumfang_XIX_SAM -> Grundumfang_XIX_SAM.RP_IF_WH_Heckintervall_XIX_Grundumfang_XIX_SAM
    connect Grundumfang_XIX_SAM.SP_IF_WH_Heckwaschen_XIX_Grundumfang_XIX_SAM -> Grundumfang_XIX_SAM.RP_IF_WH_Heckwaschen_XIX_Grundumfang_XIX_SAM
    connect Grundumfang_XIX_SAM.SP_IF_WH_Intervall_XIX_Grundumfang_XIX_SAM -> Grundumfang_XIX_SAM.RP_IF_WH_Intervall_XIX_Grundumfang_XIX_SAM
    connect Grundumfang_XIX_SAM.SP_IF_WH_Intervallstufen_XIX_Grundumfang_XIX_SAM -> Grundumfang_XIX_SAM.RP_IF_WH_Intervallstufen_XIX_Grundumfang_XIX_SAM
    connect Grundumfang_XIX_SAM.SP_IF_WH_Tipwischen_XIX_Grundumfang_XIX_SAM -> Grundumfang_XIX_SAM.RP_IF_WH_Tipwischen_XIX_Grundumfang_XIX_SAM
    connect Grundumfang_XIX_SAM.SP_IF_WH_WischerStufe1_XIX_Grundumfang_XIX_SAM -> Grundumfang_XIX_SAM.RP_IF_WH_WischerStufe1_XIX_Grundumfang_XIX_SAM
    connect Grundumfang_XIX_SAM.SP_IF_WH_WischerStufe2_XIX_Grundumfang_XIX_SAM -> Grundumfang_XIX_SAM.RP_IF_WH_WischerStufe2_XIX_Grundumfang_XIX_SAM
    connect Grundumfang_XIX_SAM.SP_IF_WH_Wischer_Fehler_XIX_Grundumfang_XIX_SAM -> Grundumfang_XIX_SAM.RP_IF_WH_Wischer_Fehler_XIX_Grundumfang_XIX_SAM
