[part 17 of 22: packages /PDU to /ISignal]
AUTOSAR XML (schema 4-3-0)
package /PDU
  dcm i pdu DCM_E3V_K2CANFD_XIX_TPCHType_CANFD_ISO_Diagnose_XIX_0x1C40000E_XIX_0x1C42000E_XIX_Physical: length=512, diag-pdu-type=DIAG-REQUEST
  dcm i pdu DCM_E3V_K2CANFD_XIX_TPCHType_CANFD_ISO_Diagnose_XIX_0x1C410000_XIX_Functional: length=62, diag-pdu-type=DIAG-REQUEST
  dcm i pdu DCM_E3V_K2CANFD_XIX_TPCHType_CANFD_ISO_Diagnose_XIX_0x1C42000E_XIX_0x1C40000E_XIX_Physical: length=512, diag-pdu-type=DIAG-RESPONSE
  dcm i pdu DCM_E3V_K2CANFD_XIX_TPCHType_CANFD_OBDC_Diagnose_XIX_0x1C40020E_XIX_0x1C42020E_XIX_Physical: length=512, diag-pdu-type=DIAG-REQUEST
  dcm i pdu DCM_E3V_K2CANFD_XIX_TPCHType_CANFD_OBDC_Diagnose_XIX_0x1C410200_XIX_Functional: length=62, diag-pdu-type=DIAG-REQUEST
  dcm i pdu DCM_E3V_K2CANFD_XIX_TPCHType_CANFD_OBDC_Diagnose_XIX_0x1C42020E_XIX_0x1C40020E_XIX_Physical: length=512, diag-pdu-type=DIAG-RESPONSE
  dcm i pdu DCM_E3V_K2CANFD_XIX_TPCHType_CANHS_Flash_DIA_XIX_0x17FC1601_XIX_0x17FE1601_XIX_Physical: length=512, diag-pdu-type=DIAG-REQUEST
  dcm i pdu DCM_E3V_K2CANFD_XIX_TPCHType_CANHS_Flash_DIA_XIX_0x17FC176E_XIX_0x17FE176E_XIX_Physical: length=512, diag-pdu-type=DIAG-REQUEST
  dcm i pdu DCM_E3V_K2CANFD_XIX_TPCHType_CANHS_Flash_DIA_XIX_0x17FE1601_XIX_0x17FC1601_XIX_Physical: length=512, diag-pdu-type=DIAG-RESPONSE
  dcm i pdu DCM_E3V_K2CANFD_XIX_TPCHType_CANHS_Flash_DIA_XIX_0x17FE176E_XIX_0x17FC176E_XIX_Physical: length=512, diag-pdu-type=DIAG-RESPONSE
  dcm i pdu DCM_E3V_K2CANFD_XIX_TPCHType_CANHS_ISO_Diagnose_XIX_0x700_XIX_Functional: length=7, diag-pdu-type=DIAG-REQUEST
  dcm i pdu DCM_E3V_K2CANFD_XIX_TPCHType_CANHS_ISO_Diagnose_XIX_0x70E_XIX_0x778_XIX_Physical: length=512, diag-pdu-type=DIAG-REQUEST
  dcm i pdu DCM_E3V_K2CANFD_XIX_TPCHType_CANHS_ISO_Diagnose_XIX_0x778_XIX_0x70E_XIX_Physical: length=512, diag-pdu-type=DIAG-RESPONSE
  dcm i pdu DCM_E3V_SAM_LIN11_XIX_TPCHType_LIN_Diagnose_XIX_0x0_XIX_0x1D_XIX_Physical: length=128
  dcm i pdu DCM_E3V_SAM_LIN11_XIX_TPCHType_LIN_Diagnose_XIX_0x0_XIX_0x4E_XIX_Physical: length=128
  dcm i pdu DCM_E3V_SAM_LIN11_XIX_TPCHType_LIN_Diagnose_XIX_0x0_XIX_0x6C_XIX_Physical: length=128
  dcm i pdu DCM_E3V_SAM_LIN11_XIX_TPCHType_LIN_Diagnose_XIX_0x1D_XIX_0x0_XIX_Physical: length=128
  dcm i pdu DCM_E3V_SAM_LIN11_XIX_TPCHType_LIN_Diagnose_XIX_0x4E_XIX_0x0_XIX_Physical: length=128
  dcm i pdu DCM_E3V_SAM_LIN11_XIX_TPCHType_LIN_Diagnose_XIX_0x6C_XIX_0x0_XIX_Physical: length=128
  dcm i pdu DCM_E3V_SAM_LIN12_XIX_TPCHType_LIN_Diagnose_XIX_0x0_XIX_0x52_XIX_Physical: length=128
  dcm i pdu DCM_E3V_SAM_LIN12_XIX_TPCHType_LIN_Diagnose_XIX_0x0_XIX_0x53_XIX_Physical: length=128
  dcm i pdu DCM_E3V_SAM_LIN12_XIX_TPCHType_LIN_Diagnose_XIX_0x52_XIX_0x0_XIX_Physical: length=128
  dcm i pdu DCM_E3V_SAM_LIN12_XIX_TPCHType_LIN_Diagnose_XIX_0x53_XIX_0x0_XIX_Physical: length=128
  dcm i pdu DCM_E3V_SAM_LIN1_XIX_TPCHType_LIN_Diagnose_XIX_0x0_XIX_0x2_XIX_Physical: length=128
  dcm i pdu DCM_E3V_SAM_LIN1_XIX_TPCHType_LIN_Diagnose_XIX_0x0_XIX_0x59_XIX_Physical: length=128
  dcm i pdu DCM_E3V_SAM_LIN1_XIX_TPCHType_LIN_Diagnose_XIX_0x0_XIX_0xB_XIX_Physical: length=128
  dcm i pdu DCM_E3V_SAM_LIN1_XIX_TPCHType_LIN_Diagnose_XIX_0x2_XIX_0x0_XIX_Physical: length=128
  dcm i pdu DCM_E3V_SAM_LIN1_XIX_TPCHType_LIN_Diagnose_XIX_0x59_XIX_0x0_XIX_Physical: length=128
  dcm i pdu DCM_E3V_SAM_LIN1_XIX_TPCHType_LIN_Diagnose_XIX_0xB_XIX_0x0_XIX_Physical: length=128
  dcm i pdu DCM_E3V_SAM_LIN3_XIX_TPCHType_LIN_Diagnose_XIX_0x0_XIX_0x1E_XIX_Physical: length=128
  dcm i pdu DCM_E3V_SAM_LIN3_XIX_TPCHType_LIN_Diagnose_XIX_0x0_XIX_0x5E_XIX_Physical: length=128
  dcm i pdu DCM_E3V_SAM_LIN3_XIX_TPCHType_LIN_Diagnose_XIX_0x1E_XIX_0x0_XIX_Physical: length=128
  dcm i pdu DCM_E3V_SAM_LIN3_XIX_TPCHType_LIN_Diagnose_XIX_0x5E_XIX_0x0_XIX_Physical: length=128
  dcm i pdu DCM_E3V_SAM_LIN4_XIX_TPCHType_LIN_Diagnose_XIX_0x0_XIX_0x15_XIX_Physical: length=128
  dcm i pdu DCM_E3V_SAM_LIN4_XIX_TPCHType_LIN_Diagnose_XIX_0x0_XIX_0x17_XIX_Physical: length=128
  dcm i pdu DCM_E3V_SAM_LIN4_XIX_TPCHType_LIN_Diagnose_XIX_0x0_XIX_0x1_XIX_Physical: length=128
  dcm i pdu DCM_E3V_SAM_LIN4_XIX_TPCHType_LIN_Diagnose_XIX_0x0_XIX_0x40_XIX_Physical: length=128
  dcm i pdu DCM_E3V_SAM_LIN4_XIX_TPCHType_LIN_Diagnose_XIX_0x0_XIX_0x41_XIX_Physical: length=128
  dcm i pdu DCM_E3V_SAM_LIN4_XIX_TPCHType_LIN_Diagnose_XIX_0x0_XIX_0xD_XIX_Physical: length=128
  dcm i pdu DCM_E3V_SAM_LIN4_XIX_TPCHType_LIN_Diagnose_XIX_0x0_XIX_0xF_XIX_Physical: length=128
  dcm i pdu DCM_E3V_SAM_LIN4_XIX_TPCHType_LIN_Diagnose_XIX_0x15_XIX_0x0_XIX_Physical: length=128
  dcm i pdu DCM_E3V_SAM_LIN4_XIX_TPCHType_LIN_Diagnose_XIX_0x17_XIX_0x0_XIX_Physical: length=128
  dcm i pdu DCM_E3V_SAM_LIN4_XIX_TPCHType_LIN_Diagnose_XIX_0x1_XIX_0x0_XIX_Physical: length=128
  dcm i pdu DCM_E3V_SAM_LIN4_XIX_TPCHType_LIN_Diagnose_XIX_0x40_XIX_0x0_XIX_Physical: length=128
  dcm i pdu DCM_E3V_SAM_LIN4_XIX_TPCHType_LIN_Diagnose_XIX_0x41_XIX_0x0_XIX_Physical: length=128
  dcm i pdu DCM_E3V_SAM_LIN4_XIX_TPCHType_LIN_Diagnose_XIX_0xD_XIX_0x0_XIX_Physical: length=128
  dcm i pdu DCM_E3V_SAM_LIN4_XIX_TPCHType_LIN_Diagnose_XIX_0xF_XIX_0x0_XIX_Physical: length=128
  dcm i pdu DCM_E3V_SAM_LIN6_XIX_TPCHType_LIN_Diagnose_XIX_0x0_XIX_0x1C_XIX_Physical: length=128
  dcm i pdu DCM_E3V_SAM_LIN6_XIX_TPCHType_LIN_Diagnose_XIX_0x1C_XIX_0x0_XIX_Physical: length=128
  pdu SOK_KST_BCM_Resp_05_XIX_E3V_K2CANFD: length=4, unused-bit-pattern=0
    signal KST_Anf_Klemme_15_Auth_XIX_SOK_KST_BCM_Resp_05_XIX_E3V_K2CANFD: start 31, 1 bit, little-endian, data-type-policy=OVERRIDE, i-signal-type=PRIMITIVE, init-value=0, base-type=BT_KST_Anf_Klemme_15_Auth, compu {0=Cx0_nicht_angefordert (CM_KST_Anf_Klemme_15_Auth_Cx0_nicht_angefordert), 1=Cx1_angefordert (CM_KST_Anf_Klemme_15_Auth_Cx1_angefordert)}, range raw 0..1, transfer-property=TRIGGERED, to SAM  # Anforderung der Klemme 15 an das SAM für das Schalten des HW-Klemme 15 Ausgangs. Signal ist SOK geschützt.
  pdu SOK_ZV_HBFS_BCM_Resp_04_XIX_E3V_K2CANFD: length=4, minimum-delay=0.01, transmission-mode-true-timing=event-controlled-timing={number-of-repetitions=0, repetition-period=0.0}, unused-bit-pattern=0
    signal ZV_HBFS_entsafen_Auth_XIX_SOK_ZV_HBFS_BCM_Resp_04_XIX_E3V_K2CANFD: start 30, 1 bit, little-endian, data-type-policy=OVERRIDE, i-signal-type=PRIMITIVE, init-value=0, base-type=BT_ZV_HBFS_entsafen_Auth, compu {0=Cx0_nicht_aktiv (CM_ZV_HBFS_entsafen_Auth_Cx0_nicht_aktiv), 1=Cx1_aktiv (CM_ZV_HBFS_entsafen_Auth_Cx1_aktiv)}, range raw 0..1, transfer-property=TRIGGERED-ON-CHANGE-WITHOUT-REPETITION, to SAM  # Anforderung zum entsafen
    signal ZV_HBFS_entriegeln_Auth_XIX_SOK_ZV_HBFS_BCM_Resp_04_XIX_E3V_K2CANFD: start 31, 1 bit, little-endian, data-type-policy=OVERRIDE, i-signal-type=PRIMITIVE, init-value=0, base-type=BT_ZV_HBFS_entriegeln_Auth, compu {0=Cx0_nicht_aktiv (CM_ZV_HBFS_entriegeln_Auth_Cx0_nicht_aktiv), 1=Cx1_aktiv (CM_ZV_HBFS_entriegeln_Auth_Cx1_aktiv)}, range raw 0..1, transfer-property=TRIGGERED-ON-CHANGE-WITHOUT-REPETITION, to SAM  # Anforderung zum entriegeln
  pdu SOK_ZV_HFS_BCM_Resp_03_XIX_E3V_K2CANFD: length=4, minimum-delay=0.01, transmission-mode-true-timing=event-controlled-timing={number-of-repetitions=0, repetition-period=0.0}, unused-bit-pattern=0
    signal ZV_HFS_entsafen_Auth_XIX_SOK_ZV_HFS_BCM_Resp_03_XIX_E3V_K2CANFD: start 30, 1 bit, little-endian, data-type-policy=OVERRIDE, i-signal-type=PRIMITIVE, init-value=0, base-type=BT_ZV_HFS_entsafen_Auth, compu {0=Cx0_nicht_aktiv (CM_ZV_HFS_entsafen_Auth_Cx0_nicht_aktiv), 1=Cx1_aktiv (CM_ZV_HFS_entsafen_Auth_Cx1_aktiv)}, range raw 0..1, transfer-property=TRIGGERED-ON-CHANGE-WITHOUT-REPETITION, to SAM  # Anforderung zum entsafen
    signal ZV_HFS_entriegeln_Auth_XIX_SOK_ZV_HFS_BCM_Resp_03_XIX_E3V_K2CANFD: start 31, 1 bit, little-endian, data-type-policy=OVERRIDE, i-signal-type=PRIMITIVE, init-value=0, base-type=BT_ZV_HFS_entriegeln_Auth, compu {0=Cx0_nicht_aktiv (CM_ZV_HFS_entriegeln_Auth_Cx0_nicht_aktiv), 1=Cx1_aktiv (CM_ZV_HFS_entriegeln_Auth_Cx1_aktiv)}, range raw 0..1, transfer-property=TRIGGERED-ON-CHANGE-WITHOUT-REPETITION, to SAM  # Anforderung zum entriegeln
  pdu SOK_ZV_HW_BCM_Resp_02_XIX_E3V_K2CANFD: length=4, transmission-mode-true-timing=event-controlled-timing={number-of-repetitions=0, repetition-period=0.0}, unused-bit-pattern=0
    signal ZV_HW_Motor_Lock_HK_Auth_XIX_SOK_ZV_HW_BCM_Resp_02_XIX_E3V_K2CANFD: start 31, 1 bit, little-endian, data-type-policy=OVERRIDE, i-signal-type=PRIMITIVE, init-value=0, base-type=BT_ZV_HW_Motor_Lock_HK_Auth, compu {0=Cx0_nicht_aktiv (CM_ZV_HW_Motor_Lock_HK_Auth_Cx0_nicht_aktiv), 1=Cx1_aktiv (CM_ZV_HW_Motor_Lock_HK_Auth_Cx1_aktiv)}, range raw 0..1, transfer-property=TRIGGERED-WITHOUT-REPETITION, to SAM  # Ansteuerung des Heckdeckelmotors zum entriegeln
  pdu SOK_ZV_Rueck_HW_Gateway_Resp_01_XIX_E3V_K2CANFD: length=4, minimum-delay=0.01, transmission-mode-true-timing=event-controlled-timing={number-of-repetitions=0, repetition-period=0.0}, unused-bit-pattern=0
    signal HD_Hauptraste_Auth_XIX_SOK_ZV_Rueck_HW_Gateway_Resp_01_XIX_E3V_K2CANFD: start 24, 1 bit, little-endian, data-type-policy=OVERRIDE, i-signal-type=PRIMITIVE, init-value=0, base-type=BT_HD_Hauptraste_Auth, compu {0=Cx0_geschlossen (CM_HD_Hauptraste_Auth_Cx0_geschlossen), 1=Cx1_offen (CM_HD_Hauptraste_Auth_Cx1_offen)}, range raw 0..1  # Rueckmeldung Heckdeckel
    signal HD_Vorraste_Auth_XIX_SOK_ZV_Rueck_HW_Gateway_Resp_01_XIX_E3V_K2CANFD: start 25, 1 bit, little-endian, data-type-policy=OVERRIDE, i-signal-type=PRIMITIVE, init-value=0, base-type=BT_HD_Vorraste_Auth, compu {0=Cx0_geschlossen (CM_HD_Vorraste_Auth_Cx0_geschlossen), 1=Cx1_offen (CM_HD_Vorraste_Auth_Cx1_offen)}, range raw 0..1  # Rueckmeldung Heckdeckel
    signal HW_Drehfalle_Tuer_HL_Auth_XIX_SOK_ZV_Rueck_HW_Gateway_Resp_01_XIX_E3V_K2CANFD: start 26, 1 bit, little-endian, data-type-policy=OVERRIDE, i-signal-type=PRIMITIVE, init-value=0, base-type=BT_HW_Drehfalle_Tuer_HL_Auth, compu {0=Cx0_geschlossen (CM_HW_Drehfalle_Tuer_HL_Auth_Cx0_geschlossen), 1=Cx1_offen (CM_HW_Drehfalle_Tuer_HL_Auth_Cx1_offen)}, range raw 0..1  # Rueckmeldung Schlossstatus
    signal HW_Drehfalle_Tuer_HR_Auth_XIX_SOK_ZV_Rueck_HW_Gateway_Resp_01_XIX_E3V_K2CANFD: start 27, 1 bit, little-endian, data-type-policy=OVERRIDE, i-signal-type=PRIMITIVE, init-value=0, base-type=BT_HW_Drehfalle_Tuer_HR_Auth, compu {0=Cx0_geschlossen (CM_HW_Drehfalle_Tuer_HR_Auth_Cx0_geschlossen), 1=Cx1_offen (CM_HW_Drehfalle_Tuer_HR_Auth_Cx1_offen)}, range raw 0..1  # Rueckmeldung Schlossstatus
    signal HW_Status_Schloss_safed_HL_Auth_XIX_SOK_ZV_Rueck_HW_Gateway_Resp_01_XIX_E3V_K2CANFD: start 28, 1 bit, little-endian, data-type-policy=OVERRIDE, i-signal-type=PRIMITIVE, base-type=BT_HW_Status_Schloss_safed_HL_Auth, compu {0=Cx0_nicht_gesafet (CM_HW_Status_Schloss_safed_HL_Auth_Cx0_nicht_gesafet), 1=Cx1_gesafet (CM_HW_Status_Schloss_safed_HL_Auth_Cx1_gesafet)}, range raw 0..1  # Rueckmeldung Schlossstatus
    signal HW_Status_Schloss_safed_HR_Auth_XIX_SOK_ZV_Rueck_HW_Gateway_Resp_01_XIX_E3V_K2CANFD: start 29, 1 bit, little-endian, data-type-policy=OVERRIDE, i-signal-type=PRIMITIVE, init-value=0, base-type=BT_HW_Status_Schloss_safed_HR_Auth, compu {0=Cx0_nicht_gesafet (CM_HW_Status_Schloss_safed_HR_Auth_Cx0_nicht_gesafet), 1=Cx1_gesafet (CM_HW_Status_Schloss_safed_HR_Auth_Cx1_gesafet)}, range raw 0..1  # Rueckmeldung Schlossstatus
    signal HW_Status_Schloss_verr_HL_Auth_XIX_SOK_ZV_Rueck_HW_Gateway_Resp_01_XIX_E3V_K2CANFD: start 30, 1 bit, little-endian, data-type-policy=OVERRIDE, i-signal-type=PRIMITIVE, init-value=0, base-type=BT_HW_Status_Schloss_verr_HL_Auth, compu {0=Cx0_nicht_verriegelt (CM_HW_Status_Schloss_verr_HL_Auth_Cx0_nicht_verriegelt), 1=Cx1_verriegelt (CM_HW_Status_Schloss_verr_HL_Auth_Cx1_verriegelt)}, range raw 0..1  # Rueckmeldung Schlossstatus
    signal HW_Status_Schloss_verr_HR_Auth_XIX_SOK_ZV_Rueck_HW_Gateway_Resp_01_XIX_E3V_K2CANFD: start 31, 1 bit, little-endian, data-type-policy=OVERRIDE, i-signal-type=PRIMITIVE, init-value=0, base-type=BT_HW_Status_Schloss_verr_HR_Auth, compu {0=Cx0_nicht_verriegelt (CM_HW_Status_Schloss_verr_HR_Auth_Cx0_nicht_verriegelt), 1=Cx1_verriegelt (CM_HW_Status_Schloss_verr_HR_Auth_Cx1_verriegelt)}, range raw 0..1  # Rueckmeldung Schlossstatus
    mapping SG_SOK_ZV_Rueck_HW_Gateway_Resp_01_XIX_E3V_K2CANFD: i-signal-group=SG_SOK_ZV_Rueck_HW_Gateway_Resp_01_XIX_E3V_K2CANFD, transfer-property=TRIGGERED-ON-CHANGE-WITHOUT-REPETITION
  pdu VIN_01_Mx00_XIX_E3V_K2CANFD: length=8, transmission-mode-true-timing={cyclic-timing={time-offset=0, time-period=0.4}, event-controlled-timing={number-of-repetitions=0, repetition-period=0.0}}, unused-bit-pattern=0  # 200ms bei D4 und folgende
    signal VIN_01_MUX_XIX_VIN_01_Mx00_XIX_E3V_K2CANFD: start 0, 2 bit, little-endian, data-type-policy=OVERRIDE, i-signal-type=PRIMITIVE, init-value=0, base-type=BT_VIN_01_MUX, compu {phys=raw for raw 0..3}, range phys 0..3, raw 0..3, to SAM(timeout 2 s)  # Achtung: Die Botschaft ist nicht linear gemultiplext!!! Sondern 0,1,0,2,0, usw.
    signal KS_Geheimnis_1_XIX_VIN_01_Mx00_XIX_E3V_K2CANFD: start 8, 8 bit, little-endian, data-type-policy=OVERRIDE, i-signal-type=PRIMITIVE, init-value=0, base-type=BT_KS_Geheimnis_1, compu {phys=raw for raw 0..255}, range phys 0..255, raw 0..255, transfer-property=TRIGGERED
    signal KS_Geheimnis_2_XIX_VIN_01_Mx00_XIX_E3V_K2CANFD: start 16, 8 bit, little-endian, data-type-policy=OVERRIDE, i-signal-type=PRIMITIVE, init-value=0, base-type=BT_KS_Geheimnis_2, compu {phys=raw for raw 0..255}, range phys 0..255, raw 0..255, transfer-property=TRIGGERED
    signal KS_Geheimnis_3_XIX_VIN_01_Mx00_XIX_E3V_K2CANFD: start 24, 8 bit, little-endian, data-type-policy=OVERRIDE, i-signal-type=PRIMITIVE, init-value=0, base-type=BT_KS_Geheimnis_3, compu {phys=raw for raw 0..255}, range phys 0..255, raw 0..255, transfer-property=TRIGGERED
    signal KS_Geheimnis_4_XIX_VIN_01_Mx00_XIX_E3V_K2CANFD: start 32, 8 bit, little-endian, data-type-policy=OVERRIDE, i-signal-type=PRIMITIVE, init-value=0, base-type=BT_KS_Geheimnis_4, compu {phys=raw for raw 0..255}, range phys 0..255, raw 0..255, transfer-property=TRIGGERED
    signal VIN_1_XIX_VIN_01_Mx00_XIX_E3V_K2CANFD: start 40, 8 bit, little-endian, data-type-policy=OVERRIDE, i-signal-type=PRIMITIVE, init-value=45, base-type=BT_VIN_1, compu {phys=raw for raw 0..255}, range phys 0..255, raw 0..255, transfer-property=TRIGGERED, to SAM(timeout 2 s)  # Initwert: 0x2D bei Fahrzeugen mit Wegfahrsperrengeneration >= 5 0x58 bei Fahrzeugen mit Wegfahrsperrengeneration < 5 (z.B. WFS-4)
    signal VIN_2_XIX_VIN_01_Mx00_XIX_E3V_K2CANFD: start 48, 8 bit, little-endian, data-type-policy=OVERRIDE, i-signal-type=PRIMITIVE, init-value=45, base-type=BT_VIN_2, compu {phys=raw for raw 0..255}, range phys 0..255, raw 0..255, transfer-property=TRIGGERED, to SAM(timeout 2 s)  # Initwert: 0x2D bei Fahrzeugen mit Wegfahrsperrengeneration >= 5 0x58 bei Fahrzeugen mit Wegfahrsperrengeneration < 5 (z.B. WFS-4)
    signal VIN_3_XIX_VIN_01_Mx00_XIX_E3V_K2CANFD: start 56, 8 bit, little-endian, data-type-policy=OVERRIDE, i-signal-type=PRIMITIVE, init-value=45, base-type=BT_VIN_3, compu {phys=raw for raw 0..255}, range phys 0..255, raw 0..255, transfer-property=TRIGGERED, to SAM(timeout 2 s)  # Initwert: 0x2D bei Fahrzeugen mit Wegfahrsperrengeneration >= 5 0x58 bei Fahrzeugen mit Wegfahrsperrengeneration < 5 (z.B. WFS-4)
  pdu VIN_01_Mx01_XIX_E3V_K2CANFD: length=8, transmission-mode-true-timing={cyclic-timing={time-offset=0.2, time-period=0.8}, event-controlled-timing={number-of-repetitions=0, repetition-period=0.0}}, unused-bit-pattern=0  # 200ms bei D4 und folgende
    signal VIN_01_MUX_XIX_VIN_01_Mx01_XIX_E3V_K2CANFD: start 0, 2 bit, little-endian, data-type-policy=OVERRIDE, i-signal-type=PRIMITIVE, init-value=1, base-type=BT_VIN_01_MUX, compu {phys=raw for raw 0..3}, range phys 0..3, raw 0..3, to SAM(timeout 2 s)  # Achtung: Die Botschaft ist nicht linear gemultiplext!!! Sondern 0,1,0,2,0, usw.
    signal VIN_4_XIX_VIN_01_Mx01_XIX_E3V_K2CANFD: start 8, 8 bit, little-endian, data-type-policy=OVERRIDE, i-signal-type=PRIMITIVE, init-value=45, base-type=BT_VIN_4, compu {phys=raw for raw 0..255}, range phys 0..255, raw 0..255, transfer-property=TRIGGERED, to SAM(timeout 2 s)  # Initwert: 0x2D bei Fahrzeugen mit Wegfahrsperrengeneration >= 5 0x58 bei Fahrzeugen mit Wegfahrsperrengeneration < 5 (z.B. WFS-4)
    signal VIN_5_XIX_VIN_01_Mx01_XIX_E3V_K2CANFD: start 16, 8 bit, little-endian, data-type-policy=OVERRIDE, i-signal-type=PRIMITIVE, init-value=45, base-type=BT_VIN_5, compu {phys=raw for raw 0..255}, range phys 0..255, raw 0..255, transfer-property=TRIGGERED, to SAM(timeout 2 s)  # Initwert: 0x2D bei Fahrzeugen mit Wegfahrsperrengeneration >= 5 0x58 bei Fahrzeugen mit Wegfahrsperrengeneration < 5 (z.B. WFS-4)
    signal VIN_6_XIX_VIN_01_Mx01_XIX_E3V_K2CANFD: start 24, 8 bit, little-endian, data-type-policy=OVERRIDE, i-signal-type=PRIMITIVE, init-value=45, base-type=BT_VIN_6, compu {phys=raw for raw 0..255}, range phys 0..255, raw 0..255, transfer-property=TRIGGERED, to SAM(timeout 2 s)  # Initwert: 0x2D bei Fahrzeugen mit Wegfahrsperrengeneration >= 5 0x58 bei Fahrzeugen mit Wegfahrsperrengeneration < 5 (z.B. WFS-4)
    signal VIN_7_XIX_VIN_01_Mx01_XIX_E3V_K2CANFD: start 32, 8 bit, little-endian, data-type-policy=OVERRIDE, i-signal-type=PRIMITIVE, init-value=45, base-type=BT_VIN_7, compu {phys=raw for raw 0..255}, range phys 0..255, raw 0..255, transfer-property=TRIGGERED, to SAM(timeout 2 s)  # Initwert: 0x2D bei Fahrzeugen mit Wegfahrsperrengeneration >= 5 0x58 bei Fahrzeugen mit Wegfahrsperrengeneration < 5 (z.B. WFS-4)
    signal VIN_8_XIX_VIN_01_Mx01_XIX_E3V_K2CANFD: start 40, 8 bit, little-endian, data-type-policy=OVERRIDE, i-signal-type=PRIMITIVE, init-value=45, base-type=BT_VIN_8, compu {phys=raw for raw 0..255}, range phys 0..255, raw 0..255, transfer-property=TRIGGERED, to SAM(timeout 2 s)  # Initwert: 0x2D bei Fahrzeugen mit Wegfahrsperrengeneration >= 5 0x58 bei Fahrzeugen mit Wegfahrsperrengeneration < 5 (z.B. WFS-4)
    signal VIN_9_XIX_VIN_01_Mx01_XIX_E3V_K2CANFD: start 48, 8 bit, little-endian, data-type-policy=OVERRIDE, i-signal-type=PRIMITIVE, init-value=45, base-type=BT_VIN_9, compu {phys=raw for raw 0..255}, range phys 0..255, raw 0..255, transfer-property=TRIGGERED, to SAM(timeout 2 s)  # Initwert: 0x2D bei Fahrzeugen mit Wegfahrsperrengeneration >= 5 0x58 bei Fahrzeugen mit Wegfahrsperrengeneration < 5 (z.B. WFS-4)
    signal VIN_10_XIX_VIN_01_Mx01_XIX_E3V_K2CANFD: start 56, 8 bit, little-endian, data-type-policy=OVERRIDE, i-signal-type=PRIMITIVE, init-value=45, base-type=BT_VIN_10, compu {phys=raw for raw 0..255}, range phys 0..255, raw 0..255, transfer-property=TRIGGERED, to SAM(timeout 2 s)  # Initwert: 0x2D bei Fahrzeugen mit Wegfahrsperrengeneration >= 5 0x58 bei Fahrzeugen mit Wegfahrsperrengeneration < 5 (z.B. WFS-4)
  pdu VIN_01_Mx02_XIX_E3V_K2CANFD: length=8, transmission-mode-true-timing={cyclic-timing={time-offset=0.6, time-period=0.8}, event-controlled-timing={number-of-repetitions=0, repetition-period=0.0}}, unused-bit-pattern=0  # 200ms bei D4 und folgende
    signal VIN_01_MUX_XIX_VIN_01_Mx02_XIX_E3V_K2CANFD: start 0, 2 bit, little-endian, data-type-policy=OVERRIDE, i-signal-type=PRIMITIVE, init-value=2, base-type=BT_VIN_01_MUX, compu {phys=raw for raw 0..3}, range phys 0..3, raw 0..3, to SAM(timeout 2 s)  # Achtung: Die Botschaft ist nicht linear gemultiplext!!! Sondern 0,1,0,2,0, usw.
    signal VIN_11_XIX_VIN_01_Mx02_XIX_E3V_K2CANFD: start 8, 8 bit, little-endian, data-type-policy=OVERRIDE, i-signal-type=PRIMITIVE, init-value=45, base-type=BT_VIN_11, compu {phys=raw for raw 0..255}, range phys 0..255, raw 0..255, transfer-property=TRIGGERED, to SAM(timeout 2 s)  # Initwert: 0x2D bei Fahrzeugen mit Wegfahrsperrengeneration >= 5 0x58 bei Fahrzeugen mit Wegfahrsperrengeneration < 5 (z.B. WFS-4)
    signal VIN_12_XIX_VIN_01_Mx02_XIX_E3V_K2CANFD: start 16, 8 bit, little-endian, data-type-policy=OVERRIDE, i-signal-type=PRIMITIVE, init-value=45, base-type=BT_VIN_12, compu {phys=raw for raw 0..255}, range phys 0..255, raw 0..255, transfer-property=TRIGGERED, to SAM(timeout 2 s)  # Initwert: 0x2D bei Fahrzeugen mit Wegfahrsperrengeneration >= 5 0x58 bei Fahrzeugen mit Wegfahrsperrengeneration < 5 (z.B. WFS-4)
    signal VIN_13_XIX_VIN_01_Mx02_XIX_E3V_K2CANFD: start 24, 8 bit, little-endian, data-type-policy=OVERRIDE, i-signal-type=PRIMITIVE, init-value=45, base-type=BT_VIN_13, compu {phys=raw for raw 0..255}, range phys 0..255, raw 0..255, transfer-property=TRIGGERED, to SAM(timeout 2 s)  # Initwert: 0x2D bei Fahrzeugen mit Wegfahrsperrengeneration >= 5 0x58 bei Fahrzeugen mit Wegfahrsperrengeneration < 5 (z.B. WFS-4)
    signal VIN_14_XIX_VIN_01_Mx02_XIX_E3V_K2CANFD: start 32, 8 bit, little-endian, data-type-policy=OVERRIDE, i-signal-type=PRIMITIVE, init-value=45, base-type=BT_VIN_14, compu {phys=raw for raw 0..255}, range phys 0..255, raw 0..255, transfer-property=TRIGGERED, to SAM(timeout 2 s)  # Initwert: 0x2D bei Fahrzeugen mit Wegfahrsperrengeneration >= 5 0x58 bei Fahrzeugen mit Wegfahrsperrengeneration < 5 (z.B. WFS-4)
    signal VIN_15_XIX_VIN_01_Mx02_XIX_E3V_K2CANFD: start 40, 8 bit, little-endian, data-type-policy=OVERRIDE, i-signal-type=PRIMITIVE, init-value=45, base-type=BT_VIN_15, compu {phys=raw for raw 0..255}, range phys 0..255, raw 0..255, transfer-property=TRIGGERED, to SAM(timeout 2 s)  # Initwert: 0x2D bei Fahrzeugen mit Wegfahrsperrengeneration >= 5 0x58 bei Fahrzeugen mit Wegfahrsperrengeneration < 5 (z.B. WFS-4)
    signal VIN_16_XIX_VIN_01_Mx02_XIX_E3V_K2CANFD: start 48, 8 bit, little-endian, data-type-policy=OVERRIDE, i-signal-type=PRIMITIVE, init-value=45, base-type=BT_VIN_16, compu {phys=raw for raw 0..255}, range phys 0..255, raw 0..255, transfer-property=TRIGGERED, to SAM(timeout 2 s)  # Initwert: 0x2D bei Fahrzeugen mit Wegfahrsperrengeneration >= 5 0x58 bei Fahrzeugen mit Wegfahrsperrengeneration < 5 (z.B. WFS-4)
    signal VIN_17_XIX_VIN_01_Mx02_XIX_E3V_K2CANFD: start 56, 8 bit, little-endian, data-type-policy=OVERRIDE, i-signal-type=PRIMITIVE, init-value=45, base-type=BT_VIN_17, compu {phys=raw for raw 0..255}, range phys 0..255, raw 0..255, transfer-property=TRIGGERED, to SAM(timeout 2 s)  # Initwert: 0x2D bei Fahrzeugen mit Wegfahrsperrengeneration >= 5 0x58 bei Fahrzeugen mit Wegfahrsperrengeneration < 5 (z.B. WFS-4)
  secured i pdu SOK_E3V_K2CANFD_XIX_TPCHType_CANHS_FoD_Master_XIX_0x17FC030E_XIX_0x17FE030E_XIX_Physical:
    length=520
    authentication-props=SecureCommunicationAuthenticationProps_XIX_64
    freshness-props=SecureCommunicationFreshnessProps
    payload=PT_E3V_K2CANFD_XIX_TPCHType_CANHS_FoD_Master_XIX_0x17FC030E_XIX_0x17FE030E_XIX_Physical
    secure-communication-props={auth-data-freshness-length=0, auth-data-freshness-start-position=0, auth-info-tx-length=64, authentication-build-attempts=1, authentication-retries=1, data-id=629, freshness-value-id=4, freshness-value-length=64, freshness-value-tx-length=0}
    use-as-cryptographic-i-pdu=false
  secured i pdu SOK_E3V_K2CANFD_XIX_TPCHType_CANHS_FoD_Master_XIX_0x17FE030E_XIX_0x17FC030E_XIX_Physical:
    length=520
    authentication-props=SecureCommunicationAuthenticationProps_XIX_64
    freshness-props=SecureCommunicationFreshnessProps
    payload=PT_E3V_K2CANFD_XIX_TPCHType_CANHS_FoD_Master_XIX_0x17FE030E_XIX_0x17FC030E_XIX_Physical
    secure-communication-props={auth-data-freshness-length=0, auth-data-freshness-start-position=0, auth-info-tx-length=64, authentication-build-attempts=1, authentication-retries=1, data-id=630, freshness-value-id=1, freshness-value-length=64, freshness-value-tx-length=0}
    use-as-cryptographic-i-pdu=false
  user defined i pdu CDD_E3V_K2CANFD_XIX_TPCHType_CANHS_FoD_Master_XIX_0x17FC030E_XIX_0x17FE030E_XIX_Physical: length=512, cdd-type=TPCHType_CANHS_FoD_Master
  user defined i pdu CDD_E3V_K2CANFD_XIX_TPCHType_CANHS_FoD_Master_XIX_0x17FE030E_XIX_0x17FC030E_XIX_Physical: length=512, cdd-type=TPCHType_CANHS_FoD_Master
package /IPDUGroup
  22 x i signal i pdu group:
    SAM_XIX_E3V_CCAN_Rx: communication-direction=IN, communication-mode=CAN_Receive_All
      i-signal-i-pdus:
        Diagnose_01_XIX_E3V_CCAN
        EM1_HYB_13_XIX_E3V_CCAN_E2E
        EM2_HYB_13_XIX_E3V_CCAN_E2E
        Kessy_Ambex_{01..04}_XIX_E3V_CCAN
        MMM_01_XIX_E3V_CCAN
        ORU_0001_XIX_E3V_CCAN_E2E
        ORU_0003_XIX_E3V_CCAN_E2E
        ORU_0006_XIX_E3V_CCAN_E2E
        ORU_0013_XIX_E3V_CCAN_E2E
        ORU_0015_XIX_E3V_CCAN_E2E
        ORU_0016_XIX_E3V_CCAN_E2E
        ORU_0019_XIX_E3V_CCAN_E2E
        ORU_0023_XIX_E3V_CCAN_E2E
        ORU_0036_XIX_E3V_CCAN_E2E
        ORU_0042_XIX_E3V_CCAN_E2E
        ORU_0044_XIX_E3V_CCAN_E2E
        ORU_0048_XIX_E3V_CCAN_E2E
        ORU_0051_XIX_E3V_CCAN_E2E
        ORU_0052_XIX_E3V_CCAN_E2E
        ORU_005B_XIX_E3V_CCAN_E2E
        ORU_0069_XIX_E3V_CCAN_E2E
        ORU_006A_XIX_E3V_CCAN_E2E
        ORU_0076_XIX_E3V_CCAN_E2E
        ORU_007A_XIX_E3V_CCAN_E2E
        ORU_007E_XIX_E3V_CCAN_E2E
        ORU_0082_XIX_E3V_CCAN_E2E
        ORU_008C_XIX_E3V_CCAN_E2E
        ORU_00A5_XIX_E3V_CCAN_E2E
        ORU_00BB_XIX_E3V_CCAN_E2E
        ORU_00BC_XIX_E3V_CCAN_E2E
        ORU_00C6_XIX_E3V_CCAN_E2E
        ORU_00CE_XIX_E3V_CCAN_E2E
        ORU_00D6_XIX_E3V_CCAN_E2E
        ORU_00D7_XIX_E3V_CCAN_E2E
        ORU_03_XIX_E3V_CCAN
        ORU_0631_XIX_E3V_CCAN_E2E
        ORU_8105_XIX_E3V_CCAN_E2E
        ORU_8109_XIX_E3V_CCAN_E2E
        ORU_810A_XIX_E3V_CCAN_E2E
        ORU_810B_XIX_E3V_CCAN_E2E
        ORU_810C_XIX_E3V_CCAN_E2E
        Systeminfo_01_XIX_E3V_CCAN
        UHF_{01..08}_XIX_E3V_CCAN
        UHF_Konfig_XIX_E3V_CCAN
        UHF_TranspID_{01..04}_XIX_E3V_CCAN
    SAM_XIX_E3V_CCAN_Tx: communication-direction=OUT, communication-mode=CAN_Transmit_All
      i-signal-i-pdus:
        BCM_01_XIX_E3V_CCAN_E2E
        KN_BCM1_XIX_E3V_CCAN
        ORU_0009_XIX_E3V_CCAN_E2E
        SAM_01_XIX_E3V_CCAN_E2E
        UHF_Kessy_01_XIX_E3V_CCAN
        UHF_Sensor_{01..09}_XIX_E3V_CCAN
    SAM_XIX_E3V_K2CANFD_Rx: communication-direction=IN, communication-mode=CAN_Receive_All
      i-signal-i-pdus:
        ADecu1_01_XIX_E3V_K2CANFD_E2E
        ADecu2_01_XIX_E3V_K2CANFD_E2E
        Airbag_01_XIX_E3V_K2CANFD_E2E
        Airbag_02_XIX_E3V_K2CANFD_E2E
        Anhaenger_01_XIX_E3V_K2CANFD
        Bel_Taster_01_XIX_E3V_K2CANFD
        BEM_02_XIX_E3V_K2CANFD
        Blinkmodi_02_XIX_E3V_K2CANFD
        BMS_07_XIX_E3V_K2CANFD
        CentralLocking_01_XIX_E3V_K2CANFD
        Charisma_03_XIX_E3V_K2CANFD
        CPD_01_XIX_E3V_K2CANFD
        Diagnose_01_XIX_E3V_K2CANFD
        Dimmung_01_XIX_E3V_K2CANFD
        DRB1_01_XIX_E3V_K2CANFD_E2E
        DRB2_01_XIX_E3V_K2CANFD_E2E
        EA_02_XIX_E3V_K2CANFD
        eRWK_01_XIX_E3V_K2CANFD
        ESC_50_XIX_E3V_K2CANFD
        ESP_21_XIX_E3V_K2CANFD_E2E
        ESP_24_XIX_E3V_K2CANFD
        FoD_01_XIX_E3V_K2CANFD
        Gateway_75_XIX_E3V_K2CANFD
        Getriebe_11_XIX_E3V_K2CANFD
        HLR_02_XIX_E3V_K2CANFD
        HVL_01_XIX_E3V_K2CANFD_E2E
        IPA_02_XIX_E3V_K2CANFD
        Klemmen_Status_01_XIX_E3V_K2CANFD_E2E
        Klemmen_Status_02_XIX_E3V_K2CANFD
        Klemmen_Steuerung_01_XIX_E3V_K2CANFD_E2E
        Klima_12_XIX_E3V_K2CANFD
        Klima_16_XIX_E3V_K2CANFD
        Licht_Anf_01_XIX_E3V_K2CANFD
        Licht_vorne_01_XIX_E3V_K2CANFD
        LR_HZG_01_XIX_E3V_K2CANFD
        LRL_L_01_XIX_E3V_K2CANFD_E2E
        LRL_M_01_XIX_E3V_K2CANFD_E2E
        LRL_R_01_XIX_E3V_K2CANFD_E2E
        Mem_BFS_01_XIX_E3V_K2CANFD
        Mem_FS_01_XIX_E3V_K2CANFD
        MFG_01_XIX_E3V_K2CANFD_E2E
        MFG_05_XIX_E3V_K2CANFD
        MFL_01_XIX_E3V_K2CANFD
        Motor_14_XIX_E3V_K2CANFD
        Motor_51_Auth_XIX_E3V_K2CANFD
        Motor_54_XIX_E3V_K2CANFD
        ORU_003D_XIX_E3V_K2CANFD_E2E
        ORU_01_XIX_E3V_K2CANFD
        ORU_8133_XIX_E3V_K2CANFD_E2E
        ORU_8134_XIX_E3V_K2CANFD_E2E
        ORU_8179_XIX_E3V_K2CANFD_E2E
        ORU_817B_XIX_E3V_K2CANFD_E2E
        ORU_8181_XIX_E3V_K2CANFD_E2E
        ORUG01_01_XIX_E3V_K2CANFD_E2E
        Personalisierung_01_XIX_E3V_K2CANFD
        PreCrash_02_XIX_E3V_K2CANFD
        RCTA_01_XIX_E3V_K2CANFD
        Rear_View_01_XIX_E3V_K2CANFD
        RHP_01_XIX_E3V_K2CANFD
        SAD_01_XIX_E3V_K2CANFD
        SAL_01_XIX_E3V_K2CANFD_E2E
        SAL_02_XIX_E3V_K2CANFD
        SMLS_01_XIX_E3V_K2CANFD_E2E
        SOK_FoD_BCM_Resp_Chal_06_XIX_E3V_K2CANFD
        SOK_KST_BCM_Resp_05_XIX_E3V_K2CANFD
        SOK_NoAuthenticTime_01_XIX_E3V_K2CANFD
        SOK_ZV_HBFS_BCM_Resp_04_XIX_E3V_K2CANFD
        SOK_ZV_HFS_BCM_Resp_03_XIX_E3V_K2CANFD
        SOK_ZV_HW_BCM_Resp_02_XIX_E3V_K2CANFD
        SOK_ZV_Rueck_HW_Gateway_Chal_01_XIX_E3V_K2CANFD
        SRL_HL_01_XIX_E3V_K2CANFD_E2E
        SRL_HR_01_XIX_E3V_K2CANFD_E2E
        SRL_SL_01_XIX_E3V_K2CANFD_E2E
        SRL_SR_01_XIX_E3V_K2CANFD_E2E
        SRL_VL_01_XIX_E3V_K2CANFD_E2E
        SRL_VR_01_XIX_E3V_K2CANFD_E2E
        STSG_HBFS_01_XIX_E3V_K2CANFD
        STSG_HBFS_02_XIX_E3V_K2CANFD
        STSG_HFS_01_XIX_E3V_K2CANFD
        STSG_HFS_02_XIX_E3V_K2CANFD
        Systeminfo_01_XIX_E3V_K2CANFD
        Temperaturen_01_XIX_E3V_K2CANFD
        TM_01_XIX_E3V_K2CANFD
        TSG_BT_01_XIX_E3V_K2CANFD
        TSG_FT_01_XIX_E3V_K2CANFD
        TSG_FT_02_XIX_E3V_K2CANFD_E2E
        TSG_HBFS_01_XIX_E3V_K2CANFD
        TSG_HFS_01_XIX_E3V_K2CANFD
        UserStateServer_01_XIX_E3V_K2CANFD
        VIN_01_Mx{00..02}_XIX_E3V_K2CANFD
        VMM_02_Auth_XIX_E3V_K2CANFD_E2E
        WFS_01_XIX_E3V_K2CANFD
        ZFH_01_XIX_E3V_K2CANFD
        ZV_01_XIX_E3V_K2CANFD
        ZV_02_XIX_E3V_K2CANFD
        ZV_04_XIX_E3V_K2CANFD_E2E
    SAM_XIX_E3V_K2CANFD_Tx: communication-direction=OUT, communication-mode=CAN_Transmit_All
      i-signal-i-pdus:
        Ambex_SAM_01_XIX_E3V_K2CANFD
        Ambex_SAM_02_XIX_E3V_K2CANFD
        BCM_01_XIX_E3V_K2CANFD_E2E
        BCM_{04..06}_XIX_E3V_K2CANFD
        BCM_Taster_{01..03}_XIX_E3V_K2CANFD
        DiETa_01_XIX_E3V_K2CANFD
        GRA_ACC_01_XIX_E3V_K2CANFD
        IL_TSG_BFS_01_XIX_E3V_K2CANFD
        IL_TSG_FS_01_XIX_E3V_K2CANFD
        IL_TSG_HBFS_01_XIX_E3V_K2CANFD
        IL_TSG_HFS_01_XIX_E3V_K2CANFD
        Innenlicht_11_XIX_E3V_K2CANFD
        Klima_Sensor_01_XIX_E3V_K2CANFD
        Klima_Sensor_02_XIX_E3V_K2CANFD
        KN_BCM1_XIX_E3V_K2CANFD
        Licht_hinten_Slave_01_XIX_E3V_K2CANFD
        LiSi_01_XIX_E3V_K2CANFD
        ORUG02_01_XIX_E3V_K2CANFD_E2E
        PAO_Status_01_XIX_E3V_K2CANFD
        RLS_01_XIX_E3V_K2CANFD
        RLS_02_XIX_E3V_K2CANFD_E2E
        RLSs_01_XIX_E3V_K2CANFD
        SAM_01_XIX_E3V_K2CANFD_E2E
        SMLS_01_XIX_E3V_K2CANFD_E2E
        SOK_FoD_BCM_Req_Chal_06_XIX_E3V_K2CANFD
        SOK_KST_BCM_Chal_05_XIX_E3V_K2CANFD
        SOK_ZV_HBFS_BCM_Chal_04_XIX_E3V_K2CANFD
        SOK_ZV_HFS_BCM_Chal_03_XIX_E3V_K2CANFD
        SOK_ZV_HW_BCM_Chal_02_XIX_E3V_K2CANFD
        SOK_ZV_Rueck_HW_Gateway_Resp_01_XIX_E3V_K2CANFD
        SoSe_01_XIX_E3V_K2CANFD
        TSG_HBFS_01_XIX_E3V_K2CANFD
        TSG_HBFS_02_XIX_E3V_K2CANFD_E2E
        TSG_HFS_01_XIX_E3V_K2CANFD
        TSG_HFS_02_XIX_E3V_K2CANFD_E2E
        Wischer_01_XIX_E3V_K2CANFD
    SAM_XIX_E3V_SAM_LIN10_Rx: communication-direction=IN, communication-mode=CAN_Receive_All
      i-signal-i-pdus:
        RGBs_Slave_{01..15}_XIX_E3V_SAM_LIN10
    SAM_XIX_E3V_SAM_LIN10_Tx: communication-direction=OUT, communication-mode=CAN_Transmit_All, i-signal-i-pdus=RGBe_Slave_XIX_E3V_SAM_LIN10
    SAM_XIX_E3V_SAM_LIN11_Rx: communication-direction=IN, communication-mode=CAN_Receive_All, i-signal-i-pdus=[DiETas_01_XIX_E3V_SAM_LIN11, LTMs_01_XIX_E3V_SAM_LIN11, SLs_02_XIX_E3V_SAM_LIN11]
    SAM_XIX_E3V_SAM_LIN11_Tx: communication-direction=OUT, communication-mode=CAN_Transmit_All, i-signal-i-pdus=LTMe_01_XIX_E3V_SAM_LIN11
    SAM_XIX_E3V_SAM_LIN12_Rx: communication-direction=IN, communication-mode=CAN_Receive_All, i-signal-i-pdus=[FHSG_HBFSs01_XIX_E3V_SAM_LIN12, FHSG_HFSs01_XIX_E3V_SAM_LIN12]
    SAM_XIX_E3V_SAM_LIN12_Tx: communication-direction=OUT, communication-mode=CAN_Transmit_All, i-signal-i-pdus=[DIAGNOSEe_01_XIX_E3V_SAM_LIN12, FHSGe01_XIX_E3V_SAM_LIN12, TSG_FHe01_XIX_E3V_SAM_LIN12]
    SAM_XIX_E3V_SAM_LIN1_Rx: communication-direction=IN, communication-mode=CAN_Receive_All
      i-signal-i-pdus:
        FSs_01_XIX_E3V_SAM_LIN1
        RLSs_01_XIX_E3V_SAM_LIN1_E2E
        SoSes_01_XIX_E3V_SAM_LIN1
        WWS2s_01_XIX_E3V_SAM_LIN1
        WWSs_01_XIX_E3V_SAM_LIN1
    SAM_XIX_E3V_SAM_LIN1_Tx: communication-direction=OUT, communication-mode=CAN_Transmit_All, i-signal-i-pdus=BCM1_LIN1_01_XIX_E3V_SAM_LIN1
    SAM_XIX_E3V_SAM_LIN3_Rx: communication-direction=IN, communication-mode=CAN_Receive_All, i-signal-i-pdus=[FSs_01_XIX_E3V_SAM_LIN3, LINDas_01_XIX_E3V_SAM_LIN3, LINDas_02_XIX_E3V_SAM_LIN3]
    SAM_XIX_E3V_SAM_LIN3_Tx: communication-direction=OUT, communication-mode=CAN_Transmit_All, i-signal-i-pdus=[LINDae_01_XIX_E3V_SAM_LIN3, LINDae_02_XIX_E3V_SAM_LIN3]
    SAM_XIX_E3V_SAM_LIN4_Rx: communication-direction=IN, communication-mode=CAN_Receive_All
      i-signal-i-pdus:
        LLRs_LL_01_XIX_E3V_SAM_LIN4
        LLRs_LS_01_XIX_E3V_SAM_LIN4
        LLRs_RL_01_XIX_E3V_SAM_LIN4
        LLRs_RS_01_XIX_E3V_SAM_LIN4
        SPRs_BFS_01_XIX_E3V_SAM_LIN4
        SPRs_BFS_02_XIX_E3V_SAM_LIN4
        SPRs_FS_01_XIX_E3V_SAM_LIN4
        SPRs_FS_02_XIX_E3V_SAM_LIN4
        UGDOs_02_XIX_E3V_SAM_LIN4
        UGDOs_BAP_XIX_E3V_SAM_LIN4
    SAM_XIX_E3V_SAM_LIN4_Tx: communication-direction=OUT, communication-mode=CAN_Transmit_All
      i-signal-i-pdus:
        LLRe_L_01_XIX_E3V_SAM_LIN4
        LLRe_R_01_XIX_E3V_SAM_LIN4
        SPRe_01_XIX_E3V_SAM_LIN4
        SPRe_02_XIX_E3V_SAM_LIN4
        UGDOe_02_XIX_E3V_SAM_LIN4
        UGDOe_BAP_XIX_E3V_SAM_LIN4
    SAM_XIX_E3V_SAM_LIN5_Rx: communication-direction=IN, communication-mode=CAN_Receive_All
      i-signal-i-pdus:
        RGBs_Slave_{01..15}_XIX_E3V_SAM_LIN5
    SAM_XIX_E3V_SAM_LIN5_Tx: communication-direction=OUT, communication-mode=CAN_Transmit_All, i-signal-i-pdus=RGBe_Slave_XIX_E3V_SAM_LIN5
    SAM_XIX_E3V_SAM_LIN6_Rx: communication-direction=IN, communication-mode=CAN_Receive_All, i-signal-i-pdus=[GRA_ACCs_01_XIX_E3V_SAM_LIN6, LIN_SMLSs_01_XIX_E3V_SAM_LIN6]
    SAM_XIX_E3V_SAM_LIN6_Tx: communication-direction=OUT, communication-mode=CAN_Transmit_All, i-signal-i-pdus=LIN_SMLSe_01_XIX_E3V_SAM_LIN6
    SAM_XIX_E3V_SAM_LIN9_Rx: communication-direction=IN, communication-mode=CAN_Receive_All
      i-signal-i-pdus:
        RGBs_Slave_{01..15}_XIX_E3V_SAM_LIN9
    SAM_XIX_E3V_SAM_LIN9_Tx: communication-direction=OUT, communication-mode=CAN_Transmit_All, i-signal-i-pdus=RGBe_Slave_XIX_E3V_SAM_LIN9
package /Gateway
  gateway SAM: ecu=SAM
    i-pdu-mappings:
      source-i-pdu=PT_E3V_K2CANFD_XIX_TPCHType_CANHS_Flash_DIA_XIX_0x17FC1601_XIX_0x17FE1601_XIX_Physical, target-i-pdu=PT_E3V_SAM_LIN1_XIX_TPCHType_LIN_Diagnose_XIX_0x0_XIX_0xB_XIX_Physical
      source-i-pdu=PT_E3V_K2CANFD_XIX_TPCHType_CANHS_Flash_DIA_XIX_0x17FC176E_XIX_0x17FE176E_XIX_Physical, target-i-pdu=PT_E3V_SAM_LIN1_XIX_TPCHType_LIN_Diagnose_XIX_0x0_XIX_0x59_XIX_Physical
      source-i-pdu=PT_E3V_SAM_LIN1_XIX_TPCHType_LIN_Diagnose_XIX_0x59_XIX_0x0_XIX_Physical, target-i-pdu=PT_E3V_K2CANFD_XIX_TPCHType_CANHS_Flash_DIA_XIX_0x17FE176E_XIX_0x17FC176E_XIX_Physical
      source-i-pdu=PT_E3V_SAM_LIN1_XIX_TPCHType_LIN_Diagnose_XIX_0xB_XIX_0x0_XIX_Physical, target-i-pdu=PT_E3V_K2CANFD_XIX_TPCHType_CANHS_Flash_DIA_XIX_0x17FE1601_XIX_0x17FC1601_XIX_Physical
      source-i-pdu=CHNL/PT_FSs_01, target-i-pdu=PT_Klima_Sensor_01
      source-i-pdu=PT_RLSs_01_E2E, target-i-pdu=PT_RLSs_01
      source-i-pdu=PT_SoSes_01, target-i-pdu=PT_SoSe_01
      source-i-pdu=PT_DiETas_01, target-i-pdu=PT_DiETa_01
      source-i-pdu=PT_LTMs_01, target-i-pdu=PT_LiSi_01
      source-i-pdu=CHNL/PT_FSs_01, target-i-pdu=PT_Klima_Sensor_01
      source-i-pdu=PT_LINDas_02, target-i-pdu=PT_PAO_Status_01
      source-i-pdu=PT_GRA_ACCs_01, target-i-pdu=PT_GRA_ACC_01
    signal-mappings:
      source-signal=ST_SAL_RFL_Anf_XIX_SAL_01, target-signal=CHNL/ST_BCM1_Rueckfahrlicht_Schalter_XIX_BCM_01
      source-signal=ST_MO_Fahrbereitschaft_XIX_Motor_54, target-signal=ST_MO_Fahrbereitschaft_XIX_BCM1_LIN1_01
      source-signal=ST_BT_Tuer_geoeffnet_XIX_TSG_BT_01, target-signal=ST_BT_Tuer_geoeffnet_XIX_BCM1_LIN1_01
      source-signal=ST_FT_Tuer_geoeffnet_XIX_TSG_FT_01, target-signal=ST_FT_Tuer_geoeffnet_XIX_BCM1_LIN1_01
      source-signal=ST_Bel_DiETa_Lock_Unlock_XIX_Bel_Taster_01, target-signal=ST_Bel_DiETa_Lock_Unlock_XIX_LTMe_01
      source-signal=ST_Bel_DiETa_Mode_XIX_Bel_Taster_01, target-signal=ST_Bel_DiETa_Mode_XIX_LTMe_01
      source-signal=ST_Bel_DiETa_Warnblinken_XIX_Bel_Taster_01, target-signal=ST_Bel_DiETa_Warnblinken_XIX_LTMe_01
      source-signal=ST_Bel_LTM_Auto_XIX_Bel_Taster_01, target-signal=ST_Bel_LTM_Auto_XIX_LTMe_01
      source-signal=ST_Bel_LTM_Fahrlicht_XIX_Bel_Taster_01, target-signal=ST_Bel_LTM_Fahrlicht_XIX_LTMe_01
      source-signal=ST_Bel_LTM_Nebellicht_XIX_Bel_Taster_01, target-signal=ST_Bel_LTM_Nebellicht_XIX_LTMe_01
      source-signal=ST_Bel_LTM_Nebelschlusslicht_XIX_Bel_Taster_01, target-signal=ST_Bel_LTM_Nebelschlusslicht_XIX_LTMe_01
      source-signal=ST_Bel_LTM_Standlicht_XIX_Bel_Taster_01, target-signal=ST_Bel_LTM_Standlicht_XIX_LTMe_01
      source-signal=ST_Bel_LTM_Tagfahrlicht_XIX_Bel_Taster_01, target-signal=ST_Bel_LTM_Tagfahrlicht_XIX_LTMe_01
      source-signal=ST_PaCo_DiETa_LED_XIX_Bel_Taster_01, target-signal=ST_Bel_DiETa_Parken_XIX_LTMe_01
      source-signal=ST_DI_KL_58xd_XIX_Dimmung_01, target-signal=ST_DI_KL_58xd_XIX_LTMe_01
      source-signal=ST_DI_KL_58xs_XIX_Dimmung_01, target-signal=ST_DI_KL_58xs_XIX_LTMe_01
      source-signal=ST_DI_KL_58xt_XIX_Dimmung_01, target-signal=ST_DI_KL_58xt_XIX_LTMe_01
      source-signal=ST_NVEM_Abschaltstufe_XIX_BEM_02, target-signal=ST_NVEM_Abschaltstufe_XIX_LINDae_01
      source-signal=ST_DI_KL_58xd_XIX_Dimmung_01, target-signal=ST_DI_KL_58xd_XIX_LINDae_01
      source-signal=ST_DI_KL_58xs_XIX_Dimmung_01, target-signal=ST_DI_KL_58xs_XIX_LINDae_01
      source-signal=ST_DI_KL_58xt_XIX_Dimmung_01, target-signal=ST_DI_KL_58xt_XIX_LINDae_01
      source-signal=ST_MF_Innenraumbel_XIX_MFG_01, target-signal=ST_MF_Innenraumbel_XIX_LINDae_01
      source-signal=ST_MF_Innenraumbel_Unterdrueck_XIX_MFG_01, target-signal=ST_MF_Innenraumbel_Unterdrueck_XIX_LINDae_01
      source-signal=ST_MD1_Lage_XIX_SAD_01, target-signal=ST_MD1_Lage_XIX_LINDae_01
      source-signal=ST_MD1_Position_XIX_SAD_01, target-signal=ST_MD1_Position_XIX_LINDae_01
      source-signal=CHNL/ST_SI_QRS_Mode_XIX_Systeminfo_01, target-signal=ST_SI_QRS_Mode_XIX_LINDae_01
      source-signal=CHNL/ST_SI_T_Mode_XIX_Systeminfo_01, target-signal=ST_SI_T_Mode_XIX_LINDae_01
      source-signal=ST_bCall_active_XIX_TM_01, target-signal=ST_bCall_active_XIX_LINDae_01
      source-signal=ST_iCall_active_XIX_TM_01, target-signal=ST_iCall_active_XIX_LINDae_01
      source-signal=ST_ZAS_Kl_15_XIX_Klemmen_Status_01, target-signal=ST_ZAS_Kl_15_XIX_SPRe_01
      source-signal=ST_ZAS_Kl_S_XIX_Klemmen_Status_01, target-signal=ST_ZAS_Kl_S_XIX_SPRe_01
      source-signal=ST_ZAS_Kl_X_XIX_Klemmen_Status_01, target-signal=ST_ZAS_Kl_X_XIX_SPRe_01
      source-signal=ST_ZV_auf_Funk_XIX_ZV_01, target-signal=ST_ZV_auf_Funk_XIX_UGDOe_02
      source-signal=ST_ZV_verriegelt_extern_soll_XIX_ZV_02, target-signal=ST_ZV_verriegelt_extern_soll_XIX_SPRe_01
      source-signal=ST_Wischer_aktiv_XIX_WWSs_01, target-signal=CHNL/ST_Wischer_aktiv_XIX_SAM_01
      source-signal=ST_LIM_bCall_Taster_XIX_LINDas_01, target-signal=ST_LIM_bCall_Taster_XIX_BCM_Taster_02
      source-signal=ST_LIM_iCall_Taster_XIX_LINDas_01, target-signal=ST_LIM_iCall_Taster_XIX_BCM_Taster_02
      source-signal=ST_LIM_S_SAD_Vo_XIX_LINDas_01, target-signal=ST_LIM_S_SAD_Vo_XIX_BCM_Taster_02
      source-signal=ST_LINDa_Touch_Event_XIX_LINDas_01, target-signal=ST_LINDa_Touch_Event_XIX_BCM_Taster_02
      source-signal=ST_Tuerkontakt_Innenlicht_Taste_XIX_LINDas_01, target-signal=ST_Tuerkontakt_Innenlicht_Taste_XIX_BCM_Taster_02
      source-signal=ST_LINDa_HL_SR3_Touch_Event_XIX_LINDas_01, target-signal=ST_LINDa_HL_SR3_Touch_Event_XIX_BCM_Taster_03
      source-signal=ST_LINDa_HL_Touch_Event_XIX_LINDas_01, target-signal=ST_LINDa_HL_Touch_Event_XIX_BCM_Taster_03
      source-signal=ST_LINDa_HR_SR3_Touch_Event_XIX_LINDas_01, target-signal=ST_LINDa_HR_SR3_Touch_Event_XIX_BCM_Taster_03
      source-signal=ST_LINDa_HR_Touch_Event_XIX_LINDas_01, target-signal=ST_LINDa_HR_Touch_Event_XIX_BCM_Taster_03
package /E2E
  end to end protection set E2E_ProtectionSet
    79 x end to end protection:
      E2E_Protection_ADecu1_01_XIX_E3V_K2CANFD: end-to-end-profile={category=PROFILE_02, data-ids=[0xea, 0x22, 0x10, 0x5d, 0x3c, 0x94, 0x16, 0x2f, 0xb2, 0xd7, 0xc8, 0x4e, 0xc0, 0xa1, 0x90, 0xc4], data-length=64, crc-offset=0, counter-offset=8}, end-to-end-protection-i-signal-i-pdu{data-offset=0, i-signal-group=SG_ADecu1_01_XIX_E3V_K2CANFD, i-signal-i-pdu=ADecu1_01_XIX_E3V_K2CANFD_E2E}
      E2E_Protection_ADecu2_01_XIX_E3V_K2CANFD: end-to-end-profile={category=PROFILE_02, data-ids=[0x9a, 0x1c, 0xd0, 0xb2, 0xee, 0xaa, 0x9f, 0xe7, 0xbb, 0x6d, 0x3b, 0x17, 0x9d, 0x56, 0x11, 0x59], data-length=64, crc-offset=0, counter-offset=8}, end-to-end-protection-i-signal-i-pdu{data-offset=0, i-signal-group=SG_ADecu2_01_XIX_E3V_K2CANFD, i-signal-i-pdu=ADecu2_01_XIX_E3V_K2CANFD_E2E}
      E2E_Protection_Airbag_01_XIX_E3V_K2CANFD: end-to-end-profile={category=PROFILE_02, data-ids=[0x40, 0x40, 0x40, 0x40, 0x40, 0x40, 0x40, 0x40, 0x40, 0x40, 0x40, 0x40, 0x40, 0x40, 0x40, 0x40], data-length=64, crc-offset=0, counter-offset=8}, end-to-end-protection-i-signal-i-pdu{data-offset=0, i-signal-group=SG_Airbag_01_XIX_E3V_K2CANFD, i-signal-i-pdu=Airbag_01_XIX_E3V_K2CANFD_E2E}
      E2E_Protection_Airbag_02_XIX_E3V_K2CANFD: end-to-end-profile={category=PROFILE_02, data-ids=[0x44, 0x44, 0x44, 0x44, 0x44, 0x44, 0x44, 0x44, 0x44, 0x44, 0x44, 0x44, 0x44, 0x44, 0x44, 0x44], data-length=64, crc-offset=0, counter-offset=8}, end-to-end-protection-i-signal-i-pdu{data-offset=0, i-signal-group=SG_Airbag_02_XIX_E3V_K2CANFD, i-signal-i-pdu=Airbag_02_XIX_E3V_K2CANFD_E2E}
      E2E_Protection_BCM_01_XIX_E3V_CCAN: end-to-end-profile={category=PROFILE_02, data-ids=[0x7b, 0xb3, 0xbf, 0x61, 0x6d, 0x80, 0x03, 0xfa, 0xb1, 0x4b, 0x5b, 0x4c, 0x8a, 0x3d, 0xdd, 0x17], data-length=64, crc-offset=0, counter-offset=8}, end-to-end-protection-i-signal-i-pdu{data-offset=0, i-signal-group=SG_BCM_01_XIX_E3V_CCAN, i-signal-i-pdu=BCM_01_XIX_E3V_CCAN_E2E}
      E2E_Protection_BCM_01_XIX_E3V_K2CANFD: end-to-end-profile={category=PROFILE_02, data-ids=[0x7b, 0xb3, 0xbf, 0x61, 0x6d, 0x80, 0x03, 0xfa, 0xb1, 0x4b, 0x5b, 0x4c, 0x8a, 0x3d, 0xdd, 0x17], data-length=64, crc-offset=0, counter-offset=8}, end-to-end-protection-i-signal-i-pdu{data-offset=0, i-signal-group=SG_BCM_01_XIX_E3V_K2CANFD, i-signal-i-pdu=BCM_01_XIX_E3V_K2CANFD_E2E}
      E2E_Protection_DRB1_01_XIX_E3V_K2CANFD: end-to-end-profile={category=PROFILE_02, data-ids=[0xc0, 0xbf, 0x65, 0xd1, 0xaa, 0x85, 0x3a, 0x5c, 0xa1, 0xa9, 0x8f, 0xb8, 0xcd, 0x66, 0xe6, 0xd5], data-length=64, crc-offset=0, counter-offset=8}, end-to-end-protection-i-signal-i-pdu{data-offset=0, i-signal-group=SG_DRB1_01_XIX_E3V_K2CANFD, i-signal-i-pdu=DRB1_01_XIX_E3V_K2CANFD_E2E}
      E2E_Protection_DRB2_01_XIX_E3V_K2CANFD: end-to-end-profile={category=PROFILE_02, data-ids=[0xbc, 0x4f, 0xeb, 0x68, 0xb1, 0x96, 0x41, 0x6a, 0x29, 0x3c, 0xf5, 0xe3, 0x66, 0xaf, 0x56, 0xab], data-length=64, crc-offset=0, counter-offset=8}, end-to-end-protection-i-signal-i-pdu{data-offset=0, i-signal-group=SG_DRB2_01_XIX_E3V_K2CANFD, i-signal-i-pdu=DRB2_01_XIX_E3V_K2CANFD_E2E}
      E2E_Protection_EM1_HYB_13_XIX_E3V_CCAN: end-to-end-profile={category=PROFILE_02, data-ids=[0xca, 0x87, 0x13, 0xb7, 0xef, 0xe5, 0x19, 0x98, 0x07, 0x54, 0x5e, 0xdd, 0x2c, 0x24, 0x94, 0xb9], data-length=64, crc-offset=0, counter-offset=8}, end-to-end-protection-i-signal-i-pdu{data-offset=0, i-signal-group=SG_EM1_HYB_13_XIX_E3V_CCAN, i-signal-i-pdu=EM1_HYB_13_XIX_E3V_CCAN_E2E}
      E2E_Protection_EM2_HYB_13_XIX_E3V_CCAN: end-to-end-profile={category=PROFILE_02, data-ids=[0xc7, 0x11, 0x27, 0x31, 0xb8, 0x76, 0x09, 0xec, 0x60, 0x10, 0x16, 0xc8, 0x90, 0x7d, 0x69, 0x17], data-length=64, crc-offset=0, counter-offset=8}, end-to-end-protection-i-signal-i-pdu{data-offset=0, i-signal-group=SG_EM2_HYB_13_XIX_E3V_CCAN, i-signal-i-pdu=EM2_HYB_13_XIX_E3V_CCAN_E2E}
      E2E_Protection_ESP_21_XIX_E3V_K2CANFD: end-to-end-profile={category=PROFILE_02, data-ids=[0xb4, 0xef, 0xf8, 0x49, 0x1e, 0xe5, 0xc2, 0xc0, 0x97, 0x19, 0x3c, 0xc9, 0xf1, 0x98, 0xd6, 0x61], data-length=64, crc-offset=0, counter-offset=8}, end-to-end-protection-i-signal-i-pdu{data-offset=0, i-signal-group=SG_ESP_21_XIX_E3V_K2CANFD, i-signal-i-pdu=ESP_21_XIX_E3V_K2CANFD_E2E}
      E2E_Protection_HVL_01_XIX_E3V_K2CANFD: end-to-end-profile={category=PROFILE_02, data-ids=[0x1d, 0x82, 0x7b, 0x79, 0xa5, 0xee, 0x3a, 0xb9, 0xb7, 0xf9, 0xe4, 0x67, 0x7f, 0x97, 0x11, 0xad], data-length=64, crc-offset=0, counter-offset=8}, end-to-end-protection-i-signal-i-pdu{data-offset=0, i-signal-group=SG_HVL_01_XIX_E3V_K2CANFD, i-signal-i-pdu=HVL_01_XIX_E3V_K2CANFD_E2E}
      E2E_Protection_Klemmen_Status_01_XIX_E3V_K2CANFD: end-to-end-profile={category=PROFILE_02, data-ids=[0xc3, 0xc3, 0xc3, 0xc3, 0xc3, 0xc3, 0xc3, 0xc3, 0xc3, 0xc3, 0xc3, 0xc3, 0xc3, 0xc3, 0xc3, 0xc3], data-length=32, crc-offset=0, counter-offset=8}, end-to-end-protection-i-signal-i-pdu{data-offset=0, i-signal-group=SG_Klemmen_Status_01_XIX_E3V_K2CANFD, i-signal-i-pdu=Klemmen_Status_01_XIX_E3V_K2CANFD_E2E}
      E2E_Protection_Klemmen_Steuerung_01_XIX_E3V_K2CANFD: end-to-end-profile={category=PROFILE_02, data-ids=[0x9b, 0xb5, 0x9d, 0x06, 0x01, 0xe7, 0x8f, 0xc1, 0xd0, 0x10, 0x47, 0xe9, 0xd3, 0xca, 0x05, 0xf0], data-length=64, crc-offset=0, counter-offset=8}, end-to-end-protection-i-signal-i-pdu{data-offset=0, i-signal-group=SG_Klemmen_Steuerung_01_XIX_E3V_K2CANFD, i-signal-i-pdu=Klemmen_Steuerung_01_XIX_E3V_K2CANFD_E2E}
      E2E_Protection_LRL_L_01_XIX_E3V_K2CANFD: end-to-end-profile={category=PROFILE_02, data-ids=[0x85, 0x75, 0xe0, 0xd3, 0x9b, 0x7d, 0x82, 0xd5, 0x8b, 0xb4, 0xeb, 0xdd, 0xbb, 0xa2, 0x86, 0xc7], data-length=64, crc-offset=0, counter-offset=8}, end-to-end-protection-i-signal-i-pdu{data-offset=0, i-signal-group=SG_LRL_L_01_XIX_E3V_K2CANFD, i-signal-i-pdu=LRL_L_01_XIX_E3V_K2CANFD_E2E}
      E2E_Protection_LRL_M_01_XIX_E3V_K2CANFD: end-to-end-profile={category=PROFILE_02, data-ids=[0x62, 0x0a, 0x55, 0x49, 0x15, 0x33, 0x78, 0x53, 0xe3, 0x39, 0xc9, 0x4c, 0xe1, 0xcc, 0x9c, 0xc8], data-length=64, crc-offset=0, counter-offset=8}, end-to-end-protection-i-signal-i-pdu{data-offset=0, i-signal-group=SG_LRL_M_01_XIX_E3V_K2CANFD, i-signal-i-pdu=LRL_M_01_XIX_E3V_K2CANFD_E2E}
      E2E_Protection_LRL_R_01_XIX_E3V_K2CANFD: end-to-end-profile={category=PROFILE_02, data-ids=[0x6c, 0xc1, 0x9f, 0x1e, 0x67, 0x56, 0x9b, 0x25, 0xf8, 0x32, 0xec, 0x4f, 0x53, 0xb4, 0xc4, 0xf9], data-length=64, crc-offset=0, counter-offset=8}, end-to-end-protection-i-signal-i-pdu{data-offset=0, i-signal-group=SG_LRL_R_01_XIX_E3V_K2CANFD, i-signal-i-pdu=LRL_R_01_XIX_E3V_K2CANFD_E2E}
      E2E_Protection_MFG_01_XIX_E3V_K2CANFD: end-to-end-profile={category=PROFILE_02, data-ids=[0x97, 0x97, 0x97, 0x97, 0x97, 0x97, 0x97, 0x97, 0x97, 0x97, 0x97, 0x97, 0x97, 0x97, 0x97, 0x97], data-length=64, crc-offset=0, counter-offset=8}, end-to-end-protection-i-signal-i-pdu{data-offset=0, i-signal-group=SG_MFG_01_XIX_E3V_K2CANFD, i-signal-i-pdu=MFG_01_XIX_E3V_K2CANFD_E2E}
      E2E_Protection_ORUG01_01_XIX_E3V_K2CANFD: end-to-end-profile={category=PROFILE_02, data-ids=[0xdf, 0xa2, 0xc0, 0x44, 0x96, 0xbf, 0x81, 0x49, 0x65, 0xe4, 0x1a, 0xd1, 0xf4, 0x10, 0xaa, 0xac], data-length=64, crc-offset=0, counter-offset=8}, end-to-end-protection-i-signal-i-pdu{data-offset=0, i-signal-group=SG_ORUG01_01_XIX_E3V_K2CANFD, i-signal-i-pdu=ORUG01_01_XIX_E3V_K2CANFD_E2E}
      E2E_Protection_ORUG02_01_XIX_E3V_K2CANFD: end-to-end-profile={category=PROFILE_02, data-ids=[0x20, 0x60, 0x3f, 0x23, 0x7c, 0x96, 0x28, 0x42, 0x0e, 0x79, 0x90, 0xe4, 0x40, 0xb1, 0xce, 0x18], data-length=64, crc-offset=0, counter-offset=8}, end-to-end-protection-i-signal-i-pdu{data-offset=0, i-signal-group=SG_ORUG02_01_XIX_E3V_K2CANFD, i-signal-i-pdu=ORUG02_01_XIX_E3V_K2CANFD_E2E}
      E2E_Protection_ORU_0001_XIX_E3V_CCAN: end-to-end-profile={category=PROFILE_02, data-ids=[0x37, 0xcf, 0x95, 0x9f, 0x36, 0x45, 0x02, 0xce, 0x80, 0x4d, 0x8a, 0x35, 0xb8, 0x07, 0x56, 0xeb], data-length=64, crc-offset=0, counter-offset=8}, end-to-end-protection-i-signal-i-pdu{data-offset=0, i-signal-group=SG_ORU_0001_XIX_E3V_CCAN, i-signal-i-pdu=ORU_0001_XIX_E3V_CCAN_E2E}
      E2E_Protection_ORU_0003_XIX_E3V_CCAN: end-to-end-profile={category=PROFILE_02, data-ids=[0xe4, 0xe8, 0xa9, 0x73, 0x1c, 0xc5, 0x67, 0x37, 0x2b, 0x12, 0x16, 0x8e, 0x7f, 0x4c, 0x15, 0xcf], data-length=64, crc-offset=0, counter-offset=8}, end-to-end-protection-i-signal-i-pdu{data-offset=0, i-signal-group=SG_ORU_0003_XIX_E3V_CCAN, i-signal-i-pdu=ORU_0003_XIX_E3V_CCAN_E2E}
      E2E_Protection_ORU_0006_XIX_E3V_CCAN: end-to-end-profile={category=PROFILE_02, data-ids=[0xd6, 0x3d, 0xdb, 0x09, 0x3b, 0x24, 0xa7, 0x03, 0x1a, 0x6c, 0x72, 0xd7, 0x91, 0xe6, 0x68, 0x6a], data-length=64, crc-offset=0, counter-offset=8}, end-to-end-protection-i-signal-i-pdu{data-offset=0, i-signal-group=SG_ORU_0006_XIX_E3V_CCAN, i-signal-i-pdu=ORU_0006_XIX_E3V_CCAN_E2E}
      E2E_Protection_ORU_0009_XIX_E3V_CCAN: end-to-end-profile={category=PROFILE_02, data-ids=[0x41, 0x46, 0xd3, 0x58, 0x6a, 0x22, 0xf8, 0xc7, 0x29, 0xc2, 0x36, 0x6d, 0x3c, 0x77, 0x0a, 0xd6], data-length=64, crc-offset=0, counter-offset=8}, end-to-end-protection-i-signal-i-pdu{data-offset=0, i-signal-group=SG_ORU_0009_XIX_E3V_CCAN, i-signal-i-pdu=ORU_0009_XIX_E3V_CCAN_E2E}
      E2E_Protection_ORU_0013_XIX_E3V_CCAN: end-to-end-profile={category=PROFILE_02, data-ids=[0xb9, 0x99, 0x69, 0xec, 0xc7, 0xa8, 0x14, 0x13, 0xf0, 0xd6, 0xce, 0x6f, 0x9e, 0x7f, 0x26, 0x33], data-length=64, crc-offset=0, counter-offset=8}, end-to-end-protection-i-signal-i-pdu{data-offset=0, i-signal-group=SG_ORU_0013_XIX_E3V_CCAN, i-signal-i-pdu=ORU_0013_XIX_E3V_CCAN_E2E}
      E2E_Protection_ORU_0015_XIX_E3V_CCAN: end-to-end-profile={category=PROFILE_02, data-ids=[0x49, 0xaf, 0x4e, 0x2b, 0xf9, 0xd9, 0xd4, 0x7b, 0x0d, 0xc0, 0x3d, 0x50, 0xe9, 0x56, 0x93, 0x0f], data-length=64, crc-offset=0, counter-offset=8}, end-to-end-protection-i-signal-i-pdu{data-offset=0, i-signal-group=SG_ORU_0015_XIX_E3V_CCAN, i-signal-i-pdu=ORU_0015_XIX_E3V_CCAN_E2E}
      E2E_Protection_ORU_0016_XIX_E3V_CCAN: end-to-end-profile={category=PROFILE_02, data-ids=[0x32, 0x74, 0x79, 0xcd, 0xf2, 0xae, 0xe5, 0x86, 0xeb, 0x82, 0xe0, 0x55, 0x9c, 0x1a, 0xa3, 0xca], data-length=64, crc-offset=0, counter-offset=8}, end-to-end-protection-i-signal-i-pdu{data-offset=0, i-signal-group=SG_ORU_0016_XIX_E3V_CCAN, i-signal-i-pdu=ORU_0016_XIX_E3V_CCAN_E2E}
      E2E_Protection_ORU_0019_XIX_E3V_CCAN: end-to-end-profile={category=PROFILE_02, data-ids=[0xcc, 0x27, 0x0c, 0x97, 0x2e, 0x3b, 0x35, 0x4a, 0x90, 0x6e, 0x13, 0x6c, 0x22, 0x1d, 0xe9, 0x81], data-length=64, crc-offset=0, counter-offset=8}, end-to-end-protection-i-signal-i-pdu{data-offset=0, i-signal-group=SG_ORU_0019_XIX_E3V_CCAN, i-signal-i-pdu=ORU_0019_XIX_E3V_CCAN_E2E}
      E2E_Protection_ORU_0023_XIX_E3V_CCAN: end-to-end-profile={category=PROFILE_02, data-ids=[0xc7, 0xcf, 0x4b, 0xd4, 0xc3, 0xae, 0x97, 0x56, 0x04, 0xbd, 0xf3, 0x40, 0x0a, 0xb5, 0x8c, 0x61], data-length=64, crc-offset=0, counter-offset=8}, end-to-end-protection-i-signal-i-pdu{data-offset=0, i-signal-group=SG_ORU_0023_XIX_E3V_CCAN, i-signal-i-pdu=ORU_0023_XIX_E3V_CCAN_E2E}
      E2E_Protection_ORU_0036_XIX_E3V_CCAN: end-to-end-profile={category=PROFILE_02, data-ids=[0x22, 0xda, 0xbe, 0x85, 0x54, 0x63, 0x7c, 0xf5, 0xb5, 0x53, 0x0f, 0x65, 0x68, 0x1e, 0xf7, 0x7f], data-length=64, crc-offset=0, counter-offset=8}, end-to-end-protection-i-signal-i-pdu{data-offset=0, i-signal-group=SG_ORU_0036_XIX_E3V_CCAN, i-signal-i-pdu=ORU_0036_XIX_E3V_CCAN_E2E}
      E2E_Protection_ORU_003D_XIX_E3V_K2CANFD: end-to-end-profile={category=PROFILE_02, data-ids=[0x7b, 0x0f, 0x90, 0xa6, 0x67, 0x03, 0x57, 0x6e, 0x6b, 0x69, 0x8a, 0x1a, 0x13, 0xa9, 0xa4, 0x9e], data-length=64, crc-offset=0, counter-offset=8}, end-to-end-protection-i-signal-i-pdu{data-offset=0, i-signal-group=SG_ORU_003D_XIX_E3V_K2CANFD, i-signal-i-pdu=ORU_003D_XIX_E3V_K2CANFD_E2E}
      E2E_Protection_ORU_0042_XIX_E3V_CCAN: end-to-end-profile={category=PROFILE_02, data-ids=[0x4f, 0x11, 0x1c, 0xdd, 0xa5, 0x3e, 0xc0, 0x38, 0x0b, 0xca, 0x35, 0x81, 0x02, 0xed, 0xcf, 0x26], data-length=64, crc-offset=0, counter-offset=8}, end-to-end-protection-i-signal-i-pdu{data-offset=0, i-signal-group=SG_ORU_0042_XIX_E3V_CCAN, i-signal-i-pdu=ORU_0042_XIX_E3V_CCAN_E2E}
      E2E_Protection_ORU_0044_XIX_E3V_CCAN: end-to-end-profile={category=PROFILE_02, data-ids=[0x08, 0x51, 0x66, 0x42, 0x5f, 0x7e, 0x6c, 0xb4, 0xb9, 0x01, 0x75, 0x0a, 0x39, 0x91, 0x8e, 0xdf], data-length=64, crc-offset=0, counter-offset=8}, end-to-end-protection-i-signal-i-pdu{data-offset=0, i-signal-group=SG_ORU_0044_XIX_E3V_CCAN, i-signal-i-pdu=ORU_0044_XIX_E3V_CCAN_E2E}
      E2E_Protection_ORU_0048_XIX_E3V_CCAN: end-to-end-profile={category=PROFILE_02, data-ids=[0x8f, 0x60, 0x38, 0x97, 0xc4, 0x26, 0x2c, 0xb5, 0x55, 0xa2, 0xce, 0x34, 0x6a, 0xd8, 0x64, 0x14], data-length=64, crc-offset=0, counter-offset=8}, end-to-end-protection-i-signal-i-pdu{data-offset=0, i-signal-group=SG_ORU_0048_XIX_E3V_CCAN, i-signal-i-pdu=ORU_0048_XIX_E3V_CCAN_E2E}
      E2E_Protection_ORU_0051_XIX_E3V_CCAN: end-to-end-profile={category=PROFILE_02, data-ids=[0xe4, 0xe7, 0x29, 0x8d, 0x26, 0xec, 0xa6, 0xd5, 0x51, 0x34, 0xef, 0xc9, 0x54, 0x6e, 0x94, 0x4f], data-length=64, crc-offset=0, counter-offset=8}, end-to-end-protection-i-signal-i-pdu{data-offset=0, i-signal-group=SG_ORU_0051_XIX_E3V_CCAN, i-signal-i-pdu=ORU_0051_XIX_E3V_CCAN_E2E}
      E2E_Protection_ORU_0052_XIX_E3V_CCAN: end-to-end-profile={category=PROFILE_02, data-ids=[0xdb, 0xc1, 0xea, 0x95, 0xd1, 0x89, 0x02, 0xb9, 0xd0, 0x8a, 0x15, 0xcc, 0x56, 0x6f, 0xc6, 0x10], data-length=64, crc-offset=0, counter-offset=8}, end-to-end-protection-i-signal-i-pdu{data-offset=0, i-signal-group=SG_ORU_0052_XIX_E3V_CCAN, i-signal-i-pdu=ORU_0052_XIX_E3V_CCAN_E2E}
      E2E_Protection_ORU_005B_XIX_E3V_CCAN: end-to-end-profile={category=PROFILE_02, data-ids=[0x55, 0x94, 0x5f, 0x5c, 0x61, 0x01, 0xd7, 0x87, 0x8e, 0x57, 0x02, 0xa1, 0x9a, 0xe3, 0xf1, 0xc7], data-length=64, crc-offset=0, counter-offset=8}, end-to-end-protection-i-signal-i-pdu{data-offset=0, i-signal-group=SG_ORU_005B_XIX_E3V_CCAN, i-signal-i-pdu=ORU_005B_XIX_E3V_CCAN_E2E}
      E2E_Protection_ORU_0069_XIX_E3V_CCAN: end-to-end-profile={category=PROFILE_02, data-ids=[0xe1, 0xa4, 0xd5, 0xd7, 0x14, 0x4f, 0x41, 0xe3, 0xb0, 0x5a, 0x07, 0x11, 0x0e, 0xac, 0x15, 0x8f], data-length=64, crc-offset=0, counter-offset=8}, end-to-end-protection-i-signal-i-pdu{data-offset=0, i-signal-group=SG_ORU_0069_XIX_E3V_CCAN, i-signal-i-pdu=ORU_0069_XIX_E3V_CCAN_E2E}
      E2E_Protection_ORU_006A_XIX_E3V_CCAN: end-to-end-profile={category=PROFILE_02, data-ids=[0x42, 0xb4, 0x0a, 0xdf, 0xa1, 0x59, 0xf6, 0x0b, 0xe5, 0xb6, 0x78, 0xa3, 0xa8, 0xe4, 0xb8, 0x3c], data-length=64, crc-offset=0, counter-offset=8}, end-to-end-protection-i-signal-i-pdu{data-offset=0, i-signal-group=SG_ORU_006A_XIX_E3V_CCAN, i-signal-i-pdu=ORU_006A_XIX_E3V_CCAN_E2E}
      E2E_Protection_ORU_0076_XIX_E3V_CCAN: end-to-end-profile={category=PROFILE_02, data-ids=[0xe2, 0x19, 0x2d, 0xd0, 0x2a, 0x41, 0x9b, 0xc5, 0x9e, 0x5d, 0xa1, 0xac, 0x96, 0x1b, 0x21, 0x82], data-length=64, crc-offset=0, counter-offset=8}, end-to-end-protection-i-signal-i-pdu{data-offset=0, i-signal-group=SG_ORU_0076_XIX_E3V_CCAN, i-signal-i-pdu=ORU_0076_XIX_E3V_CCAN_E2E}
      E2E_Protection_ORU_007A_XIX_E3V_CCAN: end-to-end-profile={category=PROFILE_02, data-ids=[0x37, 0xd1, 0x1e, 0x8a, 0xad, 0xc6, 0x42, 0x5e, 0x5d, 0x43, 0x5b, 0xe9, 0x0c, 0xb4, 0x76, 0x9c], data-length=64, crc-offset=0, counter-offset=8}, end-to-end-protection-i-signal-i-pdu{data-offset=0, i-signal-group=SG_ORU_007A_XIX_E3V_CCAN, i-signal-i-pdu=ORU_007A_XIX_E3V_CCAN_E2E}
      E2E_Protection_ORU_007E_XIX_E3V_CCAN: end-to-end-profile={category=PROFILE_02, data-ids=[0xac, 0xfb, 0xc0, 0xbc, 0x22, 0xed, 0x09, 0x2c, 0x28, 0xda, 0x04, 0x67, 0xd2, 0xd6, 0xbe, 0xd8], data-length=64, crc-offset=0, counter-offset=8}, end-to-end-protection-i-signal-i-pdu{data-offset=0, i-signal-group=SG_ORU_007E_XIX_E3V_CCAN, i-signal-i-pdu=ORU_007E_XIX_E3V_CCAN_E2E}
      E2E_Protection_ORU_0082_XIX_E3V_CCAN: end-to-end-profile={category=PROFILE_02, data-ids=[0x26, 0x34, 0x94, 0x36, 0xee, 0x5c, 0x23, 0x15, 0x01, 0xeb, 0x17, 0x87, 0xf3, 0x70, 0x57, 0xa5], data-length=64, crc-offset=0, counter-offset=8}, end-to-end-protection-i-signal-i-pdu{data-offset=0, i-signal-group=SG_ORU_0082_XIX_E3V_CCAN, i-signal-i-pdu=ORU_0082_XIX_E3V_CCAN_E2E}
      E2E_Protection_ORU_008C_XIX_E3V_CCAN: end-to-end-profile={category=PROFILE_02, data-ids=[0xd8, 0x31, 0x23, 0x21, 0x7f, 0x70, 0xcc, 0x9f, 0xe3, 0x2e, 0x49, 0xa0, 0x90, 0x32, 0x75, 0x22], data-length=64, crc-offset=0, counter-offset=8}, end-to-end-protection-i-signal-i-pdu{data-offset=0, i-signal-group=SG_ORU_008C_XIX_E3V_CCAN, i-signal-i-pdu=ORU_008C_XIX_E3V_CCAN_E2E}
      E2E_Protection_ORU_00A5_XIX_E3V_CCAN: end-to-end-profile={category=PROFILE_02, data-ids=[0x9f, 0x22, 0x99, 0xda, 0x44, 0xbe, 0x18, 0x85, 0x97, 0x54, 0x7b, 0x63, 0x72, 0x7c, 0x80, 0xf5], data-length=64, crc-offset=0, counter-offset=8}, end-to-end-protection-i-signal-i-pdu{data-offset=0, i-signal-group=SG_ORU_00A5_XIX_E3V_CCAN, i-signal-i-pdu=ORU_00A5_XIX_E3V_CCAN_E2E}
      E2E_Protection_ORU_00BB_XIX_E3V_CCAN: end-to-end-profile={category=PROFILE_02, data-ids=[0x59, 0xa3, 0x3d, 0xb3, 0x47, 0x37, 0x29, 0xb7, 0x7c, 0x04, 0x39, 0xd1, 0xcb, 0xec, 0x45, 0x2f], data-length=64, crc-offset=0, counter-offset=8}, end-to-end-protection-i-signal-i-pdu{data-offset=0, i-signal-group=SG_ORU_00BB_XIX_E3V_CCAN, i-signal-i-pdu=ORU_00BB_XIX_E3V_CCAN_E2E}
      E2E_Protection_ORU_00BC_XIX_E3V_CCAN: end-to-end-profile={category=PROFILE_02, data-ids=[0x80, 0xf7, 0x39, 0xbb, 0x9a, 0x05, 0xef, 0xc8, 0xeb, 0x27, 0xa4, 0xa8, 0x38, 0x8b, 0xc1, 0xf4], data-length=64, crc-offset=0, counter-offset=8}, end-to-end-protection-i-signal-i-pdu{data-offset=0, i-signal-group=SG_ORU_00BC_XIX_E3V_CCAN, i-signal-i-pdu=ORU_00BC_XIX_E3V_CCAN_E2E}
      E2E_Protection_ORU_00C6_XIX_E3V_CCAN: end-to-end-profile={category=PROFILE_02, data-ids=[0x39, 0x05, 0xeb, 0xa8, 0xc1, 0x5b, 0x2e, 0x9b, 0xa9, 0x95, 0x4f, 0xb2, 0x55, 0x30, 0x89, 0x1b], data-length=64, crc-offset=0, counter-offset=8}, end-to-end-protection-i-signal-i-pdu{data-offset=0, i-signal-group=SG_ORU_00C6_XIX_E3V_CCAN, i-signal-i-pdu=ORU_00C6_XIX_E3V_CCAN_E2E}
      E2E_Protection_ORU_00CE_XIX_E3V_CCAN: end-to-end-profile={category=PROFILE_02, data-ids=[0x2d, 0x41, 0x9e, 0xac, 0x21, 0xf9, 0xcb, 0xfb, 0x68, 0x9f, 0xb8, 0xc0, 0x43, 0x1f, 0xa0, 0xbc], data-length=64, crc-offset=0, counter-offset=8}, end-to-end-protection-i-signal-i-pdu{data-offset=0, i-signal-group=SG_ORU_00CE_XIX_E3V_CCAN, i-signal-i-pdu=ORU_00CE_XIX_E3V_CCAN_E2E}
      E2E_Protection_ORU_00D6_XIX_E3V_CCAN: end-to-end-profile={category=PROFILE_02, data-ids=[0x63, 0x65, 0x14, 0x98, 0xbb, 0x5a, 0x5d, 0x75, 0x15, 0xc8, 0x1a, 0xc2, 0xe7, 0xb1, 0xa8, 0x73], data-length=64, crc-offset=0, counter-offset=8}, end-to-end-protection-i-signal-i-pdu{data-offset=0, i-signal-group=SG_ORU_00D6_XIX_E3V_CCAN, i-signal-i-pdu=ORU_00D6_XIX_E3V_CCAN_E2E}
      E2E_Protection_ORU_00D7_XIX_E3V_CCAN: end-to-end-profile={category=PROFILE_02, data-ids=[0x3b, 0xdb, 0xd6, 0xc1, 0x37, 0xea, 0x48, 0x95, 0x19, 0xd1, 0x36, 0x89, 0xd4, 0x02, 0x1e, 0xb9], data-length=64, crc-offset=0, counter-offset=8}, end-to-end-protection-i-signal-i-pdu{data-offset=0, i-signal-group=SG_ORU_00D7_XIX_E3V_CCAN, i-signal-i-pdu=ORU_00D7_XIX_E3V_CCAN_E2E}
      E2E_Protection_ORU_0631_XIX_E3V_CCAN: end-to-end-profile={category=PROFILE_02, data-ids=[0x7e, 0x0a, 0x10, 0x59, 0x79, 0xe5, 0xe0, 0xa3, 0x92, 0xb8, 0xc4, 0x3d, 0x5b, 0xfa, 0x6d, 0xb3], data-length=64, crc-offset=0, counter-offset=8}, end-to-end-protection-i-signal-i-pdu{data-offset=0, i-signal-group=SG_ORU_0631_XIX_E3V_CCAN, i-signal-i-pdu=ORU_0631_XIX_E3V_CCAN_E2E}
      E2E_Protection_ORU_8105_XIX_E3V_CCAN: end-to-end-profile={category=PROFILE_02, data-ids=[0x09, 0xd6, 0xe2, 0xea, 0x7c, 0x19, 0xc8, 0x89, 0x2d, 0x1e, 0x5c, 0xd0, 0xae, 0xf4, 0x2a, 0xcc], data-length=64, crc-offset=0, counter-offset=8}, end-to-end-protection-i-signal-i-pdu{data-offset=0, i-signal-group=SG_ORU_8105_XIX_E3V_CCAN, i-signal-i-pdu=ORU_8105_XIX_E3V_CCAN_E2E}
      E2E_Protection_ORU_8109_XIX_E3V_CCAN: end-to-end-profile={category=PROFILE_02, data-ids=[0xf5, 0xe9, 0xe1, 0x09, 0x42, 0x8e, 0x05, 0xd1, 0xa3, 0xa0, 0xdd, 0x4d, 0x61, 0x97, 0xef, 0x41], data-length=64, crc-offset=0, counter-offset=8}, end-to-end-protection-i-signal-i-pdu{data-offset=0, i-signal-group=SG_ORU_8109_XIX_E3V_CCAN, i-signal-i-pdu=ORU_8109_XIX_E3V_CCAN_E2E}
      E2E_Protection_ORU_810A_XIX_E3V_CCAN: end-to-end-profile={category=PROFILE_02, data-ids=[0x0b, 0x0c, 0x64, 0x79, 0x44, 0x0f, 0xf6, 0xc6, 0xc7, 0x05, 0x45, 0xb7, 0x59, 0xe3, 0x3f, 0x73], data-length=64, crc-offset=0, counter-offset=8}, end-to-end-protection-i-signal-i-pdu{data-offset=0, i-signal-group=SG_ORU_810A_XIX_E3V_CCAN, i-signal-i-pdu=ORU_810A_XIX_E3V_CCAN_E2E}
      E2E_Protection_ORU_810B_XIX_E3V_CCAN: end-to-end-profile={category=PROFILE_02, data-ids=[0xcc, 0x5b, 0x0e, 0x84, 0x2a, 0xec, 0x59, 0x8f, 0xf4, 0x61, 0x6e, 0x63, 0xae, 0x46, 0x77, 0x8b], data-length=64, crc-offset=0, counter-offset=8}, end-to-end-protection-i-signal-i-pdu{data-offset=0, i-signal-group=SG_ORU_810B_XIX_E3V_CCAN, i-signal-i-pdu=ORU_810B_XIX_E3V_CCAN_E2E}
      E2E_Protection_ORU_810C_XIX_E3V_CCAN: end-to-end-profile={category=PROFILE_02, data-ids=[0x47, 0xb6, 0xf5, 0x98, 0x48, 0xe9, 0xc2, 0x9e, 0xe1, 0xf4, 0xd3, 0x09, 0x20, 0xfa, 0x42, 0xca], data-length=64, crc-offset=0, counter-offset=8}, end-to-end-protection-i-signal-i-pdu{data-offset=0, i-signal-group=SG_ORU_810C_XIX_E3V_CCAN, i-signal-i-pdu=ORU_810C_XIX_E3V_CCAN_E2E}
      E2E_Protection_ORU_8133_XIX_E3V_K2CANFD: end-to-end-profile={category=PROFILE_02, data-ids=[0xec, 0xdd, 0x4a, 0xb6, 0xf1, 0x01, 0x22, 0x85, 0x7c, 0x53, 0x68, 0x7f, 0xb2, 0xa6, 0xf3, 0xc6], data-length=64, crc-offset=0, counter-offset=8}, end-to-end-protection-i-signal-i-pdu{data-offset=0, i-signal-group=SG_ORU_8133_XIX_E3V_K2CANFD, i-signal-i-pdu=ORU_8133_XIX_E3V_K2CANFD_E2E}
      E2E_Protection_ORU_8134_XIX_E3V_K2CANFD: end-to-end-profile={category=PROFILE_02, data-ids=[0x68, 0x6a, 0xe3, 0xab, 0xf6, 0xef, 0x83, 0x11, 0x93, 0x84, 0xe0, 0xf0, 0x8f, 0x2b, 0x7d, 0x63], data-length=64, crc-offset=0, counter-offset=8}, end-to-end-protection-i-signal-i-pdu{data-offset=0, i-signal-group=SG_ORU_8134_XIX_E3V_K2CANFD, i-signal-i-pdu=ORU_8134_XIX_E3V_K2CANFD_E2E}
      E2E_Protection_ORU_8179_XIX_E3V_K2CANFD: end-to-end-profile={category=PROFILE_02, data-ids=[0xf0, 0xb2, 0x57, 0xe8, 0x04, 0x0e, 0x9c, 0xd3, 0xbb, 0x6b, 0xcd, 0x43, 0xa5, 0xda, 0x10, 0x56], data-length=64, crc-offset=0, counter-offset=8}, end-to-end-protection-i-signal-i-pdu{data-offset=0, i-signal-group=SG_ORU_8179_XIX_E3V_K2CANFD, i-signal-i-pdu=ORU_8179_XIX_E3V_K2CANFD_E2E}
      E2E_Protection_ORU_817B_XIX_E3V_K2CANFD: end-to-end-profile={category=PROFILE_02, data-ids=[0x58, 0xee, 0x2c, 0x6d, 0x2d, 0x11, 0x2f, 0x85, 0x5b, 0xf7, 0xd4, 0x93, 0x31, 0xc4, 0x20, 0x75], data-length=64, crc-offset=0, counter-offset=8}, end-to-end-protection-i-signal-i-pdu{data-offset=0, i-signal-group=SG_ORU_817B_XIX_E3V_K2CANFD, i-signal-i-pdu=ORU_817B_XIX_E3V_K2CANFD_E2E}
      E2E_Protection_ORU_8181_XIX_E3V_K2CANFD: end-to-end-profile={category=PROFILE_02, data-ids=[0x89, 0x3f, 0x43, 0x88, 0xca, 0xc9, 0x24, 0xae, 0x70, 0xaf, 0xee, 0x38, 0x7d, 0x95, 0x41, 0x47], data-length=64, crc-offset=0, counter-offset=8}, end-to-end-protection-i-signal-i-pdu{data-offset=0, i-signal-group=SG_ORU_8181_XIX_E3V_K2CANFD, i-signal-i-pdu=ORU_8181_XIX_E3V_K2CANFD_E2E}
      E2E_Protection_RLS_02_XIX_E3V_K2CANFD: end-to-end-profile={category=PROFILE_02, data-ids=[0x2c, 0x57, 0x41, 0xc4, 0x6c, 0xd9, 0x38, 0x4d, 0x73, 0x8f, 0x70, 0xb3, 0xd1, 0x96, 0xc9, 0xc6], data-length=64, crc-offset=0, counter-offset=8}, end-to-end-protection-i-signal-i-pdu{data-offset=0, i-signal-group=SG_RLS_02_XIX_E3V_K2CANFD, i-signal-i-pdu=RLS_02_XIX_E3V_K2CANFD_E2E}
      E2E_Protection_RLSs_01_XIX_E3V_SAM_LIN1: end-to-end-profile={category=PROFILE_02, data-ids=[0x2c, 0x57, 0x41, 0xc4, 0x6c, 0xd9, 0x38, 0x4d, 0x73, 0x8f, 0x70, 0xb3, 0xd1, 0x96, 0xc9, 0xc6], data-length=64, crc-offset=56, counter-offset=0}, end-to-end-protection-i-signal-i-pdu{data-offset=0, i-signal-group=SG_RLSs_01_XIX_E3V_SAM_LIN1, i-signal-i-pdu=RLSs_01_XIX_E3V_SAM_LIN1_E2E}
      E2E_Protection_SAL_01_XIX_E3V_K2CANFD: end-to-end-profile={category=PROFILE_02, data-ids=[0xde, 0xa9, 0x83, 0x0b, 0x0c, 0x64, 0x79, 0x44, 0x0f, 0xf6, 0xc6, 0xc7, 0x05, 0x45, 0xb7, 0x59], data-length=64, crc-offset=0, counter-offset=8}, end-to-end-protection-i-signal-i-pdu{data-offset=0, i-signal-group=SG_SAL_01_XIX_E3V_K2CANFD, i-signal-i-pdu=SAL_01_XIX_E3V_K2CANFD_E2E}
      E2E_Protection_SAM_01_XIX_E3V_CCAN: end-to-end-profile={category=PROFILE_02, data-ids=[0x19, 0x36, 0xd4, 0x1e, 0x80, 0x22, 0xf4, 0xb8, 0xad, 0x41, 0x0b, 0x3f, 0x87, 0x42, 0x25, 0x40], data-length=64, crc-offset=0, counter-offset=8}, end-to-end-protection-i-signal-i-pdu{data-offset=0, i-signal-group=SG_SAM_01_XIX_E3V_CCAN, i-signal-i-pdu=SAM_01_XIX_E3V_CCAN_E2E}
      E2E_Protection_SAM_01_XIX_E3V_K2CANFD: end-to-end-profile={category=PROFILE_02, data-ids=[0x19, 0x36, 0xd4, 0x1e, 0x80, 0x22, 0xf4, 0xb8, 0xad, 0x41, 0x0b, 0x3f, 0x87, 0x42, 0x25, 0x40], data-length=64, crc-offset=0, counter-offset=8}, end-to-end-protection-i-signal-i-pdu{data-offset=0, i-signal-group=SG_SAM_01_XIX_E3V_K2CANFD, i-signal-i-pdu=SAM_01_XIX_E3V_K2CANFD_E2E}
      E2E_Protection_SMLS_01_XIX_E3V_K2CANFD: end-to-end-profile={category=PROFILE_02, data-ids=[0xc3, 0x79, 0xbf, 0xdb, 0xe9, 0x11, 0x46, 0x86, 0x69, 0xb6, 0x9b, 0x29, 0x15, 0x9c, 0x45, 0x0d], data-length=64, crc-offset=0, counter-offset=8}, end-to-end-protection-i-signal-i-pdu{data-offset=0, i-signal-group=SG_SMLS_01_XIX_E3V_K2CANFD, i-signal-i-pdu=SMLS_01_XIX_E3V_K2CANFD_E2E}
      E2E_Protection_SRL_HL_01_XIX_E3V_K2CANFD: end-to-end-profile={category=PROFILE_02, data-ids=[0x02, 0x42, 0xcd, 0xa0, 0xe8, 0xef, 0xdf, 0x55, 0x5a, 0x8d, 0xf3, 0xf6, 0x1e, 0xc5, 0xbe, 0x33], data-length=64, crc-offset=0, counter-offset=8}, end-to-end-protection-i-signal-i-pdu{data-offset=0, i-signal-group=SG_SRL_HL_01_XIX_E3V_K2CANFD, i-signal-i-pdu=SRL_HL_01_XIX_E3V_K2CANFD_E2E}
      E2E_Protection_SRL_HR_01_XIX_E3V_K2CANFD: end-to-end-profile={category=PROFILE_02, data-ids=[0x20, 0xf0, 0x61, 0xe4, 0xa1, 0xd8, 0xd9, 0x86, 0x27, 0x2e, 0x4a, 0x13, 0x1d, 0x64, 0x25, 0xf3], data-length=64, crc-offset=0, counter-offset=8}, end-to-end-protection-i-signal-i-pdu{data-offset=0, i-signal-group=SG_SRL_HR_01_XIX_E3V_K2CANFD, i-signal-i-pdu=SRL_HR_01_XIX_E3V_K2CANFD_E2E}
      E2E_Protection_SRL_SL_01_XIX_E3V_K2CANFD: end-to-end-profile={category=PROFILE_02, data-ids=[0xa8, 0x70, 0x6c, 0x16, 0xa5, 0xc1, 0x29, 0xa1, 0x9f, 0x54, 0x5b, 0x1e, 0xf2, 0x7a, 0x67, 0x2e], data-length=64, crc-offset=0, counter-offset=8}, end-to-end-protection-i-signal-i-pdu{data-offset=0, i-signal-group=SG_SRL_SL_01_XIX_E3V_K2CANFD, i-signal-i-pdu=SRL_SL_01_XIX_E3V_K2CANFD_E2E}
      E2E_Protection_SRL_SR_01_XIX_E3V_K2CANFD: end-to-end-profile={category=PROFILE_02, data-ids=[0xa3, 0x50, 0x22, 0xbf, 0xab, 0x5d, 0x38, 0x67, 0x94, 0x68, 0xde, 0x2f, 0x15, 0x4b, 0xd7, 0x32], data-length=64, crc-offset=0, counter-offset=8}, end-to-end-protection-i-signal-i-pdu{data-offset=0, i-signal-group=SG_SRL_SR_01_XIX_E3V_K2CANFD, i-signal-i-pdu=SRL_SR_01_XIX_E3V_K2CANFD_E2E}
      E2E_Protection_SRL_VL_01_XIX_E3V_K2CANFD: end-to-end-profile={category=PROFILE_02, data-ids=[0x7a, 0x3d, 0xb4, 0x89, 0x98, 0x35, 0x66, 0x3f, 0xf3, 0x9e, 0xfb, 0x43, 0x93, 0x9d, 0x09, 0x88], data-length=64, crc-offset=0, counter-offset=8}, end-to-end-protection-i-signal-i-pdu{data-offset=0, i-signal-group=SG_SRL_VL_01_XIX_E3V_K2CANFD, i-signal-i-pdu=SRL_VL_01_XIX_E3V_K2CANFD_E2E}
      E2E_Protection_SRL_VR_01_XIX_E3V_K2CANFD: end-to-end-profile={category=PROFILE_02, data-ids=[0xa1, 0x2e, 0x25, 0xe1, 0x07, 0xf9, 0x89, 0x8e, 0x03, 0xcd, 0x8b, 0xa3, 0xba, 0x3f, 0x01, 0x4d], data-length=64, crc-offset=0, counter-offset=8}, end-to-end-protection-i-signal-i-pdu{data-offset=0, i-signal-group=SG_SRL_VR_01_XIX_E3V_K2CANFD, i-signal-i-pdu=SRL_VR_01_XIX_E3V_K2CANFD_E2E}
      E2E_Protection_TSG_FT_02_XIX_E3V_K2CANFD: end-to-end-profile={category=PROFILE_02, data-ids=[0xc4, 0x6a, 0x69, 0x30, 0xcf, 0x61, 0x58, 0x51, 0x1b, 0x86, 0x99, 0xd3, 0xf6, 0x1d, 0x9a, 0x37], data-length=64, crc-offset=0, counter-offset=8}, end-to-end-protection-i-signal-i-pdu{data-offset=0, i-signal-group=SG_TSG_FT_02_XIX_E3V_K2CANFD, i-signal-i-pdu=TSG_FT_02_XIX_E3V_K2CANFD_E2E}
      E2E_Protection_TSG_HBFS_02_XIX_E3V_K2CANFD: end-to-end-profile={category=PROFILE_02, data-ids=[0x6c, 0x8f, 0xc9, 0xf3, 0xb1, 0x77, 0xed, 0x53, 0xcd, 0x44, 0x40, 0xf1, 0x15, 0x2d, 0x37, 0xe6], data-length=64, crc-offset=0, counter-offset=8}, end-to-end-protection-i-signal-i-pdu{data-offset=0, i-signal-group=SG_TSG_HBFS_02_XIX_E3V_K2CANFD, i-signal-i-pdu=TSG_HBFS_02_XIX_E3V_K2CANFD_E2E}
      E2E_Protection_TSG_HFS_02_XIX_E3V_K2CANFD: end-to-end-profile={category=PROFILE_02, data-ids=[0x40, 0x94, 0x3e, 0x9f, 0xa6, 0x06, 0x60, 0x89, 0xa5, 0x85, 0xfb, 0xdf, 0xde, 0xa8, 0xdd, 0x80], data-length=64, crc-offset=0, counter-offset=8}, end-to-end-protection-i-signal-i-pdu{data-offset=0, i-signal-group=SG_TSG_HFS_02_XIX_E3V_K2CANFD, i-signal-i-pdu=TSG_HFS_02_XIX_E3V_K2CANFD_E2E}
      E2E_Protection_VMM_02_Auth_XIX_E3V_K2CANFD: end-to-end-profile={category=PROFILE_02, data-ids=[0x96, 0x92, 0x95, 0xb5, 0x6e, 0xe3, 0xbd, 0xb4, 0xfa, 0xae, 0xbe, 0xcb, 0xcf, 0xa5, 0x77, 0xef], data-length=224, crc-offset=0, counter-offset=8}, end-to-end-protection-i-signal-i-pdu{data-offset=0, i-signal-group=SG_VMM_02_Auth_XIX_E3V_K2CANFD, i-signal-i-pdu=VMM_02_Auth_XIX_E3V_K2CANFD_E2E}
      E2E_Protection_ZV_04_XIX_E3V_K2CANFD: end-to-end-profile={category=PROFILE_02, data-ids=[0x27, 0x23, 0xf6, 0x9b, 0x88, 0x5f, 0x4d, 0xcd, 0xe1, 0x34, 0xaa, 0x81, 0x11, 0xc6, 0x21, 0x0a], data-length=64, crc-offset=0, counter-offset=8}, end-to-end-protection-i-signal-i-pdu{data-offset=0, i-signal-group=SG_ZV_04_XIX_E3V_K2CANFD, i-signal-i-pdu=ZV_04_XIX_E3V_K2CANFD_E2E}
package /ISignal
  81 x i signal group:
    SG_ADecu1_01_XIX_E3V_K2CANFD: i-signal=[ADecu1_01_CRC_XIX_ADecu1_01_XIX_E3V_K2CANFD, ADecu1_01_BZ_XIX_ADecu1_01_XIX_E3V_K2CANFD, ADecu1_ORUDataIndex_XIX_ADecu1_01_XIX_E3V_K2CANFD, ADecu1_ORUData_XIX_ADecu1_01_XIX_E3V_K2CANFD], system-signal-group=SG_ADecu1_01  # Kennungsfolge: K_2299-0xea,0x22,0x10,0x5d,0x3c,0x94,0x16,0x2f,0xb2,0xd7,0xc8,0x4e,0xc0,0xa1,0x90,0xc4
    SG_ADecu2_01_XIX_E3V_K2CANFD: i-signal=[ADecu2_01_CRC_XIX_ADecu2_01_XIX_E3V_K2CANFD, ADecu2_01_BZ_XIX_ADecu2_01_XIX_E3V_K2CANFD, ADecu2_ORUDataIndex_XIX_ADecu2_01_XIX_E3V_K2CANFD, ADecu2_ORUData_XIX_ADecu2_01_XIX_E3V_K2CANFD], system-signal-group=SG_ADecu2_01  # Kennungsfolge: K_2300-0x9a,0x1c,0xd0,0xb2,0xee,0xaa,0x9f,0xe7,0xbb,0x6d,0x3b,0x17,0x9d,0x56,0x11,0x59
    SG_Airbag_01_XIX_E3V_K2CANFD: i-signal=[Airbag_01_CRC_XIX_Airbag_01_XIX_E3V_K2CANFD, Airbag_01_BZ_XIX_Airbag_01_XIX_E3V_K2CANFD, AB_RGS_Anst_XIX_Airbag_01_XIX_E3V_K2CANFD, AB_Front_Crash_XIX_Airbag_01_XIX_E3V_K2CANFD, AB_Heck_Crash_XIX_Airbag_01_XIX_E3V_K2CANFD, AB_SF_Crash_XIX_Airbag_01_XIX_E3V_K2CANFD, AB_SB_Crash_XIX_Airbag_01_XIX_E3V_K2CANFD, AB_Rollover_Crash_XIX_Airbag_01_XIX_E3V_K2CANFD, AB_Crash_Int_XIX_Airbag_01_XIX_E3V_K2CANFD, AB_Lampe_XIX_Airbag_01_XIX_E3V_K2CANFD, AB_Deaktiviert_XIX_Airbag_01_XIX_E3V_K2CANFD, AB_VB_deaktiviert_XIX_Airbag_01_XIX_E3V_K2CANFD, AB_Systemfehler_XIX_Airbag_01_XIX_E3V_K2CANFD, AB_Diagnose_XIX_Airbag_01_XIX_E3V_K2CANFD, AB_Stellgliedtest_XIX_Airbag_01_XIX_E3V_K2CANFD, AB_Erh_Auf_VB_XIX_Airbag_01_XIX_E3V_K2CANFD, AB_Gurtwarn_VF_XIX_Airbag_01_XIX_E3V_K2CANFD, AB_Gurtwarn_VB_XIX_Airbag_01_XIX_E3V_K2CANFD, AB_Anzeige_Fussg_XIX_Airbag_01_XIX_E3V_K2CANFD, AB_Texte_AKS_XIX_Airbag_01_XIX_E3V_K2CANFD, AB_PAO_Leuchte_Anf_XIX_Airbag_01_XIX_E3V_K2CANFD, AB_MKB_gueltig_XIX_Airbag_01_XIX_E3V_K2CANFD, AB_MKB_Anforderung_XIX_Airbag_01_XIX_E3V_K2CANFD, AB_Versorgungsspannung_XIX_Airbag_01_XIX_E3V_K2CANFD, AB_Deaktivierung_HV_XIX_Airbag_01_XIX_E3V_K2CANFD, AB_EDR_Trigger_XIX_Airbag_01_XIX_E3V_K2CANFD, AB_Belegung_VF_XIX_Airbag_01_XIX_E3V_K2CANFD, AB_Gurtschloss_FA_ext_XIX_Airbag_01_XIX_E3V_K2CANFD, AB_Gurtschloss_FA_ext_aktiv_XIX_Airbag_01_XIX_E3V_K2CANFD, AB_eCS_Error_XIX_Airbag_01_XIX_E3V_K2CANFD, AB_PSS_SollZustand_XIX_Airbag_01_XIX_E3V_K2CANFD, ISignalVoid_Airbag_01_XIX_E3V_K2CANFD_0, ASM_Masterzeit_02_XIX_Airbag_01_XIX_E3V_K2CANFD], system-signal-group=SG_Airbag_01  # Kennungsfolge: K_76-0x40,0x40,0x40,0x40,0x40,0x40,0x40,0x40,0x40,0x40,0x40,0x40,0x40,0x40,0x40,0x40
    SG_Airbag_02_XIX_E3V_K2CANFD: i-signal=[Airbag_02_CRC_XIX_Airbag_02_XIX_E3V_K2CANFD, Airbag_02_BZ_XIX_Airbag_02_XIX_E3V_K2CANFD, LoGeWa_Event_Kombiwarnung_XIX_Airbag_02_XIX_E3V_K2CANFD, AB_Anforderung_eCall_XIX_Airbag_02_XIX_E3V_K2CANFD, AB_Anprall_Seite_Beifahrer_XIX_Airbag_02_XIX_E3V_K2CANFD, ISignalVoid_Airbag_02_XIX_E3V_K2CANFD_0, AB_Anprall_FGS_XIX_Airbag_02_XIX_E3V_K2CANFD, AB_Anprall_Front_Beifahrer_XIX_Airbag_02_XIX_E3V_K2CANFD, AB_Anprall_Front_Fahrer_XIX_Airbag_02_XIX_E3V_K2CANFD, ISignalVoid_Airbag_02_XIX_E3V_K2CANFD_1, AB_Wickelklappung_Reihe2_MI_XIX_Airbag_02_XIX_E3V_K2CANFD, AB_Belegung_VB_XIX_Airbag_02_XIX_E3V_K2CANFD, AB_Abschaltanf_SIH_BF_XIX_Airbag_02_XIX_E3V_K2CANFD, AB_Anprall_Seite_Fahrer_XIX_Airbag_02_XIX_E3V_K2CANFD, SC_PAO_Schriftzug_Anf_XIX_Airbag_02_XIX_E3V_K2CANFD, SC_PAO_ON_Anf_XIX_Airbag_02_XIX_E3V_K2CANFD, SC_PAO_OFF_Anf_XIX_Airbag_02_XIX_E3V_K2CANFD, AB_Crashschwere_XIX_Airbag_02_XIX_E3V_K2CANFD, AB_Anforderung_USM_XIX_Airbag_02_XIX_E3V_K2CANFD, AB_Gurtschloss_FA_XIX_Airbag_02_XIX_E3V_K2CANFD, AB_Gurtschloss_BF_XIX_Airbag_02_XIX_E3V_K2CANFD, AB_Gurtschloss_Reihe2_FA_XIX_Airbag_02_XIX_E3V_K2CANFD, AB_Gurtschloss_Reihe2_MI_XIX_Airbag_02_XIX_E3V_K2CANFD, AB_Gurtschloss_Reihe2_BF_XIX_Airbag_02_XIX_E3V_K2CANFD, AB_Gurtschloss_Reihe3_FA_XIX_Airbag_02_XIX_E3V_K2CANFD, AB_Gurtschloss_Reihe3_MI_XIX_Airbag_02_XIX_E3V_K2CANFD, AB_Gurtschloss_Reihe3_BF_XIX_Airbag_02_XIX_E3V_K2CANFD, AB_Sitzpos_Sens_FA_XIX_Airbag_02_XIX_E3V_K2CANFD, AB_Sitzpos_Sens_BF_XIX_Airbag_02_XIX_E3V_K2CANFD, AB_Wickelklappung_Reihe2_BF_XIX_Airbag_02_XIX_E3V_K2CANFD, AB_Wickelklappung_Reihe2_FA_XIX_Airbag_02_XIX_E3V_K2CANFD], system-signal-group=SG_Airbag_02  # Kennungsfolge: K_80-0x44,0x44,0x44,0x44,0x44,0x44,0x44,0x44,0x44,0x44,0x44,0x44,0x44,0x44,0x44,0x44
    SG_BCM_01_XIX_E3V_CCAN: i-signal=[BCM_01_CRC_XIX_BCM_01_XIX_E3V_CCAN, BCM_01_BZ_XIX_BCM_01_XIX_E3V_CCAN, BCM_Bremsbelag_Sensor_XIX_BCM_01_XIX_E3V_CCAN, BCM_Bremsfluessigkeit_Sensor_XIX_BCM_01_XIX_E3V_CCAN, ISignalVoid_BCM_01_XIX_E3V_CCAN_0, BCM_Waschwasser_Sensor_XIX_BCM_01_XIX_E3V_CCAN, BCM_Kuehlmittel_Sensor_XIX_BCM_01_XIX_E3V_CCAN, BCM1_Kl_15_HW_erkannt_XIX_BCM_01_XIX_E3V_CCAN, BCM1_Kl_15_Sig_HW_erkannt_XIX_BCM_01_XIX_E3V_CCAN, BCM_Kuehlmittel_Sensor_02_XIX_BCM_01_XIX_E3V_CCAN, ISignalVoid_BCM_01_XIX_E3V_CCAN_1, BCM_Offroad_Taste_XIX_BCM_01_XIX_E3V_CCAN, BCM_Charisma_Taste2_XIX_BCM_01_XIX_E3V_CCAN, BCM_Hybrid_StSt_Taste_Fehler_XIX_BCM_01_XIX_E3V_CCAN, BCM_Hybrid_StartStopp_Taste_XIX_BCM_01_XIX_E3V_CCAN, BCM1_Warnblink_Taster_XIX_BCM_01_XIX_E3V_CCAN, BCM1_Valet_Parking_Taster_XIX_BCM_01_XIX_E3V_CCAN, ISignalVoid_BCM_01_XIX_E3V_CCAN_2, BCM1_Rueckfahrlicht_Schalter_XIX_BCM_01_XIX_E3V_CCAN, BCM1_MH_Schalter_XIX_BCM_01_XIX_E3V_CCAN, BCM1_MH_WIV_Schalter_XIX_BCM_01_XIX_E3V_CCAN, BCM_Eco_Charisma_Taste_XIX_BCM_01_XIX_E3V_CCAN, BCM1_NV_Taster_XIX_BCM_01_XIX_E3V_CCAN, BCM1_AFS_Lampe_XIX_BCM_01_XIX_E3V_CCAN, BCM1_Reisemodus_Texte_XIX_BCM_01_XIX_E3V_CCAN, ISignalVoid_BCM_01_XIX_E3V_CCAN_3, Gong_TFL_Umschaltung_XIX_BCM_01_XIX_E3V_CCAN, ISignalVoid_BCM_01_XIX_E3V_CCAN_4, BCM_ValetTaster_Fkts_LED_XIX_BCM_01_XIX_E3V_CCAN, LRH_Taster_XIX_BCM_01_XIX_E3V_CCAN, APS_Tongeber_defekt_XIX_BCM_01_XIX_E3V_CCAN, BCM1_EasyEntry_Status_XIX_BCM_01_XIX_E3V_CCAN, BCM1_Lenksaeule_aktiv_XIX_BCM_01_XIX_E3V_CCAN, BCM1_Spannungs_Anf_XIX_BCM_01_XIX_E3V_CCAN, ISignalVoid_BCM_01_XIX_E3V_CCAN_5, ISignalVoid_BCM_01_XIX_E3V_CCAN_6, BCM_Anf_AAW_MoLaWa_XIX_BCM_01_XIX_E3V_CCAN, BCM_Handbremse_Hinweis_XIX_BCM_01_XIX_E3V_CCAN, ISignalVoid_BCM_01_XIX_E3V_CCAN_7, BCM_HDF_betaetigt_XIX_BCM_01_XIX_E3V_CCAN], system-signal-group=SG_BCM_01  # Kennungsfolge: K_2174-0x7b,0xb3,0xbf,0x61,0x6d,0x80,0x03,0xfa,0xb1,0x4b,0x5b,0x4c,0x8a,0x3d,0xdd,0x17
    SG_BCM_01_XIX_E3V_K2CANFD: i-signal=[BCM_01_CRC_XIX_BCM_01_XIX_E3V_K2CANFD, BCM_01_BZ_XIX_BCM_01_XIX_E3V_K2CANFD, BCM_Bremsbelag_Sensor_XIX_BCM_01_XIX_E3V_K2CANFD, BCM_Bremsfluessigkeit_Sensor_XIX_BCM_01_XIX_E3V_K2CANFD, ISignalVoid_BCM_01_XIX_E3V_K2CANFD_0, BCM_Waschwasser_Sensor_XIX_BCM_01_XIX_E3V_K2CANFD, BCM_Kuehlmittel_Sensor_XIX_BCM_01_XIX_E3V_K2CANFD, BCM1_Kl_15_HW_erkannt_XIX_BCM_01_XIX_E3V_K2CANFD, BCM1_Kl_15_Sig_HW_erkannt_XIX_BCM_01_XIX_E3V_K2CANFD, BCM_Kuehlmittel_Sensor_02_XIX_BCM_01_XIX_E3V_K2CANFD, ISignalVoid_BCM_01_XIX_E3V_K2CANFD_1, BCM_Offroad_Taste_XIX_BCM_01_XIX_E3V_K2CANFD, BCM_Charisma_Taste2_XIX_BCM_01_XIX_E3V_K2CANFD, BCM_Hybrid_StSt_Taste_Fehler_XIX_BCM_01_XIX_E3V_K2CANFD, BCM_Hybrid_StartStopp_Taste_XIX_BCM_01_XIX_E3V_K2CANFD, BCM1_Warnblink_Taster_XIX_BCM_01_XIX_E3V_K2CANFD, BCM1_Valet_Parking_Taster_XIX_BCM_01_XIX_E3V_K2CANFD, ISignalVoid_BCM_01_XIX_E3V_K2CANFD_2, BCM1_Rueckfahrlicht_Schalter_XIX_BCM_01_XIX_E3V_K2CANFD, BCM1_MH_Schalter_XIX_BCM_01_XIX_E3V_K2CANFD, BCM1_MH_WIV_Schalter_XIX_BCM_01_XIX_E3V_K2CANFD, BCM_Eco_Charisma_Taste_XIX_BCM_01_XIX_E3V_K2CANFD, BCM1_NV_Taster_XIX_BCM_01_XIX_E3V_K2CANFD, BCM1_AFS_Lampe_XIX_BCM_01_XIX_E3V_K2CANFD, BCM1_Reisemodus_Texte_XIX_BCM_01_XIX_E3V_K2CANFD, ISignalVoid_BCM_01_XIX_E3V_K2CANFD_3, Gong_TFL_Umschaltung_XIX_BCM_01_XIX_E3V_K2CANFD, ISignalVoid_BCM_01_XIX_E3V_K2CANFD_4, BCM_ValetTaster_Fkts_LED_XIX_BCM_01_XIX_E3V_K2CANFD, LRH_Taster_XIX_BCM_01_XIX_E3V_K2CANFD, APS_Tongeber_defekt_XIX_BCM_01_XIX_E3V_K2CANFD, BCM1_EasyEntry_Status_XIX_BCM_01_XIX_E3V_K2CANFD, BCM1_Lenksaeule_aktiv_XIX_BCM_01_XIX_E3V_K2CANFD, BCM1_Spannungs_Anf_XIX_BCM_01_XIX_E3V_K2CANFD, ISignalVoid_BCM_01_XIX_E3V_K2CANFD_5, ISignalVoid_BCM_01_XIX_E3V_K2CANFD_6, BCM_Anf_AAW_MoLaWa_XIX_BCM_01_XIX_E3V_K2CANFD, BCM_Handbremse_Hinweis_XIX_BCM_01_XIX_E3V_K2CANFD, ISignalVoid_BCM_01_XIX_E3V_K2CANFD_7, BCM_HDF_betaetigt_XIX_BCM_01_XIX_E3V_K2CANFD], system-signal-group=SG_BCM_01  # Kennungsfolge: K_2174-0x7b,0xb3,0xbf,0x61,0x6d,0x80,0x03,0xfa,0xb1,0x4b,0x5b,0x4c,0x8a,0x3d,0xdd,0x17
    SG_DRB1_01_XIX_E3V_K2CANFD: i-signal=[DRB1_01_CRC_XIX_DRB1_01_XIX_E3V_K2CANFD, DRB1_01_BZ_XIX_DRB1_01_XIX_E3V_K2CANFD, DRB1_ORUDataIndex_XIX_DRB1_01_XIX_E3V_K2CANFD, DRB1_ORUData_XIX_DRB1_01_XIX_E3V_K2CANFD], system-signal-group=SG_DRB1_01  # Kennungsfolge: K_1767-0xc0,0xbf,0x65,0xd1,0xaa,0x85,0x3a,0x5c,0xa1,0xa9,0x8f,0xb8,0xcd,0x66,0xe6,0xd5
    SG_DRB2_01_XIX_E3V_K2CANFD: i-signal=[DRB2_01_CRC_XIX_DRB2_01_XIX_E3V_K2CANFD, DRB2_01_BZ_XIX_DRB2_01_XIX_E3V_K2CANFD, DRB2_ORUDataIndex_XIX_DRB2_01_XIX_E3V_K2CANFD, DRB2_ORUData_XIX_DRB2_01_XIX_E3V_K2CANFD], system-signal-group=SG_DRB2_01  # Kennungsfolge: K_2253-0xbc,0x4f,0xeb,0x68,0xb1,0x96,0x41,0x6a,0x29,0x3c,0xf5,0xe3,0x66,0xaf,0x56,0xab
    SG_EM1_HYB_13_XIX_E3V_CCAN: i-signal=[EM1_HYB_13_CRC_XIX_EM1_HYB_13_XIX_E3V_CCAN, EM1_HYB_13_BZ_XIX_EM1_HYB_13_XIX_E3V_CCAN, EM1_Freigabe_Info_WFS_XIX_EM1_HYB_13_XIX_E3V_CCAN, EM1_Sperr_Info_WFS_XIX_EM1_HYB_13_XIX_E3V_CCAN, EM1_AR_aktiv_XIX_EM1_HYB_13_XIX_E3V_CCAN, EM1_Eta_Sys_XIX_EM1_HYB_13_XIX_E3V_CCAN, EM1_IstStrom_XIX_EM1_HYB_13_XIX_E3V_CCAN, EM1_Fehler_ElAntriebFreilauf_Anf_XIX_EM1_HYB_13_XIX_E3V_CCAN, EM1_Abregelung_Temperatur_XIX_EM1_HYB_13_XIX_E3V_CCAN, ISignalVoid_EM1_HYB_13_XIX_E3V_CCAN_0, ISignalVoid_EM1_HYB_13_XIX_E3V_CCAN_1, EM1_AnlernenElMotor_Anf_XIX_EM1_HYB_13_XIX_E3V_CCAN, EM1_Moment_HVVerbraucher_XIX_EM1_HYB_13_XIX_E3V_CCAN, ISignalVoid_EM1_HYB_13_XIX_E3V_CCAN_2, EM1_Freigabe_Verfallsinfo_WFS_XIX_EM1_HYB_13_XIX_E3V_CCAN, EM1_Parken_WFS_Status_XIX_EM1_HYB_13_XIX_E3V_CCAN, EM1_HV_betriebsbereit_XIX_EM1_HYB_13_XIX_E3V_CCAN, LE1_TorqueLockStatus_XIX_EM1_HYB_13_XIX_E3V_CCAN, ISignalVoid_EM1_HYB_13_XIX_E3V_CCAN_3], system-signal-group=SG_EM1_HYB_13  # Kennungsfolge: K_684-0xca,0x87,0x13,0xb7,0xef,0xe5,0x19,0x98,0x07,0x54,0x5e,0xdd,0x2c,0x24,0x94,0xb9
    SG_EM2_HYB_13_XIX_E3V_CCAN: i-signal=[EM2_HYB_13_CRC_XIX_EM2_HYB_13_XIX_E3V_CCAN, EM2_HYB_13_BZ_XIX_EM2_HYB_13_XIX_E3V_CCAN, EM2_Freigabe_Info_WFS_XIX_EM2_HYB_13_XIX_E3V_CCAN, EM2_Sperr_Info_WFS_XIX_EM2_HYB_13_XIX_E3V_CCAN, EM2_AR_aktiv_XIX_EM2_HYB_13_XIX_E3V_CCAN, EM2_Eta_Sys_XIX_EM2_HYB_13_XIX_E3V_CCAN, EM2_IstStrom_XIX_EM2_HYB_13_XIX_E3V_CCAN, EM2_Fehler_ElAntriebFreilauf_Anf_XIX_EM2_HYB_13_XIX_E3V_CCAN, EM2_Abregelung_Temperatur_XIX_EM2_HYB_13_XIX_E3V_CCAN, ISignalVoid_EM2_HYB_13_XIX_E3V_CCAN_0, ISignalVoid_EM2_HYB_13_XIX_E3V_CCAN_1, EM2_AnlernenElMotor_Anf_XIX_EM2_HYB_13_XIX_E3V_CCAN, ISignalVoid_EM2_HYB_13_XIX_E3V_CCAN_2, ISignalVoid_EM2_HYB_13_XIX_E3V_CCAN_3, EM2_Freigabe_Verfallsinfo_WFS_XIX_EM2_HYB_13_XIX_E3V_CCAN, EM2_Parken_WFS_Status_XIX_EM2_HYB_13_XIX_E3V_CCAN, EM2_HV_betriebsbereit_XIX_EM2_HYB_13_XIX_E3V_CCAN, LE2_TorqueLockStatus_XIX_EM2_HYB_13_XIX_E3V_CCAN, ISignalVoid_EM2_HYB_13_XIX_E3V_CCAN_4], system-signal-group=SG_EM2_HYB_13  # Kennungsfolge: K_781-0xc7,0x11,0x27,0x31,0xb8,0x76,0x09,0xec,0x60,0x10,0x16,0xc8,0x90,0x7d,0x69,0x17
    SG_ESP_21_XIX_E3V_K2CANFD: i-signal=[ESP_21_CRC_XIX_ESP_21_XIX_E3V_K2CANFD, ESP_21_BZ_XIX_ESP_21_XIX_E3V_K2CANFD, BR_Eingriffsmoment_XIX_ESP_21_XIX_E3V_K2CANFD, ESP_PLA_Bremseingriff_XIX_ESP_21_XIX_E3V_K2CANFD, ESP_Diagnose_XIX_ESP_21_XIX_E3V_K2CANFD, ESC_Reku_Freigabe_XIX_ESP_21_XIX_E3V_K2CANFD, ESC_v_Signal_Qualifier_High_Low_XIX_ESP_21_XIX_E3V_K2CANFD, ESP_Vorsteuerung_XIX_ESP_21_XIX_E3V_K2CANFD, ESP_AWV3_Brems_aktiv_XIX_ESP_21_XIX_E3V_K2CANFD, OBD_Schlechtweg_XIX_ESP_21_XIX_E3V_K2CANFD, OBD_QBit_Schlechtweg_XIX_ESP_21_XIX_E3V_K2CANFD, ESP_v_Signal_XIX_ESP_21_XIX_E3V_K2CANFD, ASR_Tastung_passiv_XIX_ESP_21_XIX_E3V_K2CANFD, ESP_Tastung_passiv_XIX_ESP_21_XIX_E3V_K2CANFD, ESP_Systemstatus_XIX_ESP_21_XIX_E3V_K2CANFD, ASR_Schalteingriff_XIX_ESP_21_XIX_E3V_K2CANFD, ESP_Haltebestaetigung_XIX_ESP_21_XIX_E3V_K2CANFD, ESP_MKB_Abbruch_Geschw_XIX_ESP_21_XIX_E3V_K2CANFD, ESP_QBit_v_Signal_XIX_ESP_21_XIX_E3V_K2CANFD, ABS_Bremsung_XIX_ESP_21_XIX_E3V_K2CANFD, ASR_Anf_XIX_ESP_21_XIX_E3V_K2CANFD, MSR_Anf_XIX_ESP_21_XIX_E3V_K2CANFD, EBV_Eingriff_XIX_ESP_21_XIX_E3V_K2CANFD, EDS_Eingriff_XIX_ESP_21_XIX_E3V_K2CANFD, ESP_Eingriff_XIX_ESP_21_XIX_E3V_K2CANFD, ESP_ASP_XIX_ESP_21_XIX_E3V_K2CANFD, ESP_Anhaltevorgang_ACC_aktiv_XIX_ESP_21_XIX_E3V_K2CANFD], system-signal-group=SG_ESP_21  # Kennungsfolge: K_406-0xb4,0xef,0xf8,0x49,0x1e,0xe5,0xc2,0xc0,0x97,0x19,0x3c,0xc9,0xf1,0x98,0xd6,0x61
    SG_HVL_01_XIX_E3V_K2CANFD: i-signal=[HVL_01_CRC_XIX_HVL_01_XIX_E3V_K2CANFD, HVL_01_BZ_XIX_HVL_01_XIX_E3V_K2CANFD, HVL_Steckerstatus_XIX_HVL_01_XIX_E3V_K2CANFD, HVL_Status_EoHVL_XIX_HVL_01_XIX_E3V_K2CANFD, HVL_Kuehltemperatur_XIX_HVL_01_XIX_E3V_K2CANFD, HVL_LadeAnforderung_XIX_HVL_01_XIX_E3V_K2CANFD, HVL_HVK_Fehler_DCAbschaltung_XIX_HVL_01_XIX_E3V_K2CANFD, HVL_Status_Spgfreiheit_XIX_HVL_01_XIX_E3V_K2CANFD, HVL_OCC_IstModus_XIX_HVL_01_XIX_E3V_K2CANFD, ISignalVoid_HVL_01_XIX_E3V_K2CANFD_0, ISignalVoid_HVL_01_XIX_E3V_K2CANFD_1, ISignalVoid_HVL_01_XIX_E3V_K2CANFD_2, ISignalVoid_HVL_01_XIX_E3V_K2CANFD_3], system-signal-group=SG_HVL_01  # Kennungsfolge: K_1354-0x1d,0x82,0x7b,0x79,0xa5,0xee,0x3a,0xb9,0xb7,0xf9,0xe4,0x67,0x7f,0x97,0x11,0xad
    SG_Klemmen_Status_01_XIX_E3V_K2CANFD: i-signal=[Klemmen_Status_01_CRC_XIX_Klemmen_Status_01_XIX_E3V_K2CANFD, Klemmen_Status_01_BZ_XIX_Klemmen_Status_01_XIX_E3V_K2CANFD, RSt_Fahrerhinweise_XIX_Klemmen_Status_01_XIX_E3V_K2CANFD, ZAS_Kl_S_XIX_Klemmen_Status_01_XIX_E3V_K2CANFD, ZAS_Kl_15_XIX_Klemmen_Status_01_XIX_E3V_K2CANFD, ZAS_Kl_X_XIX_Klemmen_Status_01_XIX_E3V_K2CANFD, ZAS_Kl_50_Startanforderung_XIX_Klemmen_Status_01_XIX_E3V_K2CANFD, ISignalVoid_Klemmen_Status_01_XIX_E3V_K2CANFD_0, ZAS_Kl_Infotainment_XIX_Klemmen_Status_01_XIX_E3V_K2CANFD, ISignalVoid_Klemmen_Status_01_XIX_E3V_K2CANFD_1, KST_Warn_P1_ZST_def_XIX_Klemmen_Status_01_XIX_E3V_K2CANFD, KST_Warn_P2_ZST_def_XIX_Klemmen_Status_01_XIX_E3V_K2CANFD, ISignalVoid_Klemmen_Status_01_XIX_E3V_K2CANFD_2, KST_Fahrerhinweis_4_XIX_Klemmen_Status_01_XIX_E3V_K2CANFD, ISignalVoid_Klemmen_Status_01_XIX_E3V_K2CANFD_3], system-signal-group=SG_Klemmen_Status_01  # Kennungsfolge: K_213-0xc3,0xc3,0xc3,0xc3,0xc3,0xc3,0xc3,0xc3,0xc3,0xc3,0xc3,0xc3,0xc3,0xc3,0xc3,0xc3
    SG_Klemmen_Steuerung_01_XIX_E3V_K2CANFD: i-signal=[Klemmen_Steuerung_01_CRC_XIX_Klemmen_Steuerung_01_XIX_E3V_K2CANFD, Klemmen_Steuerung_01_BZ_XIX_Klemmen_Steuerung_01_XIX_E3V_K2CANFD, KST_Anf_Klemme_15_XIX_Klemmen_Steuerung_01_XIX_E3V_K2CANFD, KST_Anf_Klemme_50_XIX_Klemmen_Steuerung_01_XIX_E3V_K2CANFD, KST_Anf_Klemme_S_XIX_Klemmen_Steuerung_01_XIX_E3V_K2CANFD, KST_Txt_Werkstatt_XIX_Klemmen_Steuerung_01_XIX_E3V_K2CANFD, KST_Txt_P_Gang_XIX_Klemmen_Steuerung_01_XIX_E3V_K2CANFD, KST_Txt_Panikabschaltung_XIX_Klemmen_Steuerung_01_XIX_E3V_K2CANFD, KST_Anf_Klemmenfreigabe_ELV_XIX_Klemmen_Steuerung_01_XIX_E3V_K2CANFD, KST_Txt_Komfortabschaltung_XIX_Klemmen_Steuerung_01_XIX_E3V_K2CANFD, KST_ZAT_betaetigt_XIX_Klemmen_Steuerung_01_XIX_E3V_K2CANFD, KST_Unterdr_Zuendungsmeldung_XIX_Klemmen_Steuerung_01_XIX_E3V_K2CANFD, KST_aut_Abschaltung_Zuendung_XIX_Klemmen_Steuerung_01_XIX_E3V_K2CANFD, KST_Anf_Klemmenfreigabe_WFS_XIX_Klemmen_Steuerung_01_XIX_E3V_K2CANFD, KST_Anf_ZV_Verriegelung_XIX_Klemmen_Steuerung_01_XIX_E3V_K2CANFD, Relais_VoKo_angesteuert_XIX_Klemmen_Steuerung_01_XIX_E3V_K2CANFD, RSt_Anforderung_HMS_XIX_Klemmen_Steuerung_01_XIX_E3V_K2CANFD, KST_Zuendungswarnung_XIX_Klemmen_Steuerung_01_XIX_E3V_K2CANFD, KST_Fahrer_Info_Text_XIX_Klemmen_Steuerung_01_XIX_E3V_K2CANFD, KST_KL15LockStatus_XIX_Klemmen_Steuerung_01_XIX_E3V_K2CANFD, ISignalVoid_Klemmen_Steuerung_01_XIX_E3V_K2CANFD_0, ISignalVoid_Klemmen_Steuerung_01_XIX_E3V_K2CANFD_1, ISignalVoid_Klemmen_Steuerung_01_XIX_E3V_K2CANFD_2, ISignalVoid_Klemmen_Steuerung_01_XIX_E3V_K2CANFD_3], system-signal-group=SG_Klemmen_Steuerung_01  # Kennungsfolge: K_765-0x9b,0xb5,0x9d,0x06,0x01,0xe7,0x8f,0xc1,0xd0,0x10,0x47,0xe9,0xd3,0xca,0x05,0xf0
    SG_LRL_L_01_XIX_E3V_K2CANFD: i-signal=[LRL_L_01_CRC_XIX_LRL_L_01_XIX_E3V_K2CANFD, LRL_L_01_BZ_XIX_LRL_L_01_XIX_E3V_K2CANFD, LRL1_ORUDataIndex_XIX_LRL_L_01_XIX_E3V_K2CANFD, LRL1_ORUData_XIX_LRL_L_01_XIX_E3V_K2CANFD], system-signal-group=SG_LRL_L_01  # Kennungsfolge: K_2284-0x85,0x75,0xe0,0xd3,0x9b,0x7d,0x82,0xd5,0x8b,0xb4,0xeb,0xdd,0xbb,0xa2,0x86,0xc7
    SG_LRL_M_01_XIX_E3V_K2CANFD: i-signal=[LRL_M_01_CRC_XIX_LRL_M_01_XIX_E3V_K2CANFD, LRL_M_01_BZ_XIX_LRL_M_01_XIX_E3V_K2CANFD, LRL2_ORUDataIndex_XIX_LRL_M_01_XIX_E3V_K2CANFD, LRL2_ORUData_XIX_LRL_M_01_XIX_E3V_K2CANFD], system-signal-group=SG_LRL_M_01  # Kennungsfolge: K_2302-0x62,0x0a,0x55,0x49,0x15,0x33,0x78,0x53,0xe3,0x39,0xc9,0x4c,0xe1,0xcc,0x9c,0xc8
    SG_LRL_R_01_XIX_E3V_K2CANFD: i-signal=[LRL_R_01_CRC_XIX_LRL_R_01_XIX_E3V_K2CANFD, LRL_R_01_BZ_XIX_LRL_R_01_XIX_E3V_K2CANFD, LRL3_ORUDataIndex_XIX_LRL_R_01_XIX_E3V_K2CANFD, LRL3_ORUData_XIX_LRL_R_01_XIX_E3V_K2CANFD], system-signal-group=SG_LRL_R_01  # Kennungsfolge: K_2306-0x6c,0xc1,0x9f,0x1e,0x67,0x56,0x9b,0x25,0xf8,0x32,0xec,0x4f,0x53,0xb4,0xc4,0xf9
    SG_MFG_01_XIX_E3V_K2CANFD: i-signal=[MFG_01_CRC_XIX_MFG_01_XIX_E3V_K2CANFD, MFG_01_BZ_XIX_MFG_01_XIX_E3V_K2CANFD, MF_ZV_Lock_XIX_MFG_01_XIX_E3V_K2CANFD, MF_Motorweiterlauf_XIX_MFG_01_XIX_E3V_K2CANFD, MF_Abzugssperre_XIX_MFG_01_XIX_E3V_K2CANFD, MF_Anlassersperre_XIX_MFG_01_XIX_E3V_K2CANFD, MF_Variante_XIX_MFG_01_XIX_E3V_K2CANFD, MF_Schluessel_scan_XIX_MFG_01_XIX_E3V_K2CANFD, MF_Laderelais_XIX_MFG_01_XIX_E3V_K2CANFD, MF_StartStopp_Info_XIX_MFG_01_XIX_E3V_K2CANFD, MF_Fernbed_ein_XIX_MFG_01_XIX_E3V_K2CANFD, MF_Standlicht_XIX_MFG_01_XIX_E3V_K2CANFD, MF_Fahrlicht_XIX_MFG_01_XIX_E3V_K2CANFD, MF_interm_Fernlicht_XIX_MFG_01_XIX_E3V_K2CANFD, MF_Warnblinker_XIX_MFG_01_XIX_E3V_K2CANFD, MF_Fussraumbel_XIX_MFG_01_XIX_E3V_K2CANFD, MF_Innenraumbel_XIX_MFG_01_XIX_E3V_K2CANFD, MF_Innenraumbel_Unterdrueck_XIX_MFG_01_XIX_E3V_K2CANFD, MF_Notstart_XIX_MFG_01_XIX_E3V_K2CANFD, MF_Blk_li_XIX_MFG_01_XIX_E3V_K2CANFD, MF_Blk_re_XIX_MFG_01_XIX_E3V_K2CANFD, MF_Lichthupe_XIX_MFG_01_XIX_E3V_K2CANFD, MF_Fernlicht_XIX_MFG_01_XIX_E3V_K2CANFD, MF_HFS_verriegeln_XIX_MFG_01_XIX_E3V_K2CANFD, MF_HFS_entriegeln_XIX_MFG_01_XIX_E3V_K2CANFD, MF_HBFS_verriegeln_XIX_MFG_01_XIX_E3V_K2CANFD, MF_HBFS_entriegeln_XIX_MFG_01_XIX_E3V_K2CANFD, MF_Tippwischen_XIX_MFG_01_XIX_E3V_K2CANFD, MF_Frontintervall_XIX_MFG_01_XIX_E3V_K2CANFD, MF_Wischerstufe_1_XIX_MFG_01_XIX_E3V_K2CANFD, MF_Wischerstufe_2_XIX_MFG_01_XIX_E3V_K2CANFD, MF_Frontwaschen_XIX_MFG_01_XIX_E3V_K2CANFD, MF_nachtr_Stopp_Anf_XIX_MFG_01_XIX_E3V_K2CANFD, MF_Heckintervall_XIX_MFG_01_XIX_E3V_K2CANFD, MF_Heckwaschen_XIX_MFG_01_XIX_E3V_K2CANFD, MF_Summer_XIX_MFG_01_XIX_E3V_K2CANFD, MF_Alarm_Blinkertakt_XIX_MFG_01_XIX_E3V_K2CANFD, MF_Alarm_Blinker_XIX_MFG_01_XIX_E3V_K2CANFD, MF_TFL_Abschaltung_XIX_MFG_01_XIX_E3V_K2CANFD, MF_interm_Takt_XIX_MFG_01_XIX_E3V_K2CANFD, MF_Tuerentriegelung_hinten_XIX_MFG_01_XIX_E3V_K2CANFD, MF_interm_Fahrlicht_XIX_MFG_01_XIX_E3V_K2CANFD, MF_Signalhorn_XIX_MFG_01_XIX_E3V_K2CANFD, MF_FH_FT_hoch_XIX_MFG_01_XIX_E3V_K2CANFD, MF_FH_FT_tief_XIX_MFG_01_XIX_E3V_K2CANFD, MF_FH_BT_hoch_XIX_MFG_01_XIX_E3V_K2CANFD, MF_FH_BT_tief_XIX_MFG_01_XIX_E3V_K2CANFD, MF_FT_verriegeln_XIX_MFG_01_XIX_E3V_K2CANFD, MF_FT_entriegeln_XIX_MFG_01_XIX_E3V_K2CANFD, MF_BT_verriegeln_XIX_MFG_01_XIX_E3V_K2CANFD, MF_BT_entriegeln_XIX_MFG_01_XIX_E3V_K2CANFD], system-signal-group=SG_MFG_01  # Kennungsfolge: K_167-0x97,0x97,0x97,0x97,0x97,0x97,0x97,0x97,0x97,0x97,0x97,0x97,0x97,0x97,0x97,0x97
    SG_ORU_0001_XIX_E3V_CCAN: i-signal=[ORU_0001_CRC_XIX_ORU_0001_XIX_E3V_CCAN, ORU_0001_BZ_XIX_ORU_0001_XIX_E3V_CCAN, Motor_BEV_ORUDataIndex_XIX_ORU_0001_XIX_E3V_CCAN, Motor_BEV_ORUData_XIX_ORU_0001_XIX_E3V_CCAN], system-signal-group=SG_ORU_0001  # Kennungsfolge: K_1628-0x37,0xcf,0x95,0x9f,0x36,0x45,0x02,0xce,0x80,0x4d,0x8a,0x35,0xb8,0x07,0x56,0xeb
    SG_ORU_0003_XIX_E3V_CCAN: i-signal=[ORU_0003_CRC_XIX_ORU_0003_XIX_E3V_CCAN, ORU_0003_BZ_XIX_ORU_0003_XIX_E3V_CCAN, ESC_ORUDataIndex_XIX_ORU_0003_XIX_E3V_CCAN, ESC_ORUData_XIX_ORU_0003_XIX_E3V_CCAN], system-signal-group=SG_ORU_0003  # Kennungsfolge: K_1681-0xe4,0xe8,0xa9,0x73,0x1c,0xc5,0x67,0x37,0x2b,0x12,0x16,0x8e,0x7f,0x4c,0x15,0xcf
    SG_ORU_0006_XIX_E3V_CCAN: i-signal=[ORU_0006_CRC_XIX_ORU_0006_XIX_E3V_CCAN, ORU_0006_BZ_XIX_ORU_0006_XIX_E3V_CCAN, SitzMemo_BFS_ORUDataIndex_XIX_ORU_0006_XIX_E3V_CCAN, SitzMemo_BFS_ORUData_XIX_ORU_0006_XIX_E3V_CCAN], system-signal-group=SG_ORU_0006  # Kennungsfolge: K_1693-0xd6,0x3d,0xdb,0x09,0x3b,0x24,0xa7,0x03,0x1a,0x6c,0x72,0xd7,0x91,0xe6,0x68,0x6a
    SG_ORU_0009_XIX_E3V_CCAN: i-signal=[ORU_0009_CRC_XIX_ORU_0009_XIX_E3V_CCAN, ORU_0009_BZ_XIX_ORU_0009_XIX_E3V_CCAN, SAM_ORUDataIndex_XIX_ORU_0009_XIX_E3V_CCAN, SAM_ORUData_XIX_ORU_0009_XIX_E3V_CCAN], system-signal-group=SG_ORU_0009  # Kennungsfolge: K_1712-0x41,0x46,0xd3,0x58,0x6a,0x22,0xf8,0xc7,0x29,0xc2,0x36,0x6d,0x3c,0x77,0x0a,0xd6
    SG_ORU_0013_XIX_E3V_CCAN: i-signal=[ORU_0013_CRC_XIX_ORU_0013_XIX_E3V_CCAN, ORU_0013_BZ_XIX_ORU_0013_XIX_E3V_CCAN, FASFrontradar_ORUDataIndex_XIX_ORU_0013_XIX_E3V_CCAN, FASFrontradar_ORUData_XIX_ORU_0013_XIX_E3V_CCAN], system-signal-group=SG_ORU_0013  # Kennungsfolge: K_1715-0xb9,0x99,0x69,0xec,0xc7,0xa8,0x14,0x13,0xf0,0xd6,0xce,0x6f,0x9e,0x7f,0x26,0x33
    SG_ORU_0015_XIX_E3V_CCAN: i-signal=[ORU_0015_CRC_XIX_ORU_0015_XIX_E3V_CCAN, ORU_0015_BZ_XIX_ORU_0015_XIX_E3V_CCAN, Airbag_ORUDataIndex_XIX_ORU_0015_XIX_E3V_CCAN, Airbag_ORUData_XIX_ORU_0015_XIX_E3V_CCAN], system-signal-group=SG_ORU_0015  # Kennungsfolge: K_1883-0x49,0xaf,0x4e,0x2b,0xf9,0xd9,0xd4,0x7b,0x0d,0xc0,0x3d,0x50,0xe9,0x56,0x93,0x0f
    SG_ORU_0016_XIX_E3V_CCAN: i-signal=[ORU_0016_CRC_XIX_ORU_0016_XIX_E3V_CCAN, ORU_0016_BZ_XIX_ORU_0016_XIX_E3V_CCAN, SMLS_ORUDataIndex_XIX_ORU_0016_XIX_E3V_CCAN, SMLS_ORUData_XIX_ORU_0016_XIX_E3V_CCAN], system-signal-group=SG_ORU_0016  # Kennungsfolge: K_1731-0x32,0x74,0x79,0xcd,0xf2,0xae,0xe5,0x86,0xeb,0x82,0xe0,0x55,0x9c,0x1a,0xa3,0xca
    SG_ORU_0019_XIX_E3V_CCAN: i-signal=[ORU_0019_CRC_XIX_ORU_0019_XIX_E3V_CCAN, ORU_0019_BZ_XIX_ORU_0019_XIX_E3V_CCAN, ICAS1_X_ORUDataIndex_XIX_ORU_0019_XIX_E3V_CCAN, ICAS1_X_ORUData_XIX_ORU_0019_XIX_E3V_CCAN], system-signal-group=SG_ORU_0019  # Kennungsfolge: K_1732-0xcc,0x27,0x0c,0x97,0x2e,0x3b,0x35,0x4a,0x90,0x6e,0x13,0x6c,0x22,0x1d,0xe9,0x81
    SG_ORU_0023_XIX_E3V_CCAN: i-signal=[ORU_0023_CRC_XIX_ORU_0023_XIX_E3V_CCAN, ORU_0023_BZ_XIX_ORU_0023_XIX_E3V_CCAN, EBKV_2Box_ORUDataIndex_XIX_ORU_0023_XIX_E3V_CCAN, EBKV_ORUData_XIX_ORU_0023_XIX_E3V_CCAN], system-signal-group=SG_ORU_0023  # Kennungsfolge: K_1803-0xc7,0xcf,0x4b,0xd4,0xc3,0xae,0x97,0x56,0x04,0xbd,0xf3,0x40,0x0a,0xb5,0x8c,0x61
    SG_ORU_0036_XIX_E3V_CCAN: i-signal=[ORU_0036_CRC_XIX_ORU_0036_XIX_E3V_CCAN, ORU_0036_BZ_XIX_ORU_0036_XIX_E3V_CCAN, SitzMemo_FS_ORUDataIndex_XIX_ORU_0036_XIX_E3V_CCAN, SitzMemo_FS_ORUData_XIX_ORU_0036_XIX_E3V_CCAN], system-signal-group=SG_ORU_0036  # Kennungsfolge: K_1823-0x22,0xda,0xbe,0x85,0x54,0x63,0x7c,0xf5,0xb5,0x53,0x0f,0x65,0x68,0x1e,0xf7,0x7f
    SG_ORU_003D_XIX_E3V_K2CANFD: i-signal=[ORU_003D_CRC_XIX_ORU_003D_XIX_E3V_K2CANFD, ORU_003D_BZ_XIX_ORU_003D_XIX_E3V_K2CANFD, KFG_ORUDataIndex_XIX_ORU_003D_XIX_E3V_K2CANFD, KFG_ORUData_XIX_ORU_003D_XIX_E3V_K2CANFD], system-signal-group=SG_ORU_003D  # Kennungsfolge: K_1825-0x7b,0x0f,0x90,0xa6,0x67,0x03,0x57,0x6e,0x6b,0x69,0x8a,0x1a,0x13,0xa9,0xa4,0x9e
    SG_ORU_0042_XIX_E3V_CCAN: i-signal=[ORU_0042_CRC_XIX_ORU_0042_XIX_E3V_CCAN, ORU_0042_BZ_XIX_ORU_0042_XIX_E3V_CCAN, TSG_FS_ORUDataIndex_XIX_ORU_0042_XIX_E3V_CCAN, TSG_FS_ORUData_XIX_ORU_0042_XIX_E3V_CCAN], system-signal-group=SG_ORU_0042  # Kennungsfolge: K_1826-0x4f,0x11,0x1c,0xdd,0xa5,0x3e,0xc0,0x38,0x0b,0xca,0x35,0x81,0x02,0xed,0xcf,0x26
    SG_ORU_0044_XIX_E3V_CCAN: i-signal=[ORU_0044_CRC_XIX_ORU_0044_XIX_E3V_CCAN, ORU_0044_BZ_XIX_ORU_0044_XIX_E3V_CCAN, Lenkhilfe_EPS_ORUDataIndex_XIX_ORU_0044_XIX_E3V_CCAN, Lenkhilfe_EPS_ORUData_XIX_ORU_0044_XIX_E3V_CCAN], system-signal-group=SG_ORU_0044  # Kennungsfolge: K_1879-0x08,0x51,0x66,0x42,0x5f,0x7e,0x6c,0xb4,0xb9,0x01,0x75,0x0a,0x39,0x91,0x8e,0xdf
    SG_ORU_0048_XIX_E3V_CCAN: i-signal=[ORU_0048_CRC_XIX_ORU_0048_XIX_E3V_CCAN, ORU_0048_BZ_XIX_ORU_0048_XIX_E3V_CCAN, SitzMem_HFS_ORUDataIndex_XIX_ORU_0048_XIX_E3V_CCAN, SitzMem_HFS_ORUData_XIX_ORU_0048_XIX_E3V_CCAN], system-signal-group=SG_ORU_0048  # Kennungsfolge: K_1829-0x8f,0x60,0x38,0x97,0xc4,0x26,0x2c,0xb5,0x55,0xa2,0xce,0x34,0x6a,0xd8,0x64,0x14
    SG_ORU_0051_XIX_E3V_CCAN: i-signal=[ORU_0051_CRC_XIX_ORU_0051_XIX_E3V_CCAN, ORU_0051_BZ_XIX_ORU_0051_XIX_E3V_CCAN, LE1_ORUDataIndex_XIX_ORU_0051_XIX_E3V_CCAN, LE1_ORUData_XIX_ORU_0051_XIX_E3V_CCAN], system-signal-group=SG_ORU_0051  # Kennungsfolge: K_1833-0xe4,0xe7,0x29,0x8d,0x26,0xec,0xa6,0xd5,0x51,0x34,0xef,0xc9,0x54,0x6e,0x94,0x4f
    SG_ORU_0052_XIX_E3V_CCAN: i-signal=[ORU_0052_CRC_XIX_ORU_0052_XIX_E3V_CCAN, ORU_0052_BZ_XIX_ORU_0052_XIX_E3V_CCAN, TSG_BFS_ORUDataIndex_XIX_ORU_0052_XIX_E3V_CCAN, TSG_BFS_ORUData_XIX_ORU_0052_XIX_E3V_CCAN], system-signal-group=SG_ORU_0052  # Kennungsfolge: K_1836-0xdb,0xc1,0xea,0x95,0xd1,0x89,0x02,0xb9,0xd0,0x8a,0x15,0xcc,0x56,0x6f,0xc6,0x10
    SG_ORU_005B_XIX_E3V_CCAN: i-signal=[ORU_005B_CRC_XIX_ORU_005B_XIX_E3V_CCAN, ORU_005B_BZ_XIX_ORU_005B_XIX_E3V_CCAN, SitzMem_HBFS_ORUDataIndex_XIX_ORU_005B_XIX_E3V_CCAN, SitzMem_HBFS_ORUData_XIX_ORU_005B_XIX_E3V_CCAN], system-signal-group=SG_ORU_005B  # Kennungsfolge: K_1838-0x55,0x94,0x5f,0x5c,0x61,0x01,0xd7,0x87,0x8e,0x57,0x02,0xa1,0x9a,0xe3,0xf1,0xc7
    SG_ORU_0069_XIX_E3V_CCAN: i-signal=[ORU_0069_CRC_XIX_ORU_0069_XIX_E3V_CCAN, ORU_0069_BZ_XIX_ORU_0069_XIX_E3V_CCAN, AAG_ORUDataIndex_XIX_ORU_0069_XIX_E3V_CCAN, AAG_ORUData_XIX_ORU_0069_XIX_E3V_CCAN], system-signal-group=SG_ORU_0069  # Kennungsfolge: K_1839-0xe1,0xa4,0xd5,0xd7,0x14,0x4f,0x41,0xe3,0xb0,0x5a,0x07,0x11,0x0e,0xac,0x15,0x8f
    SG_ORU_006A_XIX_E3V_CCAN: i-signal=[ORU_006A_CRC_XIX_ORU_006A_XIX_E3V_CCAN, ORU_006A_BZ_XIX_ORU_006A_XIX_E3V_CCAN, STSG_HFS_ORUDataIndex_XIX_ORU_006A_XIX_E3V_CCAN, STSG_HFS_ORUData_XIX_ORU_006A_XIX_E3V_CCAN], system-signal-group=SG_ORU_006A  # Kennungsfolge: K_1840-0x42,0xb4,0x0a,0xdf,0xa1,0x59,0xf6,0x0b,0xe5,0xb6,0x78,0xa3,0xa8,0xe4,0xb8,0x3c
    SG_ORU_0076_XIX_E3V_CCAN: i-signal=[ORU_0076_CRC_XIX_ORU_0076_XIX_E3V_CCAN, ORU_0076_BZ_XIX_ORU_0076_XIX_E3V_CCAN, EPH_ORUDataIndex_XIX_ORU_0076_XIX_E3V_CCAN, EPH_ORUData_XIX_ORU_0076_XIX_E3V_CCAN], system-signal-group=SG_ORU_0076  # Kennungsfolge: K_1843-0xe2,0x19,0x2d,0xd0,0x2a,0x41,0x9b,0xc5,0x9e,0x5d,0xa1,0xac,0x96,0x1b,0x21,0x82
    SG_ORU_007A_XIX_E3V_CCAN: i-signal=[ORU_007A_CRC_XIX_ORU_007A_XIX_E3V_CCAN, ORU_007A_BZ_XIX_ORU_007A_XIX_E3V_CCAN, STSG_HBFS_ORUDataIndex_XIX_ORU_007A_XIX_E3V_CCAN, STSG_HBFS_ORUData_XIX_ORU_007A_XIX_E3V_CCAN], system-signal-group=SG_ORU_007A  # Kennungsfolge: K_1849-0x37,0xd1,0x1e,0x8a,0xad,0xc6,0x42,0x5e,0x5d,0x43,0x5b,0xe9,0x0c,0xb4,0x76,0x9c
    SG_ORU_007E_XIX_E3V_CCAN: i-signal=[ORU_007E_CRC_XIX_ORU_007E_XIX_E3V_CCAN, ORU_007E_BZ_XIX_ORU_007E_XIX_E3V_CCAN, Fahrerdisplay_Kombi_ORUDataIndex_XIX_ORU_007E_XIX_E3V_CCAN, Fahrerdisplay_Kombi_ORUData_XIX_ORU_007E_XIX_E3V_CCAN], system-signal-group=SG_ORU_007E  # Kennungsfolge: K_1853-0xac,0xfb,0xc0,0xbc,0x22,0xed,0x09,0x2c,0x28,0xda,0x04,0x67,0xd2,0xd6,0xbe,0xd8
    SG_ORU_0082_XIX_E3V_CCAN: i-signal=[ORU_0082_CRC_XIX_ORU_0082_XIX_E3V_CCAN, ORU_0082_BZ_XIX_ORU_0082_XIX_E3V_CCAN, HUD_ORUDataIndex_XIX_ORU_0082_XIX_E3V_CCAN, HUD_ORUData_XIX_ORU_0082_XIX_E3V_CCAN], system-signal-group=SG_ORU_0082  # Kennungsfolge: K_1856-0x26,0x34,0x94,0x36,0xee,0x5c,0x23,0x15,0x01,0xeb,0x17,0x87,0xf3,0x70,0x57,0xa5
    SG_ORU_008C_XIX_E3V_CCAN: i-signal=[ORU_008C_CRC_XIX_ORU_008C_XIX_E3V_CCAN, ORU_008C_BZ_XIX_ORU_008C_XIX_E3V_CCAN, BMCe_ORUDataIndex_XIX_ORU_008C_XIX_E3V_CCAN, BMCe_ORUData_XIX_ORU_008C_XIX_E3V_CCAN], system-signal-group=SG_ORU_008C  # Kennungsfolge: K_1857-0xd8,0x31,0x23,0x21,0x7f,0x70,0xcc,0x9f,0xe3,0x2e,0x49,0xa0,0x90,0x32,0x75,0x22
    SG_ORU_00A5_XIX_E3V_CCAN: i-signal=[ORU_00A5_CRC_XIX_ORU_00A5_XIX_E3V_CCAN, ORU_00A5_BZ_XIX_ORU_00A5_XIX_E3V_CCAN, MFK_ORUDataIndex_XIX_ORU_00A5_XIX_E3V_CCAN, MFK_ORUData_XIX_ORU_00A5_XIX_E3V_CCAN], system-signal-group=SG_ORU_00A5  # Kennungsfolge: K_1881-0x9f,0x22,0x99,0xda,0x44,0xbe,0x18,0x85,0x97,0x54,0x7b,0x63,0x72,0x7c,0x80,0xf5
    SG_ORU_00BB_XIX_E3V_CCAN: i-signal=[ORU_00BB_CRC_XIX_ORU_00BB_XIX_E3V_CCAN, ORU_00BB_BZ_XIX_ORU_00BB_XIX_E3V_CCAN, TSG_HFS_ORUDataIndex_XIX_ORU_00BB_XIX_E3V_CCAN, TSG_HFS_ORUData_XIX_ORU_00BB_XIX_E3V_CCAN], system-signal-group=SG_ORU_00BB  # Kennungsfolge: K_1859-0x59,0xa3,0x3d,0xb3,0x47,0x37,0x29,0xb7,0x7c,0x04,0x39,0xd1,0xcb,0xec,0x45,0x2f
    SG_ORU_00BC_XIX_E3V_CCAN: i-signal=[ORU_00BC_CRC_XIX_ORU_00BC_XIX_E3V_CCAN, ORU_00BC_BZ_XIX_ORU_00BC_XIX_E3V_CCAN, TSG_HBFS_ORUDataIndex_XIX_ORU_00BC_XIX_E3V_CCAN, TSG_HBFS_ORUData_XIX_ORU_00BC_XIX_E3V_CCAN], system-signal-group=SG_ORU_00BC  # Kennungsfolge: K_1860-0x80,0xf7,0x39,0xbb,0x9a,0x05,0xef,0xc8,0xeb,0x27,0xa4,0xa8,0x38,0x8b,0xc1,0xf4
    SG_ORU_00C6_XIX_E3V_CCAN: i-signal=[ORU_00C6_CRC_XIX_ORU_00C6_XIX_E3V_CCAN, ORU_00C6_BZ_XIX_ORU_00C6_XIX_E3V_CCAN, OCC_ORUDataIndex_XIX_ORU_00C6_XIX_E3V_CCAN, OCC_ORUData_XIX_ORU_00C6_XIX_E3V_CCAN], system-signal-group=SG_ORU_00C6  # Kennungsfolge: K_1861-0x39,0x05,0xeb,0xa8,0xc1,0x5b,0x2e,0x9b,0xa9,0x95,0x4f,0xb2,0x55,0x30,0x89,0x1b
    SG_ORU_00CE_XIX_E3V_CCAN: i-signal=[ORU_00CE_CRC_XIX_ORU_00CE_XIX_E3V_CCAN, ORU_00CE_BZ_XIX_ORU_00CE_XIX_E3V_CCAN, LE2_ORUDataIndex_XIX_ORU_00CE_XIX_E3V_CCAN, LE2_ORUData_XIX_ORU_00CE_XIX_E3V_CCAN], system-signal-group=SG_ORU_00CE  # Kennungsfolge: K_1867-0x2d,0x41,0x9e,0xac,0x21,0xf9,0xcb,0xfb,0x68,0x9f,0xb8,0xc0,0x43,0x1f,0xa0,0xbc
    SG_ORU_00D6_XIX_E3V_CCAN: i-signal=[ORU_00D6_CRC_XIX_ORU_00D6_XIX_E3V_CCAN, ORU_00D6_BZ_XIX_ORU_00D6_XIX_E3V_CCAN, LLP_L_ORUDataIndex_XIX_ORU_00D6_XIX_E3V_CCAN, LLP_L_ORUData_XIX_ORU_00D6_XIX_E3V_CCAN], system-signal-group=SG_ORU_00D6  # Kennungsfolge: K_1868-0x63,0x65,0x14,0x98,0xbb,0x5a,0x5d,0x75,0x15,0xc8,0x1a,0xc2,0xe7,0xb1,0xa8,0x73
    SG_ORU_00D7_XIX_E3V_CCAN: i-signal=[ORU_00D7_CRC_XIX_ORU_00D7_XIX_E3V_CCAN, ORU_00D7_BZ_XIX_ORU_00D7_XIX_E3V_CCAN, LLP_R_ORUDataIndex_XIX_ORU_00D7_XIX_E3V_CCAN, LLP_R_ORUData_XIX_ORU_00D7_XIX_E3V_CCAN], system-signal-group=SG_ORU_00D7  # Kennungsfolge: K_1869-0x3b,0xdb,0xd6,0xc1,0x37,0xea,0x48,0x95,0x19,0xd1,0x36,0x89,0xd4,0x02,0x1e,0xb9
    SG_ORU_0631_XIX_E3V_CCAN: i-signal=[ORU_0631_CRC_XIX_ORU_0631_XIX_E3V_CCAN, ORU_0631_BZ_XIX_ORU_0631_XIX_E3V_CCAN, MFL_CAN_ORUDataIndex_XIX_ORU_0631_XIX_E3V_CCAN, MFL_CAN_ORUData_XIX_ORU_0631_XIX_E3V_CCAN], system-signal-group=SG_ORU_0631  # Kennungsfolge: K_1871-0x7e,0x0a,0x10,0x59,0x79,0xe5,0xe0,0xa3,0x92,0xb8,0xc4,0x3d,0x5b,0xfa,0x6d,0xb3
    SG_ORU_8105_XIX_E3V_CCAN: i-signal=[ORU_8105_CRC_XIX_ORU_8105_XIX_E3V_CCAN, ORU_8105_BZ_XIX_ORU_8105_XIX_E3V_CCAN, DCDC_NV_ORUDataIndex_XIX_ORU_8105_XIX_E3V_CCAN, DCDC_ORUData_XIX_ORU_8105_XIX_E3V_CCAN], system-signal-group=SG_ORU_8105  # Kennungsfolge: K_1878-0x09,0xd6,0xe2,0xea,0x7c,0x19,0xc8,0x89,0x2d,0x1e,0x5c,0xd0,0xae,0xf4,0x2a,0xcc
    SG_ORU_8109_XIX_E3V_CCAN: i-signal=[ORU_8109_CRC_XIX_ORU_8109_XIX_E3V_CCAN, ORU_8109_BZ_XIX_ORU_8109_XIX_E3V_CCAN, NR1_ORUDataIndex_XIX_ORU_8109_XIX_E3V_CCAN, NR1_ORUData_XIX_ORU_8109_XIX_E3V_CCAN], system-signal-group=SG_ORU_8109  # Kennungsfolge: K_2280-0xf5,0xe9,0xe1,0x09,0x42,0x8e,0x05,0xd1,0xa3,0xa0,0xdd,0x4d,0x61,0x97,0xef,0x41
    SG_ORU_810A_XIX_E3V_CCAN: i-signal=[ORU_810A_CRC_XIX_ORU_810A_XIX_E3V_CCAN, ORU_810A_BZ_XIX_ORU_810A_XIX_E3V_CCAN, NR2_ORUDataIndex_XIX_ORU_810A_XIX_E3V_CCAN, NR2_ORUData_XIX_ORU_810A_XIX_E3V_CCAN], system-signal-group=SG_ORU_810A  # Kennungsfolge: K_2308-0x0b,0x0c,0x64,0x79,0x44,0x0f,0xf6,0xc6,0xc7,0x05,0x45,0xb7,0x59,0xe3,0x3f,0x73
    SG_ORU_810B_XIX_E3V_CCAN: i-signal=[ORU_810B_CRC_XIX_ORU_810B_XIX_E3V_CCAN, ORU_810B_BZ_XIX_ORU_810B_XIX_E3V_CCAN, NR3_ORUDataIndex_XIX_ORU_810B_XIX_E3V_CCAN, NR3_ORUData_XIX_ORU_810B_XIX_E3V_CCAN], system-signal-group=SG_ORU_810B  # Kennungsfolge: K_2335-0xcc,0x5b,0x0e,0x84,0x2a,0xec,0x59,0x8f,0xf4,0x61,0x6e,0x63,0xae,0x46,0x77,0x8b
    SG_ORU_810C_XIX_E3V_CCAN: i-signal=[ORU_810C_CRC_XIX_ORU_810C_XIX_E3V_CCAN, ORU_810C_BZ_XIX_ORU_810C_XIX_E3V_CCAN, NR4_ORUDataIndex_XIX_ORU_810C_XIX_E3V_CCAN, NR4_ORUData_XIX_ORU_810C_XIX_E3V_CCAN], system-signal-group=SG_ORU_810C  # Kennungsfolge: K_2332-0x47,0xb6,0xf5,0x98,0x48,0xe9,0xc2,0x9e,0xe1,0xf4,0xd3,0x09,0x20,0xfa,0x42,0xca
    SG_ORU_8133_XIX_E3V_K2CANFD: i-signal=[ORU_8133_CRC_XIX_ORU_8133_XIX_E3V_K2CANFD, ORU_8133_BZ_XIX_ORU_8133_XIX_E3V_K2CANFD, eFuse1_ORUDataIndex_XIX_ORU_8133_XIX_E3V_K2CANFD, eFuse1_ORUData_XIX_ORU_8133_XIX_E3V_K2CANFD], system-signal-group=SG_ORU_8133  # Kennungsfolge: K_2192-0xec,0xdd,0x4a,0xb6,0xf1,0x01,0x22,0x85,0x7c,0x53,0x68,0x7f,0xb2,0xa6,0xf3,0xc6
    SG_ORU_8134_XIX_E3V_K2CANFD: i-signal=[ORU_8134_CRC_XIX_ORU_8134_XIX_E3V_K2CANFD, ORU_8134_BZ_XIX_ORU_8134_XIX_E3V_K2CANFD, eFuse3_ORUDataIndex_XIX_ORU_8134_XIX_E3V_K2CANFD, eFuse3_ORUData_XIX_ORU_8134_XIX_E3V_K2CANFD], system-signal-group=SG_ORU_8134  # Kennungsfolge: K_2193-0x68,0x6a,0xe3,0xab,0xf6,0xef,0x83,0x11,0x93,0x84,0xe0,0xf0,0x8f,0x2b,0x7d,0x63
    SG_ORU_8179_XIX_E3V_K2CANFD: i-signal=[ORU_8179_CRC_XIX_ORU_8179_XIX_E3V_K2CANFD, ORU_8179_BZ_XIX_ORU_8179_XIX_E3V_K2CANFD, DCDC_HR_ORUDataIndex_XIX_ORU_8179_XIX_E3V_K2CANFD, DCDC_HR_ORUData_XIX_ORU_8179_XIX_E3V_K2CANFD], system-signal-group=SG_ORU_8179  # Kennungsfolge: K_2195-0xf0,0xb2,0x57,0xe8,0x04,0x0e,0x9c,0xd3,0xbb,0x6b,0xcd,0x43,0xa5,0xda,0x10,0x56
    SG_ORU_817B_XIX_E3V_K2CANFD: i-signal=[ORU_817B_CRC_XIX_ORU_817B_XIX_E3V_K2CANFD, ORU_817B_BZ_XIX_ORU_817B_XIX_E3V_K2CANFD, MainBlade_ORUDataIndex_XIX_ORU_817B_XIX_E3V_K2CANFD, MainBlade_ORUData_XIX_ORU_817B_XIX_E3V_K2CANFD], system-signal-group=SG_ORU_817B  # Kennungsfolge: K_2325-0x58,0xee,0x2c,0x6d,0x2d,0x11,0x2f,0x85,0x5b,0xf7,0xd4,0x93,0x31,0xc4,0x20,0x75
    SG_ORU_8181_XIX_E3V_K2CANFD: i-signal=[ORU_8181_CRC_XIX_ORU_8181_XIX_E3V_K2CANFD, ORU_8181_BZ_XIX_ORU_8181_XIX_E3V_K2CANFD, MaaSBladeMyc_ORUDataIndex_XIX_ORU_8181_XIX_E3V_K2CANFD, MaaSBladeMyc_ORUData_XIX_ORU_8181_XIX_E3V_K2CANFD], system-signal-group=SG_ORU_8181  # Kennungsfolge: K_2323-0x89,0x3f,0x43,0x88,0xca,0xc9,0x24,0xae,0x70,0xaf,0xee,0x38,0x7d,0x95,0x41,0x47
    SG_ORUG01_01_XIX_E3V_K2CANFD: i-signal=[ORUG01_01_CRC_XIX_ORUG01_01_XIX_E3V_K2CANFD, ORUG01_01_BZ_XIX_ORUG01_01_XIX_E3V_K2CANFD, ORUG1_GuardState_XIX_ORUG01_01_XIX_E3V_K2CANFD, ORUG1_GuardInfo_XIX_ORUG01_01_XIX_E3V_K2CANFD, ISignalVoid_ORUG01_01_XIX_E3V_K2CANFD_0, ORUG1_ADEngagementLock_XIX_ORUG01_01_XIX_E3V_K2CANFD, ORUG1_HVReleased_XIX_ORUG01_01_XIX_E3V_K2CANFD, ORUG1_Anforderung_HMS_XIX_ORUG01_01_XIX_E3V_K2CANFD, ORUG1_Parken_beibehalten_HMS_XIX_ORUG01_01_XIX_E3V_K2CANFD, ORUG1_Warning_XIX_ORUG01_01_XIX_E3V_K2CANFD, ORUG1_HVLock_XIX_ORUG01_01_XIX_E3V_K2CANFD, ORUG1_TargetRelease_XIX_ORUG01_01_XIX_E3V_K2CANFD], system-signal-group=SG_ORUG01_01  # Kennungsfolge: K_1612-0xdf,0xa2,0xc0,0x44,0x96,0xbf,0x81,0x49,0x65,0xe4,0x1a,0xd1,0xf4,0x10,0xaa,0xac
    SG_ORUG02_01_XIX_E3V_K2CANFD: i-signal=[ORUG02_01_CRC_XIX_ORUG02_01_XIX_E3V_K2CANFD, ORUG02_01_BZ_XIX_ORUG02_01_XIX_E3V_K2CANFD, ISignalVoid_ORUG02_01_XIX_E3V_K2CANFD_0, ISignalVoid_ORUG02_01_XIX_E3V_K2CANFD_1, ISignalVoid_ORUG02_01_XIX_E3V_K2CANFD_2, ORUG2_GuardState_XIX_ORUG02_01_XIX_E3V_K2CANFD, ORUG2_GuardInfo_XIX_ORUG02_01_XIX_E3V_K2CANFD, ORUG2_TorqueLock_XIX_ORUG02_01_XIX_E3V_K2CANFD, ORUG2_TargetRelease_XIX_ORUG02_01_XIX_E3V_K2CANFD], system-signal-group=SG_ORUG02_01  # Kennungsfolge: K_1611-0x20,0x60,0x3f,0x23,0x7c,0x96,0x28,0x42,0x0e,0x79,0x90,0xe4,0x40,0xb1,0xce,0x18
    SG_RLS_02_XIX_E3V_K2CANFD: i-signal=[RLS_02_CRC_XIX_RLS_02_XIX_E3V_K2CANFD, RLS_02_BZ_XIX_RLS_02_XIX_E3V_K2CANFD, RLS_Qualifizierungsbit_XIX_RLS_02_XIX_E3V_K2CANFD, RS_Wischergeschwindigkeit_XIX_RLS_02_XIX_E3V_K2CANFD, RS_Schwall_XIX_RLS_02_XIX_E3V_K2CANFD, RS_Verglasung_schliessen_XIX_RLS_02_XIX_E3V_K2CANFD, RS_versParklage_Wischer_XIX_RLS_02_XIX_E3V_K2CANFD, LS_Licht_ein_XIX_RLS_02_XIX_E3V_K2CANFD, LS_Licht_ein_invers_XIX_RLS_02_XIX_E3V_K2CANFD, LS_Dunkel_XIX_RLS_02_XIX_E3V_K2CANFD, LS_TFL_mit_SL_ein_XIX_RLS_02_XIX_E3V_K2CANFD, RS_Regenfahrlicht_XIX_RLS_02_XIX_E3V_K2CANFD, RS_AdaptierungError_XIX_RLS_02_XIX_E3V_K2CANFD, RS_Error_XIX_RLS_02_XIX_E3V_K2CANFD, LS_Error_XIX_RLS_02_XIX_E3V_K2CANFD, RLS_ResponseError_XIX_RLS_02_XIX_E3V_K2CANFD, RLS_Vorfeldhelligkeit_Boost_XIX_RLS_02_XIX_E3V_K2CANFD, LS_Helligkeit_IR_XIX_RLS_02_XIX_E3V_K2CANFD, LS_Helligkeit_FW_XIX_RLS_02_XIX_E3V_K2CANFD, ISignalVoid_RLS_02_XIX_E3V_K2CANFD_0, RS_Regenmenge_XIX_RLS_02_XIX_E3V_K2CANFD, ISignalVoid_RLS_02_XIX_E3V_K2CANFD_1], system-signal-group=SG_RLS_02  # Kennungsfolge: K_1416-0x2c,0x57,0x41,0xc4,0x6c,0xd9,0x38,0x4d,0x73,0x8f,0x70,0xb3,0xd1,0x96,0xc9,0xc6
    SG_RLSs_01_XIX_E3V_K2CANFD: i-signal=[RLS_Zaehler_XIX_RLSs_01_XIX_E3V_K2CANFD, RLS_Qualifizierungsbit_XIX_RLSs_01_XIX_E3V_K2CANFD, RS_Wischergeschwindigkeit_XIX_RLSs_01_XIX_E3V_K2CANFD, RS_Schwall_XIX_RLSs_01_XIX_E3V_K2CANFD, RS_Verglasung_schliessen_XIX_RLSs_01_XIX_E3V_K2CANFD, RS_versParklage_Wischer_XIX_RLSs_01_XIX_E3V_K2CANFD, LS_Licht_ein_XIX_RLSs_01_XIX_E3V_K2CANFD, LS_Licht_ein_invers_XIX_RLSs_01_XIX_E3V_K2CANFD, LS_Dunkel_XIX_RLSs_01_XIX_E3V_K2CANFD, LS_TFL_mit_SL_ein_XIX_RLSs_01_XIX_E3V_K2CANFD, RS_Regenfahrlicht_XIX_RLSs_01_XIX_E3V_K2CANFD, RS_AdaptierungError_XIX_RLSs_01_XIX_E3V_K2CANFD, RS_Error_XIX_RLSs_01_XIX_E3V_K2CANFD, LS_Error_XIX_RLSs_01_XIX_E3V_K2CANFD, RLS_ResponseError_XIX_RLSs_01_XIX_E3V_K2CANFD, RLS_Vorfeldhelligkeit_Boost_XIX_RLSs_01_XIX_E3V_K2CANFD, LS_Helligkeit_IR_XIX_RLSs_01_XIX_E3V_K2CANFD, LS_Helligkeit_FW_XIX_RLSs_01_XIX_E3V_K2CANFD, ISignalVoid_RLSs_01_XIX_E3V_K2CANFD_0, RS_Regenmenge_XIX_RLSs_01_XIX_E3V_K2CANFD, ISignalVoid_RLSs_01_XIX_E3V_K2CANFD_1, RLS_CRC_XIX_RLSs_01_XIX_E3V_K2CANFD], system-signal-group=SG_RLSs_01  # Kennungsfolge: K_1416-0x2c,0x57,0x41,0xc4,0x6c,0xd9,0x38,0x4d,0x73,0x8f,0x70,0xb3,0xd1,0x96,0xc9,0xc6
    SG_RLSs_01_XIX_E3V_SAM_LIN1: i-signal=[RLS_Zaehler_XIX_RLSs_01_XIX_E3V_SAM_LIN1, RLS_Qualifizierungsbit_XIX_RLSs_01_XIX_E3V_SAM_LIN1, RS_Wischergeschwindigkeit_XIX_RLSs_01_XIX_E3V_SAM_LIN1, RS_Schwall_XIX_RLSs_01_XIX_E3V_SAM_LIN1, RS_Verglasung_schliessen_XIX_RLSs_01_XIX_E3V_SAM_LIN1, RS_versParklage_Wischer_XIX_RLSs_01_XIX_E3V_SAM_LIN1, LS_Licht_ein_XIX_RLSs_01_XIX_E3V_SAM_LIN1, LS_Licht_ein_invers_XIX_RLSs_01_XIX_E3V_SAM_LIN1, LS_Dunkel_XIX_RLSs_01_XIX_E3V_SAM_LIN1, LS_TFL_mit_SL_ein_XIX_RLSs_01_XIX_E3V_SAM_LIN1, RS_Regenfahrlicht_XIX_RLSs_01_XIX_E3V_SAM_LIN1, RS_AdaptierungError_XIX_RLSs_01_XIX_E3V_SAM_LIN1, RS_Error_XIX_RLSs_01_XIX_E3V_SAM_LIN1, LS_Error_XIX_RLSs_01_XIX_E3V_SAM_LIN1, RLS_ResponseError_XIX_RLSs_01_XIX_E3V_SAM_LIN1, RLS_Vorfeldhelligkeit_Boost_XIX_RLSs_01_XIX_E3V_SAM_LIN1, LS_Helligkeit_IR_XIX_RLSs_01_XIX_E3V_SAM_LIN1, LS_Helligkeit_FW_XIX_RLSs_01_XIX_E3V_SAM_LIN1, ISignalVoid_RLSs_01_XIX_E3V_SAM_LIN1_0, RS_Regenmenge_XIX_RLSs_01_XIX_E3V_SAM_LIN1, ISignalVoid_RLSs_01_XIX_E3V_SAM_LIN1_1, RLS_CRC_XIX_RLSs_01_XIX_E3V_SAM_LIN1], system-signal-group=SG_RLSs_01  # Kennungsfolge: K_1416-0x2c,0x57,0x41,0xc4,0x6c,0xd9,0x38,0x4d,0x73,0x8f,0x70,0xb3,0xd1,0x96,0xc9,0xc6
    SG_SAL_01_XIX_E3V_K2CANFD: i-signal=[SAL_01_CRC_XIX_SAL_01_XIX_E3V_K2CANFD, SAL_01_BZ_XIX_SAL_01_XIX_E3V_K2CANFD, SAL_LDS_Abblendlicht_Anf_XIX_SAL_01_XIX_E3V_K2CANFD, SAL_LDS_Assistenzfahrlicht_Anf_XIX_SAL_01_XIX_E3V_K2CANFD, SAL_LDS_Nullstellung_Anf_XIX_SAL_01_XIX_E3V_K2CANFD, SAL_LDS_Standlicht_Anf_XIX_SAL_01_XIX_E3V_K2CANFD, SBBR_SL_AnimDimm_Freigabe_XIX_SAL_01_XIX_E3V_K2CANFD, BCM2_Bremsl_durch_ECD_XIX_SAL_01_XIX_E3V_K2CANFD, SAL_LH_Anf_XIX_SAL_01_XIX_E3V_K2CANFD, SAL_BRL_Anf_XIX_SAL_01_XIX_E3V_K2CANFD, SAL_WBT_Bel_XIX_SAL_01_XIX_E3V_K2CANFD, SAL_CH_Anf_XIX_SAL_01_XIX_E3V_K2CANFD, SAL_PL_R_Anf_XIX_SAL_01_XIX_E3V_K2CANFD, SAL_PL_L_Anf_XIX_SAL_01_XIX_E3V_K2CANFD, SAL_BLK_R_Anf_XIX_SAL_01_XIX_E3V_K2CANFD, SAL_BLK_L_Anf_XIX_SAL_01_XIX_E3V_K2CANFD, SAL_RFL_Anf_XIX_SAL_01_XIX_E3V_K2CANFD, SAL_NSL_Anf_XIX_SAL_01_XIX_E3V_K2CANFD, SAL_SL_Anf_XIX_SAL_01_XIX_E3V_K2CANFD, SAL_HGB_Anf_XIX_SAL_01_XIX_E3V_K2CANFD, ISignalVoid_SAL_01_XIX_E3V_K2CANFD_0, LWR_SollDC_XIX_SAL_01_XIX_E3V_K2CANFD, ISignalVoid_SAL_01_XIX_E3V_K2CANFD_1, SAL_Bremszyklus_XIX_SAL_01_XIX_E3V_K2CANFD, SAL_Blinkerzyklus_R_XIX_SAL_01_XIX_E3V_K2CANFD, SAL_Blinkerzyklus_L_XIX_SAL_01_XIX_E3V_K2CANFD, LWR_Lampe_XIX_SAL_01_XIX_E3V_K2CANFD, AFS_Lampe_XIX_SAL_01_XIX_E3V_K2CANFD, LWR_Reisemodus_Texte_XIX_SAL_01_XIX_E3V_K2CANFD, SAL_KZL_Anf_XIX_SAL_01_XIX_E3V_K2CANFD, SAL_KL_50_XIX_SAL_01_XIX_E3V_K2CANFD, SAL_KL_75a_vFzg_XIX_SAL_01_XIX_E3V_K2CANFD, SAL_KL_75a_XIX_SAL_01_XIX_E3V_K2CANFD, SAL_KL_75_vFzg_XIX_SAL_01_XIX_E3V_K2CANFD, SAL_Kl_75_XIX_SAL_01_XIX_E3V_K2CANFD, SAL_KL_50_5s_XIX_SAL_01_XIX_E3V_K2CANFD, SAL_Kl_15_vFzg_S_XIX_SAL_01_XIX_E3V_K2CANFD, SAL_Kl_15_vFzg_XIX_SAL_01_XIX_E3V_K2CANFD, SAL_Kl_15_XIX_SAL_01_XIX_E3V_K2CANFD, DLI_Ambex_RefStatus_XIX_SAL_01_XIX_E3V_K2CANFD, SAL_Aussenbeleuchtung_defekt_XIX_SAL_01_XIX_E3V_K2CANFD], system-signal-group=SG_SAL_01  # Kennungsfolge: K_1058-0xde,0xa9,0x83,0x0b,0x0c,0x64,0x79,0x44,0x0f,0xf6,0xc6,0xc7,0x05,0x45,0xb7,0x59
    SG_SAM_01_XIX_E3V_CCAN: i-signal=[SAM_01_CRC_XIX_SAM_01_XIX_E3V_CCAN, SAM_01_BZ_XIX_SAM_01_XIX_E3V_CCAN, ZV_Ladeklappe_VerEntriegeln_XIX_SAM_01_XIX_E3V_CCAN, ZV_LadeklappenStatus_XIX_SAM_01_XIX_E3V_CCAN, ISignalVoid_SAM_01_XIX_E3V_CCAN_0, ISignalVoid_SAM_01_XIX_E3V_CCAN_1, ISignalVoid_SAM_01_XIX_E3V_CCAN_2, SAM_Fehler_DC_LWR_XIX_SAM_01_XIX_E3V_CCAN, BCM_Bremsbelag_Sensor_Rdw_XIX_SAM_01_XIX_E3V_CCAN, BCM_Bremsbelag_Sensor_NAR_XIX_SAM_01_XIX_E3V_CCAN, BCM_Bremsbelag_Sensor_CND_XIX_SAM_01_XIX_E3V_CCAN, KST_BSW_Klemme_15_HW_Ist_XIX_SAM_01_XIX_E3V_CCAN, BRL_Bremslicht_Schalter_XIX_SAM_01_XIX_E3V_CCAN, SAL_li1_Blinker_Status_XIX_SAM_01_XIX_E3V_CCAN, SAL_re1_Blinker_Status_XIX_SAM_01_XIX_E3V_CCAN, KST_BSW_Fehlermode2_XIX_SAM_01_XIX_E3V_CCAN, HW_Drehfalle_Tuer_HR_XIX_SAM_01_XIX_E3V_CCAN, HW_Drehfalle_Tuer_HL_XIX_SAM_01_XIX_E3V_CCAN, HW_Status_Schloss_verriegelt_HR_XIX_SAM_01_XIX_E3V_CCAN, HW_Status_Schloss_verriegelt_HL_XIX_SAM_01_XIX_E3V_CCAN, HW_Status_Schloss_gesafet_HR_XIX_SAM_01_XIX_E3V_CCAN, HW_Status_Schloss_gesafet_HL_XIX_SAM_01_XIX_E3V_CCAN, HW_Tankdeckel_offen_XIX_SAM_01_XIX_E3V_CCAN, BCM_KiSi_Umschalt_gesperrt_XIX_SAM_01_XIX_E3V_CCAN, Fronthaube_geoeffnet_XIX_SAM_01_XIX_E3V_CCAN, Wischer_aktiv_XIX_SAM_01_XIX_E3V_CCAN, ISignalVoid_SAM_01_XIX_E3V_CCAN_3, HW_HSB_erkannt_XIX_SAM_01_XIX_E3V_CCAN, HD_Hauptraste_XIX_SAM_01_XIX_E3V_CCAN, HD_Vorraste_XIX_SAM_01_XIX_E3V_CCAN, KST_BSW_Klemmenhochschalten_Sper_XIX_SAM_01_XIX_E3V_CCAN, BCM_Tankklappensteller_Fehler_XIX_SAM_01_XIX_E3V_CCAN, HW_HD_Taste_Innenraum_XIX_SAM_01_XIX_E3V_CCAN, HW_Softtouch_betaetigt_XIX_SAM_01_XIX_E3V_CCAN, ISignalVoid_SAM_01_XIX_E3V_CCAN_4, KST_BSW_Not_Taster_betaetigt_XIX_SAM_01_XIX_E3V_CCAN, KST_BSW_ZAT_betaetigt_XIX_SAM_01_XIX_E3V_CCAN], system-signal-group=SG_SAM_01  # Kennungsfolge: K_1336-0x19,0x36,0xd4,0x1e,0x80,0x22,0xf4,0xb8,0xad,0x41,0x0b,0x3f,0x87,0x42,0x25,0x40
    SG_SAM_01_XIX_E3V_K2CANFD: i-signal=[SAM_01_CRC_XIX_SAM_01_XIX_E3V_K2CANFD, SAM_01_BZ_XIX_SAM_01_XIX_E3V_K2CANFD, ZV_Ladeklappe_VerEntriegeln_XIX_SAM_01_XIX_E3V_K2CANFD, ZV_LadeklappenStatus_XIX_SAM_01_XIX_E3V_K2CANFD, ISignalVoid_SAM_01_XIX_E3V_K2CANFD_0, ISignalVoid_SAM_01_XIX_E3V_K2CANFD_1, ISignalVoid_SAM_01_XIX_E3V_K2CANFD_2, SAM_Fehler_DC_LWR_XIX_SAM_01_XIX_E3V_K2CANFD, BCM_Bremsbelag_Sensor_Rdw_XIX_SAM_01_XIX_E3V_K2CANFD, BCM_Bremsbelag_Sensor_NAR_XIX_SAM_01_XIX_E3V_K2CANFD, BCM_Bremsbelag_Sensor_CND_XIX_SAM_01_XIX_E3V_K2CANFD, KST_BSW_Klemme_15_HW_Ist_XIX_SAM_01_XIX_E3V_K2CANFD, BRL_Bremslicht_Schalter_XIX_SAM_01_XIX_E3V_K2CANFD, SAL_li1_Blinker_Status_XIX_SAM_01_XIX_E3V_K2CANFD, SAL_re1_Blinker_Status_XIX_SAM_01_XIX_E3V_K2CANFD, KST_BSW_Fehlermode2_XIX_SAM_01_XIX_E3V_K2CANFD, HW_Drehfalle_Tuer_HR_XIX_SAM_01_XIX_E3V_K2CANFD, HW_Drehfalle_Tuer_HL_XIX_SAM_01_XIX_E3V_K2CANFD, HW_Status_Schloss_verriegelt_HR_XIX_SAM_01_XIX_E3V_K2CANFD, HW_Status_Schloss_verriegelt_HL_XIX_SAM_01_XIX_E3V_K2CANFD, HW_Status_Schloss_gesafet_HR_XIX_SAM_01_XIX_E3V_K2CANFD, HW_Status_Schloss_gesafet_HL_XIX_SAM_01_XIX_E3V_K2CANFD, HW_Tankdeckel_offen_XIX_SAM_01_XIX_E3V_K2CANFD, BCM_KiSi_Umschalt_gesperrt_XIX_SAM_01_XIX_E3V_K2CANFD, Fronthaube_geoeffnet_XIX_SAM_01_XIX_E3V_K2CANFD, Wischer_aktiv_XIX_SAM_01_XIX_E3V_K2CANFD, ISignalVoid_SAM_01_XIX_E3V_K2CANFD_3, HW_HSB_erkannt_XIX_SAM_01_XIX_E3V_K2CANFD, HD_Hauptraste_XIX_SAM_01_XIX_E3V_K2CANFD, HD_Vorraste_XIX_SAM_01_XIX_E3V_K2CANFD, KST_BSW_Klemmenhochschalten_Sper_XIX_SAM_01_XIX_E3V_K2CANFD, BCM_Tankklappensteller_Fehler_XIX_SAM_01_XIX_E3V_K2CANFD, HW_HD_Taste_Innenraum_XIX_SAM_01_XIX_E3V_K2CANFD, HW_Softtouch_betaetigt_XIX_SAM_01_XIX_E3V_K2CANFD, ISignalVoid_SAM_01_XIX_E3V_K2CANFD_4, KST_BSW_Not_Taster_betaetigt_XIX_SAM_01_XIX_E3V_K2CANFD, KST_BSW_ZAT_betaetigt_XIX_SAM_01_XIX_E3V_K2CANFD], system-signal-group=SG_SAM_01  # Kennungsfolge: K_1336-0x19,0x36,0xd4,0x1e,0x80,0x22,0xf4,0xb8,0xad,0x41,0x0b,0x3f,0x87,0x42,0x25,0x40
    SG_SMLS_01_XIX_E3V_K2CANFD: i-signal=[SMLS_01_CRC_XIX_SMLS_01_XIX_E3V_K2CANFD, SMLS_01_BZ_XIX_SMLS_01_XIX_E3V_K2CANFD, BH_Blinker_li_XIX_SMLS_01_XIX_E3V_K2CANFD, BH_Blinker_re_XIX_SMLS_01_XIX_E3V_K2CANFD, BH_Lichthupe_XIX_SMLS_01_XIX_E3V_K2CANFD, BH_Fernlicht_XIX_SMLS_01_XIX_E3V_K2CANFD, WH_Tipwischen_XIX_SMLS_01_XIX_E3V_K2CANFD, WH_Intervall_XIX_SMLS_01_XIX_E3V_K2CANFD, WH_WischerStufe1_XIX_SMLS_01_XIX_E3V_K2CANFD, WH_WischerStufe2_XIX_SMLS_01_XIX_E3V_K2CANFD, WH_Frontwaschen_XIX_SMLS_01_XIX_E3V_K2CANFD, WH_Heckintervall_XIX_SMLS_01_XIX_E3V_K2CANFD, WH_Heckwaschen_XIX_SMLS_01_XIX_E3V_K2CANFD, WH_Intervallstufen_XIX_SMLS_01_XIX_E3V_K2CANFD, FAS_Taster_XIX_SMLS_01_XIX_E3V_K2CANFD, FAS_Taster_Fehler_XIX_SMLS_01_XIX_E3V_K2CANFD, SMLS_Hupe_XIX_SMLS_01_XIX_E3V_K2CANFD, LRH_On_Off_XIX_SMLS_01_XIX_E3V_K2CANFD, LSS_Tastencode_XIX_SMLS_01_XIX_E3V_K2CANFD, LRH_aktiv_XIX_SMLS_01_XIX_E3V_K2CANFD, SMLS_P_verriegelt_XIX_SMLS_01_XIX_E3V_K2CANFD, SMLS_P_verriegelt_plausibel_XIX_SMLS_01_XIX_E3V_K2CANFD, WH_SRA_XIX_SMLS_01_XIX_E3V_K2CANFD, WH_Wischer_Fehler_XIX_SMLS_01_XIX_E3V_K2CANFD, BH_Blinker_Fehler_XIX_SMLS_01_XIX_E3V_K2CANFD, SMLS_PTT_XIX_SMLS_01_XIX_E3V_K2CANFD, WH_Tipwischen_lang_XIX_SMLS_01_XIX_E3V_K2CANFD, ISignalVoid_SMLS_01_XIX_E3V_K2CANFD_0, ISignalVoid_SMLS_01_XIX_E3V_K2CANFD_1], system-signal-group=SG_SMLS_01  # Kennungsfolge: K_444-0xc3,0x79,0xbf,0xdb,0xe9,0x11,0x46,0x86,0x69,0xb6,0x9b,0x29,0x15,0x9c,0x45,0x0d
    SG_SOK_ZV_Rueck_HW_Gateway_Resp_01_XIX_E3V_K2CANFD: i-signal=[HD_Hauptraste_Auth_XIX_SOK_ZV_Rueck_HW_Gateway_Resp_01_XIX_E3V_K2CANFD, HD_Vorraste_Auth_XIX_SOK_ZV_Rueck_HW_Gateway_Resp_01_XIX_E3V_K2CANFD, HW_Drehfalle_Tuer_HL_Auth_XIX_SOK_ZV_Rueck_HW_Gateway_Resp_01_XIX_E3V_K2CANFD, HW_Drehfalle_Tuer_HR_Auth_XIX_SOK_ZV_Rueck_HW_Gateway_Resp_01_XIX_E3V_K2CANFD, HW_Status_Schloss_safed_HL_Auth_XIX_SOK_ZV_Rueck_HW_Gateway_Resp_01_XIX_E3V_K2CANFD, HW_Status_Schloss_safed_HR_Auth_XIX_SOK_ZV_Rueck_HW_Gateway_Resp_01_XIX_E3V_K2CANFD, HW_Status_Schloss_verr_HL_Auth_XIX_SOK_ZV_Rueck_HW_Gateway_Resp_01_XIX_E3V_K2CANFD, HW_Status_Schloss_verr_HR_Auth_XIX_SOK_ZV_Rueck_HW_Gateway_Resp_01_XIX_E3V_K2CANFD], system-signal-group=SG_SOK_ZV_Rueck_HW_Gateway_Resp_01  # custom ECU specified signal group
    SG_SRL_HL_01_XIX_E3V_K2CANFD: i-signal=[SRL_HL_01_CRC_XIX_SRL_HL_01_XIX_E3V_K2CANFD, SRL_HL_01_BZ_XIX_SRL_HL_01_XIX_E3V_K2CANFD, SRL5_ORUDataIndex_XIX_SRL_HL_01_XIX_E3V_K2CANFD, SRL5_ORUData_XIX_SRL_HL_01_XIX_E3V_K2CANFD], system-signal-group=SG_SRL_HL_01  # Kennungsfolge: K_2298-0x02,0x42,0xcd,0xa0,0xe8,0xef,0xdf,0x55,0x5a,0x8d,0xf3,0xf6,0x1e,0xc5,0xbe,0x33
    SG_SRL_HR_01_XIX_E3V_K2CANFD: i-signal=[SRL_HR_01_CRC_XIX_SRL_HR_01_XIX_E3V_K2CANFD, SRL_HR_01_BZ_XIX_SRL_HR_01_XIX_E3V_K2CANFD, SRL6_ORUDataIndex_XIX_SRL_HR_01_XIX_E3V_K2CANFD, SRL6_ORUData_XIX_SRL_HR_01_XIX_E3V_K2CANFD], system-signal-group=SG_SRL_HR_01  # Kennungsfolge: K_2295-0x20,0xf0,0x61,0xe4,0xa1,0xd8,0xd9,0x86,0x27,0x2e,0x4a,0x13,0x1d,0x64,0x25,0xf3
    SG_SRL_SL_01_XIX_E3V_K2CANFD: i-signal=[SRL_SL_01_CRC_XIX_SRL_SL_01_XIX_E3V_K2CANFD, SRL_SL_01_BZ_XIX_SRL_SL_01_XIX_E3V_K2CANFD, SRL3_ORUDataIndex_XIX_SRL_SL_01_XIX_E3V_K2CANFD, SRL3_ORUData_XIX_SRL_SL_01_XIX_E3V_K2CANFD], system-signal-group=SG_SRL_SL_01  # Kennungsfolge: K_2309-0xa8,0x70,0x6c,0x16,0xa5,0xc1,0x29,0xa1,0x9f,0x54,0x5b,0x1e,0xf2,0x7a,0x67,0x2e
    SG_SRL_SR_01_XIX_E3V_K2CANFD: i-signal=[SRL_SR_01_CRC_XIX_SRL_SR_01_XIX_E3V_K2CANFD, SRL_SR_01_BZ_XIX_SRL_SR_01_XIX_E3V_K2CANFD, SRL4_ORUDataIndex_XIX_SRL_SR_01_XIX_E3V_K2CANFD, SRL4_ORUData_XIX_SRL_SR_01_XIX_E3V_K2CANFD], system-signal-group=SG_SRL_SR_01  # Kennungsfolge: K_2312-0xa3,0x50,0x22,0xbf,0xab,0x5d,0x38,0x67,0x94,0x68,0xde,0x2f,0x15,0x4b,0xd7,0x32
    SG_SRL_VL_01_XIX_E3V_K2CANFD: i-signal=[SRL_VL_01_CRC_XIX_SRL_VL_01_XIX_E3V_K2CANFD, SRL_VL_01_BZ_XIX_SRL_VL_01_XIX_E3V_K2CANFD, SRL1_ORUDataIndex_XIX_SRL_VL_01_XIX_E3V_K2CANFD, SRL1_ORUData_XIX_SRL_VL_01_XIX_E3V_K2CANFD], system-signal-group=SG_SRL_VL_01  # Kennungsfolge: K_2314-0x7a,0x3d,0xb4,0x89,0x98,0x35,0x66,0x3f,0xf3,0x9e,0xfb,0x43,0x93,0x9d,0x09,0x88
    SG_SRL_VR_01_XIX_E3V_K2CANFD: i-signal=[SRL_VR_01_CRC_XIX_SRL_VR_01_XIX_E3V_K2CANFD, SRL_VR_01_BZ_XIX_SRL_VR_01_XIX_E3V_K2CANFD, SRL2_ORUDataIndex_XIX_SRL_VR_01_XIX_E3V_K2CANFD, SRL2_ORUData_XIX_SRL_VR_01_XIX_E3V_K2CANFD], system-signal-group=SG_SRL_VR_01  # Kennungsfolge: K_2316-0xa1,0x2e,0x25,0xe1,0x07,0xf9,0x89,0x8e,0x03,0xcd,0x8b,0xa3,0xba,0x3f,0x01,0x4d
    SG_TSG_FT_02_XIX_E3V_K2CANFD: i-signal=[TSG_FT_02_CRC_XIX_TSG_FT_02_XIX_E3V_K2CANFD, TSG_FT_02_BZ_XIX_TSG_FT_02_XIX_E3V_K2CANFD, FT_Tuer_Status_XIX_TSG_FT_02_XIX_E3V_K2CANFD, FT_Tuer_Status_QBit_XIX_TSG_FT_02_XIX_E3V_K2CANFD, FT_Lock_Taster_02_XIX_TSG_FT_02_XIX_E3V_K2CANFD, FT_Schluesselschalter_zu_02_XIX_TSG_FT_02_XIX_E3V_K2CANFD, FT_BFS_Tuer_Status_XIX_TSG_FT_02_XIX_E3V_K2CANFD, FT_HBFS_Tuer_Status_XIX_TSG_FT_02_XIX_E3V_K2CANFD, FT_HFS_Tuer_Status_XIX_TSG_FT_02_XIX_E3V_K2CANFD, FT_Tueroeffnen_Warnung_XIX_TSG_FT_02_XIX_E3V_K2CANFD, FT_SP_Heizung_ein_XIX_TSG_FT_02_XIX_E3V_K2CANFD, FT_Kisi_Taster_li_02_XIX_TSG_FT_02_XIX_E3V_K2CANFD, FT_Kisi_Taster_re_02_XIX_TSG_FT_02_XIX_E3V_K2CANFD, FT_TD_Taste_Status_XIX_TSG_FT_02_XIX_E3V_K2CANFD, FT_TCR_Mode_aktiv_XIX_TSG_FT_02_XIX_E3V_K2CANFD, TBF_FS_Touch_Event_XIX_TSG_FT_02_XIX_E3V_K2CANFD, FT_KiSi_Status_Soll_HBFS_XIX_TSG_FT_02_XIX_E3V_K2CANFD, FT_KiSi_Status_Soll_HFS_XIX_TSG_FT_02_XIX_E3V_K2CANFD, FS_Push_Tuergriff_XIX_TSG_FT_02_XIX_E3V_K2CANFD, TSG_FS_Spiegel_angeklappt_XIX_TSG_FT_02_XIX_E3V_K2CANFD, FT_Cargolock_bet_XIX_TSG_FT_02_XIX_E3V_K2CANFD, ISignalVoid_TSG_FT_02_XIX_E3V_K2CANFD_0, FT_kisi_asynchron_XIX_TSG_FT_02_XIX_E3V_K2CANFD, ISignalVoid_TSG_FT_02_XIX_E3V_K2CANFD_1, FS_Status_eTAG_ext_XIX_TSG_FT_02_XIX_E3V_K2CANFD, FT_ASW_Warnton_XIX_TSG_FT_02_XIX_E3V_K2CANFD, SSA_FT_ASW_Status_XIX_TSG_FT_02_XIX_E3V_K2CANFD, ISignalVoid_TSG_FT_02_XIX_E3V_K2CANFD_2, ISignalVoid_TSG_FT_02_XIX_E3V_K2CANFD_3], system-signal-group=SG_TSG_FT_02  # Kennungsfolge: K_26541-0xc4,0x6a,0x69,0x30,0xcf,0x61,0x58,0x51,0x1b,0x86,0x99,0xd3,0xf6,0x1d,0x9a,0x37
    SG_TSG_HBFS_02_XIX_E3V_K2CANFD: i-signal=[TSG_HBFS_02_CRC_XIX_TSG_HBFS_02_XIX_E3V_K2CANFD, TSG_HBFS_02_BZ_XIX_TSG_HBFS_02_XIX_E3V_K2CANFD, HBFS_Status_KiSi_XIX_TSG_HBFS_02_XIX_E3V_K2CANFD, HBFS_KiSi_Fehler_XIX_TSG_HBFS_02_XIX_E3V_K2CANFD, HBFS_Push_Tuergriff_XIX_TSG_HBFS_02_XIX_E3V_K2CANFD, HBFS_ASW_HMI_defekt_XIX_TSG_HBFS_02_XIX_E3V_K2CANFD, ISignalVoid_TSG_HBFS_02_XIX_E3V_K2CANFD_0, ISignalVoid_TSG_HBFS_02_XIX_E3V_K2CANFD_1, ISignalVoid_TSG_HBFS_02_XIX_E3V_K2CANFD_2, ISignalVoid_TSG_HBFS_02_XIX_E3V_K2CANFD_3, SLS_Helligkeit_IR_XIX_TSG_HBFS_02_XIX_E3V_K2CANFD, HBFS_ASW_Warnton_XIX_TSG_HBFS_02_XIX_E3V_K2CANFD, SSA_HBFT_ASW_Status_XIX_TSG_HBFS_02_XIX_E3V_K2CANFD, HBFS_Status_eTAG_ext_XIX_TSG_HBFS_02_XIX_E3V_K2CANFD, HBFS_TCR_Mode_aktiv_XIX_TSG_HBFS_02_XIX_E3V_K2CANFD], system-signal-group=SG_TSG_HBFS_02  # Kennungsfolge: K_1377-0x6c,0x8f,0xc9,0xf3,0xb1,0x77,0xed,0x53,0xcd,0x44,0x40,0xf1,0x15,0x2d,0x37,0xe6
    SG_TSG_HFS_02_XIX_E3V_K2CANFD: i-signal=[TSG_HFS_02_CRC_XIX_TSG_HFS_02_XIX_E3V_K2CANFD, TSG_HFS_02_BZ_XIX_TSG_HFS_02_XIX_E3V_K2CANFD, HFS_Status_KiSi_XIX_TSG_HFS_02_XIX_E3V_K2CANFD, HFS_KiSi_Fehler_XIX_TSG_HFS_02_XIX_E3V_K2CANFD, HFS_Push_Tuergriff_XIX_TSG_HFS_02_XIX_E3V_K2CANFD, HFS_Status_eTAG_ext_XIX_TSG_HFS_02_XIX_E3V_K2CANFD, HFS_ASW_Warnton_XIX_TSG_HFS_02_XIX_E3V_K2CANFD, SSA_HFT_ASW_Status_XIX_TSG_HFS_02_XIX_E3V_K2CANFD, HFS_ASW_HMI_defekt_XIX_TSG_HFS_02_XIX_E3V_K2CANFD, ISignalVoid_TSG_HFS_02_XIX_E3V_K2CANFD_0, ISignalVoid_TSG_HFS_02_XIX_E3V_K2CANFD_1, ISignalVoid_TSG_HFS_02_XIX_E3V_K2CANFD_2, ISignalVoid_TSG_HFS_02_XIX_E3V_K2CANFD_3, ISignalVoid_TSG_HFS_02_XIX_E3V_K2CANFD_4, ISignalVoid_TSG_HFS_02_XIX_E3V_K2CANFD_5], system-signal-group=SG_TSG_HFS_02  # Kennungsfolge: K_1376-0x40,0x94,0x3e,0x9f,0xa6,0x06,0x60,0x89,0xa5,0x85,0xfb,0xdf,0xde,0xa8,0xdd,0x80
    SG_VMM_02_Auth_XIX_E3V_K2CANFD: i-signal=[VMM_02_CRC_XIX_VMM_02_Auth_XIX_E3V_K2CANFD, VMM_02_BZ_XIX_VMM_02_Auth_XIX_E3V_K2CANFD, VZM_aktiver_Basisservice_XIX_VMM_02_Auth_XIX_E3V_K2CANFD, VZM_Anhalteweg_nicht_verfuegbar_XIX_VMM_02_Auth_XIX_E3V_K2CANFD, VZM_Fahrer_bremst_XIX_VMM_02_Auth_XIX_E3V_K2CANFD, VZM_QBit_Fahrer_bremst_XIX_VMM_02_Auth_XIX_E3V_K2CANFD, VMM_MKB_codiert_XIX_VMM_02_Auth_XIX_E3V_K2CANFD, VMM_Inkonsistenz_EBKV_XIX_VMM_02_Auth_XIX_E3V_K2CANFD, VMM_Notstopp_Status_XIX_VMM_02_Auth_XIX_E3V_K2CANFD, VZM_Warnruck_nicht_verfuegbar_XIX_VMM_02_Auth_XIX_E3V_K2CANFD, VZM_Warnruckeln_nicht_verfuegbar_XIX_VMM_02_Auth_XIX_E3V_K2CANFD, VZM_Bkd_nicht_verfuegbar_XIX_VMM_02_Auth_XIX_E3V_K2CANFD, VMM_Bremslicht_defekt_XIX_VMM_02_Auth_XIX_E3V_K2CANFD, VZM_Fahrer_bremst_deutlich_XIX_VMM_02_Auth_XIX_E3V_K2CANFD, VZM_TSK_SRBM_Anf_XIX_VMM_02_Auth_XIX_E3V_K2CANFD, VZM_TSK_SRBM_nicht_verfuegbar_XIX_VMM_02_Auth_XIX_E3V_K2CANFD, VZM_Verz_Reg_aktiv_XIX_VMM_02_Auth_XIX_E3V_K2CANFD, VZM_Verz_Reg_nicht_verfuegbar_XIX_VMM_02_Auth_XIX_E3V_K2CANFD, VMM_Inkonsistenz_KAS_XIX_VMM_02_Auth_XIX_E3V_K2CANFD, VMM_Bremslicht_unplausibel_XIX_VMM_02_Auth_XIX_E3V_K2CANFD, VMM_Inkonsistenz_ACC_XIX_VMM_02_Auth_XIX_E3V_K2CANFD, VMM_Inkonsistenz_AWV_PCF_XIX_VMM_02_Auth_XIX_E3V_K2CANFD, VMM_Inkonsistenz_ARA_XIX_VMM_02_Auth_XIX_E3V_K2CANFD, VMM_Inkonsistenz_ParkAssist_XIX_VMM_02_Auth_XIX_E3V_K2CANFD, VMM_Inkonsistenz_FAS_VK_XIX_VMM_02_Auth_XIX_E3V_K2CANFD, VMM_Inkonsistenz_NV_XIX_VMM_02_Auth_XIX_E3V_K2CANFD, VMM_Inkonsistenz_RCTA_XIX_VMM_02_Auth_XIX_E3V_K2CANFD, VMM_Inkonsistenz_TSK_XIX_VMM_02_Auth_XIX_E3V_K2CANFD, VMM_Inkonsistenz_MO_XIX_VMM_02_Auth_XIX_E3V_K2CANFD, VMM_Inkonsistenz_AEB_XIX_VMM_02_Auth_XIX_E3V_K2CANFD, VMM_Fahrer_Bremskraft_bestimmend_XIX_VMM_02_Auth_XIX_E3V_K2CANFD, VMM_Inkonsistenz_EA_XIX_VMM_02_Auth_XIX_E3V_K2CANFD, VZM_Status_Wegregelung_XIX_VMM_02_Auth_XIX_E3V_K2CANFD, VZM_Verz_ASIL_Verfuegbarkeit_XIX_VMM_02_Auth_XIX_E3V_K2CANFD, VZM_aktives_System_XIX_VMM_02_Auth_XIX_E3V_K2CANFD, VZM_Verz_Begrenzung_XIX_VMM_02_Auth_XIX_E3V_K2CANFD, VZM_Systemstatus_XIX_VMM_02_Auth_XIX_E3V_K2CANFD, VZM_SRBM_Soll_XIX_VMM_02_Auth_XIX_E3V_K2CANFD, VZM_SRBM_Ist_XIX_VMM_02_Auth_XIX_E3V_K2CANFD, VZM_SRBM_max_Gradient_XIX_VMM_02_Auth_XIX_E3V_K2CANFD, VMM_Inkonsistenz_KAM_XIX_VMM_02_Auth_XIX_E3V_K2CANFD, VMM_Inkonsistenz_RHP_XIX_VMM_02_Auth_XIX_E3V_K2CANFD, VMM_Inkonsistenz_VMC_XIX_VMM_02_Auth_XIX_E3V_K2CANFD, VZM_int_Laengsverz_XIX_VMM_02_Auth_XIX_E3V_K2CANFD, ISignalVoid_VMM_02_Auth_XIX_E3V_K2CANFD_0, ISignalVoid_VMM_02_Auth_XIX_E3V_K2CANFD_1, ISignalVoid_VMM_02_Auth_XIX_E3V_K2CANFD_2, ISignalVoid_VMM_02_Auth_XIX_E3V_K2CANFD_3, ISignalVoid_VMM_02_Auth_XIX_E3V_K2CANFD_4, ISignalVoid_VMM_02_Auth_XIX_E3V_K2CANFD_5, ISignalVoid_VMM_02_Auth_XIX_E3V_K2CANFD_6, ISignalVoid_VMM_02_Auth_XIX_E3V_K2CANFD_7, ISignalVoid_VMM_02_Auth_XIX_E3V_K2CANFD_8, HMS_P_beibehalten_GE_XIX_VMM_02_Auth_XIX_E3V_K2CANFD, VZM_Unterdrueckung_Antriebsmom_XIX_VMM_02_Auth_XIX_E3V_K2CANFD, VMM_Inkonsistenz_VLK_XIX_VMM_02_Auth_XIX_E3V_K2CANFD, HMS_halten_nicht_verfuegbar_02_XIX_VMM_02_Auth_XIX_E3V_K2CANFD, ISignalVoid_VMM_02_Auth_XIX_E3V_K2CANFD_9, HMS_halten_nicht_verfuegbar_XIX_VMM_02_Auth_XIX_E3V_K2CANFD, ISignalVoid_VMM_02_Auth_XIX_E3V_K2CANFD_10, ISignalVoid_VMM_02_Auth_XIX_E3V_K2CANFD_11, HMS_parken_nicht_verfuegbar_XIX_VMM_02_Auth_XIX_E3V_K2CANFD, HMS_Anforderung_GE_XIX_VMM_02_Auth_XIX_E3V_K2CANFD, HMS_Systemstatus_XIX_VMM_02_Auth_XIX_E3V_K2CANFD, HMS_Stillstand_XIX_VMM_02_Auth_XIX_E3V_K2CANFD, HMS_aktives_System_XIX_VMM_02_Auth_XIX_E3V_K2CANFD, VMM_Inkonsistenz_GE_XIX_VMM_02_Auth_XIX_E3V_K2CANFD, VMM_Inkonsistenz_HVLM_XIX_VMM_02_Auth_XIX_E3V_K2CANFD, HMS_Fehlerstatus_XIX_VMM_02_Auth_XIX_E3V_K2CANFD, HMS_Index_Haltemoment_XIX_VMM_02_Auth_XIX_E3V_K2CANFD, HMS_Haltemoment_XIX_VMM_02_Auth_XIX_E3V_K2CANFD], system-signal-group=SG_VMM_02_Auth  # Kennungsfolge: K_296-0x96,0x92,0x95,0xb5,0x6e,0xe3,0xbd,0xb4,0xfa,0xae,0xbe,0xcb,0xcf,0xa5,0x77,0xef
    SG_ZV_04_XIX_E3V_K2CANFD: i-signal=[ZV_04_CRC_XIX_ZV_04_XIX_E3V_K2CANFD, ZV_04_BZ_XIX_ZV_04_XIX_E3V_K2CANFD, ZV_HFS_Status_KiSi_XIX_ZV_04_XIX_E3V_K2CANFD, ZV_HFS_TAG_betaetigt_XIX_ZV_04_XIX_E3V_K2CANFD, ZV_HFS_TIG_oeffnen_betaetigt_XIX_ZV_04_XIX_E3V_K2CANFD, ZV_HFS_TIG_schliessen_betaetigt_XIX_ZV_04_XIX_E3V_K2CANFD, ZV_HBFS_Status_KiSi_XIX_ZV_04_XIX_E3V_K2CANFD, ZV_HBFS_TAG_betaetigt_XIX_ZV_04_XIX_E3V_K2CANFD, ZV_HBFS_TIG_oeffnen_betaetigt_XIX_ZV_04_XIX_E3V_K2CANFD, ZV_HBFS_TIG_schliessen_betaetigt_XIX_ZV_04_XIX_E3V_K2CANFD, ZV_TAG_FT_verfahren_XIX_ZV_04_XIX_E3V_K2CANFD, ZV_TAG_BT_verfahren_XIX_ZV_04_XIX_E3V_K2CANFD, ZV_TAG_HFS_verfahren_XIX_ZV_04_XIX_E3V_K2CANFD, ZV_TAG_HBFS_verfahren_XIX_ZV_04_XIX_E3V_K2CANFD, ISignalVoid_ZV_04_XIX_E3V_K2CANFD_0, ISignalVoid_ZV_04_XIX_E3V_K2CANFD_1, ZV_Crashfall_erkannt_XIX_ZV_04_XIX_E3V_K2CANFD, ZV_Hupe_Takt_XIX_ZV_04_XIX_E3V_K2CANFD, ZV_Hupe_Anf_XIX_ZV_04_XIX_E3V_K2CANFD, ZV_Status_Cargolock_XIX_ZV_04_XIX_E3V_K2CANFD, ZV_verriegelt_extern_soll_03_XIX_ZV_04_XIX_E3V_K2CANFD, ZV_HW_TKL_mot_verr_XIX_ZV_04_XIX_E3V_K2CANFD, ZV_HW_TKL_mot_entr_XIX_ZV_04_XIX_E3V_K2CANFD, ZV_Status_KiSi_CargoLock_XIX_ZV_04_XIX_E3V_K2CANFD, ZV_HD_Parkbremse_Hinweis_XIX_ZV_04_XIX_E3V_K2CANFD, BCM_Waehlhebel_P_Hinweis_XIX_ZV_04_XIX_E3V_K2CANFD, ZV_Laderaumabd_elektr_aktiviert_XIX_ZV_04_XIX_E3V_K2CANFD, ZV_Einfachhorn_Takt_XIX_ZV_04_XIX_E3V_K2CANFD, ZV_Einfachhorn_Anf_XIX_ZV_04_XIX_E3V_K2CANFD, ZV_DWA_Einfachhorn_Takt_XIX_ZV_04_XIX_E3V_K2CANFD, ZV_DWA_Einfachhorn_Anf_XIX_ZV_04_XIX_E3V_K2CANFD, UHF_FFB_Funkschluesseltyp_XIX_ZV_04_XIX_E3V_K2CANFD, UHF_FFB_SKC_anlernen_XIX_ZV_04_XIX_E3V_K2CANFD, ZV_HW_Motor_Safe_Hinten_XIX_ZV_04_XIX_E3V_K2CANFD, ZV_HW_Motor_Lock_HK_XIX_ZV_04_XIX_E3V_K2CANFD], system-signal-group=SG_ZV_04  # Kennungsfolge: K_1296-0x27,0x23,0xf6,0x9b,0x88,0x5f,0x4d,0xcd,0xe1,0x34,0xaa,0x81,0x11,0xc6,0x21,0x0a
