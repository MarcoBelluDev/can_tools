[part 1 of 22: package /E3_1_1_UNECE_Gen2]
AUTOSAR XML (schema 4-3-0)
standard types defined: sint8, sint16, sint32, sint64, uint8, uint16, uint32, uint64, float32, float64, boolean
package /E3_1_1_UNECE_Gen2
  system System
    system mapping System_Mappings
      data-mappings:
        communication-direction=IN, data-element=Grundumfang_XIX_SAM.Geltungsbereich_E3_1_1_UNECE_Gen2.RP_IF_AAG_Anhaenger_erkannt_XIX_Grundumfang_XIX_SAM.DE_AAG_Anhaenger_erkannt, system-signal=AAG_Anhaenger_erkannt
        communication-direction=IN, data-element=VIP_XIX_SAM.Geltungsbereich_E3_1_1_UNECE_Gen2.RP_IF_AAG_Anhaenger_erkannt_XIX_VIP_XIX_SAM.DE_AAG_Anhaenger_erkannt, system-signal=AAG_Anhaenger_erkannt
        communication-direction=IN, data-element=Grundumfang_XIX_SAM.Geltungsbereich_E3_1_1_UNECE_Gen2.RP_IF_AAG_ORUData_XIX_Grundumfang_XIX_SAM.DE_AAG_ORUData, system-signal=AAG_ORUData
        communication-direction=IN, data-element=Grundumfang_XIX_SAM.Geltungsbereich_E3_1_1_UNECE_Gen2.RP_IF_AAG_ORUDataIndex_XIX_Grundumfang_XIX_SAM.DE_AAG_ORUDataIndex, system-signal=AAG_ORUDataIndex
        communication-direction=IN, data-element=Druckpunktmassage_fuer_Fahrersitz_Lehnenmassage_SAM_XIX_DPMFSLM_XIX_SAM.Geltungsbereich_E3_1_1_UNECE_Gen2.RP_IF_AB_Belegung_VB_XIX_Druckpunktmassage_fuer_Fahrersitz_Lehnenmassage_SAM_XIX_DPMFSLM_XIX_SAM.DE_AB_Belegung_VB, system-signal=AB_Belegung_VB
        communication-direction=IN, data-element=Grundumfang_XIX_SAM.Geltungsbereich_E3_1_1_UNECE_Gen2.RP_IF_AB_Belegung_VB_XIX_Grundumfang_XIX_SAM.DE_AB_Belegung_VB, system-signal=AB_Belegung_VB
        communication-direction=IN, data-element=Grundumfang_XIX_SAM.Geltungsbereich_E3_1_1_UNECE_Gen2.RP_IF_AB_Crash_Int_XIX_Grundumfang_XIX_SAM.DE_AB_Crash_Int, system-signal=AB_Crash_Int
        communication-direction=IN, data-element=Grundumfang_XIX_SAM.Geltungsbereich_E3_1_1_UNECE_Gen2.RP_IF_AB_Deaktivierung_HV_XIX_Grundumfang_XIX_SAM.DE_AB_Deaktivierung_HV, system-signal=AB_Deaktivierung_HV
        communication-direction=IN, data-element=Grundumfang_XIX_SAM.Geltungsbereich_E3_1_1_UNECE_Gen2.RP_IF_AB_Front_Crash_XIX_Grundumfang_XIX_SAM.DE_AB_Front_Crash, system-signal=AB_Front_Crash
        communication-direction=IN, data-element=Druckpunktmassage_fuer_Beifahrersitz_Lehnenmassage_SAM_XIX_DPMBFSLM_XIX_SAM.Geltungsbereich_E3_1_1_UNECE_Gen2.RP_IF_AB_Gurtschloss_BF_XIX_Druckpunktmassage_fuer_Beifahrersitz_Lehnenmassage_SAM_XIX_DPMBFSLM_XIX_SAM.DE_AB_Gurtschloss_BF, system-signal=AB_Gurtschloss_BF
        communication-direction=IN, data-element=Grundumfang_XIX_SAM.Geltungsbereich_E3_1_1_UNECE_Gen2.RP_IF_AB_Gurtschloss_BF_XIX_Grundumfang_XIX_SAM.DE_AB_Gurtschloss_BF, system-signal=AB_Gurtschloss_BF
        communication-direction=IN, data-element=Druckpunktmassage_fuer_Fahrersitz_Lehnenmassage_SAM_XIX_DPMFSLM_XIX_SAM.Geltungsbereich_E3_1_1_UNECE_Gen2.RP_IF_AB_Gurtschloss_FA_XIX_Druckpunktmassage_fuer_Fahrersitz_Lehnenmassage_SAM_XIX_DPMFSLM_XIX_SAM.DE_AB_Gurtschloss_FA, system-signal=AB_Gurtschloss_FA
        communication-direction=IN, data-element=Grundumfang_XIX_SAM.Geltungsbereich_E3_1_1_UNECE_Gen2.RP_IF_AB_Gurtschloss_FA_XIX_Grundumfang_XIX_SAM.DE_AB_Gurtschloss_FA, system-signal=AB_Gurtschloss_FA
        communication-direction=IN, data-element=Grundumfang_XIX_SAM.Geltungsbereich_E3_1_1_UNECE_Gen2.RP_IF_AB_Heck_Crash_XIX_Grundumfang_XIX_SAM.DE_AB_Heck_Crash, system-signal=AB_Heck_Crash
        communication-direction=IN, data-element=Grundumfang_XIX_SAM.Geltungsbereich_E3_1_1_UNECE_Gen2.RP_IF_AB_Rollover_Crash_XIX_Grundumfang_XIX_SAM.DE_AB_Rollover_Crash, system-signal=AB_Rollover_Crash
        communication-direction=IN, data-element=Grundumfang_XIX_SAM.Geltungsbereich_E3_1_1_UNECE_Gen2.RP_IF_AB_SB_Crash_XIX_Grundumfang_XIX_SAM.DE_AB_SB_Crash, system-signal=AB_SB_Crash
        communication-direction=IN, data-element=Grundumfang_XIX_SAM.Geltungsbereich_E3_1_1_UNECE_Gen2.RP_IF_AB_SF_Crash_XIX_Grundumfang_XIX_SAM.DE_AB_SF_Crash, system-signal=AB_SF_Crash
        communication-direction=IN, data-element=Grundumfang_XIX_SAM.Geltungsbereich_E3_1_1_UNECE_Gen2.RP_IF_ADecu1_01_BZ_XIX_Grundumfang_XIX_SAM.DE_ADecu1_01_BZ, system-signal=ADecu1_01_BZ
        communication-direction=IN, data-element=Grundumfang_XIX_SAM.Geltungsbereich_E3_1_1_UNECE_Gen2.RP_IF_ADecu1_01_CRC_XIX_Grundumfang_XIX_SAM.DE_ADecu1_01_CRC, system-signal=ADecu1_01_CRC
        communication-direction=IN, data-element=Grundumfang_XIX_SAM.Geltungsbereich_E3_1_1_UNECE_Gen2.RP_IF_ADecu1_ORUData_XIX_Grundumfang_XIX_SAM.DE_ADecu1_ORUData, system-signal=ADecu1_ORUData
        communication-direction=IN, data-element=Grundumfang_XIX_SAM.Geltungsbereich_E3_1_1_UNECE_Gen2.RP_IF_ADecu1_ORUDataIndex_XIX_Grundumfang_XIX_SAM.DE_ADecu1_ORUDataIndex, system-signal=ADecu1_ORUDataIndex
        communication-direction=IN, data-element=Grundumfang_XIX_SAM.Geltungsbereich_E3_1_1_UNECE_Gen2.RP_IF_ADecu2_01_BZ_XIX_Grundumfang_XIX_SAM.DE_ADecu2_01_BZ, system-signal=ADecu2_01_BZ
        communication-direction=IN, data-element=Grundumfang_XIX_SAM.Geltungsbereich_E3_1_1_UNECE_Gen2.RP_IF_ADecu2_01_CRC_XIX_Grundumfang_XIX_SAM.DE_ADecu2_01_CRC, system-signal=ADecu2_01_CRC
        communication-direction=IN, data-element=Grundumfang_XIX_SAM.Geltungsbereich_E3_1_1_UNECE_Gen2.RP_IF_ADecu2_ORUData_XIX_Grundumfang_XIX_SAM.DE_ADecu2_ORUData, system-signal=ADecu2_ORUData
        communication-direction=IN, data-element=Grundumfang_XIX_SAM.Geltungsbereich_E3_1_1_UNECE_Gen2.RP_IF_ADecu2_ORUDataIndex_XIX_Grundumfang_XIX_SAM.DE_ADecu2_ORUDataIndex, system-signal=ADecu2_ORUDataIndex
        communication-direction=IN, data-element=ZV_XIX_SAM.Geltungsbereich_E3_1_1_UNECE_Gen2.RP_IF_Airbag_01_BZ_XIX_ZV_XIX_SAM.DE_Airbag_01_BZ, system-signal=Airbag_01_BZ
        communication-direction=IN, data-element=ZV_XIX_SAM.Geltungsbereich_E3_1_1_UNECE_Gen2.RP_IF_Airbag_01_CRC_XIX_ZV_XIX_SAM.DE_Airbag_01_CRC, system-signal=Airbag_01_CRC
        communication-direction=OUT, data-element=Grundumfang_XIX_SAM.Geltungsbereich_E3_1_1_UNECE_Gen2.SP_IF_Airbag_02_alt_XIX_Grundumfang_XIX_SAM.DE_Airbag_02_alt, system-signal=Airbag_02_alt
        communication-direction=IN, data-element=Grundumfang_XIX_SAM.Geltungsbereich_E3_1_1_UNECE_Gen2.RP_IF_Airbag_02_BZ_XIX_Grundumfang_XIX_SAM.DE_Airbag_02_BZ, system-signal=Airbag_02_BZ
        communication-direction=IN, data-element=Grundumfang_XIX_SAM.Geltungsbereich_E3_1_1_UNECE_Gen2.RP_IF_Airbag_02_CRC_XIX_Grundumfang_XIX_SAM.DE_Airbag_02_CRC, system-signal=Airbag_02_CRC
        communication-direction=IN, data-element=Grundumfang_XIX_SAM.Geltungsbereich_E3_1_1_UNECE_Gen2.RP_IF_Airbag_ORUData_XIX_Grundumfang_XIX_SAM.DE_Airbag_ORUData, system-signal=Airbag_ORUData
        communication-direction=IN, data-element=Grundumfang_XIX_SAM.Geltungsbereich_E3_1_1_UNECE_Gen2.RP_IF_Airbag_ORUDataIndex_XIX_Grundumfang_XIX_SAM.DE_Airbag_ORUDataIndex, system-signal=Airbag_ORUDataIndex
        communication-direction=OUT, data-element=SC_789_ExAmb_MEB_XIX_Softwareblock_XIX_SAM.Geltungsbereich_E3_1_1_UNECE_Gen2.SP_IF_AMBEX_CH_aktiv_XIX_SC_789_ExAmb_MEB_XIX_Softwareblock_XIX_SAM.DE_AMBEX_CH_aktiv, system-signal=AMBEX_CH_aktiv
        communication-direction=OUT, data-element=SC_789_ExAmb_MEB_XIX_Softwareblock_XIX_SAM.Geltungsbereich_E3_1_1_UNECE_Gen2.SP_IF_AMBEX_CH_Trigger_XIX_SC_789_ExAmb_MEB_XIX_Softwareblock_XIX_SAM.DE_AMBEX_CH_Trigger, system-signal=AMBEX_CH_Trigger
        communication-direction=OUT, data-element=Grundumfang_XIX_SAM.Geltungsbereich_E3_1_1_UNECE_Gen2.SP_IF_Ambex_DLI_InszStatus_XIX_Grundumfang_XIX_SAM.DE_Ambex_DLI_InszStatus, system-signal=Ambex_DLI_InszStatus
        communication-direction=OUT, data-element=Grundumfang_XIX_SAM.Geltungsbereich_E3_1_1_UNECE_Gen2.SP_IF_Ambex_DLI_Soll_Horizontal_L_XIX_Grundumfang_XIX_SAM.DE_Ambex_DLI_Soll_Horizontal_L, system-signal=Ambex_DLI_Soll_Horizontal_L
        communication-direction=OUT, data-element=Grundumfang_XIX_SAM.Geltungsbereich_E3_1_1_UNECE_Gen2.SP_IF_Ambex_DLI_Soll_Horizontal_R_XIX_Grundumfang_XIX_SAM.DE_Ambex_DLI_Soll_Horizontal_R, system-signal=Ambex_DLI_Soll_Horizontal_R
        communication-direction=OUT, data-element=Grundumfang_XIX_SAM.Geltungsbereich_E3_1_1_UNECE_Gen2.SP_IF_Ambex_DLI_Soll_Vertikal_L_XIX_Grundumfang_XIX_SAM.DE_Ambex_DLI_Soll_Vertikal_L, system-signal=Ambex_DLI_Soll_Vertikal_L
        communication-direction=OUT, data-element=Grundumfang_XIX_SAM.Geltungsbereich_E3_1_1_UNECE_Gen2.SP_IF_Ambex_DLI_Soll_Vertikal_R_XIX_Grundumfang_XIX_SAM.DE_Ambex_DLI_Soll_Vertikal_R, system-signal=Ambex_DLI_Soll_Vertikal_R
        communication-direction=OUT, data-element=Grundumfang_XIX_SAM.Geltungsbereich_E3_1_1_UNECE_Gen2.SP_IF_Ambex_KY_Anforderung_Zonenortung_XIX_Grundumfang_XIX_SAM.DE_Ambex_KY_Anforderung_Zonenortung, system-signal=Ambex_KY_Anforderung_Zonenortung
        communication-direction=OUT, data-element=SC_789_ExAmb_MEB_XIX_Softwareblock_XIX_SAM.Geltungsbereich_E3_1_1_UNECE_Gen2.SP_IF_AMBEX_LH_aktiv_XIX_SC_789_ExAmb_MEB_XIX_Softwareblock_XIX_SAM.DE_AMBEX_LH_aktiv, system-signal=AMBEX_LH_aktiv
        communication-direction=OUT, data-element=SC_789_ExAmb_MEB_XIX_Softwareblock_XIX_SAM.Geltungsbereich_E3_1_1_UNECE_Gen2.SP_IF_AMBEX_LH_Trigger_XIX_SC_789_ExAmb_MEB_XIX_Softwareblock_XIX_SAM.DE_AMBEX_LH_Trigger, system-signal=AMBEX_LH_Trigger
        communication-direction=OUT, data-element=Grundumfang_XIX_SAM.Geltungsbereich_E3_1_1_UNECE_Gen2.SP_IF_Ambex_SAL_Abl_Vorne_XIX_Grundumfang_XIX_SAM.DE_Ambex_SAL_Abl_Vorne, system-signal=Ambex_SAL_Abl_Vorne
        communication-direction=OUT, data-element=Grundumfang_XIX_SAM.Geltungsbereich_E3_1_1_UNECE_Gen2.SP_IF_Ambex_SAL_animprofil_XIX_Grundumfang_XIX_SAM.DE_Ambex_SAL_animprofil, system-signal=Ambex_SAL_animprofil
        communication-direction=OUT, data-element=Grundumfang_XIX_SAM.Geltungsbereich_E3_1_1_UNECE_Gen2.SP_IF_Ambex_SAL_Bgr_Vorne_XIX_Grundumfang_XIX_SAM.DE_Ambex_SAL_Bgr_Vorne, system-signal=Ambex_SAL_Bgr_Vorne
        communication-direction=OUT, data-element=Grundumfang_XIX_SAM.Geltungsbereich_E3_1_1_UNECE_Gen2.SP_IF_Ambex_SAL_Design1_XIX_Grundumfang_XIX_SAM.DE_Ambex_SAL_Design1, system-signal=Ambex_SAL_Design1
        communication-direction=OUT, data-element=SC_789_ExAmb_MEB_XIX_Softwareblock_XIX_SAM.Geltungsbereich_E3_1_1_UNECE_Gen2.SP_IF_AMBEX_SAL_Design10_L_XIX_SC_789_ExAmb_MEB_XIX_Softwareblock_XIX_SAM.DE_AMBEX_SAL_Design10_L, system-signal=AMBEX_SAL_Design10_L
        communication-direction=OUT, data-element=SC_789_ExAmb_MEB_XIX_Softwareblock_XIX_SAM.Geltungsbereich_E3_1_1_UNECE_Gen2.SP_IF_AMBEX_SAL_Design10_R_XIX_SC_789_ExAmb_MEB_XIX_Softwareblock_XIX_SAM.DE_AMBEX_SAL_Design10_R, system-signal=AMBEX_SAL_Design10_R
        communication-direction=OUT, data-element=SC_789_ExAmb_MEB_XIX_Softwareblock_XIX_SAM.Geltungsbereich_E3_1_1_UNECE_Gen2.SP_IF_AMBEX_SAL_Design11_L_XIX_SC_789_ExAmb_MEB_XIX_Softwareblock_XIX_SAM.DE_AMBEX_SAL_Design11_L, system-signal=AMBEX_SAL_Design11_L
        communication-direction=OUT, data-element=SC_789_ExAmb_MEB_XIX_Softwareblock_XIX_SAM.Geltungsbereich_E3_1_1_UNECE_Gen2.SP_IF_AMBEX_SAL_Design11_R_XIX_SC_789_ExAmb_MEB_XIX_Softwareblock_XIX_SAM.DE_AMBEX_SAL_Design11_R, system-signal=AMBEX_SAL_Design11_R
        communication-direction=OUT, data-element=SC_789_ExAmb_MEB_XIX_Softwareblock_XIX_SAM.Geltungsbereich_E3_1_1_UNECE_Gen2.SP_IF_AMBEX_SAL_Design12_L_XIX_SC_789_ExAmb_MEB_XIX_Softwareblock_XIX_SAM.DE_AMBEX_SAL_Design12_L, system-signal=AMBEX_SAL_Design12_L
        communication-direction=OUT, data-element=SC_789_ExAmb_MEB_XIX_Softwareblock_XIX_SAM.Geltungsbereich_E3_1_1_UNECE_Gen2.SP_IF_AMBEX_SAL_Design12_R_XIX_SC_789_ExAmb_MEB_XIX_Softwareblock_XIX_SAM.DE_AMBEX_SAL_Design12_R, system-signal=AMBEX_SAL_Design12_R
        communication-direction=OUT, data-element=Grundumfang_XIX_SAM.Geltungsbereich_E3_1_1_UNECE_Gen2.SP_IF_Ambex_SAL_Design2_XIX_Grundumfang_XIX_SAM.DE_Ambex_SAL_Design2, system-signal=Ambex_SAL_Design2
        communication-direction=OUT, data-element=SC_789_ExAmb_MEB_XIX_Softwareblock_XIX_SAM.Geltungsbereich_E3_1_1_UNECE_Gen2.SP_IF_AMBEX_SAL_Design{3..9}_XIX_SC_789_ExAmb_MEB_XIX_Softwareblock_XIX_SAM.DE_AMBEX_SAL_Design{3..9}, system-signal=AMBEX_SAL_Design{3..9}
        communication-direction=OUT, data-element=Grundumfang_XIX_SAM.Geltungsbereich_E3_1_1_UNECE_Gen2.SP_IF_Ambex_SAL_Kzl_XIX_Grundumfang_XIX_SAM.DE_Ambex_SAL_Kzl, system-signal=Ambex_SAL_Kzl
        communication-direction=OUT, data-element=Grundumfang_XIX_SAM.Geltungsbereich_E3_1_1_UNECE_Gen2.SP_IF_Ambex_SAL_Schlusslicht_XIX_Grundumfang_XIX_SAM.DE_Ambex_SAL_Schlusslicht, system-signal=Ambex_SAL_Schlusslicht
        communication-direction=OUT, data-element=Grundumfang_XIX_SAM.Geltungsbereich_E3_1_1_UNECE_Gen2.SP_IF_Anlernen_LLR_li_XIX_Grundumfang_XIX_SAM.DE_Anlernen_LLR_li, system-signal=Anlernen_LLR_li
        communication-direction=OUT, data-element=Grundumfang_XIX_SAM.Geltungsbereich_E3_1_1_UNECE_Gen2.SP_IF_Anlernen_LLR_re_XIX_Grundumfang_XIX_SAM.DE_Anlernen_LLR_re, system-signal=Anlernen_LLR_re
        communication-direction=OUT, data-element=Grundumfang_XIX_SAM.Geltungsbereich_E3_1_1_UNECE_Gen2.SP_IF_APS_Taster_XIX_Grundumfang_XIX_SAM.DE_APS_Taster, system-signal=APS_Taster
        communication-direction=IN, data-element=SC_708_IuALicht_MEB_XIX_Softwareblock_XIX_SAM.Geltungsbereich_E3_1_1_UNECE_Gen2.RP_IF_ASW_Warnung_aktiv_BFS_XIX_SC_708_IuALicht_MEB_XIX_Softwareblock_XIX_SAM.DE_ASW_Warnung_aktiv_BFS, system-signal=ASW_Warnung_aktiv_BFS
        communication-direction=IN, data-element=SC_708_IuALicht_MEB_XIX_Softwareblock_XIX_SAM.Geltungsbereich_E3_1_1_UNECE_Gen2.RP_IF_ASW_Warnung_aktiv_FS_XIX_SC_708_IuALicht_MEB_XIX_Softwareblock_XIX_SAM.DE_ASW_Warnung_aktiv_FS, system-signal=ASW_Warnung_aktiv_FS
        communication-direction=IN, data-element=SC_708_IuALicht_MEB_XIX_Softwareblock_XIX_SAM.Geltungsbereich_E3_1_1_UNECE_Gen2.RP_IF_ASW_Warnung_aktiv_HBFS_XIX_SC_708_IuALicht_MEB_XIX_Softwareblock_XIX_SAM.DE_ASW_Warnung_aktiv_HBFS, system-signal=ASW_Warnung_aktiv_HBFS
        communication-direction=IN, data-element=SC_708_IuALicht_MEB_XIX_Softwareblock_XIX_SAM.Geltungsbereich_E3_1_1_UNECE_Gen2.RP_IF_ASW_Warnung_aktiv_HFS_XIX_SC_708_IuALicht_MEB_XIX_Softwareblock_XIX_SAM.DE_ASW_Warnung_aktiv_HFS, system-signal=ASW_Warnung_aktiv_HFS
        communication-direction=OUT, data-element=Grundumfang_XIX_SAM.Geltungsbereich_E3_1_1_UNECE_Gen2.SP_IF_Aussentemp_gef_XIX_Grundumfang_XIX_SAM.DE_Aussentemp_gef, system-signal=Aussentemp_gef
        communication-direction=OUT, data-element=Grundumfang_XIX_SAM.Geltungsbereich_E3_1_1_UNECE_Gen2.SP_IF_BAPe_Data_Byte_{1..6}_XIX_Grundumfang_XIX_SAM.DE_BAPe_Data_Byte_{1..6}, system-signal=BAPe_Data_Byte_{1..6}
        communication-direction=OUT, data-element=Grundumfang_XIX_SAM.Geltungsbereich_E3_1_1_UNECE_Gen2.SP_IF_BAPe_FCT_ID_XIX_Grundumfang_XIX_SAM.DE_BAPe_FCT_ID, system-signal=BAPe_FCT_ID
        communication-direction=OUT, data-element=Grundumfang_XIX_SAM.Geltungsbereich_E3_1_1_UNECE_Gen2.SP_IF_BAPe_LSG_ID1_XIX_Grundumfang_XIX_SAM.DE_BAPe_LSG_ID1, system-signal=BAPe_LSG_ID1
        communication-direction=OUT, data-element=Grundumfang_XIX_SAM.Geltungsbereich_E3_1_1_UNECE_Gen2.SP_IF_BAPe_LSG_ID2_XIX_Grundumfang_XIX_SAM.DE_BAPe_LSG_ID2, system-signal=BAPe_LSG_ID2
        communication-direction=OUT, data-element=Grundumfang_XIX_SAM.Geltungsbereich_E3_1_1_UNECE_Gen2.SP_IF_BAPe_Opcode_XIX_Grundumfang_XIX_SAM.DE_BAPe_Opcode, system-signal=BAPe_Opcode
        communication-direction=OUT, data-element=Grundumfang_XIX_SAM.Geltungsbereich_E3_1_1_UNECE_Gen2.SP_IF_BAPe_Segment_XIX_Grundumfang_XIX_SAM.DE_BAPe_Segment, system-signal=BAPe_Segment
        communication-direction=IN, data-element=Grundumfang_XIX_SAM.Geltungsbereich_E3_1_1_UNECE_Gen2.RP_IF_BAPs_Data_Byte_{1..6}_XIX_Grundumfang_XIX_SAM.DE_BAPs_Data_Byte_{1..6}, system-signal=BAPs_Data_Byte_{1..6}
        communication-direction=IN, data-element=Grundumfang_XIX_SAM.Geltungsbereich_E3_1_1_UNECE_Gen2.RP_IF_BAPs_FCT_ID_XIX_Grundumfang_XIX_SAM.DE_BAPs_FCT_ID, system-signal=BAPs_FCT_ID
        communication-direction=IN, data-element=Grundumfang_XIX_SAM.Geltungsbereich_E3_1_1_UNECE_Gen2.RP_IF_BAPs_LSG_ID1_XIX_Grundumfang_XIX_SAM.DE_BAPs_LSG_ID1, system-signal=BAPs_LSG_ID1
        communication-direction=IN, data-element=Grundumfang_XIX_SAM.Geltungsbereich_E3_1_1_UNECE_Gen2.RP_IF_BAPs_LSG_ID2_XIX_Grundumfang_XIX_SAM.DE_BAPs_LSG_ID2, system-signal=BAPs_LSG_ID2
        communication-direction=IN, data-element=Grundumfang_XIX_SAM.Geltungsbereich_E3_1_1_UNECE_Gen2.RP_IF_BAPs_Opcode_XIX_Grundumfang_XIX_SAM.DE_BAPs_Opcode, system-signal=BAPs_Opcode
        communication-direction=IN, data-element=Grundumfang_XIX_SAM.Geltungsbereich_E3_1_1_UNECE_Gen2.RP_IF_BAPs_Segment_XIX_Grundumfang_XIX_SAM.DE_BAPs_Segment, system-signal=BAPs_Segment
        communication-direction=OUT, data-element=Grundumfang_XIX_SAM.Geltungsbereich_E3_1_1_UNECE_Gen2.SP_IF_BCM1_Abschaltstufe_XIX_Grundumfang_XIX_SAM.DE_BCM1_Abschaltstufe, system-signal=BCM1_Abschaltstufe
        communication-direction=OUT, data-element=Grundumfang_XIX_SAM.Geltungsbereich_E3_1_1_UNECE_Gen2.SP_IF_BCM1_Aussen_Temp_ungef_XIX_Grundumfang_XIX_SAM.DE_BCM1_Aussen_Temp_ungef, system-signal=BCM1_Aussen_Temp_ungef
        communication-direction=IN, data-element=ABL_XIX_SAM.Geltungsbereich_E3_1_1_UNECE_Gen2.RP_IF_BCM1_CH_LH_aktiv_XIX_ABL_XIX_SAM.DE_BCM1_CH_LH_aktiv, system-signal=BCM1_CH_LH_aktiv
        communication-direction=OUT, data-element=Grundumfang_XIX_SAM.Geltungsbereich_E3_1_1_UNECE_Gen2.SP_IF_BCM1_EasyEntry_Status_XIX_Grundumfang_XIX_SAM.DE_BCM1_EasyEntry_Status, system-signal=BCM1_EasyEntry_Status
        communication-direction=OUT, data-element=Grundumfang_XIX_SAM.Geltungsbereich_E3_1_1_UNECE_Gen2.SP_IF_BCM1_FStatus_Aussentemp_ungef_XIX_Grundumfang_XIX_SAM.DE_BCM1_FStatus_Aussentemp_ungef, system-signal=BCM1_FStatus_Aussentemp_ungef
        communication-direction=OUT, data-element=Grundumfang_XIX_SAM.Geltungsbereich_E3_1_1_UNECE_Gen2.SP_IF_BCM1_KD_Fehler_XIX_Grundumfang_XIX_SAM.DE_BCM1_KD_Fehler, system-signal=BCM1_KD_Fehler
        communication-direction=OUT, data-element=Grundumfang_XIX_SAM.Geltungsbereich_E3_1_1_UNECE_Gen2.SP_IF_BCM1_MH_Schalter_XIX_Grundumfang_XIX_SAM.DE_BCM1_MH_Schalter, system-signal=BCM1_MH_Schalter
        communication-direction=OUT, data-element=Grundumfang_XIX_SAM.Geltungsbereich_E3_1_1_UNECE_Gen2.SP_IF_BCM1_Nachlauftyp_XIX_Grundumfang_XIX_SAM.DE_BCM1_Nachlauftyp, system-signal=BCM1_Nachlauftyp
        communication-direction=IN, data-element=ABL_XIX_SAM.Geltungsbereich_E3_1_1_UNECE_Gen2.RP_IF_BCM1_Nebelschluss_Fzg_Anf_XIX_ABL_XIX_SAM.DE_BCM1_Nebelschluss_Fzg_Anf, system-signal=BCM1_Nebelschluss_Fzg_Anf
        communication-direction=OUT, data-element=Grundumfang_XIX_SAM.Geltungsbereich_E3_1_1_UNECE_Gen2.SP_IF_BCM1_OBD_FStatus_ATemp_XIX_Grundumfang_XIX_SAM.DE_BCM1_OBD_FStatus_ATemp, system-signal=BCM1_OBD_FStatus_ATemp
        communication-direction=IN, data-element=ABL_XIX_SAM.Geltungsbereich_E3_1_1_UNECE_Gen2.RP_IF_BCM1_Parklicht_li_Anf_XIX_ABL_XIX_SAM.DE_BCM1_Parklicht_li_Anf, system-signal=BCM1_Parklicht_li_Anf
        communication-direction=IN, data-element=Grundumfang_XIX_SAM.Geltungsbereich_E3_1_1_UNECE_Gen2.RP_IF_BCM1_Parklicht_li_Anf_XIX_Grundumfang_XIX_SAM.DE_BCM1_Parklicht_li_Anf, system-signal=BCM1_Parklicht_li_Anf
        communication-direction=IN, data-element=ABL_XIX_SAM.Geltungsbereich_E3_1_1_UNECE_Gen2.RP_IF_BCM1_Parklicht_re_Anf_XIX_ABL_XIX_SAM.DE_BCM1_Parklicht_re_Anf, system-signal=BCM1_Parklicht_re_Anf
        communication-direction=IN, data-element=Grundumfang_XIX_SAM.Geltungsbereich_E3_1_1_UNECE_Gen2.RP_IF_BCM1_Parklicht_re_Anf_XIX_Grundumfang_XIX_SAM.DE_BCM1_Parklicht_re_Anf, system-signal=BCM1_Parklicht_re_Anf
        communication-direction=IN, data-element=ABL_XIX_SAM.Geltungsbereich_E3_1_1_UNECE_Gen2.RP_IF_BCM1_Schlusslicht_Anf_XIX_ABL_XIX_SAM.DE_BCM1_Schlusslicht_Anf, system-signal=BCM1_Schlusslicht_Anf
        communication-direction=OUT, data-element=Grundumfang_XIX_SAM.Geltungsbereich_E3_1_1_UNECE_Gen2.SP_IF_BCM1_SRA_aktiv_XIX_Grundumfang_XIX_SAM.DE_BCM1_SRA_aktiv, system-signal=BCM1_SRA_aktiv
        communication-direction=IN, data-element=ABL_XIX_SAM.Geltungsbereich_E3_1_1_UNECE_Gen2.RP_IF_BCM1_Standlicht_Anf_XIX_ABL_XIX_SAM.DE_BCM1_Standlicht_Anf, system-signal=BCM1_Standlicht_Anf
        communication-direction=IN, data-element=Grundumfang_XIX_SAM.Geltungsbereich_E3_1_1_UNECE_Gen2.RP_IF_BCM1_Standlicht_Anf_XIX_Grundumfang_XIX_SAM.DE_BCM1_Standlicht_Anf, system-signal=BCM1_Standlicht_Anf
        communication-direction=OUT, data-element=Grundumfang_XIX_SAM.Geltungsbereich_E3_1_1_UNECE_Gen2.SP_IF_BCM1_Transport_Mode_XIX_Grundumfang_XIX_SAM.DE_BCM1_Transport_Mode, system-signal=BCM1_Transport_Mode
        communication-direction=IN, data-element=ABL_XIX_SAM.Geltungsbereich_E3_1_1_UNECE_Gen2.RP_IF_BCM1_Umfeldleuchten_Anf_XIX_ABL_XIX_SAM.DE_BCM1_Umfeldleuchten_Anf, system-signal=BCM1_Umfeldleuchten_Anf
        communication-direction=IN, data-element=Grundumfang_XIX_SAM.Geltungsbereich_E3_1_1_UNECE_Gen2.RP_IF_BCM1_Umfeldleuchten_Anf_XIX_Grundumfang_XIX_SAM.DE_BCM1_Umfeldleuchten_Anf, system-signal=BCM1_Umfeldleuchten_Anf
        communication-direction=OUT, data-element=Grundumfang_XIX_SAM.Geltungsbereich_E3_1_1_UNECE_Gen2.SP_IF_BCM1_Warnblink_Taster_XIX_Grundumfang_XIX_SAM.DE_BCM1_Warnblink_Taster, system-signal=BCM1_Warnblink_Taster
        communication-direction=OUT, data-element=Grundumfang_XIX_SAM.Geltungsbereich_E3_1_1_UNECE_Gen2.SP_IF_BCM_01_BZ_XIX_Grundumfang_XIX_SAM.DE_BCM_01_BZ, system-signal=BCM_01_BZ
        communication-direction=OUT, data-element=Grundumfang_XIX_SAM.Geltungsbereich_E3_1_1_UNECE_Gen2.SP_IF_BCM_01_CRC_XIX_Grundumfang_XIX_SAM.DE_BCM_01_CRC, system-signal=BCM_01_CRC
        communication-direction=OUT, data-element=Grundumfang_XIX_SAM.Geltungsbereich_E3_1_1_UNECE_Gen2.SP_IF_BCM_BFS_aktive_MuFu_Fkt_XIX_Grundumfang_XIX_SAM.DE_BCM_BFS_aktive_MuFu_Fkt, system-signal=BCM_BFS_aktive_MuFu_Fkt
        communication-direction=OUT, data-element=Grundumfang_XIX_SAM.Geltungsbereich_E3_1_1_UNECE_Gen2.SP_IF_BCM_BFS_Fernsteuerung_aktiv_XIX_Grundumfang_XIX_SAM.DE_BCM_BFS_Fernsteuerung_aktiv, system-signal=BCM_BFS_Fernsteuerung_aktiv
        communication-direction=OUT, data-element=Grundumfang_XIX_SAM.Geltungsbereich_E3_1_1_UNECE_Gen2.SP_IF_BCM_BFS_Lordose_ab_XIX_Grundumfang_XIX_SAM.DE_BCM_BFS_Lordose_ab, system-signal=BCM_BFS_Lordose_ab
        communication-direction=OUT, data-element=Grundumfang_XIX_SAM.Geltungsbereich_E3_1_1_UNECE_Gen2.SP_IF_BCM_BFS_Lordose_auf_XIX_Grundumfang_XIX_SAM.DE_BCM_BFS_Lordose_auf, system-signal=BCM_BFS_Lordose_auf
        communication-direction=OUT, data-element=Grundumfang_XIX_SAM.Geltungsbereich_E3_1_1_UNECE_Gen2.SP_IF_BCM_BFS_Lordose_vor_XIX_Grundumfang_XIX_SAM.DE_BCM_BFS_Lordose_vor, system-signal=BCM_BFS_Lordose_vor
        communication-direction=OUT, data-element=Grundumfang_XIX_SAM.Geltungsbereich_E3_1_1_UNECE_Gen2.SP_IF_BCM_BFS_Lordose_zurueck_XIX_Grundumfang_XIX_SAM.DE_BCM_BFS_Lordose_zurueck, system-signal=BCM_BFS_Lordose_zurueck
        communication-direction=OUT, data-element=Druckpunktmassage_fuer_Beifahrersitz_Lehnenmassage_SAM_XIX_DPMBFSLM_XIX_SAM.Geltungsbereich_E3_1_1_UNECE_Gen2.SP_IF_BCM_BFS_Massage_Dauer_XIX_Druckpunktmassage_fuer_Beifahrersitz_Lehnenmassage_SAM_XIX_DPMBFSLM_XIX_SAM.DE_BCM_BFS_Massage_Dauer, system-signal=BCM_BFS_Massage_Dauer
        communication-direction=OUT, data-element=Druckpunktmassage_fuer_Beifahrersitz_Lehnenmassage_SAM_XIX_DPMBFSLM_XIX_SAM.Geltungsbereich_E3_1_1_UNECE_Gen2.SP_IF_BCM_BFS_Massage_Intens_Lehne_XIX_Druckpunktmassage_fuer_Beifahrersitz_Lehnenmassage_SAM_XIX_DPMBFSLM_XIX_SAM.DE_BCM_BFS_Massage_Intens_Lehne, system-signal=BCM_BFS_Massage_Intens_Lehne
        communication-direction=OUT, data-element=Druckpunktmassage_fuer_Beifahrersitz_Lehnenmassage_SAM_XIX_DPMBFSLM_XIX_SAM.Geltungsbereich_E3_1_1_UNECE_Gen2.SP_IF_BCM_BFS_Massage_Intens_Sitz_XIX_Druckpunktmassage_fuer_Beifahrersitz_Lehnenmassage_SAM_XIX_DPMBFSLM_XIX_SAM.DE_BCM_BFS_Massage_Intens_Sitz, system-signal=BCM_BFS_Massage_Intens_Sitz
        communication-direction=OUT, data-element=Grundumfang_XIX_SAM.Geltungsbereich_E3_1_1_UNECE_Gen2.SP_IF_BCM_BFS_Massage_Intensitaet_XIX_Grundumfang_XIX_SAM.DE_BCM_BFS_Massage_Intensitaet, system-signal=BCM_BFS_Massage_Intensitaet
        communication-direction=OUT, data-element=Grundumfang_XIX_SAM.Geltungsbereich_E3_1_1_UNECE_Gen2.SP_IF_BCM_BFS_Massage_Prg_XIX_Grundumfang_XIX_SAM.DE_BCM_BFS_Massage_Prg, system-signal=BCM_BFS_Massage_Prg
        communication-direction=OUT, data-element=Druckpunktmassage_fuer_Beifahrersitz_Lehnenmassage_SAM_XIX_DPMBFSLM_XIX_SAM.Geltungsbereich_E3_1_1_UNECE_Gen2.SP_IF_BCM_BFS_Massage_Prg_erweitert_XIX_Druckpunktmassage_fuer_Beifahrersitz_Lehnenmassage_SAM_XIX_DPMBFSLM_XIX_SAM.DE_BCM_BFS_Massage_Prg_erweitert, system-signal=BCM_BFS_Massage_Prg_erweitert
        communication-direction=OUT, data-element=Druckpunktmassage_fuer_Beifahrersitz_Lehnenmassage_SAM_XIX_DPMBFSLM_XIX_SAM.Geltungsbereich_E3_1_1_UNECE_Gen2.SP_IF_BCM_BFS_Massage_Taster_XIX_Druckpunktmassage_fuer_Beifahrersitz_Lehnenmassage_SAM_XIX_DPMBFSLM_XIX_SAM.DE_BCM_BFS_Massage_Taster, system-signal=BCM_BFS_Massage_Taster
        communication-direction=OUT, data-element=Grundumfang_XIX_SAM.Geltungsbereich_E3_1_1_UNECE_Gen2.SP_IF_BCM_BFS_Memory_Abbruch_XIX_Grundumfang_XIX_SAM.DE_BCM_BFS_Memory_Abbruch, system-signal=BCM_BFS_Memory_Abbruch
        communication-direction=OUT, data-element=Grundumfang_XIX_SAM.Geltungsbereich_E3_1_1_UNECE_Gen2.SP_IF_BCM_BFS_Memory_Pos_XIX_Grundumfang_XIX_SAM.DE_BCM_BFS_Memory_Pos, system-signal=BCM_BFS_Memory_Pos
        communication-direction=OUT, data-element=Grundumfang_XIX_SAM.Geltungsbereich_E3_1_1_UNECE_Gen2.SP_IF_BCM_BFS_Memory_Save_Recall_XIX_Grundumfang_XIX_SAM.DE_BCM_BFS_Memory_Save_Recall, system-signal=BCM_BFS_Memory_Save_Recall
        communication-direction=OUT, data-element=Grundumfang_XIX_SAM.Geltungsbereich_E3_1_1_UNECE_Gen2.SP_IF_BCM_BFS_MSG_Status_XIX_Grundumfang_XIX_SAM.DE_BCM_BFS_MSG_Status, system-signal=BCM_BFS_MSG_Status
        communication-direction=OUT, data-element=Druckpunktmassage_fuer_Beifahrersitz_Lehnenmassage_SAM_XIX_DPMBFSLM_XIX_SAM.Geltungsbereich_E3_1_1_UNECE_Gen2.SP_IF_BCM_BFS_Multif_Taster_XIX_Druckpunktmassage_fuer_Beifahrersitz_Lehnenmassage_SAM_XIX_DPMBFSLM_XIX_SAM.DE_BCM_BFS_Multif_Taster, system-signal=BCM_BFS_Multif_Taster
        communication-direction=OUT, data-element=Druckpunktmassage_fuer_Beifahrersitz_Lehnenmassage_SAM_XIX_DPMBFSLM_XIX_SAM.Geltungsbereich_E3_1_1_UNECE_Gen2.SP_IF_BCM_BFS_Pneumatik_Verstellung_XIX_Druckpunktmassage_fuer_Beifahrersitz_Lehnenmassage_SAM_XIX_DPMBFSLM_XIX_SAM.DE_BCM_BFS_Pneumatik_Verstellung, system-signal=BCM_BFS_Pneumatik_Verstellung
        communication-direction=OUT, data-element=Grundumfang_XIX_SAM.Geltungsbereich_E3_1_1_UNECE_Gen2.SP_IF_BCM_BFS_PreCrash_XIX_Grundumfang_XIX_SAM.DE_BCM_BFS_PreCrash, system-signal=BCM_BFS_PreCrash
        communication-direction=OUT, data-element=Druckpunktmassage_fuer_Beifahrersitz_Lehnenmassage_SAM_XIX_DPMBFSLM_XIX_SAM.Geltungsbereich_E3_1_1_UNECE_Gen2.SP_IF_BCM_BFS_Programmwippe_XIX_Druckpunktmassage_fuer_Beifahrersitz_Lehnenmassage_SAM_XIX_DPMBFSLM_XIX_SAM.DE_BCM_BFS_Programmwippe, system-signal=BCM_BFS_Programmwippe
        communication-direction=OUT, data-element=Grundumfang_XIX_SAM.Geltungsbereich_E3_1_1_UNECE_Gen2.SP_IF_BCM_BFS_SW_eng_XIX_Grundumfang_XIX_SAM.DE_BCM_BFS_SW_eng, system-signal=BCM_BFS_SW_eng
        communication-direction=OUT, data-element=Grundumfang_XIX_SAM.Geltungsbereich_E3_1_1_UNECE_Gen2.SP_IF_BCM_BFS_SW_weit_XIX_Grundumfang_XIX_SAM.DE_BCM_BFS_SW_weit, system-signal=BCM_BFS_SW_weit
        communication-direction=OUT, data-element=Druckpunktmassage_fuer_Beifahrersitz_Lehnenmassage_SAM_XIX_DPMBFSLM_XIX_SAM.Geltungsbereich_E3_1_1_UNECE_Gen2.SP_IF_BCM_BFS_Wellness_Status_XIX_Druckpunktmassage_fuer_Beifahrersitz_Lehnenmassage_SAM_XIX_DPMBFSLM_XIX_SAM.DE_BCM_BFS_Wellness_Status, system-signal=BCM_BFS_Wellness_Status
        communication-direction=OUT, data-element=Grundumfang_XIX_SAM.Geltungsbereich_E3_1_1_UNECE_Gen2.SP_IF_BCM_BFT_geoeffnet_plaus_XIX_Grundumfang_XIX_SAM.DE_BCM_BFT_geoeffnet_plaus, system-signal=BCM_BFT_geoeffnet_plaus
        communication-direction=OUT, data-element=Grundumfang_XIX_SAM.Geltungsbereich_E3_1_1_UNECE_Gen2.SP_IF_BCM_Bremsbelag_Sensor_XIX_Grundumfang_XIX_SAM.DE_BCM_Bremsbelag_Sensor, system-signal=BCM_Bremsbelag_Sensor
        communication-direction=OUT, data-element=Grundumfang_XIX_SAM.Geltungsbereich_E3_1_1_UNECE_Gen2.SP_IF_BCM_Bremsbelag_Sensor_CND_XIX_Grundumfang_XIX_SAM.DE_BCM_Bremsbelag_Sensor_CND, system-signal=BCM_Bremsbelag_Sensor_CND
        communication-direction=OUT, data-element=Grundumfang_XIX_SAM.Geltungsbereich_E3_1_1_UNECE_Gen2.SP_IF_BCM_Bremsbelag_Sensor_NAR_XIX_Grundumfang_XIX_SAM.DE_BCM_Bremsbelag_Sensor_NAR, system-signal=BCM_Bremsbelag_Sensor_NAR
        communication-direction=OUT, data-element=Grundumfang_XIX_SAM.Geltungsbereich_E3_1_1_UNECE_Gen2.SP_IF_BCM_Bremsbelag_Sensor_Rdw_XIX_Grundumfang_XIX_SAM.DE_BCM_Bremsbelag_Sensor_Rdw, system-signal=BCM_Bremsbelag_Sensor_Rdw
        communication-direction=OUT, data-element=Grundumfang_XIX_SAM.Geltungsbereich_E3_1_1_UNECE_Gen2.SP_IF_BCM_Bremsfluessigkeit_Sensor_XIX_Grundumfang_XIX_SAM.DE_BCM_Bremsfluessigkeit_Sensor, system-signal=BCM_Bremsfluessigkeit_Sensor
        communication-direction=OUT, data-element=Grundumfang_XIX_SAM.Geltungsbereich_E3_1_1_UNECE_Gen2.SP_IF_BCM_Drehwinkel_HL_XIX_Grundumfang_XIX_SAM.DE_BCM_Drehwinkel_HL, system-signal=BCM_Drehwinkel_HL
        communication-direction=OUT, data-element=Grundumfang_XIX_SAM.Geltungsbereich_E3_1_1_UNECE_Gen2.SP_IF_BCM_Drehwinkel_VL_XIX_Grundumfang_XIX_SAM.DE_BCM_Drehwinkel_VL, system-signal=BCM_Drehwinkel_VL
        communication-direction=OUT, data-element=Grundumfang_XIX_SAM.Geltungsbereich_E3_1_1_UNECE_Gen2.SP_IF_BCM_Drehwinkelsensortausch_HL_XIX_Grundumfang_XIX_SAM.DE_BCM_Drehwinkelsensortausch_HL, system-signal=BCM_Drehwinkelsensortausch_HL
        communication-direction=OUT, data-element=Grundumfang_XIX_SAM.Geltungsbereich_E3_1_1_UNECE_Gen2.SP_IF_BCM_Drehwinkelsensortausch_VL_XIX_Grundumfang_XIX_SAM.DE_BCM_Drehwinkelsensortausch_VL, system-signal=BCM_Drehwinkelsensortausch_VL
        communication-direction=OUT, data-element=Grundumfang_XIX_SAM.Geltungsbereich_E3_1_1_UNECE_Gen2.SP_IF_BCM_Eco_Charisma_Taste_XIX_Grundumfang_XIX_SAM.DE_BCM_Eco_Charisma_Taste, system-signal=BCM_Eco_Charisma_Taste
        communication-direction=OUT, data-element=Grundumfang_XIX_SAM.Geltungsbereich_E3_1_1_UNECE_Gen2.SP_IF_BCM_Fehlerspeicher_loeschen_XIX_Grundumfang_XIX_SAM.DE_BCM_Fehlerspeicher_loeschen, system-signal=BCM_Fehlerspeicher_loeschen
        communication-direction=IN, data-element=Grundumfang_XIX_SAM.Geltungsbereich_E3_1_1_UNECE_Gen2.RP_IF_BCM_FH_Freigabe_XIX_Grundumfang_XIX_SAM.DE_BCM_FH_Freigabe, system-signal=BCM_FH_Freigabe
        communication-direction=OUT, data-element=Grundumfang_XIX_SAM.Geltungsbereich_E3_1_1_UNECE_Gen2.SP_IF_BCM_FH_Freigabe_XIX_Grundumfang_XIX_SAM.DE_BCM_FH_Freigabe, system-signal=BCM_FH_Freigabe
        communication-direction=OUT, data-element=Grundumfang_XIX_SAM.Geltungsbereich_E3_1_1_UNECE_Gen2.SP_IF_BCM_FS_aktive_MuFu_Fkt_XIX_Grundumfang_XIX_SAM.DE_BCM_FS_aktive_MuFu_Fkt, system-signal=BCM_FS_aktive_MuFu_Fkt
        communication-direction=OUT, data-element=Grundumfang_XIX_SAM.Geltungsbereich_E3_1_1_UNECE_Gen2.SP_IF_BCM_FS_Lordose_ab_XIX_Grundumfang_XIX_SAM.DE_BCM_FS_Lordose_ab, system-signal=BCM_FS_Lordose_ab
        communication-direction=OUT, data-element=Grundumfang_XIX_SAM.Geltungsbereich_E3_1_1_UNECE_Gen2.SP_IF_BCM_FS_Lordose_auf_XIX_Grundumfang_XIX_SAM.DE_BCM_FS_Lordose_auf, system-signal=BCM_FS_Lordose_auf
        communication-direction=OUT, data-element=Grundumfang_XIX_SAM.Geltungsbereich_E3_1_1_UNECE_Gen2.SP_IF_BCM_FS_Lordose_vor_XIX_Grundumfang_XIX_SAM.DE_BCM_FS_Lordose_vor, system-signal=BCM_FS_Lordose_vor
        communication-direction=OUT, data-element=Grundumfang_XIX_SAM.Geltungsbereich_E3_1_1_UNECE_Gen2.SP_IF_BCM_FS_Lordose_zurueck_XIX_Grundumfang_XIX_SAM.DE_BCM_FS_Lordose_zurueck, system-signal=BCM_FS_Lordose_zurueck
        communication-direction=OUT, data-element=Druckpunktmassage_fuer_Fahrersitz_Lehnenmassage_SAM_XIX_DPMFSLM_XIX_SAM.Geltungsbereich_E3_1_1_UNECE_Gen2.SP_IF_BCM_FS_Massage_Dauer_XIX_Druckpunktmassage_fuer_Fahrersitz_Lehnenmassage_SAM_XIX_DPMFSLM_XIX_SAM.DE_BCM_FS_Massage_Dauer, system-signal=BCM_FS_Massage_Dauer
        communication-direction=OUT, data-element=Druckpunktmassage_fuer_Fahrersitz_Lehnenmassage_SAM_XIX_DPMFSLM_XIX_SAM.Geltungsbereich_E3_1_1_UNECE_Gen2.SP_IF_BCM_FS_Massage_Intens_Lehne_XIX_Druckpunktmassage_fuer_Fahrersitz_Lehnenmassage_SAM_XIX_DPMFSLM_XIX_SAM.DE_BCM_FS_Massage_Intens_Lehne, system-signal=BCM_FS_Massage_Intens_Lehne
        communication-direction=OUT, data-element=Druckpunktmassage_fuer_Fahrersitz_Lehnenmassage_SAM_XIX_DPMFSLM_XIX_SAM.Geltungsbereich_E3_1_1_UNECE_Gen2.SP_IF_BCM_FS_Massage_Intens_Sitz_XIX_Druckpunktmassage_fuer_Fahrersitz_Lehnenmassage_SAM_XIX_DPMFSLM_XIX_SAM.DE_BCM_FS_Massage_Intens_Sitz, system-signal=BCM_FS_Massage_Intens_Sitz
        communication-direction=OUT, data-element=Grundumfang_XIX_SAM.Geltungsbereich_E3_1_1_UNECE_Gen2.SP_IF_BCM_FS_Massage_Intensitaet_XIX_Grundumfang_XIX_SAM.DE_BCM_FS_Massage_Intensitaet, system-signal=BCM_FS_Massage_Intensitaet
        communication-direction=OUT, data-element=Grundumfang_XIX_SAM.Geltungsbereich_E3_1_1_UNECE_Gen2.SP_IF_BCM_FS_Massage_Prg_XIX_Grundumfang_XIX_SAM.DE_BCM_FS_Massage_Prg, system-signal=BCM_FS_Massage_Prg
        communication-direction=OUT, data-element=Druckpunktmassage_fuer_Fahrersitz_Lehnenmassage_SAM_XIX_DPMFSLM_XIX_SAM.Geltungsbereich_E3_1_1_UNECE_Gen2.SP_IF_BCM_FS_Massage_Prg_erweitert_XIX_Druckpunktmassage_fuer_Fahrersitz_Lehnenmassage_SAM_XIX_DPMFSLM_XIX_SAM.DE_BCM_FS_Massage_Prg_erweitert, system-signal=BCM_FS_Massage_Prg_erweitert
        communication-direction=OUT, data-element=Druckpunktmassage_fuer_Fahrersitz_Lehnenmassage_SAM_XIX_DPMFSLM_XIX_SAM.Geltungsbereich_E3_1_1_UNECE_Gen2.SP_IF_BCM_FS_Massage_Taster_XIX_Druckpunktmassage_fuer_Fahrersitz_Lehnenmassage_SAM_XIX_DPMFSLM_XIX_SAM.DE_BCM_FS_Massage_Taster, system-signal=BCM_FS_Massage_Taster
        communication-direction=OUT, data-element=Grundumfang_XIX_SAM.Geltungsbereich_E3_1_1_UNECE_Gen2.SP_IF_BCM_FS_Memory_Abbruch_XIX_Grundumfang_XIX_SAM.DE_BCM_FS_Memory_Abbruch, system-signal=BCM_FS_Memory_Abbruch
        communication-direction=OUT, data-element=Grundumfang_XIX_SAM.Geltungsbereich_E3_1_1_UNECE_Gen2.SP_IF_BCM_FS_Memory_Pos_XIX_Grundumfang_XIX_SAM.DE_BCM_FS_Memory_Pos, system-signal=BCM_FS_Memory_Pos
        communication-direction=OUT, data-element=Grundumfang_XIX_SAM.Geltungsbereich_E3_1_1_UNECE_Gen2.SP_IF_BCM_FS_Memory_Save_Recall_XIX_Grundumfang_XIX_SAM.DE_BCM_FS_Memory_Save_Recall, system-signal=BCM_FS_Memory_Save_Recall
        communication-direction=OUT, data-element=Grundumfang_XIX_SAM.Geltungsbereich_E3_1_1_UNECE_Gen2.SP_IF_BCM_FS_MSG_Status_XIX_Grundumfang_XIX_SAM.DE_BCM_FS_MSG_Status, system-signal=BCM_FS_MSG_Status
        communication-direction=OUT, data-element=Druckpunktmassage_fuer_Fahrersitz_Lehnenmassage_SAM_XIX_DPMFSLM_XIX_SAM.Geltungsbereich_E3_1_1_UNECE_Gen2.SP_IF_BCM_FS_Multif_Taster_XIX_Druckpunktmassage_fuer_Fahrersitz_Lehnenmassage_SAM_XIX_DPMFSLM_XIX_SAM.DE_BCM_FS_Multif_Taster, system-signal=BCM_FS_Multif_Taster
        communication-direction=OUT, data-element=Druckpunktmassage_fuer_Fahrersitz_Lehnenmassage_SAM_XIX_DPMFSLM_XIX_SAM.Geltungsbereich_E3_1_1_UNECE_Gen2.SP_IF_BCM_FS_Pneumatik_Verstellung_XIX_Druckpunktmassage_fuer_Fahrersitz_Lehnenmassage_SAM_XIX_DPMFSLM_XIX_SAM.DE_BCM_FS_Pneumatik_Verstellung, system-signal=BCM_FS_Pneumatik_Verstellung
        communication-direction=OUT, data-element=Grundumfang_XIX_SAM.Geltungsbereich_E3_1_1_UNECE_Gen2.SP_IF_BCM_FS_PreCrash_XIX_Grundumfang_XIX_SAM.DE_BCM_FS_PreCrash, system-signal=BCM_FS_PreCrash
        communication-direction=OUT, data-element=Druckpunktmassage_fuer_Fahrersitz_Lehnenmassage_SAM_XIX_DPMFSLM_XIX_SAM.Geltungsbereich_E3_1_1_UNECE_Gen2.SP_IF_BCM_FS_Programmwippe_XIX_Druckpunktmassage_fuer_Fahrersitz_Lehnenmassage_SAM_XIX_DPMFSLM_XIX_SAM.DE_BCM_FS_Programmwippe, system-signal=BCM_FS_Programmwippe
        communication-direction=OUT, data-element=Grundumfang_XIX_SAM.Geltungsbereich_E3_1_1_UNECE_Gen2.SP_IF_BCM_FS_SW_eng_XIX_Grundumfang_XIX_SAM.DE_BCM_FS_SW_eng, system-signal=BCM_FS_SW_eng
        communication-direction=OUT, data-element=Grundumfang_XIX_SAM.Geltungsbereich_E3_1_1_UNECE_Gen2.SP_IF_BCM_FS_SW_weit_XIX_Grundumfang_XIX_SAM.DE_BCM_FS_SW_weit, system-signal=BCM_FS_SW_weit
        communication-direction=OUT, data-element=Druckpunktmassage_fuer_Fahrersitz_Lehnenmassage_SAM_XIX_DPMFSLM_XIX_SAM.Geltungsbereich_E3_1_1_UNECE_Gen2.SP_IF_BCM_FS_Wellness_Status_XIX_Druckpunktmassage_fuer_Fahrersitz_Lehnenmassage_SAM_XIX_DPMFSLM_XIX_SAM.DE_BCM_FS_Wellness_Status, system-signal=BCM_FS_Wellness_Status
        communication-direction=OUT, data-element=Grundumfang_XIX_SAM.Geltungsbereich_E3_1_1_UNECE_Gen2.SP_IF_BCM_FT_geoeffnet_plaus_XIX_Grundumfang_XIX_SAM.DE_BCM_FT_geoeffnet_plaus, system-signal=BCM_FT_geoeffnet_plaus
        communication-direction=OUT, data-element=Grundumfang_XIX_SAM.Geltungsbereich_E3_1_1_UNECE_Gen2.SP_IF_BCM_Kennung_RL_Fzg_XIX_Grundumfang_XIX_SAM.DE_BCM_Kennung_RL_Fzg, system-signal=BCM_Kennung_RL_Fzg
        communication-direction=OUT, data-element=ZV_XIX_SAM.Geltungsbereich_E3_1_1_UNECE_Gen2.SP_IF_BCM_KiSi_Umschalt_gesperrt_XIX_ZV_XIX_SAM.DE_BCM_KiSi_Umschalt_gesperrt, system-signal=BCM_KiSi_Umschalt_gesperrt
        communication-direction=IN, data-element=Grundumfang_XIX_SAM.Geltungsbereich_E3_1_1_UNECE_Gen2.RP_IF_BCM_Komfortfkt_Freigabe_XIX_Grundumfang_XIX_SAM.DE_BCM_Komfortfkt_Freigabe, system-signal=BCM_Komfortfkt_Freigabe
        communication-direction=OUT, data-element=Grundumfang_XIX_SAM.Geltungsbereich_E3_1_1_UNECE_Gen2.SP_IF_BCM_Komfortfkt_Freigabe_XIX_Grundumfang_XIX_SAM.DE_BCM_Komfortfkt_Freigabe, system-signal=BCM_Komfortfkt_Freigabe
        communication-direction=OUT, data-element=Grundumfang_XIX_SAM.Geltungsbereich_E3_1_1_UNECE_Gen2.SP_IF_BCM_Kuehlmittel_Sensor_XIX_Grundumfang_XIX_SAM.DE_BCM_Kuehlmittel_Sensor, system-signal=BCM_Kuehlmittel_Sensor
        communication-direction=OUT, data-element=Grundumfang_XIX_SAM.Geltungsbereich_E3_1_1_UNECE_Gen2.SP_IF_BCM_LINDa_Toggle_XIX_Grundumfang_XIX_SAM.DE_BCM_LINDa_Toggle, system-signal=BCM_LINDa_Toggle
        communication-direction=OUT, data-element=Grundumfang_XIX_SAM.Geltungsbereich_E3_1_1_UNECE_Gen2.SP_IF_BCM_LRH_Taster_XIX_Grundumfang_XIX_SAM.DE_BCM_LRH_Taster, system-signal=BCM_LRH_Taster
        communication-direction=OUT, data-element=Grundumfang_XIX_SAM.Geltungsbereich_E3_1_1_UNECE_Gen2.SP_IF_BCM_P_Mode_aktiv_XIX_Grundumfang_XIX_SAM.DE_BCM_P_Mode_aktiv, system-signal=BCM_P_Mode_aktiv
        communication-direction=OUT, data-element=Grundumfang_XIX_SAM.Geltungsbereich_E3_1_1_UNECE_Gen2.SP_IF_BCM_P_Mode_FH_Kl15_aus_aktiv_XIX_Grundumfang_XIX_SAM.DE_BCM_P_Mode_FH_Kl15_aus_aktiv, system-signal=BCM_P_Mode_FH_Kl15_aus_aktiv
        communication-direction=OUT, data-element=Grundumfang_XIX_SAM.Geltungsbereich_E3_1_1_UNECE_Gen2.SP_IF_BCM_P_Mode_FH_Reversierschwelle_XIX_Grundumfang_XIX_SAM.DE_BCM_P_Mode_FH_Reversierschwelle, system-signal=BCM_P_Mode_FH_Reversierschwelle
        communication-direction=OUT, data-element=Grundumfang_XIX_SAM.Geltungsbereich_E3_1_1_UNECE_Gen2.SP_IF_BCM_RACE_Mode_aktiv_XIX_Grundumfang_XIX_SAM.DE_BCM_RACE_Mode_aktiv, system-signal=BCM_RACE_Mode_aktiv
        communication-direction=OUT, data-element=Grundumfang_XIX_SAM.Geltungsbereich_E3_1_1_UNECE_Gen2.SP_IF_BCM_RGB_Adressierungsart_XIX_Grundumfang_XIX_SAM.DE_BCM_RGB_Adressierungsart, system-signal=BCM_RGB_Adressierungsart
        communication-direction=OUT, data-element=Grundumfang_XIX_SAM.Geltungsbereich_E3_1_1_UNECE_Gen2.SP_IF_BCM_RGB_Bewertung_Dimmzeit_XIX_Grundumfang_XIX_SAM.DE_BCM_RGB_Bewertung_Dimmzeit, system-signal=BCM_RGB_Bewertung_Dimmzeit
        communication-direction=OUT, data-element=Grundumfang_XIX_SAM.Geltungsbereich_E3_1_1_UNECE_Gen2.SP_IF_BCM_RGB_Blau_XIX_Grundumfang_XIX_SAM.DE_BCM_RGB_Blau, system-signal=BCM_RGB_Blau
        communication-direction=OUT, data-element=Grundumfang_XIX_SAM.Geltungsbereich_E3_1_1_UNECE_Gen2.SP_IF_BCM_RGB_Dimmrampe_XIX_Grundumfang_XIX_SAM.DE_BCM_RGB_Dimmrampe, system-signal=BCM_RGB_Dimmrampe
        communication-direction=OUT, data-element=Grundumfang_XIX_SAM.Geltungsbereich_E3_1_1_UNECE_Gen2.SP_IF_BCM_RGB_Dimmzeit_Zeitbasis_XIX_Grundumfang_XIX_SAM.DE_BCM_RGB_Dimmzeit_Zeitbasis, system-signal=BCM_RGB_Dimmzeit_Zeitbasis
        communication-direction=OUT, data-element=Grundumfang_XIX_SAM.Geltungsbereich_E3_1_1_UNECE_Gen2.SP_IF_BCM_RGB_Gruen_XIX_Grundumfang_XIX_SAM.DE_BCM_RGB_Gruen, system-signal=BCM_RGB_Gruen
        communication-direction=OUT, data-element=Grundumfang_XIX_SAM.Geltungsbereich_E3_1_1_UNECE_Gen2.SP_IF_BCM_RGB_Gueltigkeit_XIX_Grundumfang_XIX_SAM.DE_BCM_RGB_Gueltigkeit, system-signal=BCM_RGB_Gueltigkeit
        communication-direction=OUT, data-element=Grundumfang_XIX_SAM.Geltungsbereich_E3_1_1_UNECE_Gen2.SP_IF_BCM_RGB_Intensitaet_XIX_Grundumfang_XIX_SAM.DE_BCM_RGB_Intensitaet, system-signal=BCM_RGB_Intensitaet
        communication-direction=OUT, data-element=Grundumfang_XIX_SAM.Geltungsbereich_E3_1_1_UNECE_Gen2.SP_IF_BCM_RGB_Normierung_Intensitaet_XIX_Grundumfang_XIX_SAM.DE_BCM_RGB_Normierung_Intensitaet, system-signal=BCM_RGB_Normierung_Intensitaet
        communication-direction=OUT, data-element=Grundumfang_XIX_SAM.Geltungsbereich_E3_1_1_UNECE_Gen2.SP_IF_BCM_RGB_Rot_XIX_Grundumfang_XIX_SAM.DE_BCM_RGB_Rot, system-signal=BCM_RGB_Rot
        communication-direction=OUT, data-element=Grundumfang_XIX_SAM.Geltungsbereich_E3_1_1_UNECE_Gen2.SP_IF_BCM_RGB_Slave_Adresse_XIX_Grundumfang_XIX_SAM.DE_BCM_RGB_Slave_Adresse, system-signal=BCM_RGB_Slave_Adresse
        communication-direction=OUT, data-element=Grundumfang_XIX_SAM.Geltungsbereich_E3_1_1_UNECE_Gen2.SP_IF_BCM_RGB_Sonderfunktion_XIX_Grundumfang_XIX_SAM.DE_BCM_RGB_Sonderfunktion, system-signal=BCM_RGB_Sonderfunktion
        communication-direction=IN, data-element=ABL_XIX_SAM.Geltungsbereich_E3_1_1_UNECE_Gen2.RP_IF_BCM_Rueckfahrlicht_Anf_XIX_ABL_XIX_SAM.DE_BCM_Rueckfahrlicht_Anf, system-signal=BCM_Rueckfahrlicht_Anf
        communication-direction=OUT, data-element=Grundumfang_XIX_SAM.Geltungsbereich_E3_1_1_UNECE_Gen2.SP_IF_BCM_SBE_XIX_Grundumfang_XIX_SAM.DE_BCM_SBE, system-signal=BCM_SBE
        communication-direction=OUT, data-element=Grundumfang_XIX_SAM.Geltungsbereich_E3_1_1_UNECE_Gen2.SP_IF_BCM_SGT_Pumpe_BFS_XIX_Grundumfang_XIX_SAM.DE_BCM_SGT_Pumpe_BFS, system-signal=BCM_SGT_Pumpe_BFS
        communication-direction=OUT, data-element=Grundumfang_XIX_SAM.Geltungsbereich_E3_1_1_UNECE_Gen2.SP_IF_BCM_SGT_Pumpe_FS_XIX_Grundumfang_XIX_SAM.DE_BCM_SGT_Pumpe_FS, system-signal=BCM_SGT_Pumpe_FS
        communication-direction=OUT, data-element=Grundumfang_XIX_SAM.Geltungsbereich_E3_1_1_UNECE_Gen2.SP_IF_BCM_SPR_Nachregelung_Freigabe_XIX_Grundumfang_XIX_SAM.DE_BCM_SPR_Nachregelung_Freigabe, system-signal=BCM_SPR_Nachregelung_Freigabe
        communication-direction=OUT, data-element=Grundumfang_XIX_SAM.Geltungsbereich_E3_1_1_UNECE_Gen2.SP_IF_BCM_Systemfunkionstest_BFS_XIX_Grundumfang_XIX_SAM.DE_BCM_Systemfunkionstest_BFS, system-signal=BCM_Systemfunkionstest_BFS
        communication-direction=OUT, data-element=Grundumfang_XIX_SAM.Geltungsbereich_E3_1_1_UNECE_Gen2.SP_IF_BCM_Systemfunkionstest_FS_XIX_Grundumfang_XIX_SAM.DE_BCM_Systemfunkionstest_FS, system-signal=BCM_Systemfunkionstest_FS
        communication-direction=OUT, data-element=Grundumfang_XIX_SAM.Geltungsbereich_E3_1_1_UNECE_Gen2.SP_IF_BCM_Tankklappensteller_Fehler_XIX_Grundumfang_XIX_SAM.DE_BCM_Tankklappensteller_Fehler, system-signal=BCM_Tankklappensteller_Fehler
        communication-direction=OUT, data-element=Grundumfang_XIX_SAM.Geltungsbereich_E3_1_1_UNECE_Gen2.SP_IF_BCM_Waschwasser_Sensor_XIX_Grundumfang_XIX_SAM.DE_BCM_Waschwasser_Sensor, system-signal=BCM_Waschwasser_Sensor
        communication-direction=OUT, data-element=Grundumfang_XIX_SAM.Geltungsbereich_E3_1_1_UNECE_Gen2.SP_IF_BCM_Wischer_Parklage_XIX_Grundumfang_XIX_SAM.DE_BCM_Wischer_Parklage, system-signal=BCM_Wischer_Parklage
        communication-direction=OUT, data-element=Grundumfang_XIX_SAM.Geltungsbereich_E3_1_1_UNECE_Gen2.SP_IF_Bel_DiETa_Car_XIX_Grundumfang_XIX_SAM.DE_Bel_DiETa_Car, system-signal=Bel_DiETa_Car
        communication-direction=OUT, data-element=Grundumfang_XIX_SAM.Geltungsbereich_E3_1_1_UNECE_Gen2.SP_IF_Bel_DiETa_Lock_Unlock_XIX_Grundumfang_XIX_SAM.DE_Bel_DiETa_Lock_Unlock, system-signal=Bel_DiETa_Lock_Unlock
        communication-direction=IN, data-element=Grundumfang_XIX_SAM.Geltungsbereich_E3_1_1_UNECE_Gen2.RP_IF_Bel_DiETa_Mode_XIX_Grundumfang_XIX_SAM.DE_Bel_DiETa_Mode, system-signal=Bel_DiETa_Mode
        communication-direction=IN, data-element=Grundumfang_XIX_SAM.Geltungsbereich_E3_1_1_UNECE_Gen2.RP_IF_Bel_DiETa_Warnblinken_XIX_Grundumfang_XIX_SAM.DE_Bel_DiETa_Warnblinken, system-signal=Bel_DiETa_Warnblinken
        communication-direction=OUT, data-element=Grundumfang_XIX_SAM.Geltungsbereich_E3_1_1_UNECE_Gen2.SP_IF_Bel_LiSi_Defrost_XIX_Grundumfang_XIX_SAM.DE_Bel_LiSi_Defrost, system-signal=Bel_LiSi_Defrost
        communication-direction=OUT, data-element=Grundumfang_XIX_SAM.Geltungsbereich_E3_1_1_UNECE_Gen2.SP_IF_Bel_LiSi_FSH_XIX_Grundumfang_XIX_SAM.DE_Bel_LiSi_FSH, system-signal=Bel_LiSi_FSH
        communication-direction=OUT, data-element=Grundumfang_XIX_SAM.Geltungsbereich_E3_1_1_UNECE_Gen2.SP_IF_Bel_LiSi_HSH_XIX_Grundumfang_XIX_SAM.DE_Bel_LiSi_HSH, system-signal=Bel_LiSi_HSH
        communication-direction=IN, data-element=Druckpunktmassage_fuer_Beifahrersitz_Lehnenmassage_SAM_XIX_DPMBFSLM_XIX_SAM.Geltungsbereich_E3_1_1_UNECE_Gen2.RP_IF_BFS_MMB_glob_stop_XIX_Druckpunktmassage_fuer_Beifahrersitz_Lehnenmassage_SAM_XIX_DPMBFSLM_XIX_SAM.DE_BFS_MMB_glob_stop, system-signal=BFS_MMB_glob_stop
        communication-direction=IN, data-element=Druckpunktmassage_fuer_Fahrersitz_Lehnenmassage_SAM_XIX_DPMFSLM_XIX_SAM.Geltungsbereich_E3_1_1_UNECE_Gen2.RP_IF_BFS_MMB_glob_stop_XIX_Druckpunktmassage_fuer_Fahrersitz_Lehnenmassage_SAM_XIX_DPMFSLM_XIX_SAM.DE_BFS_MMB_glob_stop, system-signal=BFS_MMB_glob_stop
        communication-direction=IN, data-element=Grundumfang_XIX_SAM.Geltungsbereich_E3_1_1_UNECE_Gen2.RP_IF_BFS_MMB_glob_stop_XIX_Grundumfang_XIX_SAM.DE_BFS_MMB_glob_stop, system-signal=BFS_MMB_glob_stop
        communication-direction=IN, data-element=Druckpunktmassage_fuer_Beifahrersitz_Lehnenmassage_SAM_XIX_DPMBFSLM_XIX_SAM.Geltungsbereich_E3_1_1_UNECE_Gen2.RP_IF_BFS_MMB_storage_XIX_Druckpunktmassage_fuer_Beifahrersitz_Lehnenmassage_SAM_XIX_DPMBFSLM_XIX_SAM.DE_BFS_MMB_storage, system-signal=BFS_MMB_storage
        communication-direction=IN, data-element=Druckpunktmassage_fuer_Fahrersitz_Lehnenmassage_SAM_XIX_DPMFSLM_XIX_SAM.Geltungsbereich_E3_1_1_UNECE_Gen2.RP_IF_BFS_MMB_storage_XIX_Druckpunktmassage_fuer_Fahrersitz_Lehnenmassage_SAM_XIX_DPMFSLM_XIX_SAM.DE_BFS_MMB_storage, system-signal=BFS_MMB_storage
        communication-direction=IN, data-element=Grundumfang_XIX_SAM.Geltungsbereich_E3_1_1_UNECE_Gen2.RP_IF_BFS_MMB_storage_XIX_Grundumfang_XIX_SAM.DE_BFS_MMB_storage, system-signal=BFS_MMB_storage
        communication-direction=IN, data-element=Druckpunktmassage_fuer_Beifahrersitz_Lehnenmassage_SAM_XIX_DPMBFSLM_XIX_SAM.Geltungsbereich_E3_1_1_UNECE_Gen2.RP_IF_BFS_MMB_tast_XIX_Druckpunktmassage_fuer_Beifahrersitz_Lehnenmassage_SAM_XIX_DPMBFSLM_XIX_SAM.DE_BFS_MMB_tast, system-signal=BFS_MMB_tast
        communication-direction=IN, data-element=Druckpunktmassage_fuer_Fahrersitz_Lehnenmassage_SAM_XIX_DPMFSLM_XIX_SAM.Geltungsbereich_E3_1_1_UNECE_Gen2.RP_IF_BFS_MMB_tast_XIX_Druckpunktmassage_fuer_Fahrersitz_Lehnenmassage_SAM_XIX_DPMFSLM_XIX_SAM.DE_BFS_MMB_tast, system-signal=BFS_MMB_tast
        communication-direction=IN, data-element=Grundumfang_XIX_SAM.Geltungsbereich_E3_1_1_UNECE_Gen2.RP_IF_BFS_MMB_tast_XIX_Grundumfang_XIX_SAM.DE_BFS_MMB_tast, system-signal=BFS_MMB_tast
        communication-direction=IN, data-element=Druckpunktmassage_fuer_Beifahrersitz_Lehnenmassage_SAM_XIX_DPMBFSLM_XIX_SAM.Geltungsbereich_E3_1_1_UNECE_Gen2.RP_IF_BFS_MMB_tipp_XIX_Druckpunktmassage_fuer_Beifahrersitz_Lehnenmassage_SAM_XIX_DPMBFSLM_XIX_SAM.DE_BFS_MMB_tipp, system-signal=BFS_MMB_tipp
        communication-direction=IN, data-element=Druckpunktmassage_fuer_Fahrersitz_Lehnenmassage_SAM_XIX_DPMFSLM_XIX_SAM.Geltungsbereich_E3_1_1_UNECE_Gen2.RP_IF_BFS_MMB_tipp_XIX_Druckpunktmassage_fuer_Fahrersitz_Lehnenmassage_SAM_XIX_DPMFSLM_XIX_SAM.DE_BFS_MMB_tipp, system-signal=BFS_MMB_tipp
        communication-direction=IN, data-element=Grundumfang_XIX_SAM.Geltungsbereich_E3_1_1_UNECE_Gen2.RP_IF_BFS_MMB_tipp_XIX_Grundumfang_XIX_SAM.DE_BFS_MMB_tipp, system-signal=BFS_MMB_tipp
        communication-direction=IN, data-element=ABL_XIX_SAM.Geltungsbereich_E3_1_1_UNECE_Gen2.RP_IF_BH_Blinker_Fehler_XIX_ABL_XIX_SAM.DE_BH_Blinker_Fehler, system-signal=BH_Blinker_Fehler
        communication-direction=OUT, data-element=ABL_XIX_SAM.Geltungsbereich_E3_1_1_UNECE_Gen2.SP_IF_BH_Blinker_Fehler_XIX_ABL_XIX_SAM.DE_BH_Blinker_Fehler, system-signal=BH_Blinker_Fehler
        communication-direction=IN, data-element=Grundumfang_XIX_SAM.Geltungsbereich_E3_1_1_UNECE_Gen2.RP_IF_BH_Blinker_Fehler_XIX_Grundumfang_XIX_SAM.DE_BH_Blinker_Fehler, system-signal=BH_Blinker_Fehler
        communication-direction=OUT, data-element=Grundumfang_XIX_SAM.Geltungsbereich_E3_1_1_UNECE_Gen2.SP_IF_BH_Blinker_Fehler_XIX_Grundumfang_XIX_SAM.DE_BH_Blinker_Fehler, system-signal=BH_Blinker_Fehler
        communication-direction=IN, data-element=ABL_XIX_SAM.Geltungsbereich_E3_1_1_UNECE_Gen2.RP_IF_BH_Blinker_li_XIX_ABL_XIX_SAM.DE_BH_Blinker_li, system-signal=BH_Blinker_li
        communication-direction=OUT, data-element=ABL_XIX_SAM.Geltungsbereich_E3_1_1_UNECE_Gen2.SP_IF_BH_Blinker_li_XIX_ABL_XIX_SAM.DE_BH_Blinker_li, system-signal=BH_Blinker_li
        communication-direction=IN, data-element=Grundumfang_XIX_SAM.Geltungsbereich_E3_1_1_UNECE_Gen2.RP_IF_BH_Blinker_li_XIX_Grundumfang_XIX_SAM.DE_BH_Blinker_li, system-signal=BH_Blinker_li
        communication-direction=OUT, data-element=Grundumfang_XIX_SAM.Geltungsbereich_E3_1_1_UNECE_Gen2.SP_IF_BH_Blinker_li_XIX_Grundumfang_XIX_SAM.DE_BH_Blinker_li, system-signal=BH_Blinker_li
        communication-direction=IN, data-element=ABL_XIX_SAM.Geltungsbereich_E3_1_1_UNECE_Gen2.RP_IF_BH_Blinker_li_invers_XIX_ABL_XIX_SAM.DE_BH_Blinker_li_invers, system-signal=BH_Blinker_li_invers
        communication-direction=IN, data-element=Grundumfang_XIX_SAM.Geltungsbereich_E3_1_1_UNECE_Gen2.RP_IF_BH_Blinker_li_invers_XIX_Grundumfang_XIX_SAM.DE_BH_Blinker_li_invers, system-signal=BH_Blinker_li_invers
        communication-direction=IN, data-element=ABL_XIX_SAM.Geltungsbereich_E3_1_1_UNECE_Gen2.RP_IF_BH_Blinker_re_XIX_ABL_XIX_SAM.DE_BH_Blinker_re, system-signal=BH_Blinker_re
        communication-direction=OUT, data-element=ABL_XIX_SAM.Geltungsbereich_E3_1_1_UNECE_Gen2.SP_IF_BH_Blinker_re_XIX_ABL_XIX_SAM.DE_BH_Blinker_re, system-signal=BH_Blinker_re
        communication-direction=IN, data-element=Grundumfang_XIX_SAM.Geltungsbereich_E3_1_1_UNECE_Gen2.RP_IF_BH_Blinker_re_XIX_Grundumfang_XIX_SAM.DE_BH_Blinker_re, system-signal=BH_Blinker_re
        communication-direction=OUT, data-element=Grundumfang_XIX_SAM.Geltungsbereich_E3_1_1_UNECE_Gen2.SP_IF_BH_Blinker_re_XIX_Grundumfang_XIX_SAM.DE_BH_Blinker_re, system-signal=BH_Blinker_re
        communication-direction=IN, data-element=ABL_XIX_SAM.Geltungsbereich_E3_1_1_UNECE_Gen2.RP_IF_BH_Blinker_re_invers_XIX_ABL_XIX_SAM.DE_BH_Blinker_re_invers, system-signal=BH_Blinker_re_invers
        communication-direction=IN, data-element=Grundumfang_XIX_SAM.Geltungsbereich_E3_1_1_UNECE_Gen2.RP_IF_BH_Blinker_re_invers_XIX_Grundumfang_XIX_SAM.DE_BH_Blinker_re_invers, system-signal=BH_Blinker_re_invers
        communication-direction=IN, data-element=ABL_XIX_SAM.Geltungsbereich_E3_1_1_UNECE_Gen2.RP_IF_BH_Fernlicht_XIX_ABL_XIX_SAM.DE_BH_Fernlicht, system-signal=BH_Fernlicht
        communication-direction=OUT, data-element=ABL_XIX_SAM.Geltungsbereich_E3_1_1_UNECE_Gen2.SP_IF_BH_Fernlicht_XIX_ABL_XIX_SAM.DE_BH_Fernlicht, system-signal=BH_Fernlicht
        communication-direction=IN, data-element=Grundumfang_XIX_SAM.Geltungsbereich_E3_1_1_UNECE_Gen2.RP_IF_BH_Fernlicht_XIX_Grundumfang_XIX_SAM.DE_BH_Fernlicht, system-signal=BH_Fernlicht
        communication-direction=OUT, data-element=Grundumfang_XIX_SAM.Geltungsbereich_E3_1_1_UNECE_Gen2.SP_IF_BH_Fernlicht_XIX_Grundumfang_XIX_SAM.DE_BH_Fernlicht, system-signal=BH_Fernlicht
        communication-direction=IN, data-element=ABL_XIX_SAM.Geltungsbereich_E3_1_1_UNECE_Gen2.RP_IF_BH_Lichthupe_XIX_ABL_XIX_SAM.DE_BH_Lichthupe, system-signal=BH_Lichthupe
        communication-direction=OUT, data-element=ABL_XIX_SAM.Geltungsbereich_E3_1_1_UNECE_Gen2.SP_IF_BH_Lichthupe_XIX_ABL_XIX_SAM.DE_BH_Lichthupe, system-signal=BH_Lichthupe
        communication-direction=IN, data-element=Grundumfang_XIX_SAM.Geltungsbereich_E3_1_1_UNECE_Gen2.RP_IF_BH_Lichthupe_XIX_Grundumfang_XIX_SAM.DE_BH_Lichthupe, system-signal=BH_Lichthupe
        communication-direction=OUT, data-element=Grundumfang_XIX_SAM.Geltungsbereich_E3_1_1_UNECE_Gen2.SP_IF_BH_Lichthupe_XIX_Grundumfang_XIX_SAM.DE_BH_Lichthupe, system-signal=BH_Lichthupe
        communication-direction=IN, data-element=ABL_XIX_SAM.Geltungsbereich_E3_1_1_UNECE_Gen2.RP_IF_BM_Warnblinken_XIX_ABL_XIX_SAM.DE_BM_Warnblinken, system-signal=BM_Warnblinken
        communication-direction=IN, data-element=Grundumfang_XIX_SAM.Geltungsbereich_E3_1_1_UNECE_Gen2.RP_IF_BM_Warnblinken_XIX_Grundumfang_XIX_SAM.DE_BM_Warnblinken, system-signal=BM_Warnblinken
        communication-direction=IN, data-element=ABL_XIX_SAM.Geltungsbereich_E3_1_1_UNECE_Gen2.RP_IF_BM_WBT_Beleuchtung_XIX_ABL_XIX_SAM.DE_BM_WBT_Beleuchtung, system-signal=BM_WBT_Beleuchtung
        communication-direction=IN, data-element=Grundumfang_XIX_SAM.Geltungsbereich_E3_1_1_UNECE_Gen2.RP_IF_BM_WBT_Beleuchtung_XIX_Grundumfang_XIX_SAM.DE_BM_WBT_Beleuchtung, system-signal=BM_WBT_Beleuchtung
        communication-direction=IN, data-element=ABL_XIX_SAM.Geltungsbereich_E3_1_1_UNECE_Gen2.RP_IF_BM_ZV_auf_XIX_ABL_XIX_SAM.DE_BM_ZV_auf, system-signal=BM_ZV_auf
        communication-direction=IN, data-element=Grundumfang_XIX_SAM.Geltungsbereich_E3_1_1_UNECE_Gen2.RP_IF_BM_ZV_auf_XIX_Grundumfang_XIX_SAM.DE_BM_ZV_auf, system-signal=BM_ZV_auf
        communication-direction=IN, data-element=ABL_XIX_SAM.Geltungsbereich_E3_1_1_UNECE_Gen2.RP_IF_BM_ZV_zu_XIX_ABL_XIX_SAM.DE_BM_ZV_zu, system-signal=BM_ZV_zu
        communication-direction=IN, data-element=Grundumfang_XIX_SAM.Geltungsbereich_E3_1_1_UNECE_Gen2.RP_IF_BM_ZV_zu_XIX_Grundumfang_XIX_SAM.DE_BM_ZV_zu, system-signal=BM_ZV_zu
        communication-direction=IN, data-element=Grundumfang_XIX_SAM.Geltungsbereich_E3_1_1_UNECE_Gen2.RP_IF_BMCe_ORUData_XIX_Grundumfang_XIX_SAM.DE_BMCe_ORUData, system-signal=BMCe_ORUData
        communication-direction=IN, data-element=Grundumfang_XIX_SAM.Geltungsbereich_E3_1_1_UNECE_Gen2.RP_IF_BMCe_ORUDataIndex_XIX_Grundumfang_XIX_SAM.DE_BMCe_ORUDataIndex, system-signal=BMCe_ORUDataIndex
        communication-direction=IN, data-element=Grundumfang_XIX_SAM.Geltungsbereich_E3_1_1_UNECE_Gen2.RP_IF_BMS_KundenWarnung_XIX_Grundumfang_XIX_SAM.DE_BMS_KundenWarnung, system-signal=BMS_KundenWarnung
        communication-direction=OUT, data-element=ABL_XIX_SAM.Geltungsbereich_E3_1_1_UNECE_Gen2.SP_IF_BRL_Bremslicht_Schalter_XIX_ABL_XIX_SAM.DE_BRL_Bremslicht_Schalter, system-signal=BRL_Bremslicht_Schalter
        communication-direction=OUT, data-element=Grundumfang_XIX_SAM.Geltungsbereich_E3_1_1_UNECE_Gen2.SP_IF_BRL_Bremslicht_Schalter_XIX_Grundumfang_XIX_SAM.DE_BRL_Bremslicht_Schalter, system-signal=BRL_Bremslicht_Schalter
        communication-direction=IN, data-element=Grundumfang_XIX_SAM.Geltungsbereich_E3_1_1_UNECE_Gen2.RP_IF_BT_FH_Bew_hoch_XIX_Grundumfang_XIX_SAM.DE_BT_FH_Bew_hoch, system-signal=BT_FH_Bew_hoch
        communication-direction=IN, data-element=Grundumfang_XIX_SAM.Geltungsbereich_E3_1_1_UNECE_Gen2.RP_IF_BT_FH_Bew_tief_XIX_Grundumfang_XIX_SAM.DE_BT_FH_Bew_tief, system-signal=BT_FH_Bew_tief
        communication-direction=IN, data-element=Grundumfang_XIX_SAM.Geltungsbereich_E3_1_1_UNECE_Gen2.RP_IF_BT_Oben_Block_erw_XIX_Grundumfang_XIX_SAM.DE_BT_Oben_Block_erw, system-signal=BT_Oben_Block_erw
        communication-direction=IN, data-element=Grundumfang_XIX_SAM.Geltungsbereich_E3_1_1_UNECE_Gen2.RP_IF_BT_Sp_Blk_def_XIX_Grundumfang_XIX_SAM.DE_BT_Sp_Blk_def, system-signal=BT_Sp_Blk_def
        communication-direction=IN, data-element=Grundumfang_XIX_SAM.Geltungsbereich_E3_1_1_UNECE_Gen2.RP_IF_BT_Tuer_geoeffnet_XIX_Grundumfang_XIX_SAM.DE_BT_Tuer_geoeffnet, system-signal=BT_Tuer_geoeffnet
        communication-direction=IN, data-element=Grundumfang_XIX_SAM.Geltungsbereich_E3_1_1_UNECE_Gen2.RP_IF_BT_Unten_Block_erw_XIX_Grundumfang_XIX_SAM.DE_BT_Unten_Block_erw, system-signal=BT_Unten_Block_erw
        communication-direction=IN, data-element=Grundumfang_XIX_SAM.Geltungsbereich_E3_1_1_UNECE_Gen2.RP_IF_CHA_Fahrer_Umschaltung_XIX_Grundumfang_XIX_SAM.DE_CHA_Fahrer_Umschaltung, system-signal=CHA_Fahrer_Umschaltung
        communication-direction=IN, data-element=Grundumfang_XIX_SAM.Geltungsbereich_E3_1_1_UNECE_Gen2.RP_IF_CHA_Ziel_FahrPr_AMB_XIX_Grundumfang_XIX_SAM.DE_CHA_Ziel_FahrPr_AMB, system-signal=CHA_Ziel_FahrPr_AMB
        communication-direction=IN, data-element=SC_708_IuALicht_MEB_XIX_Softwareblock_XIX_SAM.Geltungsbereich_E3_1_1_UNECE_Gen2.RP_IF_CHA_Ziel_FahrPr_AMB_XIX_SC_708_IuALicht_MEB_XIX_Softwareblock_XIX_SAM.DE_CHA_Ziel_FahrPr_AMB, system-signal=CHA_Ziel_FahrPr_AMB
        communication-direction=IN, data-element=Grundumfang_XIX_SAM.Geltungsbereich_E3_1_1_UNECE_Gen2.RP_IF_CPDFct_FlashAndHonk_XIX_Grundumfang_XIX_SAM.DE_CPDFct_FlashAndHonk, system-signal=CPDFct_FlashAndHonk
        communication-direction=IN, data-element=Grundumfang_XIX_SAM.Geltungsbereich_E3_1_1_UNECE_Gen2.RP_IF_DCDC_HR_ORUData_XIX_Grundumfang_XIX_SAM.DE_DCDC_HR_ORUData, system-signal=DCDC_HR_ORUData
        communication-direction=IN, data-element=Grundumfang_XIX_SAM.Geltungsbereich_E3_1_1_UNECE_Gen2.RP_IF_DCDC_HR_ORUDataIndex_XIX_Grundumfang_XIX_SAM.DE_DCDC_HR_ORUDataIndex, system-signal=DCDC_HR_ORUDataIndex
        communication-direction=IN, data-element=Grundumfang_XIX_SAM.Geltungsbereich_E3_1_1_UNECE_Gen2.RP_IF_DCDC_NV_ORUDataIndex_XIX_Grundumfang_XIX_SAM.DE_DCDC_NV_ORUDataIndex, system-signal=DCDC_NV_ORUDataIndex
        communication-direction=IN, data-element=Grundumfang_XIX_SAM.Geltungsbereich_E3_1_1_UNECE_Gen2.RP_IF_DCDC_ORUData_XIX_Grundumfang_XIX_SAM.DE_DCDC_ORUData, system-signal=DCDC_ORUData
        communication-direction=OUT, data-element=Grundumfang_XIX_SAM.Geltungsbereich_E3_1_1_UNECE_Gen2.SP_IF_Deaktivierung_RS_XIX_Grundumfang_XIX_SAM.DE_Deaktivierung_RS, system-signal=Deaktivierung_RS
        communication-direction=IN, data-element=Grundumfang_XIX_SAM.Geltungsbereich_E3_1_1_UNECE_Gen2.RP_IF_DGN_Verlernzaehler_XIX_Grundumfang_XIX_SAM.DE_DGN_Verlernzaehler, system-signal=DGN_Verlernzaehler
        communication-direction=IN, data-element=Dimmung_XIX_SAM.Geltungsbereich_E3_1_1_UNECE_Gen2.RP_IF_DI_KL_58xd_XIX_Dimmung_XIX_SAM.DE_DI_KL_58xd, system-signal=DI_KL_58xd
        communication-direction=IN, data-element=Grundumfang_XIX_SAM.Geltungsbereich_E3_1_1_UNECE_Gen2.RP_IF_DI_KL_58xd_XIX_Grundumfang_XIX_SAM.DE_DI_KL_58xd, system-signal=DI_KL_58xd
        communication-direction=OUT, data-element=Grundumfang_XIX_SAM.Geltungsbereich_E3_1_1_UNECE_Gen2.SP_IF_DI_KL_58xd_XIX_Grundumfang_XIX_SAM.DE_DI_KL_58xd, system-signal=DI_KL_58xd
        communication-direction=IN, data-element=Dimmung_XIX_SAM.Geltungsbereich_E3_1_1_UNECE_Gen2.RP_IF_DI_KL_58xs_XIX_Dimmung_XIX_SAM.DE_DI_KL_58xs, system-signal=DI_KL_58xs
        communication-direction=IN, data-element=Grundumfang_XIX_SAM.Geltungsbereich_E3_1_1_UNECE_Gen2.RP_IF_DI_KL_58xs_XIX_Grundumfang_XIX_SAM.DE_DI_KL_58xs, system-signal=DI_KL_58xs
        communication-direction=OUT, data-element=Grundumfang_XIX_SAM.Geltungsbereich_E3_1_1_UNECE_Gen2.SP_IF_DI_KL_58xs_XIX_Grundumfang_XIX_SAM.DE_DI_KL_58xs, system-signal=DI_KL_58xs
        communication-direction=IN, data-element=SC_708_IuALicht_MEB_XIX_Softwareblock_XIX_SAM.Geltungsbereich_E3_1_1_UNECE_Gen2.RP_IF_DI_KL_58xs_XIX_SC_708_IuALicht_MEB_XIX_Softwareblock_XIX_SAM.DE_DI_KL_58xs, system-signal=DI_KL_58xs
        communication-direction=IN, data-element=Dimmung_XIX_SAM.Geltungsbereich_E3_1_1_UNECE_Gen2.RP_IF_DI_KL_58xt_XIX_Dimmung_XIX_SAM.DE_DI_KL_58xt, system-signal=DI_KL_58xt
        communication-direction=IN, data-element=Grundumfang_XIX_SAM.Geltungsbereich_E3_1_1_UNECE_Gen2.RP_IF_DI_KL_58xt_XIX_Grundumfang_XIX_SAM.DE_DI_KL_58xt, system-signal=DI_KL_58xt
        communication-direction=IN, data-element=Grundumfang_XIX_SAM.Geltungsbereich_E3_1_1_UNECE_Gen2.RP_IF_DiETa_Car_XIX_Grundumfang_XIX_SAM.DE_DiETa_Car, system-signal=DiETa_Car
        communication-direction=IN, data-element=Grundumfang_XIX_SAM.Geltungsbereich_E3_1_1_UNECE_Gen2.RP_IF_DiETa_Defrost_Taste_XIX_Grundumfang_XIX_SAM.DE_DiETa_Defrost_Taste, system-signal=DiETa_Defrost_Taste
        communication-direction=IN, data-element=Grundumfang_XIX_SAM.Geltungsbereich_E3_1_1_UNECE_Gen2.RP_IF_DiETa_FAS_Stufe_XIX_Grundumfang_XIX_SAM.DE_DiETa_FAS_Stufe, system-signal=DiETa_FAS_Stufe
        communication-direction=IN, data-element=Grundumfang_XIX_SAM.Geltungsbereich_E3_1_1_UNECE_Gen2.RP_IF_DiETa_FSH_Taste_XIX_Grundumfang_XIX_SAM.DE_DiETa_FSH_Taste, system-signal=DiETa_FSH_Taste
        communication-direction=IN, data-element=Grundumfang_XIX_SAM.Geltungsbereich_E3_1_1_UNECE_Gen2.RP_IF_DiETa_HSH_Taste_XIX_Grundumfang_XIX_SAM.DE_DiETa_HSH_Taste, system-signal=DiETa_HSH_Taste
        communication-direction=IN, data-element=Grundumfang_XIX_SAM.Geltungsbereich_E3_1_1_UNECE_Gen2.RP_IF_DiETa_Klima_XIX_Grundumfang_XIX_SAM.DE_DiETa_Klima, system-signal=DiETa_Klima
        communication-direction=IN, data-element=Grundumfang_XIX_SAM.Geltungsbereich_E3_1_1_UNECE_Gen2.RP_IF_DiETa_Lock_Unlock_Taste_XIX_Grundumfang_XIX_SAM.DE_DiETa_Lock_Unlock_Taste, system-signal=DiETa_Lock_Unlock_Taste
        communication-direction=IN, data-element=Grundumfang_XIX_SAM.Geltungsbereich_E3_1_1_UNECE_Gen2.RP_IF_DiETa_Mode_XIX_Grundumfang_XIX_SAM.DE_DiETa_Mode, system-signal=DiETa_Mode
        communication-direction=IN, data-element=Grundumfang_XIX_SAM.Geltungsbereich_E3_1_1_UNECE_Gen2.RP_IF_DiETa_Parken_XIX_Grundumfang_XIX_SAM.DE_DiETa_Parken, system-signal=DiETa_Parken
        communication-direction=IN, data-element=ABL_XIX_SAM.Geltungsbereich_E3_1_1_UNECE_Gen2.RP_IF_DiETa_ResponseError_XIX_ABL_XIX_SAM.DE_DiETa_ResponseError, system-signal=DiETa_ResponseError
        communication-direction=IN, data-element=Grundumfang_XIX_SAM.Geltungsbereich_E3_1_1_UNECE_Gen2.RP_IF_DiETa_ResponseError_XIX_Grundumfang_XIX_SAM.DE_DiETa_ResponseError, system-signal=DiETa_ResponseError
        communication-direction=IN, data-element=ABL_XIX_SAM.Geltungsbereich_E3_1_1_UNECE_Gen2.RP_IF_DiETa_Status_XIX_ABL_XIX_SAM.DE_DiETa_Status, system-signal=DiETa_Status
        communication-direction=IN, data-element=Grundumfang_XIX_SAM.Geltungsbereich_E3_1_1_UNECE_Gen2.RP_IF_DiETa_Status_XIX_Grundumfang_XIX_SAM.DE_DiETa_Status, system-signal=DiETa_Status
        communication-direction=IN, data-element=ABL_XIX_SAM.Geltungsbereich_E3_1_1_UNECE_Gen2.RP_IF_DiETa_Warnblink_Taste_XIX_ABL_XIX_SAM.DE_DiETa_Warnblink_Taste, system-signal=DiETa_Warnblink_Taste
        communication-direction=IN, data-element=Grundumfang_XIX_SAM.Geltungsbereich_E3_1_1_UNECE_Gen2.RP_IF_DLI_Ambex_RefStatus_XIX_Grundumfang_XIX_SAM.DE_DLI_Ambex_RefStatus, system-signal=DLI_Ambex_RefStatus
        communication-direction=IN, data-element=Grundumfang_XIX_SAM.Geltungsbereich_E3_1_1_UNECE_Gen2.RP_IF_DRB1_01_BZ_XIX_Grundumfang_XIX_SAM.DE_DRB1_01_BZ, system-signal=DRB1_01_BZ
        communication-direction=IN, data-element=Grundumfang_XIX_SAM.Geltungsbereich_E3_1_1_UNECE_Gen2.RP_IF_DRB1_01_CRC_XIX_Grundumfang_XIX_SAM.DE_DRB1_01_CRC, system-signal=DRB1_01_CRC
        communication-direction=IN, data-element=Grundumfang_XIX_SAM.Geltungsbereich_E3_1_1_UNECE_Gen2.RP_IF_DRB1_ORUData_XIX_Grundumfang_XIX_SAM.DE_DRB1_ORUData, system-signal=DRB1_ORUData
        communication-direction=IN, data-element=Grundumfang_XIX_SAM.Geltungsbereich_E3_1_1_UNECE_Gen2.RP_IF_DRB1_ORUDataIndex_XIX_Grundumfang_XIX_SAM.DE_DRB1_ORUDataIndex, system-signal=DRB1_ORUDataIndex
        communication-direction=IN, data-element=Grundumfang_XIX_SAM.Geltungsbereich_E3_1_1_UNECE_Gen2.RP_IF_DRB2_01_BZ_XIX_Grundumfang_XIX_SAM.DE_DRB2_01_BZ, system-signal=DRB2_01_BZ
        communication-direction=IN, data-element=Grundumfang_XIX_SAM.Geltungsbereich_E3_1_1_UNECE_Gen2.RP_IF_DRB2_01_CRC_XIX_Grundumfang_XIX_SAM.DE_DRB2_01_CRC, system-signal=DRB2_01_CRC
        communication-direction=IN, data-element=Grundumfang_XIX_SAM.Geltungsbereich_E3_1_1_UNECE_Gen2.RP_IF_DRB2_ORUData_XIX_Grundumfang_XIX_SAM.DE_DRB2_ORUData, system-signal=DRB2_ORUData
        communication-direction=IN, data-element=Grundumfang_XIX_SAM.Geltungsbereich_E3_1_1_UNECE_Gen2.RP_IF_DRB2_ORUDataIndex_XIX_Grundumfang_XIX_SAM.DE_DRB2_ORUDataIndex, system-signal=DRB2_ORUDataIndex
        communication-direction=IN, data-element=Grundumfang_XIX_SAM.Geltungsbereich_E3_1_1_UNECE_Gen2.RP_IF_EA_Fahrzeughupe_Anf_XIX_Grundumfang_XIX_SAM.DE_EA_Fahrzeughupe_Anf, system-signal=EA_Fahrzeughupe_Anf
        communication-direction=IN, data-element=Grundumfang_XIX_SAM.Geltungsbereich_E3_1_1_UNECE_Gen2.RP_IF_EA_Innenraumlicht_Anf_XIX_Grundumfang_XIX_SAM.DE_EA_Innenraumlicht_Anf, system-signal=EA_Innenraumlicht_Anf
        communication-direction=IN, data-element=Grundumfang_XIX_SAM.Geltungsbereich_E3_1_1_UNECE_Gen2.RP_IF_EBKV_2Box_ORUDataIndex_XIX_Grundumfang_XIX_SAM.DE_EBKV_2Box_ORUDataIndex, system-signal=EBKV_2Box_ORUDataIndex
        communication-direction=IN, data-element=Grundumfang_XIX_SAM.Geltungsbereich_E3_1_1_UNECE_Gen2.RP_IF_EBKV_ORUData_XIX_Grundumfang_XIX_SAM.DE_EBKV_ORUData, system-signal=EBKV_ORUData
        communication-direction=IN, data-element=Grundumfang_XIX_SAM.Geltungsbereich_E3_1_1_UNECE_Gen2.RP_IF_eFuse1_ORUData_XIX_Grundumfang_XIX_SAM.DE_eFuse1_ORUData, system-signal=eFuse1_ORUData
        communication-direction=IN, data-element=Grundumfang_XIX_SAM.Geltungsbereich_E3_1_1_UNECE_Gen2.RP_IF_eFuse1_ORUDataIndex_XIX_Grundumfang_XIX_SAM.DE_eFuse1_ORUDataIndex, system-signal=eFuse1_ORUDataIndex
        communication-direction=IN, data-element=Grundumfang_XIX_SAM.Geltungsbereich_E3_1_1_UNECE_Gen2.RP_IF_eFuse3_ORUData_XIX_Grundumfang_XIX_SAM.DE_eFuse3_ORUData, system-signal=eFuse3_ORUData
        communication-direction=IN, data-element=Grundumfang_XIX_SAM.Geltungsbereich_E3_1_1_UNECE_Gen2.RP_IF_eFuse3_ORUDataIndex_XIX_Grundumfang_XIX_SAM.DE_eFuse3_ORUDataIndex, system-signal=eFuse3_ORUDataIndex
        communication-direction=IN, data-element=Grundumfang_XIX_SAM.Geltungsbereich_E3_1_1_UNECE_Gen2.RP_IF_EM1_HYB_13_BZ_XIX_Grundumfang_XIX_SAM.DE_EM1_HYB_13_BZ, system-signal=EM1_HYB_13_BZ
        communication-direction=IN, data-element=Grundumfang_XIX_SAM.Geltungsbereich_E3_1_1_UNECE_Gen2.RP_IF_EM1_HYB_13_CRC_XIX_Grundumfang_XIX_SAM.DE_EM1_HYB_13_CRC, system-signal=EM1_HYB_13_CRC
        communication-direction=IN, data-element=Grundumfang_XIX_SAM.Geltungsbereich_E3_1_1_UNECE_Gen2.RP_IF_EM2_HYB_13_BZ_XIX_Grundumfang_XIX_SAM.DE_EM2_HYB_13_BZ, system-signal=EM2_HYB_13_BZ
        communication-direction=IN, data-element=Grundumfang_XIX_SAM.Geltungsbereich_E3_1_1_UNECE_Gen2.RP_IF_EM2_HYB_13_CRC_XIX_Grundumfang_XIX_SAM.DE_EM2_HYB_13_CRC, system-signal=EM2_HYB_13_CRC
        communication-direction=OUT, data-element=Grundumfang_XIX_SAM.Geltungsbereich_E3_1_1_UNECE_Gen2.SP_IF_Empfindlichkeit_LS_XIX_Grundumfang_XIX_SAM.DE_Empfindlichkeit_LS, system-signal=Empfindlichkeit_LS
        communication-direction=OUT, data-element=Grundumfang_XIX_SAM.Geltungsbereich_E3_1_1_UNECE_Gen2.SP_IF_Empfindlichkeit_RS_XIX_Grundumfang_XIX_SAM.DE_Empfindlichkeit_RS, system-signal=Empfindlichkeit_RS
        communication-direction=IN, data-element=Grundumfang_XIX_SAM.Geltungsbereich_E3_1_1_UNECE_Gen2.RP_IF_EPB_Status_02_XIX_Grundumfang_XIX_SAM.DE_EPB_Status_02, system-signal=EPB_Status_02
        communication-direction=IN, data-element=Grundumfang_XIX_SAM.Geltungsbereich_E3_1_1_UNECE_Gen2.RP_IF_EPH_ORUData_XIX_Grundumfang_XIX_SAM.DE_EPH_ORUData, system-signal=EPH_ORUData
        communication-direction=IN, data-element=Grundumfang_XIX_SAM.Geltungsbereich_E3_1_1_UNECE_Gen2.RP_IF_EPH_ORUDataIndex_XIX_Grundumfang_XIX_SAM.DE_EPH_ORUDataIndex, system-signal=EPH_ORUDataIndex
        communication-direction=IN, data-element=Grundumfang_XIX_SAM.Geltungsbereich_E3_1_1_UNECE_Gen2.RP_IF_eRWK_AD_oeffnen_Anf_XIX_Grundumfang_XIX_SAM.DE_eRWK_AD_oeffnen_Anf, system-signal=eRWK_AD_oeffnen_Anf
        communication-direction=IN, data-element=Grundumfang_XIX_SAM.Geltungsbereich_E3_1_1_UNECE_Gen2.RP_IF_eRWK_AD_schliessen_Anf_XIX_Grundumfang_XIX_SAM.DE_eRWK_AD_schliessen_Anf, system-signal=eRWK_AD_schliessen_Anf
        communication-direction=IN, data-element=Grundumfang_XIX_SAM.Geltungsbereich_E3_1_1_UNECE_Gen2.RP_IF_ESC_Bremsfluessigkeits_Sensor_XIX_Grundumfang_XIX_SAM.DE_ESC_Bremsfluessigkeits_Sensor, system-signal=ESC_Bremsfluessigkeits_Sensor
        communication-direction=IN, data-element=Grundumfang_XIX_SAM.Geltungsbereich_E3_1_1_UNECE_Gen2.RP_IF_ESC_ORUData_XIX_Grundumfang_XIX_SAM.DE_ESC_ORUData, system-signal=ESC_ORUData
        communication-direction=IN, data-element=Grundumfang_XIX_SAM.Geltungsbereich_E3_1_1_UNECE_Gen2.RP_IF_ESC_ORUDataIndex_XIX_Grundumfang_XIX_SAM.DE_ESC_ORUDataIndex, system-signal=ESC_ORUDataIndex
        communication-direction=IN, data-element=Grundumfang_XIX_SAM.Geltungsbereich_E3_1_1_UNECE_Gen2.RP_IF_ESC_v_Signal_Qualifier_High_Low_XIX_Grundumfang_XIX_SAM.DE_ESC_v_Signal_Qualifier_High_Low, system-signal=ESC_v_Signal_Qualifier_High_Low
        communication-direction=IN, data-element=Grundumfang_XIX_SAM.Geltungsbereich_E3_1_1_UNECE_Gen2.RP_IF_ESP_21_BZ_XIX_Grundumfang_XIX_SAM.DE_ESP_21_BZ, system-signal=ESP_21_BZ
        communication-direction=IN, data-element=Grundumfang_XIX_SAM.Geltungsbereich_E3_1_1_UNECE_Gen2.RP_IF_ESP_21_CRC_XIX_Grundumfang_XIX_SAM.DE_ESP_21_CRC, system-signal=ESP_21_CRC
        communication-direction=IN, data-element=Grundumfang_XIX_SAM.Geltungsbereich_E3_1_1_UNECE_Gen2.RP_IF_ESP_Laengsbeschl_XIX_Grundumfang_XIX_SAM.DE_ESP_Laengsbeschl, system-signal=ESP_Laengsbeschl
        communication-direction=IN, data-element=Grundumfang_XIX_SAM.Geltungsbereich_E3_1_1_UNECE_Gen2.RP_IF_ESP_m_Raddrehz_XIX_Grundumfang_XIX_SAM.DE_ESP_m_Raddrehz, system-signal=ESP_m_Raddrehz
        communication-direction=IN, data-element=Grundumfang_XIX_SAM.Geltungsbereich_E3_1_1_UNECE_Gen2.RP_IF_ESP_QBit_v_Signal_XIX_Grundumfang_XIX_SAM.DE_ESP_QBit_v_Signal, system-signal=ESP_QBit_v_Signal
        communication-direction=IN, data-element=Grundumfang_XIX_SAM.Geltungsbereich_E3_1_1_UNECE_Gen2.RP_IF_ESP_Querbeschleunigung_XIX_Grundumfang_XIX_SAM.DE_ESP_Querbeschleunigung, system-signal=ESP_Querbeschleunigung
        communication-direction=IN, data-element=Grundumfang_XIX_SAM.Geltungsbereich_E3_1_1_UNECE_Gen2.RP_IF_ESP_Status_Bremsentemp_02_XIX_Grundumfang_XIX_SAM.DE_ESP_Status_Bremsentemp_02, system-signal=ESP_Status_Bremsentemp_02
        communication-direction=IN, data-element=Grundumfang_XIX_SAM.Geltungsbereich_E3_1_1_UNECE_Gen2.RP_IF_ESP_v_Signal_XIX_Grundumfang_XIX_SAM.DE_ESP_v_Signal, system-signal=ESP_v_Signal
        communication-direction=OUT, data-element=Grundumfang_XIX_SAM.Geltungsbereich_E3_1_1_UNECE_Gen2.SP_IF_ESP_v_Signal_XIX_Grundumfang_XIX_SAM.DE_ESP_v_Signal, system-signal=ESP_v_Signal
        communication-direction=IN, data-element=VIP_XIX_SAM.Geltungsbereich_E3_1_1_UNECE_Gen2.RP_IF_ESP_v_Signal_XIX_VIP_XIX_SAM.DE_ESP_v_Signal, system-signal=ESP_v_Signal
        communication-direction=OUT, data-element=Grundumfang_XIX_SAM.Geltungsbereich_E3_1_1_UNECE_Gen2.SP_IF_ESP_v_Signal_8Bit_XIX_Grundumfang_XIX_SAM.DE_ESP_v_Signal_8Bit, system-signal=ESP_v_Signal_8Bit
        communication-direction=IN, data-element=Grundumfang_XIX_SAM.Geltungsbereich_E3_1_1_UNECE_Gen2.RP_IF_Fahrerdisplay_Kombi_ORUData_XIX_Grundumfang_XIX_SAM.DE_Fahrerdisplay_Kombi_ORUData, system-signal=Fahrerdisplay_Kombi_ORUData
        communication-direction=IN, data-element=Grundumfang_XIX_SAM.Geltungsbereich_E3_1_1_UNECE_Gen2.RP_IF_Fahrerdisplay_Kombi_ORUDataIndex_XIX_Grundumfang_XIX_SAM.DE_Fahrerdisplay_Kombi_ORUDataIndex, system-signal=Fahrerdisplay_Kombi_ORUDataIndex
        communication-direction=OUT, data-element=Grundumfang_XIX_SAM.Geltungsbereich_E3_1_1_UNECE_Gen2.SP_IF_FAS_Profile_Taster_XIX_Grundumfang_XIX_SAM.DE_FAS_Profile_Taster, system-signal=FAS_Profile_Taster
        communication-direction=IN, data-element=Grundumfang_XIX_SAM.Geltungsbereich_E3_1_1_UNECE_Gen2.RP_IF_FAS_Taster_XIX_Grundumfang_XIX_SAM.DE_FAS_Taster, system-signal=FAS_Taster
        communication-direction=OUT, data-element=Grundumfang_XIX_SAM.Geltungsbereich_E3_1_1_UNECE_Gen2.SP_IF_FAS_Taster_XIX_Grundumfang_XIX_SAM.DE_FAS_Taster, system-signal=FAS_Taster
        communication-direction=IN, data-element=Grundumfang_XIX_SAM.Geltungsbereich_E3_1_1_UNECE_Gen2.RP_IF_FAS_Taster_Fehler_XIX_Grundumfang_XIX_SAM.DE_FAS_Taster_Fehler, system-signal=FAS_Taster_Fehler
        communication-direction=OUT, data-element=Grundumfang_XIX_SAM.Geltungsbereich_E3_1_1_UNECE_Gen2.SP_IF_FAS_Taster_Fehler_XIX_Grundumfang_XIX_SAM.DE_FAS_Taster_Fehler, system-signal=FAS_Taster_Fehler
        communication-direction=IN, data-element=Grundumfang_XIX_SAM.Geltungsbereich_E3_1_1_UNECE_Gen2.RP_IF_FASFrontradar_ORUData_XIX_Grundumfang_XIX_SAM.DE_FASFrontradar_ORUData, system-signal=FASFrontradar_ORUData
        communication-direction=IN, data-element=Grundumfang_XIX_SAM.Geltungsbereich_E3_1_1_UNECE_Gen2.RP_IF_FASFrontradar_ORUDataIndex_XIX_Grundumfang_XIX_SAM.DE_FASFrontradar_ORUDataIndex, system-signal=FASFrontradar_ORUDataIndex
        communication-direction=IN, data-element=Grundumfang_XIX_SAM.Geltungsbereich_E3_1_1_UNECE_Gen2.RP_IF_FFB_HDF_Taste_XIX_Grundumfang_XIX_SAM.DE_FFB_HDF_Taste, system-signal=FFB_HDF_Taste
        communication-direction=IN, data-element=Grundumfang_XIX_SAM.Geltungsbereich_E3_1_1_UNECE_Gen2.RP_IF_FH_HBFS_hoch_XIX_Grundumfang_XIX_SAM.DE_FH_HBFS_hoch, system-signal=FH_HBFS_hoch
        communication-direction=IN, data-element=Grundumfang_XIX_SAM.Geltungsbereich_E3_1_1_UNECE_Gen2.RP_IF_FH_HBFS_tief_XIX_Grundumfang_XIX_SAM.DE_FH_HBFS_tief, system-signal=FH_HBFS_tief
        communication-direction=IN, data-element=Grundumfang_XIX_SAM.Geltungsbereich_E3_1_1_UNECE_Gen2.RP_IF_FH_HFS_hoch_XIX_Grundumfang_XIX_SAM.DE_FH_HFS_hoch, system-signal=FH_HFS_hoch
        communication-direction=IN, data-element=Grundumfang_XIX_SAM.Geltungsbereich_E3_1_1_UNECE_Gen2.RP_IF_FH_HFS_tief_XIX_Grundumfang_XIX_SAM.DE_FH_HFS_tief, system-signal=FH_HFS_tief
        communication-direction=OUT, data-element=Grundumfang_XIX_SAM.Geltungsbereich_E3_1_1_UNECE_Gen2.SP_IF_FHSG_MST_Architektur_XIX_Grundumfang_XIX_SAM.DE_FHSG_MST_Architektur, system-signal=FHSG_MST_Architektur
        communication-direction=OUT, data-element=Grundumfang_XIX_SAM.Geltungsbereich_E3_1_1_UNECE_Gen2.SP_IF_FHSG_MST_Aussentemp_ungefiltert_XIX_Grundumfang_XIX_SAM.DE_FHSG_MST_Aussentemp_ungefiltert, system-signal=FHSG_MST_Aussentemp_ungefiltert
        communication-direction=OUT, data-element=Grundumfang_XIX_SAM.Geltungsbereich_E3_1_1_UNECE_Gen2.SP_IF_FHSG_MST_BT_Blockerwartung_XIX_Grundumfang_XIX_SAM.DE_FHSG_MST_BT_Blockerwartung, system-signal=FHSG_MST_BT_Blockerwartung
        communication-direction=OUT, data-element=Grundumfang_XIX_SAM.Geltungsbereich_E3_1_1_UNECE_Gen2.SP_IF_FHSG_MST_Crashfall_erkannt_XIX_Grundumfang_XIX_SAM.DE_FHSG_MST_Crashfall_erkannt, system-signal=FHSG_MST_Crashfall_erkannt
        communication-direction=OUT, data-element=Grundumfang_XIX_SAM.Geltungsbereich_E3_1_1_UNECE_Gen2.SP_IF_FHSG_MST_FH_HBFS_AutoHoch_XIX_Grundumfang_XIX_SAM.DE_FHSG_MST_FH_HBFS_AutoHoch, system-signal=FHSG_MST_FH_HBFS_AutoHoch
        communication-direction=OUT, data-element=Grundumfang_XIX_SAM.Geltungsbereich_E3_1_1_UNECE_Gen2.SP_IF_FHSG_MST_FH_HBFS_AutoTief_XIX_Grundumfang_XIX_SAM.DE_FHSG_MST_FH_HBFS_AutoTief, system-signal=FHSG_MST_FH_HBFS_AutoTief
        communication-direction=OUT, data-element=Grundumfang_XIX_SAM.Geltungsbereich_E3_1_1_UNECE_Gen2.SP_IF_FHSG_MST_FH_HBFS_ManHoch_XIX_Grundumfang_XIX_SAM.DE_FHSG_MST_FH_HBFS_ManHoch, system-signal=FHSG_MST_FH_HBFS_ManHoch
        communication-direction=OUT, data-element=Grundumfang_XIX_SAM.Geltungsbereich_E3_1_1_UNECE_Gen2.SP_IF_FHSG_MST_FH_HBFS_ManTief_XIX_Grundumfang_XIX_SAM.DE_FHSG_MST_FH_HBFS_ManTief, system-signal=FHSG_MST_FH_HBFS_ManTief
        communication-direction=OUT, data-element=Grundumfang_XIX_SAM.Geltungsbereich_E3_1_1_UNECE_Gen2.SP_IF_FHSG_MST_FH_HFS_AutoHoch_XIX_Grundumfang_XIX_SAM.DE_FHSG_MST_FH_HFS_AutoHoch, system-signal=FHSG_MST_FH_HFS_AutoHoch
        communication-direction=OUT, data-element=Grundumfang_XIX_SAM.Geltungsbereich_E3_1_1_UNECE_Gen2.SP_IF_FHSG_MST_FH_HFS_AutoTief_XIX_Grundumfang_XIX_SAM.DE_FHSG_MST_FH_HFS_AutoTief, system-signal=FHSG_MST_FH_HFS_AutoTief
        communication-direction=OUT, data-element=Grundumfang_XIX_SAM.Geltungsbereich_E3_1_1_UNECE_Gen2.SP_IF_FHSG_MST_FH_HFS_ManHoch_XIX_Grundumfang_XIX_SAM.DE_FHSG_MST_FH_HFS_ManHoch, system-signal=FHSG_MST_FH_HFS_ManHoch
        communication-direction=OUT, data-element=Grundumfang_XIX_SAM.Geltungsbereich_E3_1_1_UNECE_Gen2.SP_IF_FHSG_MST_FH_HFS_ManTief_XIX_Grundumfang_XIX_SAM.DE_FHSG_MST_FH_HFS_ManTief, system-signal=FHSG_MST_FH_HFS_ManTief
        communication-direction=OUT, data-element=Grundumfang_XIX_SAM.Geltungsbereich_E3_1_1_UNECE_Gen2.SP_IF_FHSG_MST_FH_KomfortHoch_XIX_Grundumfang_XIX_SAM.DE_FHSG_MST_FH_KomfortHoch, system-signal=FHSG_MST_FH_KomfortHoch
        communication-direction=OUT, data-element=Grundumfang_XIX_SAM.Geltungsbereich_E3_1_1_UNECE_Gen2.SP_IF_FHSG_MST_FH_Komforttief_XIX_Grundumfang_XIX_SAM.DE_FHSG_MST_FH_Komforttief, system-signal=FHSG_MST_FH_Komforttief
        communication-direction=OUT, data-element=Grundumfang_XIX_SAM.Geltungsbereich_E3_1_1_UNECE_Gen2.SP_IF_FHSG_MST_FT_Blockerwartung_XIX_Grundumfang_XIX_SAM.DE_FHSG_MST_FT_Blockerwartung, system-signal=FHSG_MST_FT_Blockerwartung
        communication-direction=OUT, data-element=Grundumfang_XIX_SAM.Geltungsbereich_E3_1_1_UNECE_Gen2.SP_IF_FHSG_MST_FT_FH_H_Kisi_ein_XIX_Grundumfang_XIX_SAM.DE_FHSG_MST_FT_FH_H_Kisi_ein, system-signal=FHSG_MST_FT_FH_H_Kisi_ein
        communication-direction=OUT, data-element=Grundumfang_XIX_SAM.Geltungsbereich_E3_1_1_UNECE_Gen2.SP_IF_FHSG_MST_HBFS_Blockerwartung_XIX_Grundumfang_XIX_SAM.DE_FHSG_MST_HBFS_Blockerwartung, system-signal=FHSG_MST_HBFS_Blockerwartung
        communication-direction=OUT, data-element=Grundumfang_XIX_SAM.Geltungsbereich_E3_1_1_UNECE_Gen2.SP_IF_FHSG_MST_HFS_Blockerwartung_XIX_Grundumfang_XIX_SAM.DE_FHSG_MST_HFS_Blockerwartung, system-signal=FHSG_MST_HFS_Blockerwartung
        communication-direction=OUT, data-element=Grundumfang_XIX_SAM.Geltungsbereich_E3_1_1_UNECE_Gen2.SP_IF_FHSG_MST_Lenkigkeit_XIX_Grundumfang_XIX_SAM.DE_FHSG_MST_Lenkigkeit, system-signal=FHSG_MST_Lenkigkeit
        communication-direction=OUT, data-element=Grundumfang_XIX_SAM.Geltungsbereich_E3_1_1_UNECE_Gen2.SP_IF_FHSG_MST_Precrash_XIX_Grundumfang_XIX_SAM.DE_FHSG_MST_Precrash, system-signal=FHSG_MST_Precrash
        communication-direction=OUT, data-element=Grundumfang_XIX_SAM.Geltungsbereich_E3_1_1_UNECE_Gen2.SP_IF_FHSG_void_1_XIX_Grundumfang_XIX_SAM.DE_FHSG_void_1, system-signal=FHSG_void_1
        communication-direction=OUT, data-element=Grundumfang_XIX_SAM.Geltungsbereich_E3_1_1_UNECE_Gen2.SP_IF_FHSG_void_{3..8}_XIX_Grundumfang_XIX_SAM.DE_FHSG_void_{3..8}, system-signal=FHSG_void_{3..8}
        communication-direction=IN, data-element=Grundumfang_XIX_SAM.Geltungsbereich_E3_1_1_UNECE_Gen2.RP_IF_FoD_Transmission_Info_XIX_Grundumfang_XIX_SAM.DE_FoD_Transmission_Info, system-signal=FoD_Transmission_Info
        communication-direction=IN, data-element=SC_447_FoD_Slave_4_XIX_Softwareblock_XIX_SAM.Geltungsbereich_E3_1_1_UNECE_Gen2.RP_IF_FoD_Transmission_Info_XIX_SC_447_FoD_Slave_4_XIX_Softwareblock_XIX_SAM.DE_FoD_Transmission_Info, system-signal=FoD_Transmission_Info
        communication-direction=OUT, data-element=Grundumfang_XIX_SAM.Geltungsbereich_E3_1_1_UNECE_Gen2.SP_IF_Fronthaube_geoeffnet_XIX_Grundumfang_XIX_SAM.DE_Fronthaube_geoeffnet, system-signal=Fronthaube_geoeffnet
        communication-direction=IN, data-element=Grundumfang_XIX_SAM.Geltungsbereich_E3_1_1_UNECE_Gen2.RP_IF_FS_Luftfeuchte_rel_XIX_Grundumfang_XIX_SAM.DE_FS_Luftfeuchte_rel, system-signal=FS_Luftfeuchte_rel
        communication-direction=OUT, data-element=Grundumfang_XIX_SAM.Geltungsbereich_E3_1_1_UNECE_Gen2.SP_IF_FS_Luftfeuchte_rel_XIX_Grundumfang_XIX_SAM.DE_FS_Luftfeuchte_rel, system-signal=FS_Luftfeuchte_rel
        communication-direction=IN, data-element=Druckpunktmassage_fuer_Beifahrersitz_Lehnenmassage_SAM_XIX_DPMBFSLM_XIX_SAM.Geltungsbereich_E3_1_1_UNECE_Gen2.RP_IF_FS_MMB_glob_stop_XIX_Druckpunktmassage_fuer_Beifahrersitz_Lehnenmassage_SAM_XIX_DPMBFSLM_XIX_SAM.DE_FS_MMB_glob_stop, system-signal=FS_MMB_glob_stop
        communication-direction=IN, data-element=Druckpunktmassage_fuer_Fahrersitz_Lehnenmassage_SAM_XIX_DPMFSLM_XIX_SAM.Geltungsbereich_E3_1_1_UNECE_Gen2.RP_IF_FS_MMB_glob_stop_XIX_Druckpunktmassage_fuer_Fahrersitz_Lehnenmassage_SAM_XIX_DPMFSLM_XIX_SAM.DE_FS_MMB_glob_stop, system-signal=FS_MMB_glob_stop
        communication-direction=IN, data-element=Grundumfang_XIX_SAM.Geltungsbereich_E3_1_1_UNECE_Gen2.RP_IF_FS_MMB_glob_stop_XIX_Grundumfang_XIX_SAM.DE_FS_MMB_glob_stop, system-signal=FS_MMB_glob_stop
        communication-direction=IN, data-element=Druckpunktmassage_fuer_Beifahrersitz_Lehnenmassage_SAM_XIX_DPMBFSLM_XIX_SAM.Geltungsbereich_E3_1_1_UNECE_Gen2.RP_IF_FS_MMB_storage_XIX_Druckpunktmassage_fuer_Beifahrersitz_Lehnenmassage_SAM_XIX_DPMBFSLM_XIX_SAM.DE_FS_MMB_storage, system-signal=FS_MMB_storage
        communication-direction=IN, data-element=Druckpunktmassage_fuer_Fahrersitz_Lehnenmassage_SAM_XIX_DPMFSLM_XIX_SAM.Geltungsbereich_E3_1_1_UNECE_Gen2.RP_IF_FS_MMB_storage_XIX_Druckpunktmassage_fuer_Fahrersitz_Lehnenmassage_SAM_XIX_DPMFSLM_XIX_SAM.DE_FS_MMB_storage, system-signal=FS_MMB_storage
        communication-direction=IN, data-element=Grundumfang_XIX_SAM.Geltungsbereich_E3_1_1_UNECE_Gen2.RP_IF_FS_MMB_storage_XIX_Grundumfang_XIX_SAM.DE_FS_MMB_storage, system-signal=FS_MMB_storage
        communication-direction=IN, data-element=Druckpunktmassage_fuer_Beifahrersitz_Lehnenmassage_SAM_XIX_DPMBFSLM_XIX_SAM.Geltungsbereich_E3_1_1_UNECE_Gen2.RP_IF_FS_MMB_tast_XIX_Druckpunktmassage_fuer_Beifahrersitz_Lehnenmassage_SAM_XIX_DPMBFSLM_XIX_SAM.DE_FS_MMB_tast, system-signal=FS_MMB_tast
        communication-direction=IN, data-element=Druckpunktmassage_fuer_Fahrersitz_Lehnenmassage_SAM_XIX_DPMFSLM_XIX_SAM.Geltungsbereich_E3_1_1_UNECE_Gen2.RP_IF_FS_MMB_tast_XIX_Druckpunktmassage_fuer_Fahrersitz_Lehnenmassage_SAM_XIX_DPMFSLM_XIX_SAM.DE_FS_MMB_tast, system-signal=FS_MMB_tast
        communication-direction=IN, data-element=Grundumfang_XIX_SAM.Geltungsbereich_E3_1_1_UNECE_Gen2.RP_IF_FS_MMB_tast_XIX_Grundumfang_XIX_SAM.DE_FS_MMB_tast, system-signal=FS_MMB_tast
        communication-direction=IN, data-element=Druckpunktmassage_fuer_Beifahrersitz_Lehnenmassage_SAM_XIX_DPMBFSLM_XIX_SAM.Geltungsbereich_E3_1_1_UNECE_Gen2.RP_IF_FS_MMB_tipp_XIX_Druckpunktmassage_fuer_Beifahrersitz_Lehnenmassage_SAM_XIX_DPMBFSLM_XIX_SAM.DE_FS_MMB_tipp, system-signal=FS_MMB_tipp
        communication-direction=IN, data-element=Druckpunktmassage_fuer_Fahrersitz_Lehnenmassage_SAM_XIX_DPMFSLM_XIX_SAM.Geltungsbereich_E3_1_1_UNECE_Gen2.RP_IF_FS_MMB_tipp_XIX_Druckpunktmassage_fuer_Fahrersitz_Lehnenmassage_SAM_XIX_DPMFSLM_XIX_SAM.DE_FS_MMB_tipp, system-signal=FS_MMB_tipp
        communication-direction=IN, data-element=Grundumfang_XIX_SAM.Geltungsbereich_E3_1_1_UNECE_Gen2.RP_IF_FS_MMB_tipp_XIX_Grundumfang_XIX_SAM.DE_FS_MMB_tipp, system-signal=FS_MMB_tipp
        communication-direction=IN, data-element=Grundumfang_XIX_SAM.Geltungsbereich_E3_1_1_UNECE_Gen2.RP_IF_FS_ResponseError_XIX_Grundumfang_XIX_SAM.DE_FS_ResponseError, system-signal=FS_ResponseError
        communication-direction=OUT, data-element=Grundumfang_XIX_SAM.Geltungsbereich_E3_1_1_UNECE_Gen2.SP_IF_FS_ResponseError_XIX_Grundumfang_XIX_SAM.DE_FS_ResponseError, system-signal=FS_ResponseError
        communication-direction=IN, data-element=Grundumfang_XIX_SAM.Geltungsbereich_E3_1_1_UNECE_Gen2.RP_IF_FS_Taupunkt_XIX_Grundumfang_XIX_SAM.DE_FS_Taupunkt, system-signal=FS_Taupunkt
        communication-direction=OUT, data-element=Grundumfang_XIX_SAM.Geltungsbereich_E3_1_1_UNECE_Gen2.SP_IF_FS_Taupunkt_XIX_Grundumfang_XIX_SAM.DE_FS_Taupunkt, system-signal=FS_Taupunkt
        communication-direction=IN, data-element=Grundumfang_XIX_SAM.Geltungsbereich_E3_1_1_UNECE_Gen2.RP_IF_FS_Temp_Scheibe_XIX_Grundumfang_XIX_SAM.DE_FS_Temp_Scheibe, system-signal=FS_Temp_Scheibe
        communication-direction=OUT, data-element=Grundumfang_XIX_SAM.Geltungsbereich_E3_1_1_UNECE_Gen2.SP_IF_FS_Temp_Scheibe_XIX_Grundumfang_XIX_SAM.DE_FS_Temp_Scheibe, system-signal=FS_Temp_Scheibe
        communication-direction=IN, data-element=Grundumfang_XIX_SAM.Geltungsbereich_E3_1_1_UNECE_Gen2.RP_IF_FS_Temp_Sensor_XIX_Grundumfang_XIX_SAM.DE_FS_Temp_Sensor, system-signal=FS_Temp_Sensor
        communication-direction=OUT, data-element=Grundumfang_XIX_SAM.Geltungsbereich_E3_1_1_UNECE_Gen2.SP_IF_FS_Temp_Sensor_XIX_Grundumfang_XIX_SAM.DE_FS_Temp_Sensor, system-signal=FS_Temp_Sensor
        communication-direction=IN, data-element=Grundumfang_XIX_SAM.Geltungsbereich_E3_1_1_UNECE_Gen2.RP_IF_FT_FH_Bew_hoch_XIX_Grundumfang_XIX_SAM.DE_FT_FH_Bew_hoch, system-signal=FT_FH_Bew_hoch
        communication-direction=IN, data-element=Grundumfang_XIX_SAM.Geltungsbereich_E3_1_1_UNECE_Gen2.RP_IF_FT_FH_Bew_tief_XIX_Grundumfang_XIX_SAM.DE_FT_FH_Bew_tief, system-signal=FT_FH_Bew_tief
        communication-direction=IN, data-element=Grundumfang_XIX_SAM.Geltungsbereich_E3_1_1_UNECE_Gen2.RP_IF_FT_Kisi_li_aktiv_XIX_Grundumfang_XIX_SAM.DE_FT_Kisi_li_aktiv, system-signal=FT_Kisi_li_aktiv
        communication-direction=IN, data-element=Grundumfang_XIX_SAM.Geltungsbereich_E3_1_1_UNECE_Gen2.RP_IF_FT_Kisi_re_aktiv_XIX_Grundumfang_XIX_SAM.DE_FT_Kisi_re_aktiv, system-signal=FT_Kisi_re_aktiv
        communication-direction=IN, data-element=Grundumfang_XIX_SAM.Geltungsbereich_E3_1_1_UNECE_Gen2.RP_IF_FT_Kisi_Taster_li_XIX_Grundumfang_XIX_SAM.DE_FT_Kisi_Taster_li, system-signal=FT_Kisi_Taster_li
        communication-direction=IN, data-element=ZV_XIX_SAM.Geltungsbereich_E3_1_1_UNECE_Gen2.RP_IF_FT_Kisi_Taster_li_02_XIX_ZV_XIX_SAM.DE_FT_Kisi_Taster_li_02, system-signal=FT_Kisi_Taster_li_02
        communication-direction=IN, data-element=Grundumfang_XIX_SAM.Geltungsbereich_E3_1_1_UNECE_Gen2.RP_IF_FT_Kisi_Taster_re_XIX_Grundumfang_XIX_SAM.DE_FT_Kisi_Taster_re, system-signal=FT_Kisi_Taster_re
        communication-direction=IN, data-element=ZV_XIX_SAM.Geltungsbereich_E3_1_1_UNECE_Gen2.RP_IF_FT_Kisi_Taster_re_02_XIX_ZV_XIX_SAM.DE_FT_Kisi_Taster_re_02, system-signal=FT_Kisi_Taster_re_02
        communication-direction=IN, data-element=Grundumfang_XIX_SAM.Geltungsbereich_E3_1_1_UNECE_Gen2.RP_IF_FT_Oben_Block_erw_XIX_Grundumfang_XIX_SAM.DE_FT_Oben_Block_erw, system-signal=FT_Oben_Block_erw
        communication-direction=IN, data-element=Grundumfang_XIX_SAM.Geltungsbereich_E3_1_1_UNECE_Gen2.RP_IF_FT_Sp_Blk_def_XIX_Grundumfang_XIX_SAM.DE_FT_Sp_Blk_def, system-signal=FT_Sp_Blk_def
        communication-direction=IN, data-element=Grundumfang_XIX_SAM.Geltungsbereich_E3_1_1_UNECE_Gen2.RP_IF_FT_Tuer_geoeffnet_XIX_Grundumfang_XIX_SAM.DE_FT_Tuer_geoeffnet, system-signal=FT_Tuer_geoeffnet
        communication-direction=IN, data-element=Grundumfang_XIX_SAM.Geltungsbereich_E3_1_1_UNECE_Gen2.RP_IF_FT_Unten_Block_erw_XIX_Grundumfang_XIX_SAM.DE_FT_Unten_Block_erw, system-signal=FT_Unten_Block_erw
        communication-direction=IN, data-element=Grundumfang_XIX_SAM.Geltungsbereich_E3_1_1_UNECE_Gen2.RP_IF_GE_Fahrstufe_XIX_Grundumfang_XIX_SAM.DE_GE_Fahrstufe, system-signal=GE_Fahrstufe
        communication-direction=IN, data-element=Grundumfang_XIX_SAM.Geltungsbereich_E3_1_1_UNECE_Gen2.RP_IF_HBFS_Fehler_Beleuchtung_XIX_Grundumfang_XIX_SAM.DE_HBFS_Fehler_Beleuchtung, system-signal=HBFS_Fehler_Beleuchtung
        communication-direction=IN, data-element=Grundumfang_XIX_SAM.Geltungsbereich_E3_1_1_UNECE_Gen2.RP_IF_HBFS_Fehler_FH_Normierung_XIX_Grundumfang_XIX_SAM.DE_HBFS_Fehler_FH_Normierung, system-signal=HBFS_Fehler_FH_Normierung
        communication-direction=IN, data-element=Grundumfang_XIX_SAM.Geltungsbereich_E3_1_1_UNECE_Gen2.RP_IF_HBFS_Fehler_FH_Schalter_XIX_Grundumfang_XIX_SAM.DE_HBFS_Fehler_FH_Schalter, system-signal=HBFS_Fehler_FH_Schalter
        communication-direction=IN, data-element=Grundumfang_XIX_SAM.Geltungsbereich_E3_1_1_UNECE_Gen2.RP_IF_HBFS_Fehler_Hallsensor_XIX_Grundumfang_XIX_SAM.DE_HBFS_Fehler_Hallsensor, system-signal=HBFS_Fehler_Hallsensor
        communication-direction=IN, data-element=Grundumfang_XIX_SAM.Geltungsbereich_E3_1_1_UNECE_Gen2.RP_IF_HBFS_Fehler_Kodierdaten_XIX_Grundumfang_XIX_SAM.DE_HBFS_Fehler_Kodierdaten, system-signal=HBFS_Fehler_Kodierdaten
        communication-direction=IN, data-element=Grundumfang_XIX_SAM.Geltungsbereich_E3_1_1_UNECE_Gen2.RP_IF_HBFS_Fehler_Parameter_XIX_Grundumfang_XIX_SAM.DE_HBFS_Fehler_Parameter, system-signal=HBFS_Fehler_Parameter
        communication-direction=IN, data-element=Grundumfang_XIX_SAM.Geltungsbereich_E3_1_1_UNECE_Gen2.RP_IF_HBFS_Fehler_SG_XIX_Grundumfang_XIX_SAM.DE_HBFS_Fehler_SG, system-signal=HBFS_Fehler_SG
        communication-direction=IN, data-element=Grundumfang_XIX_SAM.Geltungsbereich_E3_1_1_UNECE_Gen2.RP_IF_HBFS_FH_Bew_hoch_XIX_Grundumfang_XIX_SAM.DE_HBFS_FH_Bew_hoch, system-signal=HBFS_FH_Bew_hoch
        communication-direction=OUT, data-element=Grundumfang_XIX_SAM.Geltungsbereich_E3_1_1_UNECE_Gen2.SP_IF_HBFS_FH_Bew_hoch_XIX_Grundumfang_XIX_SAM.DE_HBFS_FH_Bew_hoch, system-signal=HBFS_FH_Bew_hoch
        communication-direction=IN, data-element=Grundumfang_XIX_SAM.Geltungsbereich_E3_1_1_UNECE_Gen2.RP_IF_HBFS_FH_Bew_tief_XIX_Grundumfang_XIX_SAM.DE_HBFS_FH_Bew_tief, system-signal=HBFS_FH_Bew_tief
        communication-direction=OUT, data-element=Grundumfang_XIX_SAM.Geltungsbereich_E3_1_1_UNECE_Gen2.SP_IF_HBFS_FH_Bew_tief_XIX_Grundumfang_XIX_SAM.DE_HBFS_FH_Bew_tief, system-signal=HBFS_FH_Bew_tief
        communication-direction=IN, data-element=Grundumfang_XIX_SAM.Geltungsbereich_E3_1_1_UNECE_Gen2.RP_IF_HBFS_FH_Block_XIX_Grundumfang_XIX_SAM.DE_HBFS_FH_Block, system-signal=HBFS_FH_Block
        communication-direction=OUT, data-element=Grundumfang_XIX_SAM.Geltungsbereich_E3_1_1_UNECE_Gen2.SP_IF_HBFS_FH_Block_XIX_Grundumfang_XIX_SAM.DE_HBFS_FH_Block, system-signal=HBFS_FH_Block
        communication-direction=IN, data-element=Grundumfang_XIX_SAM.Geltungsbereich_E3_1_1_UNECE_Gen2.RP_IF_HBFS_FH_Fang_XIX_Grundumfang_XIX_SAM.DE_HBFS_FH_Fang, system-signal=HBFS_FH_Fang
        communication-direction=OUT, data-element=Grundumfang_XIX_SAM.Geltungsbereich_E3_1_1_UNECE_Gen2.SP_IF_HBFS_FH_Fang_XIX_Grundumfang_XIX_SAM.DE_HBFS_FH_Fang, system-signal=HBFS_FH_Fang
        communication-direction=IN, data-element=Grundumfang_XIX_SAM.Geltungsbereich_E3_1_1_UNECE_Gen2.RP_IF_HBFS_FH_normiert_XIX_Grundumfang_XIX_SAM.DE_HBFS_FH_normiert, system-signal=HBFS_FH_normiert
        communication-direction=OUT, data-element=Grundumfang_XIX_SAM.Geltungsbereich_E3_1_1_UNECE_Gen2.SP_IF_HBFS_FH_normiert_XIX_Grundumfang_XIX_SAM.DE_HBFS_FH_normiert, system-signal=HBFS_FH_normiert
        communication-direction=IN, data-element=Grundumfang_XIX_SAM.Geltungsbereich_E3_1_1_UNECE_Gen2.RP_IF_HBFS_FH_Oeffnung_XIX_Grundumfang_XIX_SAM.DE_HBFS_FH_Oeffnung, system-signal=HBFS_FH_Oeffnung
        communication-direction=OUT, data-element=Grundumfang_XIX_SAM.Geltungsbereich_E3_1_1_UNECE_Gen2.SP_IF_HBFS_FH_Oeffnung_XIX_Grundumfang_XIX_SAM.DE_HBFS_FH_Oeffnung, system-signal=HBFS_FH_Oeffnung
        communication-direction=IN, data-element=Grundumfang_XIX_SAM.Geltungsbereich_E3_1_1_UNECE_Gen2.RP_IF_HBFS_FH_S_AutoHoch_XIX_Grundumfang_XIX_SAM.DE_HBFS_FH_S_AutoHoch, system-signal=HBFS_FH_S_AutoHoch
        communication-direction=OUT, data-element=Grundumfang_XIX_SAM.Geltungsbereich_E3_1_1_UNECE_Gen2.SP_IF_HBFS_FH_S_AutoHoch_XIX_Grundumfang_XIX_SAM.DE_HBFS_FH_S_AutoHoch, system-signal=HBFS_FH_S_AutoHoch
        communication-direction=IN, data-element=Grundumfang_XIX_SAM.Geltungsbereich_E3_1_1_UNECE_Gen2.RP_IF_HBFS_FH_S_AutoTief_XIX_Grundumfang_XIX_SAM.DE_HBFS_FH_S_AutoTief, system-signal=HBFS_FH_S_AutoTief
        communication-direction=OUT, data-element=Grundumfang_XIX_SAM.Geltungsbereich_E3_1_1_UNECE_Gen2.SP_IF_HBFS_FH_S_AutoTief_XIX_Grundumfang_XIX_SAM.DE_HBFS_FH_S_AutoTief, system-signal=HBFS_FH_S_AutoTief
        communication-direction=IN, data-element=Grundumfang_XIX_SAM.Geltungsbereich_E3_1_1_UNECE_Gen2.RP_IF_HBFS_FH_S_ManHoch_XIX_Grundumfang_XIX_SAM.DE_HBFS_FH_S_ManHoch, system-signal=HBFS_FH_S_ManHoch
        communication-direction=OUT, data-element=Grundumfang_XIX_SAM.Geltungsbereich_E3_1_1_UNECE_Gen2.SP_IF_HBFS_FH_S_ManHoch_XIX_Grundumfang_XIX_SAM.DE_HBFS_FH_S_ManHoch, system-signal=HBFS_FH_S_ManHoch
        communication-direction=IN, data-element=Grundumfang_XIX_SAM.Geltungsbereich_E3_1_1_UNECE_Gen2.RP_IF_HBFS_FH_S_ManTief_XIX_Grundumfang_XIX_SAM.DE_HBFS_FH_S_ManTief, system-signal=HBFS_FH_S_ManTief
        communication-direction=OUT, data-element=Grundumfang_XIX_SAM.Geltungsbereich_E3_1_1_UNECE_Gen2.SP_IF_HBFS_FH_S_ManTief_XIX_Grundumfang_XIX_SAM.DE_HBFS_FH_S_ManTief, system-signal=HBFS_FH_S_ManTief
        communication-direction=IN, data-element=Grundumfang_XIX_SAM.Geltungsbereich_E3_1_1_UNECE_Gen2.RP_IF_HBFS_FH_Thermo_XIX_Grundumfang_XIX_SAM.DE_HBFS_FH_Thermo, system-signal=HBFS_FH_Thermo
        communication-direction=OUT, data-element=Grundumfang_XIX_SAM.Geltungsbereich_E3_1_1_UNECE_Gen2.SP_IF_HBFS_FH_Thermo_XIX_Grundumfang_XIX_SAM.DE_HBFS_FH_Thermo, system-signal=HBFS_FH_Thermo
        communication-direction=IN, data-element=Grundumfang_XIX_SAM.Geltungsbereich_E3_1_1_UNECE_Gen2.RP_IF_HBFS_FH_Ueberspannung_XIX_Grundumfang_XIX_SAM.DE_HBFS_FH_Ueberspannung, system-signal=HBFS_FH_Ueberspannung
        communication-direction=IN, data-element=Grundumfang_XIX_SAM.Geltungsbereich_E3_1_1_UNECE_Gen2.RP_IF_HBFS_FH_Unterspannung_XIX_Grundumfang_XIX_SAM.DE_HBFS_FH_Unterspannung, system-signal=HBFS_FH_Unterspannung
        communication-direction=OUT, data-element=Grundumfang_XIX_SAM.Geltungsbereich_E3_1_1_UNECE_Gen2.SP_IF_HBFS_gesafet_XIX_Grundumfang_XIX_SAM.DE_HBFS_gesafet, system-signal=HBFS_gesafet
        communication-direction=OUT, data-element=Grundumfang_XIX_SAM.Geltungsbereich_E3_1_1_UNECE_Gen2.SP_IF_HBFS_Heckrollotaster_betaetigt_XIX_Grundumfang_XIX_SAM.DE_HBFS_Heckrollotaster_betaetigt, system-signal=HBFS_Heckrollotaster_betaetigt
        communication-direction=OUT, data-element=Grundumfang_XIX_SAM.Geltungsbereich_E3_1_1_UNECE_Gen2.SP_IF_HBFS_KiSi_Fehler_XIX_Grundumfang_XIX_SAM.DE_HBFS_KiSi_Fehler, system-signal=HBFS_KiSi_Fehler
        communication-direction=OUT, data-element=Grundumfang_XIX_SAM.Geltungsbereich_E3_1_1_UNECE_Gen2.SP_IF_HBFS_Lock_Taster_inv_XIX_Grundumfang_XIX_SAM.DE_HBFS_Lock_Taster_inv, system-signal=HBFS_Lock_Taster_inv
        communication-direction=IN, data-element=Grundumfang_XIX_SAM.Geltungsbereich_E3_1_1_UNECE_Gen2.RP_IF_HBFS_Oben_Block_erw_XIX_Grundumfang_XIX_SAM.DE_HBFS_Oben_Block_erw, system-signal=HBFS_Oben_Block_erw
        communication-direction=OUT, data-element=Grundumfang_XIX_SAM.Geltungsbereich_E3_1_1_UNECE_Gen2.SP_IF_HBFS_Oben_Block_erw_XIX_Grundumfang_XIX_SAM.DE_HBFS_Oben_Block_erw, system-signal=HBFS_Oben_Block_erw
        communication-direction=IN, data-element=Grundumfang_XIX_SAM.Geltungsbereich_E3_1_1_UNECE_Gen2.RP_IF_HBFS_RelaisFehler_XIX_Grundumfang_XIX_SAM.DE_HBFS_RelaisFehler, system-signal=HBFS_RelaisFehler
        communication-direction=IN, data-element=Grundumfang_XIX_SAM.Geltungsbereich_E3_1_1_UNECE_Gen2.RP_IF_HBFS_ResponseError_XIX_Grundumfang_XIX_SAM.DE_HBFS_ResponseError, system-signal=HBFS_ResponseError
        communication-direction=OUT, data-element=Grundumfang_XIX_SAM.Geltungsbereich_E3_1_1_UNECE_Gen2.SP_IF_HBFS_Seitenrollo_hoch_XIX_Grundumfang_XIX_SAM.DE_HBFS_Seitenrollo_hoch, system-signal=HBFS_Seitenrollo_hoch
        communication-direction=OUT, data-element=Grundumfang_XIX_SAM.Geltungsbereich_E3_1_1_UNECE_Gen2.SP_IF_HBFS_Seitenrollo_tief_XIX_Grundumfang_XIX_SAM.DE_HBFS_Seitenrollo_tief, system-signal=HBFS_Seitenrollo_tief
        communication-direction=OUT, data-element=Grundumfang_XIX_SAM.Geltungsbereich_E3_1_1_UNECE_Gen2.SP_IF_HBFS_SK_betaetigt_XIX_Grundumfang_XIX_SAM.DE_HBFS_SK_betaetigt, system-signal=HBFS_SK_betaetigt
        communication-direction=IN, data-element=Grundumfang_XIX_SAM.Geltungsbereich_E3_1_1_UNECE_Gen2.RP_IF_HBFS_SleepIndication_XIX_Grundumfang_XIX_SAM.DE_HBFS_SleepIndication, system-signal=HBFS_SleepIndication
        communication-direction=OUT, data-element=Grundumfang_XIX_SAM.Geltungsbereich_E3_1_1_UNECE_Gen2.SP_IF_HBFS_Sperrklinke_XIX_Grundumfang_XIX_SAM.DE_HBFS_Sperrklinke, system-signal=HBFS_Sperrklinke
        communication-direction=IN, data-element=Grundumfang_XIX_SAM.Geltungsbereich_E3_1_1_UNECE_Gen2.RP_IF_HBFS_Status_KiSi_XIX_Grundumfang_XIX_SAM.DE_HBFS_Status_KiSi, system-signal=HBFS_Status_KiSi
        communication-direction=OUT, data-element=Grundumfang_XIX_SAM.Geltungsbereich_E3_1_1_UNECE_Gen2.SP_IF_HBFS_Status_KiSi_XIX_Grundumfang_XIX_SAM.DE_HBFS_Status_KiSi, system-signal=HBFS_Status_KiSi
        communication-direction=OUT, data-element=Grundumfang_XIX_SAM.Geltungsbereich_E3_1_1_UNECE_Gen2.SP_IF_HBFS_Status_KiSi_inv_XIX_Grundumfang_XIX_SAM.DE_HBFS_Status_KiSi_inv, system-signal=HBFS_Status_KiSi_inv
        communication-direction=IN, data-element=Grundumfang_XIX_SAM.Geltungsbereich_E3_1_1_UNECE_Gen2.RP_IF_HBFS_Status_Routine_XIX_Grundumfang_XIX_SAM.DE_HBFS_Status_Routine, system-signal=HBFS_Status_Routine
        communication-direction=IN, data-element=Grundumfang_XIX_SAM.Geltungsbereich_E3_1_1_UNECE_Gen2.RP_IF_HBFS_Status_Stellgliedtest_XIX_Grundumfang_XIX_SAM.DE_HBFS_Status_Stellgliedtest, system-signal=HBFS_Status_Stellgliedtest
        communication-direction=OUT, data-element=Grundumfang_XIX_SAM.Geltungsbereich_E3_1_1_UNECE_Gen2.SP_IF_HBFS_TAG_betaetigt_XIX_Grundumfang_XIX_SAM.DE_HBFS_TAG_betaetigt, system-signal=HBFS_TAG_betaetigt
        communication-direction=OUT, data-element=Grundumfang_XIX_SAM.Geltungsbereich_E3_1_1_UNECE_Gen2.SP_IF_HBFS_TCR_Mode_aktiv_XIX_Grundumfang_XIX_SAM.DE_HBFS_TCR_Mode_aktiv, system-signal=HBFS_TCR_Mode_aktiv
        communication-direction=IN, data-element=Grundumfang_XIX_SAM.Geltungsbereich_E3_1_1_UNECE_Gen2.RP_IF_HBFS_TIG_betaetigt_XIX_Grundumfang_XIX_SAM.DE_HBFS_TIG_betaetigt, system-signal=HBFS_TIG_betaetigt
        communication-direction=OUT, data-element=Grundumfang_XIX_SAM.Geltungsbereich_E3_1_1_UNECE_Gen2.SP_IF_HBFS_TIG_betaetigt_XIX_Grundumfang_XIX_SAM.DE_HBFS_TIG_betaetigt, system-signal=HBFS_TIG_betaetigt
        communication-direction=OUT, data-element=Grundumfang_XIX_SAM.Geltungsbereich_E3_1_1_UNECE_Gen2.SP_IF_HBFS_TIG_betaetigt_oeffnen_XIX_Grundumfang_XIX_SAM.DE_HBFS_TIG_betaetigt_oeffnen, system-signal=HBFS_TIG_betaetigt_oeffnen
        communication-direction=OUT, data-element=Grundumfang_XIX_SAM.Geltungsbereich_E3_1_1_UNECE_Gen2.SP_IF_HBFS_TIG_betaetigt_schliessen_XIX_Grundumfang_XIX_SAM.DE_HBFS_TIG_betaetigt_schliessen, system-signal=HBFS_TIG_betaetigt_schliessen
        communication-direction=IN, data-element=Grundumfang_XIX_SAM.Geltungsbereich_E3_1_1_UNECE_Gen2.RP_IF_HBFS_Tuer_geoeffnet_XIX_Grundumfang_XIX_SAM.DE_HBFS_Tuer_geoeffnet, system-signal=HBFS_Tuer_geoeffnet
        communication-direction=OUT, data-element=Grundumfang_XIX_SAM.Geltungsbereich_E3_1_1_UNECE_Gen2.SP_IF_HBFS_Tuer_geoeffnet_XIX_Grundumfang_XIX_SAM.DE_HBFS_Tuer_geoeffnet, system-signal=HBFS_Tuer_geoeffnet
        communication-direction=OUT, data-element=Grundumfang_XIX_SAM.Geltungsbereich_E3_1_1_UNECE_Gen2.SP_IF_HBFS_Tuer_Status_XIX_Grundumfang_XIX_SAM.DE_HBFS_Tuer_Status, system-signal=HBFS_Tuer_Status
        communication-direction=OUT, data-element=Grundumfang_XIX_SAM.Geltungsbereich_E3_1_1_UNECE_Gen2.SP_IF_HBFS_Tueroeffnen_Warnung_XIX_Grundumfang_XIX_SAM.DE_HBFS_Tueroeffnen_Warnung, system-signal=HBFS_Tueroeffnen_Warnung
        communication-direction=OUT, data-element=Grundumfang_XIX_SAM.Geltungsbereich_E3_1_1_UNECE_Gen2.SP_IF_HBFS_Tuerschloss_defekt_XIX_Grundumfang_XIX_SAM.DE_HBFS_Tuerschloss_defekt, system-signal=HBFS_Tuerschloss_defekt
        communication-direction=IN, data-element=Grundumfang_XIX_SAM.Geltungsbereich_E3_1_1_UNECE_Gen2.RP_IF_HBFS_UEKB_aktiviert_XIX_Grundumfang_XIX_SAM.DE_HBFS_UEKB_aktiviert, system-signal=HBFS_UEKB_aktiviert
        communication-direction=OUT, data-element=Grundumfang_XIX_SAM.Geltungsbereich_E3_1_1_UNECE_Gen2.SP_IF_HBFS_UEKB_aktiviert_XIX_Grundumfang_XIX_SAM.DE_HBFS_UEKB_aktiviert, system-signal=HBFS_UEKB_aktiviert
        communication-direction=IN, data-element=Grundumfang_XIX_SAM.Geltungsbereich_E3_1_1_UNECE_Gen2.RP_IF_HBFS_Unten_Block_erw_XIX_Grundumfang_XIX_SAM.DE_HBFS_Unten_Block_erw, system-signal=HBFS_Unten_Block_erw
        communication-direction=OUT, data-element=Grundumfang_XIX_SAM.Geltungsbereich_E3_1_1_UNECE_Gen2.SP_IF_HBFS_Unten_Block_erw_XIX_Grundumfang_XIX_SAM.DE_HBFS_Unten_Block_erw, system-signal=HBFS_Unten_Block_erw
        communication-direction=OUT, data-element=Grundumfang_XIX_SAM.Geltungsbereich_E3_1_1_UNECE_Gen2.SP_IF_HBFS_verriegelt_XIX_Grundumfang_XIX_SAM.DE_HBFS_verriegelt, system-signal=HBFS_verriegelt
        communication-direction=OUT, data-element=Grundumfang_XIX_SAM.Geltungsbereich_E3_1_1_UNECE_Gen2.SP_IF_HBFS_Vorraste_betaetigt_XIX_Grundumfang_XIX_SAM.DE_HBFS_Vorraste_betaetigt, system-signal=HBFS_Vorraste_betaetigt
        communication-direction=OUT, data-element=Grundumfang_XIX_SAM.Geltungsbereich_E3_1_1_UNECE_Gen2.SP_IF_HD_Hauptraste_XIX_Grundumfang_XIX_SAM.DE_HD_Hauptraste, system-signal=HD_Hauptraste
        communication-direction=OUT, data-element=Grundumfang_XIX_SAM.Geltungsbereich_E3_1_1_UNECE_Gen2.SP_IF_HD_Hauptraste_Auth_XIX_Grundumfang_XIX_SAM.DE_HD_Hauptraste_Auth, system-signal=HD_Hauptraste_Auth
        communication-direction=OUT, data-element=Grundumfang_XIX_SAM.Geltungsbereich_E3_1_1_UNECE_Gen2.SP_IF_HD_Vorraste_XIX_Grundumfang_XIX_SAM.DE_HD_Vorraste, system-signal=HD_Vorraste
        communication-direction=OUT, data-element=Grundumfang_XIX_SAM.Geltungsbereich_E3_1_1_UNECE_Gen2.SP_IF_HD_Vorraste_Auth_XIX_Grundumfang_XIX_SAM.DE_HD_Vorraste_Auth, system-signal=HD_Vorraste_Auth
        communication-direction=IN, data-element=Grundumfang_XIX_SAM.Geltungsbereich_E3_1_1_UNECE_Gen2.RP_IF_HFS_Fehler_Beleuchtung_XIX_Grundumfang_XIX_SAM.DE_HFS_Fehler_Beleuchtung, system-signal=HFS_Fehler_Beleuchtung
        communication-direction=IN, data-element=Grundumfang_XIX_SAM.Geltungsbereich_E3_1_1_UNECE_Gen2.RP_IF_HFS_Fehler_FH_Normierung_XIX_Grundumfang_XIX_SAM.DE_HFS_Fehler_FH_Normierung, system-signal=HFS_Fehler_FH_Normierung
        communication-direction=IN, data-element=Grundumfang_XIX_SAM.Geltungsbereich_E3_1_1_UNECE_Gen2.RP_IF_HFS_Fehler_FH_Schalter_XIX_Grundumfang_XIX_SAM.DE_HFS_Fehler_FH_Schalter, system-signal=HFS_Fehler_FH_Schalter
        communication-direction=IN, data-element=Grundumfang_XIX_SAM.Geltungsbereich_E3_1_1_UNECE_Gen2.RP_IF_HFS_Fehler_Hallsensor_XIX_Grundumfang_XIX_SAM.DE_HFS_Fehler_Hallsensor, system-signal=HFS_Fehler_Hallsensor
        communication-direction=IN, data-element=Grundumfang_XIX_SAM.Geltungsbereich_E3_1_1_UNECE_Gen2.RP_IF_HFS_Fehler_Kodierdaten_XIX_Grundumfang_XIX_SAM.DE_HFS_Fehler_Kodierdaten, system-signal=HFS_Fehler_Kodierdaten
        communication-direction=IN, data-element=Grundumfang_XIX_SAM.Geltungsbereich_E3_1_1_UNECE_Gen2.RP_IF_HFS_Fehler_Parameter_XIX_Grundumfang_XIX_SAM.DE_HFS_Fehler_Parameter, system-signal=HFS_Fehler_Parameter
        communication-direction=IN, data-element=Grundumfang_XIX_SAM.Geltungsbereich_E3_1_1_UNECE_Gen2.RP_IF_HFS_Fehler_SG_XIX_Grundumfang_XIX_SAM.DE_HFS_Fehler_SG, system-signal=HFS_Fehler_SG
        communication-direction=IN, data-element=Grundumfang_XIX_SAM.Geltungsbereich_E3_1_1_UNECE_Gen2.RP_IF_HFS_FH_Bew_hoch_XIX_Grundumfang_XIX_SAM.DE_HFS_FH_Bew_hoch, system-signal=HFS_FH_Bew_hoch
        communication-direction=OUT, data-element=Grundumfang_XIX_SAM.Geltungsbereich_E3_1_1_UNECE_Gen2.SP_IF_HFS_FH_Bew_hoch_XIX_Grundumfang_XIX_SAM.DE_HFS_FH_Bew_hoch, system-signal=HFS_FH_Bew_hoch
        communication-direction=IN, data-element=Grundumfang_XIX_SAM.Geltungsbereich_E3_1_1_UNECE_Gen2.RP_IF_HFS_FH_Bew_tief_XIX_Grundumfang_XIX_SAM.DE_HFS_FH_Bew_tief, system-signal=HFS_FH_Bew_tief
        communication-direction=OUT, data-element=Grundumfang_XIX_SAM.Geltungsbereich_E3_1_1_UNECE_Gen2.SP_IF_HFS_FH_Bew_tief_XIX_Grundumfang_XIX_SAM.DE_HFS_FH_Bew_tief, system-signal=HFS_FH_Bew_tief
        communication-direction=IN, data-element=Grundumfang_XIX_SAM.Geltungsbereich_E3_1_1_UNECE_Gen2.RP_IF_HFS_FH_Block_XIX_Grundumfang_XIX_SAM.DE_HFS_FH_Block, system-signal=HFS_FH_Block
        communication-direction=OUT, data-element=Grundumfang_XIX_SAM.Geltungsbereich_E3_1_1_UNECE_Gen2.SP_IF_HFS_FH_Block_XIX_Grundumfang_XIX_SAM.DE_HFS_FH_Block, system-signal=HFS_FH_Block
        communication-direction=IN, data-element=Grundumfang_XIX_SAM.Geltungsbereich_E3_1_1_UNECE_Gen2.RP_IF_HFS_FH_Fang_XIX_Grundumfang_XIX_SAM.DE_HFS_FH_Fang, system-signal=HFS_FH_Fang
        communication-direction=OUT, data-element=Grundumfang_XIX_SAM.Geltungsbereich_E3_1_1_UNECE_Gen2.SP_IF_HFS_FH_Fang_XIX_Grundumfang_XIX_SAM.DE_HFS_FH_Fang, system-signal=HFS_FH_Fang
        communication-direction=IN, data-element=Grundumfang_XIX_SAM.Geltungsbereich_E3_1_1_UNECE_Gen2.RP_IF_HFS_FH_normiert_XIX_Grundumfang_XIX_SAM.DE_HFS_FH_normiert, system-signal=HFS_FH_normiert
        communication-direction=OUT, data-element=Grundumfang_XIX_SAM.Geltungsbereich_E3_1_1_UNECE_Gen2.SP_IF_HFS_FH_normiert_XIX_Grundumfang_XIX_SAM.DE_HFS_FH_normiert, system-signal=HFS_FH_normiert
        communication-direction=IN, data-element=Grundumfang_XIX_SAM.Geltungsbereich_E3_1_1_UNECE_Gen2.RP_IF_HFS_FH_Oeffnung_XIX_Grundumfang_XIX_SAM.DE_HFS_FH_Oeffnung, system-signal=HFS_FH_Oeffnung
        communication-direction=OUT, data-element=Grundumfang_XIX_SAM.Geltungsbereich_E3_1_1_UNECE_Gen2.SP_IF_HFS_FH_Oeffnung_XIX_Grundumfang_XIX_SAM.DE_HFS_FH_Oeffnung, system-signal=HFS_FH_Oeffnung
        communication-direction=IN, data-element=Grundumfang_XIX_SAM.Geltungsbereich_E3_1_1_UNECE_Gen2.RP_IF_HFS_FH_S_AutoHoch_XIX_Grundumfang_XIX_SAM.DE_HFS_FH_S_AutoHoch, system-signal=HFS_FH_S_AutoHoch
        communication-direction=OUT, data-element=Grundumfang_XIX_SAM.Geltungsbereich_E3_1_1_UNECE_Gen2.SP_IF_HFS_FH_S_AutoHoch_XIX_Grundumfang_XIX_SAM.DE_HFS_FH_S_AutoHoch, system-signal=HFS_FH_S_AutoHoch
        communication-direction=IN, data-element=Grundumfang_XIX_SAM.Geltungsbereich_E3_1_1_UNECE_Gen2.RP_IF_HFS_FH_S_AutoTief_XIX_Grundumfang_XIX_SAM.DE_HFS_FH_S_AutoTief, system-signal=HFS_FH_S_AutoTief
        communication-direction=OUT, data-element=Grundumfang_XIX_SAM.Geltungsbereich_E3_1_1_UNECE_Gen2.SP_IF_HFS_FH_S_AutoTief_XIX_Grundumfang_XIX_SAM.DE_HFS_FH_S_AutoTief, system-signal=HFS_FH_S_AutoTief
        communication-direction=IN, data-element=Grundumfang_XIX_SAM.Geltungsbereich_E3_1_1_UNECE_Gen2.RP_IF_HFS_FH_S_ManHoch_XIX_Grundumfang_XIX_SAM.DE_HFS_FH_S_ManHoch, system-signal=HFS_FH_S_ManHoch
        communication-direction=OUT, data-element=Grundumfang_XIX_SAM.Geltungsbereich_E3_1_1_UNECE_Gen2.SP_IF_HFS_FH_S_ManHoch_XIX_Grundumfang_XIX_SAM.DE_HFS_FH_S_ManHoch, system-signal=HFS_FH_S_ManHoch
        communication-direction=IN, data-element=Grundumfang_XIX_SAM.Geltungsbereich_E3_1_1_UNECE_Gen2.RP_IF_HFS_FH_S_ManTief_XIX_Grundumfang_XIX_SAM.DE_HFS_FH_S_ManTief, system-signal=HFS_FH_S_ManTief
        communication-direction=OUT, data-element=Grundumfang_XIX_SAM.Geltungsbereich_E3_1_1_UNECE_Gen2.SP_IF_HFS_FH_S_ManTief_XIX_Grundumfang_XIX_SAM.DE_HFS_FH_S_ManTief, system-signal=HFS_FH_S_ManTief
        communication-direction=IN, data-element=Grundumfang_XIX_SAM.Geltungsbereich_E3_1_1_UNECE_Gen2.RP_IF_HFS_FH_Thermo_XIX_Grundumfang_XIX_SAM.DE_HFS_FH_Thermo, system-signal=HFS_FH_Thermo
        communication-direction=OUT, data-element=Grundumfang_XIX_SAM.Geltungsbereich_E3_1_1_UNECE_Gen2.SP_IF_HFS_FH_Thermo_XIX_Grundumfang_XIX_SAM.DE_HFS_FH_Thermo, system-signal=HFS_FH_Thermo
        communication-direction=IN, data-element=Grundumfang_XIX_SAM.Geltungsbereich_E3_1_1_UNECE_Gen2.RP_IF_HFS_FH_Ueberspannung_XIX_Grundumfang_XIX_SAM.DE_HFS_FH_Ueberspannung, system-signal=HFS_FH_Ueberspannung
        communication-direction=IN, data-element=Grundumfang_XIX_SAM.Geltungsbereich_E3_1_1_UNECE_Gen2.RP_IF_HFS_FH_Unterspannung_XIX_Grundumfang_XIX_SAM.DE_HFS_FH_Unterspannung, system-signal=HFS_FH_Unterspannung
        communication-direction=OUT, data-element=Grundumfang_XIX_SAM.Geltungsbereich_E3_1_1_UNECE_Gen2.SP_IF_HFS_gesafet_XIX_Grundumfang_XIX_SAM.DE_HFS_gesafet, system-signal=HFS_gesafet
        communication-direction=OUT, data-element=Grundumfang_XIX_SAM.Geltungsbereich_E3_1_1_UNECE_Gen2.SP_IF_HFS_Heckrollotaster_betaetigt_XIX_Grundumfang_XIX_SAM.DE_HFS_Heckrollotaster_betaetigt, system-signal=HFS_Heckrollotaster_betaetigt
        communication-direction=OUT, data-element=Grundumfang_XIX_SAM.Geltungsbereich_E3_1_1_UNECE_Gen2.SP_IF_HFS_KiSi_Fehler_XIX_Grundumfang_XIX_SAM.DE_HFS_KiSi_Fehler, system-signal=HFS_KiSi_Fehler
        communication-direction=OUT, data-element=ZV_XIX_SAM.Geltungsbereich_E3_1_1_UNECE_Gen2.SP_IF_HFS_Lock_Taster_inv_XIX_ZV_XIX_SAM.DE_HFS_Lock_Taster_inv, system-signal=HFS_Lock_Taster_inv
        communication-direction=IN, data-element=Grundumfang_XIX_SAM.Geltungsbereich_E3_1_1_UNECE_Gen2.RP_IF_HFS_Oben_Block_erw_XIX_Grundumfang_XIX_SAM.DE_HFS_Oben_Block_erw, system-signal=HFS_Oben_Block_erw
        communication-direction=OUT, data-element=Grundumfang_XIX_SAM.Geltungsbereich_E3_1_1_UNECE_Gen2.SP_IF_HFS_Oben_Block_erw_XIX_Grundumfang_XIX_SAM.DE_HFS_Oben_Block_erw, system-signal=HFS_Oben_Block_erw
        communication-direction=IN, data-element=Grundumfang_XIX_SAM.Geltungsbereich_E3_1_1_UNECE_Gen2.RP_IF_HFS_RelaisFehler_XIX_Grundumfang_XIX_SAM.DE_HFS_RelaisFehler, system-signal=HFS_RelaisFehler
        communication-direction=IN, data-element=Grundumfang_XIX_SAM.Geltungsbereich_E3_1_1_UNECE_Gen2.RP_IF_HFS_ResponseError_XIX_Grundumfang_XIX_SAM.DE_HFS_ResponseError, system-signal=HFS_ResponseError
        communication-direction=OUT, data-element=Grundumfang_XIX_SAM.Geltungsbereich_E3_1_1_UNECE_Gen2.SP_IF_HFS_Seitenrollo_hoch_XIX_Grundumfang_XIX_SAM.DE_HFS_Seitenrollo_hoch, system-signal=HFS_Seitenrollo_hoch
        communication-direction=OUT, data-element=Grundumfang_XIX_SAM.Geltungsbereich_E3_1_1_UNECE_Gen2.SP_IF_HFS_Seitenrollo_tief_XIX_Grundumfang_XIX_SAM.DE_HFS_Seitenrollo_tief, system-signal=HFS_Seitenrollo_tief
        communication-direction=OUT, data-element=Grundumfang_XIX_SAM.Geltungsbereich_E3_1_1_UNECE_Gen2.SP_IF_HFS_SK_betaetigt_XIX_Grundumfang_XIX_SAM.DE_HFS_SK_betaetigt, system-signal=HFS_SK_betaetigt
        communication-direction=IN, data-element=Grundumfang_XIX_SAM.Geltungsbereich_E3_1_1_UNECE_Gen2.RP_IF_HFS_SleepIndication_XIX_Grundumfang_XIX_SAM.DE_HFS_SleepIndication, system-signal=HFS_SleepIndication
        communication-direction=IN, data-element=Grundumfang_XIX_SAM.Geltungsbereich_E3_1_1_UNECE_Gen2.RP_IF_HFS_Status_KiSi_XIX_Grundumfang_XIX_SAM.DE_HFS_Status_KiSi, system-signal=HFS_Status_KiSi
        communication-direction=OUT, data-element=Grundumfang_XIX_SAM.Geltungsbereich_E3_1_1_UNECE_Gen2.SP_IF_HFS_Status_KiSi_XIX_Grundumfang_XIX_SAM.DE_HFS_Status_KiSi, system-signal=HFS_Status_KiSi
        communication-direction=IN, data-element=Grundumfang_XIX_SAM.Geltungsbereich_E3_1_1_UNECE_Gen2.RP_IF_HFS_Status_Routine_XIX_Grundumfang_XIX_SAM.DE_HFS_Status_Routine, system-signal=HFS_Status_Routine
        communication-direction=IN, data-element=Grundumfang_XIX_SAM.Geltungsbereich_E3_1_1_UNECE_Gen2.RP_IF_HFS_Status_Stellgliedtest_XIX_Grundumfang_XIX_SAM.DE_HFS_Status_Stellgliedtest, system-signal=HFS_Status_Stellgliedtest
        communication-direction=OUT, data-element=Grundumfang_XIX_SAM.Geltungsbereich_E3_1_1_UNECE_Gen2.SP_IF_HFS_TAG_betaetigt_XIX_Grundumfang_XIX_SAM.DE_HFS_TAG_betaetigt, system-signal=HFS_TAG_betaetigt
        communication-direction=OUT, data-element=Grundumfang_XIX_SAM.Geltungsbereich_E3_1_1_UNECE_Gen2.SP_IF_HFS_TCR_Mode_aktiv_XIX_Grundumfang_XIX_SAM.DE_HFS_TCR_Mode_aktiv, system-signal=HFS_TCR_Mode_aktiv
        communication-direction=IN, data-element=Grundumfang_XIX_SAM.Geltungsbereich_E3_1_1_UNECE_Gen2.RP_IF_HFS_TIG_betaetigt_XIX_Grundumfang_XIX_SAM.DE_HFS_TIG_betaetigt, system-signal=HFS_TIG_betaetigt
        communication-direction=OUT, data-element=Grundumfang_XIX_SAM.Geltungsbereich_E3_1_1_UNECE_Gen2.SP_IF_HFS_TIG_betaetigt_XIX_Grundumfang_XIX_SAM.DE_HFS_TIG_betaetigt, system-signal=HFS_TIG_betaetigt
        communication-direction=OUT, data-element=Grundumfang_XIX_SAM.Geltungsbereich_E3_1_1_UNECE_Gen2.SP_IF_HFS_TIG_betaetigt_oeffnen_XIX_Grundumfang_XIX_SAM.DE_HFS_TIG_betaetigt_oeffnen, system-signal=HFS_TIG_betaetigt_oeffnen
        communication-direction=OUT, data-element=Grundumfang_XIX_SAM.Geltungsbereich_E3_1_1_UNECE_Gen2.SP_IF_HFS_TIG_betaetigt_schliessen_XIX_Grundumfang_XIX_SAM.DE_HFS_TIG_betaetigt_schliessen, system-signal=HFS_TIG_betaetigt_schliessen
        communication-direction=IN, data-element=Grundumfang_XIX_SAM.Geltungsbereich_E3_1_1_UNECE_Gen2.RP_IF_HFS_Tuer_geoeffnet_XIX_Grundumfang_XIX_SAM.DE_HFS_Tuer_geoeffnet, system-signal=HFS_Tuer_geoeffnet
        communication-direction=OUT, data-element=Grundumfang_XIX_SAM.Geltungsbereich_E3_1_1_UNECE_Gen2.SP_IF_HFS_Tuer_geoeffnet_XIX_Grundumfang_XIX_SAM.DE_HFS_Tuer_geoeffnet, system-signal=HFS_Tuer_geoeffnet
        communication-direction=OUT, data-element=Grundumfang_XIX_SAM.Geltungsbereich_E3_1_1_UNECE_Gen2.SP_IF_HFS_Tuer_Status_XIX_Grundumfang_XIX_SAM.DE_HFS_Tuer_Status, system-signal=HFS_Tuer_Status
        communication-direction=OUT, data-element=Grundumfang_XIX_SAM.Geltungsbereich_E3_1_1_UNECE_Gen2.SP_IF_HFS_Tuer_Status_QBit_XIX_Grundumfang_XIX_SAM.DE_HFS_Tuer_Status_QBit, system-signal=HFS_Tuer_Status_QBit
        communication-direction=OUT, data-element=Grundumfang_XIX_SAM.Geltungsbereich_E3_1_1_UNECE_Gen2.SP_IF_HFS_Tueroeffnen_Warnung_XIX_Grundumfang_XIX_SAM.DE_HFS_Tueroeffnen_Warnung, system-signal=HFS_Tueroeffnen_Warnung
        communication-direction=OUT, data-element=Grundumfang_XIX_SAM.Geltungsbereich_E3_1_1_UNECE_Gen2.SP_IF_HFS_Tuerschloss_defekt_XIX_Grundumfang_XIX_SAM.DE_HFS_Tuerschloss_defekt, system-signal=HFS_Tuerschloss_defekt
        communication-direction=IN, data-element=Grundumfang_XIX_SAM.Geltungsbereich_E3_1_1_UNECE_Gen2.RP_IF_HFS_UEKB_aktiviert_XIX_Grundumfang_XIX_SAM.DE_HFS_UEKB_aktiviert, system-signal=HFS_UEKB_aktiviert
        communication-direction=OUT, data-element=Grundumfang_XIX_SAM.Geltungsbereich_E3_1_1_UNECE_Gen2.SP_IF_HFS_UEKB_aktiviert_XIX_Grundumfang_XIX_SAM.DE_HFS_UEKB_aktiviert, system-signal=HFS_UEKB_aktiviert
        communication-direction=IN, data-element=Grundumfang_XIX_SAM.Geltungsbereich_E3_1_1_UNECE_Gen2.RP_IF_HFS_Unten_Block_erw_XIX_Grundumfang_XIX_SAM.DE_HFS_Unten_Block_erw, system-signal=HFS_Unten_Block_erw
        communication-direction=OUT, data-element=Grundumfang_XIX_SAM.Geltungsbereich_E3_1_1_UNECE_Gen2.SP_IF_HFS_Unten_Block_erw_XIX_Grundumfang_XIX_SAM.DE_HFS_Unten_Block_erw, system-signal=HFS_Unten_Block_erw
        communication-direction=OUT, data-element=Grundumfang_XIX_SAM.Geltungsbereich_E3_1_1_UNECE_Gen2.SP_IF_HFS_verriegelt_XIX_Grundumfang_XIX_SAM.DE_HFS_verriegelt, system-signal=HFS_verriegelt
        communication-direction=OUT, data-element=Grundumfang_XIX_SAM.Geltungsbereich_E3_1_1_UNECE_Gen2.SP_IF_HFS_Vorraste_betaetigt_XIX_Grundumfang_XIX_SAM.DE_HFS_Vorraste_betaetigt, system-signal=HFS_Vorraste_betaetigt
        communication-direction=IN, data-element=Grundumfang_XIX_SAM.Geltungsbereich_E3_1_1_UNECE_Gen2.RP_IF_HLR_LRH_Freigabe_XIX_Grundumfang_XIX_SAM.DE_HLR_LRH_Freigabe, system-signal=HLR_LRH_Freigabe
        communication-direction=OUT, data-element=Grundumfang_XIX_SAM.Geltungsbereich_E3_1_1_UNECE_Gen2.SP_IF_HLR_LRH_Freigabe_XIX_Grundumfang_XIX_SAM.DE_HLR_LRH_Freigabe, system-signal=HLR_LRH_Freigabe
        communication-direction=IN, data-element=Grundumfang_XIX_SAM.Geltungsbereich_E3_1_1_UNECE_Gen2.RP_IF_HMS_aktives_System_XIX_Grundumfang_XIX_SAM.DE_HMS_aktives_System, system-signal=HMS_aktives_System
        communication-direction=IN, data-element=Grundumfang_XIX_SAM.Geltungsbereich_E3_1_1_UNECE_Gen2.RP_IF_HMS_Fehlerstatus_XIX_Grundumfang_XIX_SAM.DE_HMS_Fehlerstatus, system-signal=HMS_Fehlerstatus
        communication-direction=IN, data-element=Grundumfang_XIX_SAM.Geltungsbereich_E3_1_1_UNECE_Gen2.RP_IF_HMS_parken_nicht_verfuegbar_XIX_Grundumfang_XIX_SAM.DE_HMS_parken_nicht_verfuegbar, system-signal=HMS_parken_nicht_verfuegbar
        communication-direction=IN, data-element=Grundumfang_XIX_SAM.Geltungsbereich_E3_1_1_UNECE_Gen2.RP_IF_HMS_Stillstand_XIX_Grundumfang_XIX_SAM.DE_HMS_Stillstand, system-signal=HMS_Stillstand
        communication-direction=IN, data-element=Grundumfang_XIX_SAM.Geltungsbereich_E3_1_1_UNECE_Gen2.RP_IF_HMS_Systemstatus_XIX_Grundumfang_XIX_SAM.DE_HMS_Systemstatus, system-signal=HMS_Systemstatus
        communication-direction=IN, data-element=Grundumfang_XIX_SAM.Geltungsbereich_E3_1_1_UNECE_Gen2.RP_IF_HSH_Relais_Anf_XIX_Grundumfang_XIX_SAM.DE_HSH_Relais_Anf, system-signal=HSH_Relais_Anf
        communication-direction=OUT, data-element=Grundumfang_XIX_SAM.Geltungsbereich_E3_1_1_UNECE_Gen2.SP_IF_HSH_Status_XIX_Grundumfang_XIX_SAM.DE_HSH_Status, system-signal=HSH_Status
        communication-direction=IN, data-element=Grundumfang_XIX_SAM.Geltungsbereich_E3_1_1_UNECE_Gen2.RP_IF_HUD_ORUData_XIX_Grundumfang_XIX_SAM.DE_HUD_ORUData, system-signal=HUD_ORUData
        communication-direction=IN, data-element=Grundumfang_XIX_SAM.Geltungsbereich_E3_1_1_UNECE_Gen2.RP_IF_HUD_ORUDataIndex_XIX_Grundumfang_XIX_SAM.DE_HUD_ORUDataIndex, system-signal=HUD_ORUDataIndex
        communication-direction=IN, data-element=Grundumfang_XIX_SAM.Geltungsbereich_E3_1_1_UNECE_Gen2.RP_IF_HVL_01_BZ_XIX_Grundumfang_XIX_SAM.DE_HVL_01_BZ, system-signal=HVL_01_BZ
        communication-direction=IN, data-element=Grundumfang_XIX_SAM.Geltungsbereich_E3_1_1_UNECE_Gen2.RP_IF_HVL_01_CRC_XIX_Grundumfang_XIX_SAM.DE_HVL_01_CRC, system-signal=HVL_01_CRC
        communication-direction=IN, data-element=Grundumfang_XIX_SAM.Geltungsbereich_E3_1_1_UNECE_Gen2.RP_IF_HVL_Steckerstatus_XIX_Grundumfang_XIX_SAM.DE_HVL_Steckerstatus, system-signal=HVL_Steckerstatus
        communication-direction=IN, data-element=Grundumfang_XIX_SAM.Geltungsbereich_E3_1_1_UNECE_Gen2.RP_IF_HVLS_Ladedose_SG1_alt_XIX_Grundumfang_XIX_SAM.DE_HVLS_Ladedose_SG1_alt, system-signal=HVLS_Ladedose_SG1_alt
        communication-direction=IN, data-element=Grundumfang_XIX_SAM.Geltungsbereich_E3_1_1_UNECE_Gen2.RP_IF_HVLS_Ladedose_SG2_alt_XIX_Grundumfang_XIX_SAM.DE_HVLS_Ladedose_SG2_alt, system-signal=HVLS_Ladedose_SG2_alt
        communication-direction=IN, data-element=Grundumfang_XIX_SAM.Geltungsbereich_E3_1_1_UNECE_Gen2.RP_IF_HVLS_Steckerstatus_SG1_XIX_Grundumfang_XIX_SAM.DE_HVLS_Steckerstatus_SG1, system-signal=HVLS_Steckerstatus_SG1
        communication-direction=IN, data-element=Grundumfang_XIX_SAM.Geltungsbereich_E3_1_1_UNECE_Gen2.RP_IF_HVLS_Steckerstatus_SG2_XIX_Grundumfang_XIX_SAM.DE_HVLS_Steckerstatus_SG2, system-signal=HVLS_Steckerstatus_SG2
        communication-direction=OUT, data-element=Grundumfang_XIX_SAM.Geltungsbereich_E3_1_1_UNECE_Gen2.SP_IF_HW_Drehfalle_Tuer_HL_XIX_Grundumfang_XIX_SAM.DE_HW_Drehfalle_Tuer_HL, system-signal=HW_Drehfalle_Tuer_HL
        communication-direction=OUT, data-element=Grundumfang_XIX_SAM.Geltungsbereich_E3_1_1_UNECE_Gen2.SP_IF_HW_Drehfalle_Tuer_HL_Auth_XIX_Grundumfang_XIX_SAM.DE_HW_Drehfalle_Tuer_HL_Auth, system-signal=HW_Drehfalle_Tuer_HL_Auth
        communication-direction=OUT, data-element=Grundumfang_XIX_SAM.Geltungsbereich_E3_1_1_UNECE_Gen2.SP_IF_HW_Drehfalle_Tuer_HR_XIX_Grundumfang_XIX_SAM.DE_HW_Drehfalle_Tuer_HR, system-signal=HW_Drehfalle_Tuer_HR
        communication-direction=OUT, data-element=Grundumfang_XIX_SAM.Geltungsbereich_E3_1_1_UNECE_Gen2.SP_IF_HW_Drehfalle_Tuer_HR_Auth_XIX_Grundumfang_XIX_SAM.DE_HW_Drehfalle_Tuer_HR_Auth, system-signal=HW_Drehfalle_Tuer_HR_Auth
        communication-direction=OUT, data-element=Grundumfang_XIX_SAM.Geltungsbereich_E3_1_1_UNECE_Gen2.SP_IF_HW_HD_Taste_Innenraum_XIX_Grundumfang_XIX_SAM.DE_HW_HD_Taste_Innenraum, system-signal=HW_HD_Taste_Innenraum
        communication-direction=OUT, data-element=ZV_XIX_SAM.Geltungsbereich_E3_1_1_UNECE_Gen2.SP_IF_HW_HSB_erkannt_XIX_ZV_XIX_SAM.DE_HW_HSB_erkannt, system-signal=HW_HSB_erkannt
        communication-direction=OUT, data-element=Grundumfang_XIX_SAM.Geltungsbereich_E3_1_1_UNECE_Gen2.SP_IF_HW_Softtouch_betaetigt_XIX_Grundumfang_XIX_SAM.DE_HW_Softtouch_betaetigt, system-signal=HW_Softtouch_betaetigt
        communication-direction=OUT, data-element=Grundumfang_XIX_SAM.Geltungsbereich_E3_1_1_UNECE_Gen2.SP_IF_HW_Status_Schloss_gesafet_HL_XIX_Grundumfang_XIX_SAM.DE_HW_Status_Schloss_gesafet_HL, system-signal=HW_Status_Schloss_gesafet_HL
        communication-direction=OUT, data-element=Grundumfang_XIX_SAM.Geltungsbereich_E3_1_1_UNECE_Gen2.SP_IF_HW_Status_Schloss_gesafet_HR_XIX_Grundumfang_XIX_SAM.DE_HW_Status_Schloss_gesafet_HR, system-signal=HW_Status_Schloss_gesafet_HR
        communication-direction=OUT, data-element=Grundumfang_XIX_SAM.Geltungsbereich_E3_1_1_UNECE_Gen2.SP_IF_HW_Status_Schloss_safed_HL_Auth_XIX_Grundumfang_XIX_SAM.DE_HW_Status_Schloss_safed_HL_Auth, system-signal=HW_Status_Schloss_safed_HL_Auth
        communication-direction=OUT, data-element=Grundumfang_XIX_SAM.Geltungsbereich_E3_1_1_UNECE_Gen2.SP_IF_HW_Status_Schloss_safed_HR_Auth_XIX_Grundumfang_XIX_SAM.DE_HW_Status_Schloss_safed_HR_Auth, system-signal=HW_Status_Schloss_safed_HR_Auth
        communication-direction=OUT, data-element=Grundumfang_XIX_SAM.Geltungsbereich_E3_1_1_UNECE_Gen2.SP_IF_HW_Status_Schloss_verr_HL_Auth_XIX_Grundumfang_XIX_SAM.DE_HW_Status_Schloss_verr_HL_Auth, system-signal=HW_Status_Schloss_verr_HL_Auth
        communication-direction=OUT, data-element=Grundumfang_XIX_SAM.Geltungsbereich_E3_1_1_UNECE_Gen2.SP_IF_HW_Status_Schloss_verr_HR_Auth_XIX_Grundumfang_XIX_SAM.DE_HW_Status_Schloss_verr_HR_Auth, system-signal=HW_Status_Schloss_verr_HR_Auth
        communication-direction=OUT, data-element=Grundumfang_XIX_SAM.Geltungsbereich_E3_1_1_UNECE_Gen2.SP_IF_HW_Status_Schloss_verriegelt_HL_XIX_Grundumfang_XIX_SAM.DE_HW_Status_Schloss_verriegelt_HL, system-signal=HW_Status_Schloss_verriegelt_HL
        communication-direction=OUT, data-element=Grundumfang_XIX_SAM.Geltungsbereich_E3_1_1_UNECE_Gen2.SP_IF_HW_Status_Schloss_verriegelt_HR_XIX_Grundumfang_XIX_SAM.DE_HW_Status_Schloss_verriegelt_HR, system-signal=HW_Status_Schloss_verriegelt_HR
        communication-direction=OUT, data-element=ZV_XIX_SAM.Geltungsbereich_E3_1_1_UNECE_Gen2.SP_IF_HW_Tankdeckel_offen_XIX_ZV_XIX_SAM.DE_HW_Tankdeckel_offen, system-signal=HW_Tankdeckel_offen
        communication-direction=IN, data-element=Grundumfang_XIX_SAM.Geltungsbereich_E3_1_1_UNECE_Gen2.RP_IF_ICAS1_X_ORUData_XIX_Grundumfang_XIX_SAM.DE_ICAS1_X_ORUData, system-signal=ICAS1_X_ORUData
        communication-direction=IN, data-element=Grundumfang_XIX_SAM.Geltungsbereich_E3_1_1_UNECE_Gen2.RP_IF_ICAS1_X_ORUDataIndex_XIX_Grundumfang_XIX_SAM.DE_ICAS1_X_ORUDataIndex, system-signal=ICAS1_X_ORUDataIndex
        communication-direction=IN, data-element=Grundumfang_XIX_SAM.Geltungsbereich_E3_1_1_UNECE_Gen2.RP_IF_ICC_eKiSi_Unterdrueck_XIX_Grundumfang_XIX_SAM.DE_ICC_eKiSi_Unterdrueck, system-signal=ICC_eKiSi_Unterdrueck
        communication-direction=IN, data-element=Grundumfang_XIX_SAM.Geltungsbereich_E3_1_1_UNECE_Gen2.RP_IF_ICC_Fernbed_ein_XIX_Grundumfang_XIX_SAM.DE_ICC_Fernbed_ein, system-signal=ICC_Fernbed_ein
        communication-direction=IN, data-element=Grundumfang_XIX_SAM.Geltungsbereich_E3_1_1_UNECE_Gen2.RP_IF_ICC_Innenraumbel_Unterdrueck_XIX_Grundumfang_XIX_SAM.DE_ICC_Innenraumbel_Unterdrueck, system-signal=ICC_Innenraumbel_Unterdrueck
        communication-direction=IN, data-element=SC_708_IuALicht_MEB_XIX_Softwareblock_XIX_SAM.Geltungsbereich_E3_1_1_UNECE_Gen2.RP_IF_ICC_Innenraumbel_Unterdrueck_XIX_SC_708_IuALicht_MEB_XIX_Softwareblock_XIX_SAM.DE_ICC_Innenraumbel_Unterdrueck, system-signal=ICC_Innenraumbel_Unterdrueck
        communication-direction=OUT, data-element=Grundumfang_XIX_SAM.Geltungsbereich_E3_1_1_UNECE_Gen2.SP_IF_IL_Dachkonsole_Adressat_XIX_Grundumfang_XIX_SAM.DE_IL_Dachkonsole_Adressat, system-signal=IL_Dachkonsole_Adressat
        communication-direction=OUT, data-element=SC_708_IuALicht_MEB_XIX_Softwareblock_XIX_SAM.Geltungsbereich_E3_1_1_UNECE_Gen2.SP_IF_IL_Dachkonsole_Adressat_XIX_SC_708_IuALicht_MEB_XIX_Softwareblock_XIX_SAM.DE_IL_Dachkonsole_Adressat, system-signal=IL_Dachkonsole_Adressat
        communication-direction=OUT, data-element=Grundumfang_XIX_SAM.Geltungsbereich_E3_1_1_UNECE_Gen2.SP_IF_IL_Dachkonsole_Dimmzeit_XIX_Grundumfang_XIX_SAM.DE_IL_Dachkonsole_Dimmzeit, system-signal=IL_Dachkonsole_Dimmzeit
        communication-direction=OUT, data-element=SC_708_IuALicht_MEB_XIX_Softwareblock_XIX_SAM.Geltungsbereich_E3_1_1_UNECE_Gen2.SP_IF_IL_Dachkonsole_Dimmzeit_XIX_SC_708_IuALicht_MEB_XIX_Softwareblock_XIX_SAM.DE_IL_Dachkonsole_Dimmzeit, system-signal=IL_Dachkonsole_Dimmzeit
        communication-direction=OUT, data-element=Grundumfang_XIX_SAM.Geltungsbereich_E3_1_1_UNECE_Gen2.SP_IF_IL_Dachkonsole_Zeitbasis_XIX_Grundumfang_XIX_SAM.DE_IL_Dachkonsole_Zeitbasis, system-signal=IL_Dachkonsole_Zeitbasis
        communication-direction=OUT, data-element=SC_708_IuALicht_MEB_XIX_Softwareblock_XIX_SAM.Geltungsbereich_E3_1_1_UNECE_Gen2.SP_IF_IL_Dachkonsole_Zeitbasis_XIX_SC_708_IuALicht_MEB_XIX_Softwareblock_XIX_SAM.DE_IL_Dachkonsole_Zeitbasis, system-signal=IL_Dachkonsole_Zeitbasis
        communication-direction=OUT, data-element=Grundumfang_XIX_SAM.Geltungsbereich_E3_1_1_UNECE_Gen2.SP_IF_IL_Dachkonsole_Zielhelligkeit_XIX_Grundumfang_XIX_SAM.DE_IL_Dachkonsole_Zielhelligkeit, system-signal=IL_Dachkonsole_Zielhelligkeit
        communication-direction=OUT, data-element=SC_708_IuALicht_MEB_XIX_Softwareblock_XIX_SAM.Geltungsbereich_E3_1_1_UNECE_Gen2.SP_IF_IL_Dachkonsole_Zielhelligkeit_XIX_SC_708_IuALicht_MEB_XIX_Softwareblock_XIX_SAM.DE_IL_Dachkonsole_Zielhelligkeit, system-signal=IL_Dachkonsole_Zielhelligkeit
        communication-direction=OUT, data-element=Dimmung_XIX_SAM.Geltungsbereich_E3_1_1_UNECE_Gen2.SP_IF_IL_Innenlicht_aktiv_XIX_Dimmung_XIX_SAM.DE_IL_Innenlicht_aktiv, system-signal=IL_Innenlicht_aktiv
        communication-direction=OUT, data-element=Grundumfang_XIX_SAM.Geltungsbereich_E3_1_1_UNECE_Gen2.SP_IF_IL_Innenlicht_aktiv_XIX_Grundumfang_XIX_SAM.DE_IL_Innenlicht_aktiv, system-signal=IL_Innenlicht_aktiv
        communication-direction=OUT, data-element=SC_708_IuALicht_MEB_XIX_Softwareblock_XIX_SAM.Geltungsbereich_E3_1_1_UNECE_Gen2.SP_IF_IL_Innenlicht_aktiv_XIX_SC_708_IuALicht_MEB_XIX_Softwareblock_XIX_SAM.DE_IL_Innenlicht_aktiv, system-signal=IL_Innenlicht_aktiv
        communication-direction=OUT, data-element=Grundumfang_XIX_SAM.Geltungsbereich_E3_1_1_UNECE_Gen2.SP_IF_IL_Klemme_30G_aktiv_XIX_Grundumfang_XIX_SAM.DE_IL_Klemme_30G_aktiv, system-signal=IL_Klemme_30G_aktiv
        communication-direction=OUT, data-element=SC_708_IuALicht_MEB_XIX_Softwareblock_XIX_SAM.Geltungsbereich_E3_1_1_UNECE_Gen2.SP_IF_IL_Klemme_30G_aktiv_XIX_SC_708_IuALicht_MEB_XIX_Softwareblock_XIX_SAM.DE_IL_Klemme_30G_aktiv, system-signal=IL_Klemme_30G_aktiv
        communication-direction=OUT, data-element=Grundumfang_XIX_SAM.Geltungsbereich_E3_1_1_UNECE_Gen2.SP_IF_IL_TSG_BFS_Dimmzeit_{1..4}_XIX_Grundumfang_XIX_SAM.DE_IL_TSG_BFS_Dimmzeit_{1..4}, system-signal=IL_TSG_BFS_Dimmzeit_{1..4}
        communication-direction=OUT, data-element=Grundumfang_XIX_SAM.Geltungsbereich_E3_1_1_UNECE_Gen2.SP_IF_IL_TSG_BFS_Dimmzeit_Basis_{1..4}_XIX_Grundumfang_XIX_SAM.DE_IL_TSG_BFS_Dimmzeit_Basis_{1..4}, system-signal=IL_TSG_BFS_Dimmzeit_Basis_{1..4}
        communication-direction=OUT, data-element=Grundumfang_XIX_SAM.Geltungsbereich_E3_1_1_UNECE_Gen2.SP_IF_IL_TSG_BFS_Zielhelligkeit_{1..4}_XIX_Grundumfang_XIX_SAM.DE_IL_TSG_BFS_Zielhelligkeit_{1..4}, system-signal=IL_TSG_BFS_Zielhelligkeit_{1..4}
        communication-direction=OUT, data-element=Grundumfang_XIX_SAM.Geltungsbereich_E3_1_1_UNECE_Gen2.SP_IF_IL_TSG_FS_Dimmzeit_{1..4}_XIX_Grundumfang_XIX_SAM.DE_IL_TSG_FS_Dimmzeit_{1..4}, system-signal=IL_TSG_FS_Dimmzeit_{1..4}
        communication-direction=OUT, data-element=Grundumfang_XIX_SAM.Geltungsbereich_E3_1_1_UNECE_Gen2.SP_IF_IL_TSG_FS_Dimmzeit_Basis_{1..4}_XIX_Grundumfang_XIX_SAM.DE_IL_TSG_FS_Dimmzeit_Basis_{1..4}, system-signal=IL_TSG_FS_Dimmzeit_Basis_{1..4}
        communication-direction=OUT, data-element=Grundumfang_XIX_SAM.Geltungsbereich_E3_1_1_UNECE_Gen2.SP_IF_IL_TSG_FS_Zielhelligkeit_{1..4}_XIX_Grundumfang_XIX_SAM.DE_IL_TSG_FS_Zielhelligkeit_{1..4}, system-signal=IL_TSG_FS_Zielhelligkeit_{1..4}
        communication-direction=OUT, data-element=Grundumfang_XIX_SAM.Geltungsbereich_E3_1_1_UNECE_Gen2.SP_IF_IL_TSG_HBFS_Dimmzeit_{1..4}_XIX_Grundumfang_XIX_SAM.DE_IL_TSG_HBFS_Dimmzeit_{1..4}, system-signal=IL_TSG_HBFS_Dimmzeit_{1..4}
        communication-direction=OUT, data-element=Grundumfang_XIX_SAM.Geltungsbereich_E3_1_1_UNECE_Gen2.SP_IF_IL_TSG_HBFS_Dimmzeit_Basis_{1..4}_XIX_Grundumfang_XIX_SAM.DE_IL_TSG_HBFS_Dimmzeit_Basis_{1..4}, system-signal=IL_TSG_HBFS_Dimmzeit_Basis_{1..4}
        communication-direction=OUT, data-element=Grundumfang_XIX_SAM.Geltungsbereich_E3_1_1_UNECE_Gen2.SP_IF_IL_TSG_HBFS_Zielhelligkeit_{1..4}_XIX_Grundumfang_XIX_SAM.DE_IL_TSG_HBFS_Zielhelligkeit_{1..4}, system-signal=IL_TSG_HBFS_Zielhelligkeit_{1..4}
        communication-direction=OUT, data-element=Grundumfang_XIX_SAM.Geltungsbereich_E3_1_1_UNECE_Gen2.SP_IF_IL_TSG_HFS_Dimmzeit_{1..4}_XIX_Grundumfang_XIX_SAM.DE_IL_TSG_HFS_Dimmzeit_{1..4}, system-signal=IL_TSG_HFS_Dimmzeit_{1..4}
        communication-direction=OUT, data-element=Grundumfang_XIX_SAM.Geltungsbereich_E3_1_1_UNECE_Gen2.SP_IF_IL_TSG_HFS_Dimmzeit_Basis_{1..4}_XIX_Grundumfang_XIX_SAM.DE_IL_TSG_HFS_Dimmzeit_Basis_{1..4}, system-signal=IL_TSG_HFS_Dimmzeit_Basis_{1..4}
        communication-direction=OUT, data-element=Grundumfang_XIX_SAM.Geltungsbereich_E3_1_1_UNECE_Gen2.SP_IF_IL_TSG_HFS_Zielhelligkeit_{1..4}_XIX_Grundumfang_XIX_SAM.DE_IL_TSG_HFS_Zielhelligkeit_{1..4}, system-signal=IL_TSG_HFS_Zielhelligkeit_{1..4}
        communication-direction=IN, data-element=Grundumfang_XIX_SAM.Geltungsbereich_E3_1_1_UNECE_Gen2.RP_IF_KBI_Aussen_Temp_gef_XIX_Grundumfang_XIX_SAM.DE_KBI_Aussen_Temp_gef, system-signal=KBI_Aussen_Temp_gef
        communication-direction=IN, data-element=Grundumfang_XIX_SAM.Geltungsbereich_E3_1_1_UNECE_Gen2.RP_IF_KBI_Kilometerstand_XIX_Grundumfang_XIX_SAM.DE_KBI_Kilometerstand, system-signal=KBI_Kilometerstand
        communication-direction=IN, data-element=Grundumfang_XIX_SAM.Geltungsbereich_E3_1_1_UNECE_Gen2.RP_IF_KFG_ORUData_XIX_Grundumfang_XIX_SAM.DE_KFG_ORUData, system-signal=KFG_ORUData
        communication-direction=IN, data-element=Grundumfang_XIX_SAM.Geltungsbereich_E3_1_1_UNECE_Gen2.RP_IF_KFG_ORUDataIndex_XIX_Grundumfang_XIX_SAM.DE_KFG_ORUDataIndex, system-signal=KFG_ORUDataIndex
        communication-direction=IN, data-element=Grundumfang_XIX_SAM.Geltungsbereich_E3_1_1_UNECE_Gen2.RP_IF_KL_AL_HL_Anf_XIX_Grundumfang_XIX_SAM.DE_KL_AL_HL_Anf, system-signal=KL_AL_HL_Anf
        communication-direction=IN, data-element=Grundumfang_XIX_SAM.Geltungsbereich_E3_1_1_UNECE_Gen2.RP_IF_KL_AL_HR_Anf_XIX_Grundumfang_XIX_SAM.DE_KL_AL_HR_Anf, system-signal=KL_AL_HR_Anf
        communication-direction=IN, data-element=Grundumfang_XIX_SAM.Geltungsbereich_E3_1_1_UNECE_Gen2.RP_IF_KL_AL_VL_Anf_XIX_Grundumfang_XIX_SAM.DE_KL_AL_VL_Anf, system-signal=KL_AL_VL_Anf
        communication-direction=IN, data-element=Grundumfang_XIX_SAM.Geltungsbereich_E3_1_1_UNECE_Gen2.RP_IF_KL_AL_VR_Anf_XIX_Grundumfang_XIX_SAM.DE_KL_AL_VR_Anf, system-signal=KL_AL_VR_Anf
        communication-direction=IN, data-element=Grundumfang_XIX_SAM.Geltungsbereich_E3_1_1_UNECE_Gen2.RP_IF_KL_Defrost_LED_XIX_Grundumfang_XIX_SAM.DE_KL_Defrost_LED, system-signal=KL_Defrost_LED
        communication-direction=IN, data-element=Grundumfang_XIX_SAM.Geltungsbereich_E3_1_1_UNECE_Gen2.RP_IF_KL_FSH_LED_XIX_Grundumfang_XIX_SAM.DE_KL_FSH_LED, system-signal=KL_FSH_LED
        communication-direction=IN, data-element=Grundumfang_XIX_SAM.Geltungsbereich_E3_1_1_UNECE_Gen2.RP_IF_KL_HSH_LED_XIX_Grundumfang_XIX_SAM.DE_KL_HSH_LED, system-signal=KL_HSH_LED
        communication-direction=IN, data-element=Grundumfang_XIX_SAM.Geltungsbereich_E3_1_1_UNECE_Gen2.RP_IF_KL_LRH_Stufe_XIX_Grundumfang_XIX_SAM.DE_KL_LRH_Stufe, system-signal=KL_LRH_Stufe
        communication-direction=OUT, data-element=Grundumfang_XIX_SAM.Geltungsbereich_E3_1_1_UNECE_Gen2.SP_IF_KL_LRH_Stufe_XIX_Grundumfang_XIX_SAM.DE_KL_LRH_Stufe, system-signal=KL_LRH_Stufe
        communication-direction=IN, data-element=Grundumfang_XIX_SAM.Geltungsbereich_E3_1_1_UNECE_Gen2.RP_IF_KL_LRH_Taster_XIX_Grundumfang_XIX_SAM.DE_KL_LRH_Taster, system-signal=KL_LRH_Taster
        communication-direction=IN, data-element=Grundumfang_XIX_SAM.Geltungsbereich_E3_1_1_UNECE_Gen2.RP_IF_KL_SIL_Soll_li_XIX_Grundumfang_XIX_SAM.DE_KL_SIL_Soll_li, system-signal=KL_SIL_Soll_li
        communication-direction=IN, data-element=Grundumfang_XIX_SAM.Geltungsbereich_E3_1_1_UNECE_Gen2.RP_IF_KL_SIL_Soll_re_XIX_Grundumfang_XIX_SAM.DE_KL_SIL_Soll_re, system-signal=KL_SIL_Soll_re
        communication-direction=OUT, data-element=Grundumfang_XIX_SAM.Geltungsbereich_E3_1_1_UNECE_Gen2.SP_IF_Klemme_15_XIX_Grundumfang_XIX_SAM.DE_Klemme_15, system-signal=Klemme_15
        communication-direction=OUT, data-element=Grundumfang_XIX_SAM.Geltungsbereich_E3_1_1_UNECE_Gen2.SP_IF_Klemme_X_WWS_XIX_Grundumfang_XIX_SAM.DE_Klemme_X_WWS, system-signal=Klemme_X_WWS
        communication-direction=IN, data-element=Grundumfang_XIX_SAM.Geltungsbereich_E3_1_1_UNECE_Gen2.RP_IF_Klemmen_Status_01_BZ_XIX_Grundumfang_XIX_SAM.DE_Klemmen_Status_01_BZ, system-signal=Klemmen_Status_01_BZ
        communication-direction=IN, data-element=Grundumfang_XIX_SAM.Geltungsbereich_E3_1_1_UNECE_Gen2.RP_IF_Klemmen_Status_01_CRC_XIX_Grundumfang_XIX_SAM.DE_Klemmen_Status_01_CRC, system-signal=Klemmen_Status_01_CRC
        communication-direction=IN, data-element=Grundumfang_XIX_SAM.Geltungsbereich_E3_1_1_UNECE_Gen2.RP_IF_Klemmen_Steuerung_01_BZ_XIX_Grundumfang_XIX_SAM.DE_Klemmen_Steuerung_01_BZ, system-signal=Klemmen_Steuerung_01_BZ
        communication-direction=IN, data-element=Grundumfang_XIX_SAM.Geltungsbereich_E3_1_1_UNECE_Gen2.RP_IF_Klemmen_Steuerung_01_CRC_XIX_Grundumfang_XIX_SAM.DE_Klemmen_Steuerung_01_CRC, system-signal=Klemmen_Steuerung_01_CRC
        communication-direction=OUT, data-element=Grundumfang_XIX_SAM.Geltungsbereich_E3_1_1_UNECE_Gen2.SP_IF_KN_BCM1_DiagPfad_XIX_Grundumfang_XIX_SAM.DE_KN_BCM1_DiagPfad, system-signal=KN_BCM1_DiagPfad
        communication-direction=IN, data-element=Grundumfang_XIX_SAM.Geltungsbereich_E3_1_1_UNECE_Gen2.RP_IF_KST_Anf_Klemme_15_Auth_XIX_Grundumfang_XIX_SAM.DE_KST_Anf_Klemme_15_Auth, system-signal=KST_Anf_Klemme_15_Auth
        communication-direction=IN, data-element=Grundumfang_XIX_SAM.Geltungsbereich_E3_1_1_UNECE_Gen2.RP_IF_KST_Anf_Klemme_S_XIX_Grundumfang_XIX_SAM.DE_KST_Anf_Klemme_S, system-signal=KST_Anf_Klemme_S
        communication-direction=OUT, data-element=Grundumfang_XIX_SAM.Geltungsbereich_E3_1_1_UNECE_Gen2.SP_IF_KST_BSW_Fehlermode2_XIX_Grundumfang_XIX_SAM.DE_KST_BSW_Fehlermode2, system-signal=KST_BSW_Fehlermode2
        communication-direction=OUT, data-element=Grundumfang_XIX_SAM.Geltungsbereich_E3_1_1_UNECE_Gen2.SP_IF_KST_BSW_Klemme_15_HW_Ist_XIX_Grundumfang_XIX_SAM.DE_KST_BSW_Klemme_15_HW_Ist, system-signal=KST_BSW_Klemme_15_HW_Ist
        communication-direction=OUT, data-element=Grundumfang_XIX_SAM.Geltungsbereich_E3_1_1_UNECE_Gen2.SP_IF_KST_BSW_Klemmenhochschalten_Sper_XIX_Grundumfang_XIX_SAM.DE_KST_BSW_Klemmenhochschalten_Sper, system-signal=KST_BSW_Klemmenhochschalten_Sper
        communication-direction=OUT, data-element=Grundumfang_XIX_SAM.Geltungsbereich_E3_1_1_UNECE_Gen2.SP_IF_KST_BSW_Not_Taster_betaetigt_XIX_Grundumfang_XIX_SAM.DE_KST_BSW_Not_Taster_betaetigt, system-signal=KST_BSW_Not_Taster_betaetigt
        communication-direction=OUT, data-element=Grundumfang_XIX_SAM.Geltungsbereich_E3_1_1_UNECE_Gen2.SP_IF_KST_BSW_ZAT_betaetigt_XIX_Grundumfang_XIX_SAM.DE_KST_BSW_ZAT_betaetigt, system-signal=KST_BSW_ZAT_betaetigt
        communication-direction=IN, data-element=Grundumfang_XIX_SAM.Geltungsbereich_E3_1_1_UNECE_Gen2.RP_IF_KST_KL15LockStatus_XIX_Grundumfang_XIX_SAM.DE_KST_KL15LockStatus, system-signal=KST_KL15LockStatus
        communication-direction=IN, data-element=Grundumfang_XIX_SAM.Geltungsbereich_E3_1_1_UNECE_Gen2.RP_IF_KST_Sonderzustand_Anforderung_XIX_Grundumfang_XIX_SAM.DE_KST_Sonderzustand_Anforderung, system-signal=KST_Sonderzustand_Anforderung
        communication-direction=IN, data-element=Grundumfang_XIX_SAM.Geltungsbereich_E3_1_1_UNECE_Gen2.RP_IF_KST_Sonderzustand_Status_XIX_Grundumfang_XIX_SAM.DE_KST_Sonderzustand_Status, system-signal=KST_Sonderzustand_Status
        communication-direction=IN, data-element=Grundumfang_XIX_SAM.Geltungsbereich_E3_1_1_UNECE_Gen2.RP_IF_KY_Ambex_Entfernung_Delta_IDG_{01..08}_XIX_Grundumfang_XIX_SAM.DE_KY_Ambex_Entfernung_Delta_IDG_{01..08}, system-signal=KY_Ambex_Entfernung_Delta_IDG_{01..08}
        communication-direction=IN, data-element=Grundumfang_XIX_SAM.Geltungsbereich_E3_1_1_UNECE_Gen2.RP_IF_KY_Ambex_Entfernung_IDG_{01..08}_XIX_Grundumfang_XIX_SAM.DE_KY_Ambex_Entfernung_IDG_{01..08}, system-signal=KY_Ambex_Entfernung_IDG_{01..08}
        communication-direction=IN, data-element=Grundumfang_XIX_SAM.Geltungsbereich_E3_1_1_UNECE_Gen2.RP_IF_KY_Ambex_Richtung_Delta_IDG_{01..08}_XIX_Grundumfang_XIX_SAM.DE_KY_Ambex_Richtung_Delta_IDG_{01..08}, system-signal=KY_Ambex_Richtung_Delta_IDG_{01..08}
        communication-direction=IN, data-element=Grundumfang_XIX_SAM.Geltungsbereich_E3_1_1_UNECE_Gen2.RP_IF_KY_Ambex_Richtung_IDG_{01..08}_XIX_Grundumfang_XIX_SAM.DE_KY_Ambex_Richtung_IDG_{01..08}, system-signal=KY_Ambex_Richtung_IDG_{01..08}
        communication-direction=OUT, data-element=Grundumfang_XIX_SAM.Geltungsbereich_E3_1_1_UNECE_Gen2.SP_IF_KY_UHF_aktiver_Scantyp_XIX_Grundumfang_XIX_SAM.DE_KY_UHF_aktiver_Scantyp, system-signal=KY_UHF_aktiver_Scantyp
        communication-direction=OUT, data-element=Grundumfang_XIX_SAM.Geltungsbereich_E3_1_1_UNECE_Gen2.SP_IF_KY_UHF_Bitrate_XIX_Grundumfang_XIX_SAM.DE_KY_UHF_Bitrate, system-signal=KY_UHF_Bitrate
        communication-direction=OUT, data-element=Grundumfang_XIX_SAM.Geltungsbereich_E3_1_1_UNECE_Gen2.SP_IF_KY_UHF_Telegramm_CRCStatus_XIX_Grundumfang_XIX_SAM.DE_KY_UHF_Telegramm_CRCStatus, system-signal=KY_UHF_Telegramm_CRCStatus
        communication-direction=OUT, data-element=Grundumfang_XIX_SAM.Geltungsbereich_E3_1_1_UNECE_Gen2.SP_IF_KY_UHF_Transceiver_Modus_XIX_Grundumfang_XIX_SAM.DE_KY_UHF_Transceiver_Modus, system-signal=KY_UHF_Transceiver_Modus
        communication-direction=IN, data-element=Grundumfang_XIX_SAM.Geltungsbereich_E3_1_1_UNECE_Gen2.RP_IF_LE1_ORUData_XIX_Grundumfang_XIX_SAM.DE_LE1_ORUData, system-signal=LE1_ORUData
        communication-direction=IN, data-element=Grundumfang_XIX_SAM.Geltungsbereich_E3_1_1_UNECE_Gen2.RP_IF_LE1_ORUDataIndex_XIX_Grundumfang_XIX_SAM.DE_LE1_ORUDataIndex, system-signal=LE1_ORUDataIndex
        communication-direction=IN, data-element=Grundumfang_XIX_SAM.Geltungsbereich_E3_1_1_UNECE_Gen2.RP_IF_LE1_TorqueLockStatus_XIX_Grundumfang_XIX_SAM.DE_LE1_TorqueLockStatus, system-signal=LE1_TorqueLockStatus
        communication-direction=IN, data-element=Grundumfang_XIX_SAM.Geltungsbereich_E3_1_1_UNECE_Gen2.RP_IF_LE2_ORUData_XIX_Grundumfang_XIX_SAM.DE_LE2_ORUData, system-signal=LE2_ORUData
        communication-direction=IN, data-element=Grundumfang_XIX_SAM.Geltungsbereich_E3_1_1_UNECE_Gen2.RP_IF_LE2_ORUDataIndex_XIX_Grundumfang_XIX_SAM.DE_LE2_ORUDataIndex, system-signal=LE2_ORUDataIndex
        communication-direction=IN, data-element=Grundumfang_XIX_SAM.Geltungsbereich_E3_1_1_UNECE_Gen2.RP_IF_LE2_TorqueLockStatus_XIX_Grundumfang_XIX_SAM.DE_LE2_TorqueLockStatus, system-signal=LE2_TorqueLockStatus
        communication-direction=IN, data-element=Grundumfang_XIX_SAM.Geltungsbereich_E3_1_1_UNECE_Gen2.RP_IF_Lenkhilfe_EPS_ORUData_XIX_Grundumfang_XIX_SAM.DE_Lenkhilfe_EPS_ORUData, system-signal=Lenkhilfe_EPS_ORUData
        communication-direction=IN, data-element=Grundumfang_XIX_SAM.Geltungsbereich_E3_1_1_UNECE_Gen2.RP_IF_Lenkhilfe_EPS_ORUDataIndex_XIX_Grundumfang_XIX_SAM.DE_Lenkhilfe_EPS_ORUDataIndex, system-signal=Lenkhilfe_EPS_ORUDataIndex
        communication-direction=IN, data-element=Grundumfang_XIX_SAM.Geltungsbereich_E3_1_1_UNECE_Gen2.RP_IF_Leselicht_hi_li_LED_defekt_XIX_Grundumfang_XIX_SAM.DE_Leselicht_hi_li_LED_defekt, system-signal=Leselicht_hi_li_LED_defekt
        communication-direction=IN, data-element=Grundumfang_XIX_SAM.Geltungsbereich_E3_1_1_UNECE_Gen2.RP_IF_Leselicht_hi_li_SR3_LED_defekt_XIX_Grundumfang_XIX_SAM.DE_Leselicht_hi_li_SR3_LED_defekt, system-signal=Leselicht_hi_li_SR3_LED_defekt
        communication-direction=IN, data-element=Grundumfang_XIX_SAM.Geltungsbereich_E3_1_1_UNECE_Gen2.RP_IF_Leselicht_hi_li_SR3_Taste_defekt_XIX_Grundumfang_XIX_SAM.DE_Leselicht_hi_li_SR3_Taste_defekt, system-signal=Leselicht_hi_li_SR3_Taste_defekt
        communication-direction=IN, data-element=Grundumfang_XIX_SAM.Geltungsbereich_E3_1_1_UNECE_Gen2.RP_IF_Leselicht_hi_li_Taste_defekt_XIX_Grundumfang_XIX_SAM.DE_Leselicht_hi_li_Taste_defekt, system-signal=Leselicht_hi_li_Taste_defekt
        communication-direction=IN, data-element=Grundumfang_XIX_SAM.Geltungsbereich_E3_1_1_UNECE_Gen2.RP_IF_Leselicht_hi_re_LED_defekt_XIX_Grundumfang_XIX_SAM.DE_Leselicht_hi_re_LED_defekt, system-signal=Leselicht_hi_re_LED_defekt
        communication-direction=IN, data-element=Grundumfang_XIX_SAM.Geltungsbereich_E3_1_1_UNECE_Gen2.RP_IF_Leselicht_hi_re_SR3_LED_defekt_XIX_Grundumfang_XIX_SAM.DE_Leselicht_hi_re_SR3_LED_defekt, system-signal=Leselicht_hi_re_SR3_LED_defekt
        communication-direction=IN, data-element=Grundumfang_XIX_SAM.Geltungsbereich_E3_1_1_UNECE_Gen2.RP_IF_Leselicht_hi_re_SR3_Taste_defekt_XIX_Grundumfang_XIX_SAM.DE_Leselicht_hi_re_SR3_Taste_defekt, system-signal=Leselicht_hi_re_SR3_Taste_defekt
        communication-direction=IN, data-element=Grundumfang_XIX_SAM.Geltungsbereich_E3_1_1_UNECE_Gen2.RP_IF_Leselicht_hi_re_Taste_defekt_XIX_Grundumfang_XIX_SAM.DE_Leselicht_hi_re_Taste_defekt, system-signal=Leselicht_hi_re_Taste_defekt
        communication-direction=IN, data-element=Grundumfang_XIX_SAM.Geltungsbereich_E3_1_1_UNECE_Gen2.RP_IF_Leselicht_vo_defekt_XIX_Grundumfang_XIX_SAM.DE_Leselicht_vo_defekt, system-signal=Leselicht_vo_defekt
        communication-direction=OUT, data-element=ABL_XIX_SAM.Geltungsbereich_E3_1_1_UNECE_Gen2.SP_IF_LH_S_3_Bremsl_def_XIX_ABL_XIX_SAM.DE_LH_S_3_Bremsl_def, system-signal=LH_S_3_Bremsl_def
        communication-direction=OUT, data-element=Grundumfang_XIX_SAM.Geltungsbereich_E3_1_1_UNECE_Gen2.SP_IF_LH_S_3_Bremsl_def_XIX_Grundumfang_XIX_SAM.DE_LH_S_3_Bremsl_def, system-signal=LH_S_3_Bremsl_def
        communication-direction=OUT, data-element=ABL_XIX_SAM.Geltungsbereich_E3_1_1_UNECE_Gen2.SP_IF_LH_S_Aussenlicht_def_XIX_ABL_XIX_SAM.DE_LH_S_Aussenlicht_def, system-signal=LH_S_Aussenlicht_def
        communication-direction=OUT, data-element=Grundumfang_XIX_SAM.Geltungsbereich_E3_1_1_UNECE_Gen2.SP_IF_LH_S_Aussenlicht_def_XIX_Grundumfang_XIX_SAM.DE_LH_S_Aussenlicht_def, system-signal=LH_S_Aussenlicht_def
        communication-direction=OUT, data-element=ABL_XIX_SAM.Geltungsbereich_E3_1_1_UNECE_Gen2.SP_IF_LH_S_Blinker_li_def_XIX_ABL_XIX_SAM.DE_LH_S_Blinker_li_def, system-signal=LH_S_Blinker_li_def
        communication-direction=OUT, data-element=Grundumfang_XIX_SAM.Geltungsbereich_E3_1_1_UNECE_Gen2.SP_IF_LH_S_Blinker_li_def_XIX_Grundumfang_XIX_SAM.DE_LH_S_Blinker_li_def, system-signal=LH_S_Blinker_li_def
        communication-direction=OUT, data-element=ABL_XIX_SAM.Geltungsbereich_E3_1_1_UNECE_Gen2.SP_IF_LH_S_Blinker_re_def_XIX_ABL_XIX_SAM.DE_LH_S_Blinker_re_def, system-signal=LH_S_Blinker_re_def
        communication-direction=OUT, data-element=Grundumfang_XIX_SAM.Geltungsbereich_E3_1_1_UNECE_Gen2.SP_IF_LH_S_Blinker_re_def_XIX_Grundumfang_XIX_SAM.DE_LH_S_Blinker_re_def, system-signal=LH_S_Blinker_re_def
        communication-direction=OUT, data-element=ABL_XIX_SAM.Geltungsbereich_E3_1_1_UNECE_Gen2.SP_IF_LH_S_Brems_Blk_li_def_XIX_ABL_XIX_SAM.DE_LH_S_Brems_Blk_li_def, system-signal=LH_S_Brems_Blk_li_def
        communication-direction=OUT, data-element=Grundumfang_XIX_SAM.Geltungsbereich_E3_1_1_UNECE_Gen2.SP_IF_LH_S_Brems_Blk_li_def_XIX_Grundumfang_XIX_SAM.DE_LH_S_Brems_Blk_li_def, system-signal=LH_S_Brems_Blk_li_def
        communication-direction=OUT, data-element=ABL_XIX_SAM.Geltungsbereich_E3_1_1_UNECE_Gen2.SP_IF_LH_S_Brems_Blk_re_def_XIX_ABL_XIX_SAM.DE_LH_S_Brems_Blk_re_def, system-signal=LH_S_Brems_Blk_re_def
        communication-direction=OUT, data-element=Grundumfang_XIX_SAM.Geltungsbereich_E3_1_1_UNECE_Gen2.SP_IF_LH_S_Brems_Blk_re_def_XIX_Grundumfang_XIX_SAM.DE_LH_S_Brems_Blk_re_def, system-signal=LH_S_Brems_Blk_re_def
        communication-direction=OUT, data-element=ABL_XIX_SAM.Geltungsbereich_E3_1_1_UNECE_Gen2.SP_IF_LH_S_Bremsl_li_def_XIX_ABL_XIX_SAM.DE_LH_S_Bremsl_li_def, system-signal=LH_S_Bremsl_li_def
        communication-direction=OUT, data-element=Grundumfang_XIX_SAM.Geltungsbereich_E3_1_1_UNECE_Gen2.SP_IF_LH_S_Bremsl_li_def_XIX_Grundumfang_XIX_SAM.DE_LH_S_Bremsl_li_def, system-signal=LH_S_Bremsl_li_def
        communication-direction=OUT, data-element=ABL_XIX_SAM.Geltungsbereich_E3_1_1_UNECE_Gen2.SP_IF_LH_S_Bremsl_li_ges_def_XIX_ABL_XIX_SAM.DE_LH_S_Bremsl_li_ges_def, system-signal=LH_S_Bremsl_li_ges_def
        communication-direction=OUT, data-element=Grundumfang_XIX_SAM.Geltungsbereich_E3_1_1_UNECE_Gen2.SP_IF_LH_S_Bremsl_li_ges_def_XIX_Grundumfang_XIX_SAM.DE_LH_S_Bremsl_li_ges_def, system-signal=LH_S_Bremsl_li_ges_def
        communication-direction=OUT, data-element=ABL_XIX_SAM.Geltungsbereich_E3_1_1_UNECE_Gen2.SP_IF_LH_S_Bremsl_re_def_XIX_ABL_XIX_SAM.DE_LH_S_Bremsl_re_def, system-signal=LH_S_Bremsl_re_def
        communication-direction=OUT, data-element=Grundumfang_XIX_SAM.Geltungsbereich_E3_1_1_UNECE_Gen2.SP_IF_LH_S_Bremsl_re_def_XIX_Grundumfang_XIX_SAM.DE_LH_S_Bremsl_re_def, system-signal=LH_S_Bremsl_re_def
        communication-direction=OUT, data-element=ABL_XIX_SAM.Geltungsbereich_E3_1_1_UNECE_Gen2.SP_IF_LH_S_Bremsl_re_ges_def_XIX_ABL_XIX_SAM.DE_LH_S_Bremsl_re_ges_def, system-signal=LH_S_Bremsl_re_ges_def
        communication-direction=OUT, data-element=Grundumfang_XIX_SAM.Geltungsbereich_E3_1_1_UNECE_Gen2.SP_IF_LH_S_Bremsl_re_ges_def_XIX_Grundumfang_XIX_SAM.DE_LH_S_Bremsl_re_ges_def, system-signal=LH_S_Bremsl_re_ges_def
        communication-direction=OUT, data-element=ABL_XIX_SAM.Geltungsbereich_E3_1_1_UNECE_Gen2.SP_IF_LH_S_Bremslicht_H_aktiv_XIX_ABL_XIX_SAM.DE_LH_S_Bremslicht_H_aktiv, system-signal=LH_S_Bremslicht_H_aktiv
        communication-direction=OUT, data-element=Grundumfang_XIX_SAM.Geltungsbereich_E3_1_1_UNECE_Gen2.SP_IF_LH_S_Bremslicht_H_aktiv_XIX_Grundumfang_XIX_SAM.DE_LH_S_Bremslicht_H_aktiv, system-signal=LH_S_Bremslicht_H_aktiv
        communication-direction=OUT, data-element=ABL_XIX_SAM.Geltungsbereich_E3_1_1_UNECE_Gen2.SP_IF_LH_S_Kennzl_def_XIX_ABL_XIX_SAM.DE_LH_S_Kennzl_def, system-signal=LH_S_Kennzl_def
        communication-direction=OUT, data-element=Grundumfang_XIX_SAM.Geltungsbereich_E3_1_1_UNECE_Gen2.SP_IF_LH_S_Kennzl_def_XIX_Grundumfang_XIX_SAM.DE_LH_S_Kennzl_def, system-signal=LH_S_Kennzl_def
        communication-direction=OUT, data-element=ABL_XIX_SAM.Geltungsbereich_E3_1_1_UNECE_Gen2.SP_IF_LH_S_Nebel_li_def_XIX_ABL_XIX_SAM.DE_LH_S_Nebel_li_def, system-signal=LH_S_Nebel_li_def
        communication-direction=OUT, data-element=Grundumfang_XIX_SAM.Geltungsbereich_E3_1_1_UNECE_Gen2.SP_IF_LH_S_Nebel_li_def_XIX_Grundumfang_XIX_SAM.DE_LH_S_Nebel_li_def, system-signal=LH_S_Nebel_li_def
        communication-direction=OUT, data-element=ABL_XIX_SAM.Geltungsbereich_E3_1_1_UNECE_Gen2.SP_IF_LH_S_Nebel_mi_def_XIX_ABL_XIX_SAM.DE_LH_S_Nebel_mi_def, system-signal=LH_S_Nebel_mi_def
        communication-direction=OUT, data-element=Grundumfang_XIX_SAM.Geltungsbereich_E3_1_1_UNECE_Gen2.SP_IF_LH_S_Nebel_mi_def_XIX_Grundumfang_XIX_SAM.DE_LH_S_Nebel_mi_def, system-signal=LH_S_Nebel_mi_def
        communication-direction=OUT, data-element=ABL_XIX_SAM.Geltungsbereich_E3_1_1_UNECE_Gen2.SP_IF_LH_S_Nebel_re_def_XIX_ABL_XIX_SAM.DE_LH_S_Nebel_re_def, system-signal=LH_S_Nebel_re_def
        communication-direction=OUT, data-element=Grundumfang_XIX_SAM.Geltungsbereich_E3_1_1_UNECE_Gen2.SP_IF_LH_S_Nebel_re_def_XIX_Grundumfang_XIX_SAM.DE_LH_S_Nebel_re_def, system-signal=LH_S_Nebel_re_def
        communication-direction=OUT, data-element=ABL_XIX_SAM.Geltungsbereich_E3_1_1_UNECE_Gen2.SP_IF_LH_S_Rueckf_li_def_XIX_ABL_XIX_SAM.DE_LH_S_Rueckf_li_def, system-signal=LH_S_Rueckf_li_def
        communication-direction=OUT, data-element=Grundumfang_XIX_SAM.Geltungsbereich_E3_1_1_UNECE_Gen2.SP_IF_LH_S_Rueckf_li_def_XIX_Grundumfang_XIX_SAM.DE_LH_S_Rueckf_li_def, system-signal=LH_S_Rueckf_li_def
        communication-direction=OUT, data-element=ABL_XIX_SAM.Geltungsbereich_E3_1_1_UNECE_Gen2.SP_IF_LH_S_Rueckf_mi_def_XIX_ABL_XIX_SAM.DE_LH_S_Rueckf_mi_def, system-signal=LH_S_Rueckf_mi_def
        communication-direction=OUT, data-element=Grundumfang_XIX_SAM.Geltungsbereich_E3_1_1_UNECE_Gen2.SP_IF_LH_S_Rueckf_mi_def_XIX_Grundumfang_XIX_SAM.DE_LH_S_Rueckf_mi_def, system-signal=LH_S_Rueckf_mi_def
        communication-direction=OUT, data-element=ABL_XIX_SAM.Geltungsbereich_E3_1_1_UNECE_Gen2.SP_IF_LH_S_Rueckf_re_def_XIX_ABL_XIX_SAM.DE_LH_S_Rueckf_re_def, system-signal=LH_S_Rueckf_re_def
        communication-direction=OUT, data-element=Grundumfang_XIX_SAM.Geltungsbereich_E3_1_1_UNECE_Gen2.SP_IF_LH_S_Rueckf_re_def_XIX_Grundumfang_XIX_SAM.DE_LH_S_Rueckf_re_def, system-signal=LH_S_Rueckf_re_def
        communication-direction=OUT, data-element=ABL_XIX_SAM.Geltungsbereich_E3_1_1_UNECE_Gen2.SP_IF_LH_S_Schluss_Brems_li_def_XIX_ABL_XIX_SAM.DE_LH_S_Schluss_Brems_li_def, system-signal=LH_S_Schluss_Brems_li_def
        communication-direction=OUT, data-element=Grundumfang_XIX_SAM.Geltungsbereich_E3_1_1_UNECE_Gen2.SP_IF_LH_S_Schluss_Brems_li_def_XIX_Grundumfang_XIX_SAM.DE_LH_S_Schluss_Brems_li_def, system-signal=LH_S_Schluss_Brems_li_def
        communication-direction=OUT, data-element=ABL_XIX_SAM.Geltungsbereich_E3_1_1_UNECE_Gen2.SP_IF_LH_S_Schluss_Brems_mi_def_XIX_ABL_XIX_SAM.DE_LH_S_Schluss_Brems_mi_def, system-signal=LH_S_Schluss_Brems_mi_def
        communication-direction=OUT, data-element=Grundumfang_XIX_SAM.Geltungsbereich_E3_1_1_UNECE_Gen2.SP_IF_LH_S_Schluss_Brems_mi_def_XIX_Grundumfang_XIX_SAM.DE_LH_S_Schluss_Brems_mi_def, system-signal=LH_S_Schluss_Brems_mi_def
        communication-direction=OUT, data-element=ABL_XIX_SAM.Geltungsbereich_E3_1_1_UNECE_Gen2.SP_IF_LH_S_Schluss_Brems_Nebel_li_def_XIX_ABL_XIX_SAM.DE_LH_S_Schluss_Brems_Nebel_li_def, system-signal=LH_S_Schluss_Brems_Nebel_li_def
        communication-direction=OUT, data-element=Grundumfang_XIX_SAM.Geltungsbereich_E3_1_1_UNECE_Gen2.SP_IF_LH_S_Schluss_Brems_Nebel_li_def_XIX_Grundumfang_XIX_SAM.DE_LH_S_Schluss_Brems_Nebel_li_def, system-signal=LH_S_Schluss_Brems_Nebel_li_def
        communication-direction=OUT, data-element=ABL_XIX_SAM.Geltungsbereich_E3_1_1_UNECE_Gen2.SP_IF_LH_S_Schluss_Brems_Nebel_re_def_XIX_ABL_XIX_SAM.DE_LH_S_Schluss_Brems_Nebel_re_def, system-signal=LH_S_Schluss_Brems_Nebel_re_def
        communication-direction=OUT, data-element=Grundumfang_XIX_SAM.Geltungsbereich_E3_1_1_UNECE_Gen2.SP_IF_LH_S_Schluss_Brems_Nebel_re_def_XIX_Grundumfang_XIX_SAM.DE_LH_S_Schluss_Brems_Nebel_re_def, system-signal=LH_S_Schluss_Brems_Nebel_re_def
        communication-direction=OUT, data-element=ABL_XIX_SAM.Geltungsbereich_E3_1_1_UNECE_Gen2.SP_IF_LH_S_Schluss_Brems_re_def_XIX_ABL_XIX_SAM.DE_LH_S_Schluss_Brems_re_def, system-signal=LH_S_Schluss_Brems_re_def
        communication-direction=OUT, data-element=Grundumfang_XIX_SAM.Geltungsbereich_E3_1_1_UNECE_Gen2.SP_IF_LH_S_Schluss_Brems_re_def_XIX_Grundumfang_XIX_SAM.DE_LH_S_Schluss_Brems_re_def, system-signal=LH_S_Schluss_Brems_re_def
        communication-direction=OUT, data-element=ABL_XIX_SAM.Geltungsbereich_E3_1_1_UNECE_Gen2.SP_IF_LH_S_Schluss_Nebel_li_def_XIX_ABL_XIX_SAM.DE_LH_S_Schluss_Nebel_li_def, system-signal=LH_S_Schluss_Nebel_li_def
        communication-direction=OUT, data-element=Grundumfang_XIX_SAM.Geltungsbereich_E3_1_1_UNECE_Gen2.SP_IF_LH_S_Schluss_Nebel_li_def_XIX_Grundumfang_XIX_SAM.DE_LH_S_Schluss_Nebel_li_def, system-signal=LH_S_Schluss_Nebel_li_def
        communication-direction=OUT, data-element=ABL_XIX_SAM.Geltungsbereich_E3_1_1_UNECE_Gen2.SP_IF_LH_S_Schluss_Nebel_re_def_XIX_ABL_XIX_SAM.DE_LH_S_Schluss_Nebel_re_def, system-signal=LH_S_Schluss_Nebel_re_def
        communication-direction=OUT, data-element=Grundumfang_XIX_SAM.Geltungsbereich_E3_1_1_UNECE_Gen2.SP_IF_LH_S_Schluss_Nebel_re_def_XIX_Grundumfang_XIX_SAM.DE_LH_S_Schluss_Nebel_re_def, system-signal=LH_S_Schluss_Nebel_re_def
        communication-direction=OUT, data-element=ABL_XIX_SAM.Geltungsbereich_E3_1_1_UNECE_Gen2.SP_IF_LH_S_Schlusslicht_li_def_XIX_ABL_XIX_SAM.DE_LH_S_Schlusslicht_li_def, system-signal=LH_S_Schlusslicht_li_def
        communication-direction=OUT, data-element=Grundumfang_XIX_SAM.Geltungsbereich_E3_1_1_UNECE_Gen2.SP_IF_LH_S_Schlusslicht_li_def_XIX_Grundumfang_XIX_SAM.DE_LH_S_Schlusslicht_li_def, system-signal=LH_S_Schlusslicht_li_def
        communication-direction=OUT, data-element=ABL_XIX_SAM.Geltungsbereich_E3_1_1_UNECE_Gen2.SP_IF_LH_S_Schlusslicht_mi_def_XIX_ABL_XIX_SAM.DE_LH_S_Schlusslicht_mi_def, system-signal=LH_S_Schlusslicht_mi_def
        communication-direction=OUT, data-element=Grundumfang_XIX_SAM.Geltungsbereich_E3_1_1_UNECE_Gen2.SP_IF_LH_S_Schlusslicht_mi_def_XIX_Grundumfang_XIX_SAM.DE_LH_S_Schlusslicht_mi_def, system-signal=LH_S_Schlusslicht_mi_def
        communication-direction=OUT, data-element=ABL_XIX_SAM.Geltungsbereich_E3_1_1_UNECE_Gen2.SP_IF_LH_S_Schlusslicht_re_def_XIX_ABL_XIX_SAM.DE_LH_S_Schlusslicht_re_def, system-signal=LH_S_Schlusslicht_re_def
        communication-direction=OUT, data-element=Grundumfang_XIX_SAM.Geltungsbereich_E3_1_1_UNECE_Gen2.SP_IF_LH_S_Schlusslicht_re_def_XIX_Grundumfang_XIX_SAM.DE_LH_S_Schlusslicht_re_def, system-signal=LH_S_Schlusslicht_re_def
        communication-direction=OUT, data-element=ABL_XIX_SAM.Geltungsbereich_E3_1_1_UNECE_Gen2.SP_IF_LH_S_SL_BRL_BLK_li_def_XIX_ABL_XIX_SAM.DE_LH_S_SL_BRL_BLK_li_def, system-signal=LH_S_SL_BRL_BLK_li_def
        communication-direction=OUT, data-element=Grundumfang_XIX_SAM.Geltungsbereich_E3_1_1_UNECE_Gen2.SP_IF_LH_S_SL_BRL_BLK_li_def_XIX_Grundumfang_XIX_SAM.DE_LH_S_SL_BRL_BLK_li_def, system-signal=LH_S_SL_BRL_BLK_li_def
        communication-direction=OUT, data-element=ABL_XIX_SAM.Geltungsbereich_E3_1_1_UNECE_Gen2.SP_IF_LH_S_SL_BRL_BLK_re_def_XIX_ABL_XIX_SAM.DE_LH_S_SL_BRL_BLK_re_def, system-signal=LH_S_SL_BRL_BLK_re_def
        communication-direction=OUT, data-element=Grundumfang_XIX_SAM.Geltungsbereich_E3_1_1_UNECE_Gen2.SP_IF_LH_S_SL_BRL_BLK_re_def_XIX_Grundumfang_XIX_SAM.DE_LH_S_SL_BRL_BLK_re_def, system-signal=LH_S_SL_BRL_BLK_re_def
        communication-direction=OUT, data-element=Grundumfang_XIX_SAM.Geltungsbereich_E3_1_1_UNECE_Gen2.SP_IF_LIM_P_Mode_XIX_Grundumfang_XIX_SAM.DE_LIM_P_Mode, system-signal=LIM_P_Mode
        communication-direction=OUT, data-element=Grundumfang_XIX_SAM.Geltungsbereich_E3_1_1_UNECE_Gen2.SP_IF_LIM_S_Rollo_vo_XIX_Grundumfang_XIX_SAM.DE_LIM_S_Rollo_vo, system-signal=LIM_S_Rollo_vo
        communication-direction=IN, data-element=Grundumfang_XIX_SAM.Geltungsbereich_E3_1_1_UNECE_Gen2.RP_IF_LIM_Tasten_Innenlicht_V_def_XIX_Grundumfang_XIX_SAM.DE_LIM_Tasten_Innenlicht_V_def, system-signal=LIM_Tasten_Innenlicht_V_def
        communication-direction=IN, data-element=Grundumfang_XIX_SAM.Geltungsbereich_E3_1_1_UNECE_Gen2.RP_IF_LIN_SMLS_ECU_defekt_XIX_Grundumfang_XIX_SAM.DE_LIN_SMLS_ECU_defekt, system-signal=LIN_SMLS_ECU_defekt
        communication-direction=IN, data-element=Grundumfang_XIX_SAM.Geltungsbereich_E3_1_1_UNECE_Gen2.RP_IF_LIN_SMLS_elektrischer_Fehler_XIX_Grundumfang_XIX_SAM.DE_LIN_SMLS_elektrischer_Fehler, system-signal=LIN_SMLS_elektrischer_Fehler
        communication-direction=IN, data-element=Grundumfang_XIX_SAM.Geltungsbereich_E3_1_1_UNECE_Gen2.RP_IF_LIN_SMLS_mechanischer_Fehler_XIX_Grundumfang_XIX_SAM.DE_LIN_SMLS_mechanischer_Fehler, system-signal=LIN_SMLS_mechanischer_Fehler
        communication-direction=IN, data-element=Grundumfang_XIX_SAM.Geltungsbereich_E3_1_1_UNECE_Gen2.RP_IF_LIN_SMLS_RAM_ROM_Fehler_XIX_Grundumfang_XIX_SAM.DE_LIN_SMLS_RAM_ROM_Fehler, system-signal=LIN_SMLS_RAM_ROM_Fehler
        communication-direction=IN, data-element=Grundumfang_XIX_SAM.Geltungsbereich_E3_1_1_UNECE_Gen2.RP_IF_LIN_SMLS_ResponseError_XIX_Grundumfang_XIX_SAM.DE_LIN_SMLS_ResponseError, system-signal=LIN_SMLS_ResponseError
        communication-direction=IN, data-element=Grundumfang_XIX_SAM.Geltungsbereich_E3_1_1_UNECE_Gen2.RP_IF_LIN_SMLS_Ueberspannung_XIX_Grundumfang_XIX_SAM.DE_LIN_SMLS_Ueberspannung, system-signal=LIN_SMLS_Ueberspannung
        communication-direction=IN, data-element=Grundumfang_XIX_SAM.Geltungsbereich_E3_1_1_UNECE_Gen2.RP_IF_LIN_SMLS_Unterspannung_XIX_Grundumfang_XIX_SAM.DE_LIN_SMLS_Unterspannung, system-signal=LIN_SMLS_Unterspannung
        communication-direction=IN, data-element=Grundumfang_XIX_SAM.Geltungsbereich_E3_1_1_UNECE_Gen2.RP_IF_LIN_SMLS_Zaehler_XIX_Grundumfang_XIX_SAM.DE_LIN_SMLS_Zaehler, system-signal=LIN_SMLS_Zaehler
        communication-direction=IN, data-element=Grundumfang_XIX_SAM.Geltungsbereich_E3_1_1_UNECE_Gen2.RP_IF_LINDa_defekt_XIX_Grundumfang_XIX_SAM.DE_LINDa_defekt, system-signal=LINDa_defekt
        communication-direction=IN, data-element=Grundumfang_XIX_SAM.Geltungsbereich_E3_1_1_UNECE_Gen2.RP_IF_LINDa_ResponseError_XIX_Grundumfang_XIX_SAM.DE_LINDa_ResponseError, system-signal=LINDa_ResponseError
        communication-direction=IN, data-element=Grundumfang_XIX_SAM.Geltungsbereich_E3_1_1_UNECE_Gen2.RP_IF_LINDa_S_Rollo_vo_XIX_Grundumfang_XIX_SAM.DE_LINDa_S_Rollo_vo, system-signal=LINDa_S_Rollo_vo
        communication-direction=OUT, data-element=Grundumfang_XIX_SAM.Geltungsbereich_E3_1_1_UNECE_Gen2.SP_IF_LINDae_Dummy_4_7_XIX_Grundumfang_XIX_SAM.DE_LINDae_Dummy_4_7, system-signal=LINDae_Dummy_4_7
        communication-direction=IN, data-element=Grundumfang_XIX_SAM.Geltungsbereich_E3_1_1_UNECE_Gen2.RP_IF_LLP_L_ORUData_XIX_Grundumfang_XIX_SAM.DE_LLP_L_ORUData, system-signal=LLP_L_ORUData
        communication-direction=IN, data-element=Grundumfang_XIX_SAM.Geltungsbereich_E3_1_1_UNECE_Gen2.RP_IF_LLP_L_ORUDataIndex_XIX_Grundumfang_XIX_SAM.DE_LLP_L_ORUDataIndex, system-signal=LLP_L_ORUDataIndex
        communication-direction=IN, data-element=Grundumfang_XIX_SAM.Geltungsbereich_E3_1_1_UNECE_Gen2.RP_IF_LLP_R_ORUData_XIX_Grundumfang_XIX_SAM.DE_LLP_R_ORUData, system-signal=LLP_R_ORUData
        communication-direction=IN, data-element=Grundumfang_XIX_SAM.Geltungsbereich_E3_1_1_UNECE_Gen2.RP_IF_LLP_R_ORUDataIndex_XIX_Grundumfang_XIX_SAM.DE_LLP_R_ORUDataIndex, system-signal=LLP_R_ORUDataIndex
        communication-direction=IN, data-element=Grundumfang_XIX_SAM.Geltungsbereich_E3_1_1_UNECE_Gen2.RP_IF_LLR_LL1_Blockierung_XIX_Grundumfang_XIX_SAM.DE_LLR_LL1_Blockierung, system-signal=LLR_LL1_Blockierung
        communication-direction=IN, data-element=Grundumfang_XIX_SAM.Geltungsbereich_E3_1_1_UNECE_Gen2.RP_IF_LLR_LL1_CodierPinError_XIX_Grundumfang_XIX_SAM.DE_LLR_LL1_CodierPinError, system-signal=LLR_LL1_CodierPinError
        communication-direction=IN, data-element=Grundumfang_XIX_SAM.Geltungsbereich_E3_1_1_UNECE_Gen2.RP_IF_LLR_LL1_Ist_Drehzahl_XIX_Grundumfang_XIX_SAM.DE_LLR_LL1_Ist_Drehzahl, system-signal=LLR_LL1_Ist_Drehzahl
        communication-direction=IN, data-element=Grundumfang_XIX_SAM.Geltungsbereich_E3_1_1_UNECE_Gen2.RP_IF_LLR_LL1_Lokalaktiv_XIX_Grundumfang_XIX_SAM.DE_LLR_LL1_Lokalaktiv, system-signal=LLR_LL1_Lokalaktiv
        communication-direction=IN, data-element=Grundumfang_XIX_SAM.Geltungsbereich_E3_1_1_UNECE_Gen2.RP_IF_LLR_LL1_Luefter_defekt_XIX_Grundumfang_XIX_SAM.DE_LLR_LL1_Luefter_defekt, system-signal=LLR_LL1_Luefter_defekt
        communication-direction=IN, data-element=Grundumfang_XIX_SAM.Geltungsbereich_E3_1_1_UNECE_Gen2.RP_IF_LLR_LL1_ResponseError_XIX_Grundumfang_XIX_SAM.DE_LLR_LL1_ResponseError, system-signal=LLR_LL1_ResponseError
        communication-direction=IN, data-element=Grundumfang_XIX_SAM.Geltungsbereich_E3_1_1_UNECE_Gen2.RP_IF_LLR_LL1_Ueberspannung_XIX_Grundumfang_XIX_SAM.DE_LLR_LL1_Ueberspannung, system-signal=LLR_LL1_Ueberspannung
        communication-direction=IN, data-element=Grundumfang_XIX_SAM.Geltungsbereich_E3_1_1_UNECE_Gen2.RP_IF_LLR_LL1_Uebertemperatur_XIX_Grundumfang_XIX_SAM.DE_LLR_LL1_Uebertemperatur, system-signal=LLR_LL1_Uebertemperatur
        communication-direction=IN, data-element=Grundumfang_XIX_SAM.Geltungsbereich_E3_1_1_UNECE_Gen2.RP_IF_LLR_LL1_Unterspannung_XIX_Grundumfang_XIX_SAM.DE_LLR_LL1_Unterspannung, system-signal=LLR_LL1_Unterspannung
        communication-direction=IN, data-element=Grundumfang_XIX_SAM.Geltungsbereich_E3_1_1_UNECE_Gen2.RP_IF_LLR_LS1_Blockierung_XIX_Grundumfang_XIX_SAM.DE_LLR_LS1_Blockierung, system-signal=LLR_LS1_Blockierung
        communication-direction=IN, data-element=Grundumfang_XIX_SAM.Geltungsbereich_E3_1_1_UNECE_Gen2.RP_IF_LLR_LS1_CodierPinError_XIX_Grundumfang_XIX_SAM.DE_LLR_LS1_CodierPinError, system-signal=LLR_LS1_CodierPinError
        communication-direction=IN, data-element=Grundumfang_XIX_SAM.Geltungsbereich_E3_1_1_UNECE_Gen2.RP_IF_LLR_LS1_Ist_Drehzahl_XIX_Grundumfang_XIX_SAM.DE_LLR_LS1_Ist_Drehzahl, system-signal=LLR_LS1_Ist_Drehzahl
        communication-direction=IN, data-element=Grundumfang_XIX_SAM.Geltungsbereich_E3_1_1_UNECE_Gen2.RP_IF_LLR_LS1_Lokalaktiv_XIX_Grundumfang_XIX_SAM.DE_LLR_LS1_Lokalaktiv, system-signal=LLR_LS1_Lokalaktiv
        communication-direction=IN, data-element=Grundumfang_XIX_SAM.Geltungsbereich_E3_1_1_UNECE_Gen2.RP_IF_LLR_LS1_Luefter_defekt_XIX_Grundumfang_XIX_SAM.DE_LLR_LS1_Luefter_defekt, system-signal=LLR_LS1_Luefter_defekt
        communication-direction=IN, data-element=Grundumfang_XIX_SAM.Geltungsbereich_E3_1_1_UNECE_Gen2.RP_IF_LLR_LS1_ResponseError_XIX_Grundumfang_XIX_SAM.DE_LLR_LS1_ResponseError, system-signal=LLR_LS1_ResponseError
        communication-direction=IN, data-element=Grundumfang_XIX_SAM.Geltungsbereich_E3_1_1_UNECE_Gen2.RP_IF_LLR_LS1_Ueberspannung_XIX_Grundumfang_XIX_SAM.DE_LLR_LS1_Ueberspannung, system-signal=LLR_LS1_Ueberspannung
        communication-direction=IN, data-element=Grundumfang_XIX_SAM.Geltungsbereich_E3_1_1_UNECE_Gen2.RP_IF_LLR_LS1_Uebertemperatur_XIX_Grundumfang_XIX_SAM.DE_LLR_LS1_Uebertemperatur, system-signal=LLR_LS1_Uebertemperatur
        communication-direction=IN, data-element=Grundumfang_XIX_SAM.Geltungsbereich_E3_1_1_UNECE_Gen2.RP_IF_LLR_LS1_Unterspannung_XIX_Grundumfang_XIX_SAM.DE_LLR_LS1_Unterspannung, system-signal=LLR_LS1_Unterspannung
        communication-direction=IN, data-element=Grundumfang_XIX_SAM.Geltungsbereich_E3_1_1_UNECE_Gen2.RP_IF_LLR_RL1_Blockierung_XIX_Grundumfang_XIX_SAM.DE_LLR_RL1_Blockierung, system-signal=LLR_RL1_Blockierung
        communication-direction=IN, data-element=Grundumfang_XIX_SAM.Geltungsbereich_E3_1_1_UNECE_Gen2.RP_IF_LLR_RL1_CodierPinError_XIX_Grundumfang_XIX_SAM.DE_LLR_RL1_CodierPinError, system-signal=LLR_RL1_CodierPinError
        communication-direction=IN, data-element=Grundumfang_XIX_SAM.Geltungsbereich_E3_1_1_UNECE_Gen2.RP_IF_LLR_RL1_Ist_Drehzahl_XIX_Grundumfang_XIX_SAM.DE_LLR_RL1_Ist_Drehzahl, system-signal=LLR_RL1_Ist_Drehzahl
        communication-direction=IN, data-element=Grundumfang_XIX_SAM.Geltungsbereich_E3_1_1_UNECE_Gen2.RP_IF_LLR_RL1_Lokalaktiv_XIX_Grundumfang_XIX_SAM.DE_LLR_RL1_Lokalaktiv, system-signal=LLR_RL1_Lokalaktiv
        communication-direction=IN, data-element=Grundumfang_XIX_SAM.Geltungsbereich_E3_1_1_UNECE_Gen2.RP_IF_LLR_RL1_Luefter_defekt_XIX_Grundumfang_XIX_SAM.DE_LLR_RL1_Luefter_defekt, system-signal=LLR_RL1_Luefter_defekt
        communication-direction=IN, data-element=Grundumfang_XIX_SAM.Geltungsbereich_E3_1_1_UNECE_Gen2.RP_IF_LLR_RL1_ResponseError_XIX_Grundumfang_XIX_SAM.DE_LLR_RL1_ResponseError, system-signal=LLR_RL1_ResponseError
        communication-direction=IN, data-element=Grundumfang_XIX_SAM.Geltungsbereich_E3_1_1_UNECE_Gen2.RP_IF_LLR_RL1_Ueberspannung_XIX_Grundumfang_XIX_SAM.DE_LLR_RL1_Ueberspannung, system-signal=LLR_RL1_Ueberspannung
        communication-direction=IN, data-element=Grundumfang_XIX_SAM.Geltungsbereich_E3_1_1_UNECE_Gen2.RP_IF_LLR_RL1_Uebertemperatur_XIX_Grundumfang_XIX_SAM.DE_LLR_RL1_Uebertemperatur, system-signal=LLR_RL1_Uebertemperatur
        communication-direction=IN, data-element=Grundumfang_XIX_SAM.Geltungsbereich_E3_1_1_UNECE_Gen2.RP_IF_LLR_RL1_Unterspannung_XIX_Grundumfang_XIX_SAM.DE_LLR_RL1_Unterspannung, system-signal=LLR_RL1_Unterspannung
        communication-direction=IN, data-element=Grundumfang_XIX_SAM.Geltungsbereich_E3_1_1_UNECE_Gen2.RP_IF_LLR_RS1_Blockierung_XIX_Grundumfang_XIX_SAM.DE_LLR_RS1_Blockierung, system-signal=LLR_RS1_Blockierung
        communication-direction=IN, data-element=Grundumfang_XIX_SAM.Geltungsbereich_E3_1_1_UNECE_Gen2.RP_IF_LLR_RS1_CodierPinError_XIX_Grundumfang_XIX_SAM.DE_LLR_RS1_CodierPinError, system-signal=LLR_RS1_CodierPinError
        communication-direction=IN, data-element=Grundumfang_XIX_SAM.Geltungsbereich_E3_1_1_UNECE_Gen2.RP_IF_LLR_RS1_Ist_Drehzahl_XIX_Grundumfang_XIX_SAM.DE_LLR_RS1_Ist_Drehzahl, system-signal=LLR_RS1_Ist_Drehzahl
        communication-direction=IN, data-element=Grundumfang_XIX_SAM.Geltungsbereich_E3_1_1_UNECE_Gen2.RP_IF_LLR_RS1_Lokalaktiv_XIX_Grundumfang_XIX_SAM.DE_LLR_RS1_Lokalaktiv, system-signal=LLR_RS1_Lokalaktiv
        communication-direction=IN, data-element=Grundumfang_XIX_SAM.Geltungsbereich_E3_1_1_UNECE_Gen2.RP_IF_LLR_RS1_Luefter_defekt_XIX_Grundumfang_XIX_SAM.DE_LLR_RS1_Luefter_defekt, system-signal=LLR_RS1_Luefter_defekt
        communication-direction=IN, data-element=Grundumfang_XIX_SAM.Geltungsbereich_E3_1_1_UNECE_Gen2.RP_IF_LLR_RS1_ResponseError_XIX_Grundumfang_XIX_SAM.DE_LLR_RS1_ResponseError, system-signal=LLR_RS1_ResponseError
        communication-direction=IN, data-element=Grundumfang_XIX_SAM.Geltungsbereich_E3_1_1_UNECE_Gen2.RP_IF_LLR_RS1_Ueberspannung_XIX_Grundumfang_XIX_SAM.DE_LLR_RS1_Ueberspannung, system-signal=LLR_RS1_Ueberspannung
        communication-direction=IN, data-element=Grundumfang_XIX_SAM.Geltungsbereich_E3_1_1_UNECE_Gen2.RP_IF_LLR_RS1_Uebertemperatur_XIX_Grundumfang_XIX_SAM.DE_LLR_RS1_Uebertemperatur, system-signal=LLR_RS1_Uebertemperatur
        communication-direction=IN, data-element=Grundumfang_XIX_SAM.Geltungsbereich_E3_1_1_UNECE_Gen2.RP_IF_LLR_RS1_Unterspannung_XIX_Grundumfang_XIX_SAM.DE_LLR_RS1_Unterspannung, system-signal=LLR_RS1_Unterspannung
        communication-direction=IN, data-element=Grundumfang_XIX_SAM.Geltungsbereich_E3_1_1_UNECE_Gen2.RP_IF_LnchCtl_StReq_XIX_Grundumfang_XIX_SAM.DE_LnchCtl_StReq, system-signal=LnchCtl_StReq
        communication-direction=OUT, data-element=Grundumfang_XIX_SAM.Geltungsbereich_E3_1_1_UNECE_Gen2.SP_IF_LR_HZG_01_alt_XIX_Grundumfang_XIX_SAM.DE_LR_HZG_01_alt, system-signal=LR_HZG_01_alt
        communication-direction=IN, data-element=Grundumfang_XIX_SAM.Geltungsbereich_E3_1_1_UNECE_Gen2.RP_IF_LR_HZG_Konfiguration_XIX_Grundumfang_XIX_SAM.DE_LR_HZG_Konfiguration, system-signal=LR_HZG_Konfiguration
        communication-direction=OUT, data-element=Grundumfang_XIX_SAM.Geltungsbereich_E3_1_1_UNECE_Gen2.SP_IF_LR_HZG_Konfiguration_XIX_Grundumfang_XIX_SAM.DE_LR_HZG_Konfiguration, system-signal=LR_HZG_Konfiguration
        communication-direction=IN, data-element=Grundumfang_XIX_SAM.Geltungsbereich_E3_1_1_UNECE_Gen2.RP_IF_LR_HZG_Taster_on_off_XIX_Grundumfang_XIX_SAM.DE_LR_HZG_Taster_on_off, system-signal=LR_HZG_Taster_on_off
        communication-direction=IN, data-element=Grundumfang_XIX_SAM.Geltungsbereich_E3_1_1_UNECE_Gen2.RP_IF_LR_HZG_Temp_Sensor_XIX_Grundumfang_XIX_SAM.DE_LR_HZG_Temp_Sensor, system-signal=LR_HZG_Temp_Sensor
        communication-direction=OUT, data-element=Grundumfang_XIX_SAM.Geltungsbereich_E3_1_1_UNECE_Gen2.SP_IF_LR_HZG_Temp_Sensor_XIX_Grundumfang_XIX_SAM.DE_LR_HZG_Temp_Sensor, system-signal=LR_HZG_Temp_Sensor
        communication-direction=IN, data-element=Grundumfang_XIX_SAM.Geltungsbereich_E3_1_1_UNECE_Gen2.RP_IF_LRH_aktiv_XIX_Grundumfang_XIX_SAM.DE_LRH_aktiv, system-signal=LRH_aktiv
        communication-direction=OUT, data-element=Grundumfang_XIX_SAM.Geltungsbereich_E3_1_1_UNECE_Gen2.SP_IF_LRH_aktiv_XIX_Grundumfang_XIX_SAM.DE_LRH_aktiv, system-signal=LRH_aktiv
        communication-direction=IN, data-element=Grundumfang_XIX_SAM.Geltungsbereich_E3_1_1_UNECE_Gen2.RP_IF_LRH_On_Off_XIX_Grundumfang_XIX_SAM.DE_LRH_On_Off, system-signal=LRH_On_Off
        communication-direction=OUT, data-element=Grundumfang_XIX_SAM.Geltungsbereich_E3_1_1_UNECE_Gen2.SP_IF_LRH_On_Off_XIX_Grundumfang_XIX_SAM.DE_LRH_On_Off, system-signal=LRH_On_Off
        communication-direction=IN, data-element=Grundumfang_XIX_SAM.Geltungsbereich_E3_1_1_UNECE_Gen2.RP_IF_LRH_Stellglied_aktiv_XIX_Grundumfang_XIX_SAM.DE_LRH_Stellglied_aktiv, system-signal=LRH_Stellglied_aktiv
        communication-direction=IN, data-element=Grundumfang_XIX_SAM.Geltungsbereich_E3_1_1_UNECE_Gen2.RP_IF_LRL1_ORUData_XIX_Grundumfang_XIX_SAM.DE_LRL1_ORUData, system-signal=LRL1_ORUData
        communication-direction=IN, data-element=Grundumfang_XIX_SAM.Geltungsbereich_E3_1_1_UNECE_Gen2.RP_IF_LRL1_ORUDataIndex_XIX_Grundumfang_XIX_SAM.DE_LRL1_ORUDataIndex, system-signal=LRL1_ORUDataIndex
        communication-direction=IN, data-element=Grundumfang_XIX_SAM.Geltungsbereich_E3_1_1_UNECE_Gen2.RP_IF_LRL2_ORUData_XIX_Grundumfang_XIX_SAM.DE_LRL2_ORUData, system-signal=LRL2_ORUData
        communication-direction=IN, data-element=Grundumfang_XIX_SAM.Geltungsbereich_E3_1_1_UNECE_Gen2.RP_IF_LRL2_ORUDataIndex_XIX_Grundumfang_XIX_SAM.DE_LRL2_ORUDataIndex, system-signal=LRL2_ORUDataIndex
        communication-direction=IN, data-element=Grundumfang_XIX_SAM.Geltungsbereich_E3_1_1_UNECE_Gen2.RP_IF_LRL3_ORUData_XIX_Grundumfang_XIX_SAM.DE_LRL3_ORUData, system-signal=LRL3_ORUData
        communication-direction=IN, data-element=Grundumfang_XIX_SAM.Geltungsbereich_E3_1_1_UNECE_Gen2.RP_IF_LRL3_ORUDataIndex_XIX_Grundumfang_XIX_SAM.DE_LRL3_ORUDataIndex, system-signal=LRL3_ORUDataIndex
        communication-direction=IN, data-element=Grundumfang_XIX_SAM.Geltungsbereich_E3_1_1_UNECE_Gen2.RP_IF_LRL_L_01_BZ_XIX_Grundumfang_XIX_SAM.DE_LRL_L_01_BZ, system-signal=LRL_L_01_BZ
        communication-direction=IN, data-element=Grundumfang_XIX_SAM.Geltungsbereich_E3_1_1_UNECE_Gen2.RP_IF_LRL_L_01_CRC_XIX_Grundumfang_XIX_SAM.DE_LRL_L_01_CRC, system-signal=LRL_L_01_CRC
        communication-direction=IN, data-element=Grundumfang_XIX_SAM.Geltungsbereich_E3_1_1_UNECE_Gen2.RP_IF_LRL_M_01_BZ_XIX_Grundumfang_XIX_SAM.DE_LRL_M_01_BZ, system-signal=LRL_M_01_BZ
        communication-direction=IN, data-element=Grundumfang_XIX_SAM.Geltungsbereich_E3_1_1_UNECE_Gen2.RP_IF_LRL_M_01_CRC_XIX_Grundumfang_XIX_SAM.DE_LRL_M_01_CRC, system-signal=LRL_M_01_CRC
        communication-direction=IN, data-element=Grundumfang_XIX_SAM.Geltungsbereich_E3_1_1_UNECE_Gen2.RP_IF_LRL_R_01_BZ_XIX_Grundumfang_XIX_SAM.DE_LRL_R_01_BZ, system-signal=LRL_R_01_BZ
        communication-direction=IN, data-element=Grundumfang_XIX_SAM.Geltungsbereich_E3_1_1_UNECE_Gen2.RP_IF_LRL_R_01_CRC_XIX_Grundumfang_XIX_SAM.DE_LRL_R_01_CRC, system-signal=LRL_R_01_CRC
        communication-direction=OUT, data-element=Grundumfang_XIX_SAM.Geltungsbereich_E3_1_1_UNECE_Gen2.SP_IF_LS_defekt_XIX_Grundumfang_XIX_SAM.DE_LS_defekt, system-signal=LS_defekt
        communication-direction=IN, data-element=ABL_XIX_SAM.Geltungsbereich_E3_1_1_UNECE_Gen2.RP_IF_LS_Dunkel_XIX_ABL_XIX_SAM.DE_LS_Dunkel, system-signal=LS_Dunkel
        communication-direction=IN, data-element=Grundumfang_XIX_SAM.Geltungsbereich_E3_1_1_UNECE_Gen2.RP_IF_LS_Dunkel_XIX_Grundumfang_XIX_SAM.DE_LS_Dunkel, system-signal=LS_Dunkel
        communication-direction=OUT, data-element=Grundumfang_XIX_SAM.Geltungsbereich_E3_1_1_UNECE_Gen2.SP_IF_LS_Dunkel_XIX_Grundumfang_XIX_SAM.DE_LS_Dunkel, system-signal=LS_Dunkel
        communication-direction=IN, data-element=ABL_XIX_SAM.Geltungsbereich_E3_1_1_UNECE_Gen2.RP_IF_LS_Error_XIX_ABL_XIX_SAM.DE_LS_Error, system-signal=LS_Error
        communication-direction=IN, data-element=Grundumfang_XIX_SAM.Geltungsbereich_E3_1_1_UNECE_Gen2.RP_IF_LS_Error_XIX_Grundumfang_XIX_SAM.DE_LS_Error, system-signal=LS_Error
        communication-direction=OUT, data-element=Grundumfang_XIX_SAM.Geltungsbereich_E3_1_1_UNECE_Gen2.SP_IF_LS_Error_XIX_Grundumfang_XIX_SAM.DE_LS_Error, system-signal=LS_Error
        communication-direction=IN, data-element=ABL_XIX_SAM.Geltungsbereich_E3_1_1_UNECE_Gen2.RP_IF_LS_Helligkeit_FW_XIX_ABL_XIX_SAM.DE_LS_Helligkeit_FW, system-signal=LS_Helligkeit_FW
        communication-direction=IN, data-element=Grundumfang_XIX_SAM.Geltungsbereich_E3_1_1_UNECE_Gen2.RP_IF_LS_Helligkeit_FW_XIX_Grundumfang_XIX_SAM.DE_LS_Helligkeit_FW, system-signal=LS_Helligkeit_FW
        communication-direction=OUT, data-element=Grundumfang_XIX_SAM.Geltungsbereich_E3_1_1_UNECE_Gen2.SP_IF_LS_Helligkeit_FW_XIX_Grundumfang_XIX_SAM.DE_LS_Helligkeit_FW, system-signal=LS_Helligkeit_FW
        communication-direction=IN, data-element=ABL_XIX_SAM.Geltungsbereich_E3_1_1_UNECE_Gen2.RP_IF_LS_Helligkeit_IR_XIX_ABL_XIX_SAM.DE_LS_Helligkeit_IR, system-signal=LS_Helligkeit_IR
        communication-direction=IN, data-element=Grundumfang_XIX_SAM.Geltungsbereich_E3_1_1_UNECE_Gen2.RP_IF_LS_Helligkeit_IR_XIX_Grundumfang_XIX_SAM.DE_LS_Helligkeit_IR, system-signal=LS_Helligkeit_IR
        communication-direction=OUT, data-element=Grundumfang_XIX_SAM.Geltungsbereich_E3_1_1_UNECE_Gen2.SP_IF_LS_Helligkeit_IR_XIX_Grundumfang_XIX_SAM.DE_LS_Helligkeit_IR, system-signal=LS_Helligkeit_IR
        communication-direction=IN, data-element=ABL_XIX_SAM.Geltungsbereich_E3_1_1_UNECE_Gen2.RP_IF_LS_Licht_ein_XIX_ABL_XIX_SAM.DE_LS_Licht_ein, system-signal=LS_Licht_ein
        communication-direction=IN, data-element=Grundumfang_XIX_SAM.Geltungsbereich_E3_1_1_UNECE_Gen2.RP_IF_LS_Licht_ein_XIX_Grundumfang_XIX_SAM.DE_LS_Licht_ein, system-signal=LS_Licht_ein
        communication-direction=OUT, data-element=Grundumfang_XIX_SAM.Geltungsbereich_E3_1_1_UNECE_Gen2.SP_IF_LS_Licht_ein_XIX_Grundumfang_XIX_SAM.DE_LS_Licht_ein, system-signal=LS_Licht_ein
        communication-direction=IN, data-element=ABL_XIX_SAM.Geltungsbereich_E3_1_1_UNECE_Gen2.RP_IF_LS_Licht_ein_invers_XIX_ABL_XIX_SAM.DE_LS_Licht_ein_invers, system-signal=LS_Licht_ein_invers
        communication-direction=IN, data-element=Grundumfang_XIX_SAM.Geltungsbereich_E3_1_1_UNECE_Gen2.RP_IF_LS_Licht_ein_invers_XIX_Grundumfang_XIX_SAM.DE_LS_Licht_ein_invers, system-signal=LS_Licht_ein_invers
        communication-direction=OUT, data-element=Grundumfang_XIX_SAM.Geltungsbereich_E3_1_1_UNECE_Gen2.SP_IF_LS_Licht_ein_invers_XIX_Grundumfang_XIX_SAM.DE_LS_Licht_ein_invers, system-signal=LS_Licht_ein_invers
        communication-direction=IN, data-element=ABL_XIX_SAM.Geltungsbereich_E3_1_1_UNECE_Gen2.RP_IF_LS_TFL_mit_SL_ein_XIX_ABL_XIX_SAM.DE_LS_TFL_mit_SL_ein, system-signal=LS_TFL_mit_SL_ein
        communication-direction=IN, data-element=Grundumfang_XIX_SAM.Geltungsbereich_E3_1_1_UNECE_Gen2.RP_IF_LS_TFL_mit_SL_ein_XIX_Grundumfang_XIX_SAM.DE_LS_TFL_mit_SL_ein, system-signal=LS_TFL_mit_SL_ein
        communication-direction=OUT, data-element=Grundumfang_XIX_SAM.Geltungsbereich_E3_1_1_UNECE_Gen2.SP_IF_LS_TFL_mit_SL_ein_XIX_Grundumfang_XIX_SAM.DE_LS_TFL_mit_SL_ein, system-signal=LS_TFL_mit_SL_ein
        communication-direction=OUT, data-element=Grundumfang_XIX_SAM.Geltungsbereich_E3_1_1_UNECE_Gen2.SP_IF_LS_Verbau_XIX_Grundumfang_XIX_SAM.DE_LS_Verbau, system-signal=LS_Verbau
        communication-direction=IN, data-element=Grundumfang_XIX_SAM.Geltungsbereich_E3_1_1_UNECE_Gen2.RP_IF_LSS_Tastencode_XIX_Grundumfang_XIX_SAM.DE_LSS_Tastencode, system-signal=LSS_Tastencode
        communication-direction=OUT, data-element=Grundumfang_XIX_SAM.Geltungsbereich_E3_1_1_UNECE_Gen2.SP_IF_LSS_Tastencode_XIX_Grundumfang_XIX_SAM.DE_LSS_Tastencode, system-signal=LSS_Tastencode
        communication-direction=IN, data-element=Grundumfang_XIX_SAM.Geltungsbereich_E3_1_1_UNECE_Gen2.RP_IF_LTM_ResponseError_XIX_Grundumfang_XIX_SAM.DE_LTM_ResponseError, system-signal=LTM_ResponseError
        communication-direction=IN, data-element=Grundumfang_XIX_SAM.Geltungsbereich_E3_1_1_UNECE_Gen2.RP_IF_LTM_StatusLichttastenmodul_XIX_Grundumfang_XIX_SAM.DE_LTM_StatusLichttastenmodul, system-signal=LTM_StatusLichttastenmodul
        communication-direction=IN, data-element=Grundumfang_XIX_SAM.Geltungsbereich_E3_1_1_UNECE_Gen2.RP_IF_LV_Abblendlicht_Anzeige_XIX_Grundumfang_XIX_SAM.DE_LV_Abblendlicht_Anzeige, system-signal=LV_Abblendlicht_Anzeige
        communication-direction=IN, data-element=Grundumfang_XIX_SAM.Geltungsbereich_E3_1_1_UNECE_Gen2.RP_IF_LWR_SollDC_XIX_Grundumfang_XIX_SAM.DE_LWR_SollDC, system-signal=LWR_SollDC
        communication-direction=IN, data-element=Grundumfang_XIX_SAM.Geltungsbereich_E3_1_1_UNECE_Gen2.RP_IF_MaaSBladeMyc_ORUData_XIX_Grundumfang_XIX_SAM.DE_MaaSBladeMyc_ORUData, system-signal=MaaSBladeMyc_ORUData
        communication-direction=IN, data-element=Grundumfang_XIX_SAM.Geltungsbereich_E3_1_1_UNECE_Gen2.RP_IF_MaaSBladeMyc_ORUDataIndex_XIX_Grundumfang_XIX_SAM.DE_MaaSBladeMyc_ORUDataIndex, system-signal=MaaSBladeMyc_ORUDataIndex
        communication-direction=IN, data-element=Grundumfang_XIX_SAM.Geltungsbereich_E3_1_1_UNECE_Gen2.RP_IF_MainBlade_ORUData_XIX_Grundumfang_XIX_SAM.DE_MainBlade_ORUData, system-signal=MainBlade_ORUData
        communication-direction=IN, data-element=Grundumfang_XIX_SAM.Geltungsbereich_E3_1_1_UNECE_Gen2.RP_IF_MainBlade_ORUDataIndex_XIX_Grundumfang_XIX_SAM.DE_MainBlade_ORUDataIndex, system-signal=MainBlade_ORUDataIndex
        communication-direction=OUT, data-element=Grundumfang_XIX_SAM.Geltungsbereich_E3_1_1_UNECE_Gen2.SP_IF_Master_Zaehler_XIX_Grundumfang_XIX_SAM.DE_Master_Zaehler, system-signal=Master_Zaehler
        communication-direction=IN, data-element=Grundumfang_XIX_SAM.Geltungsbereich_E3_1_1_UNECE_Gen2.RP_IF_MF_DCDC_Istmodus_XIX_Grundumfang_XIX_SAM.DE_MF_DCDC_Istmodus, system-signal=MF_DCDC_Istmodus
        communication-direction=IN, data-element=Grundumfang_XIX_SAM.Geltungsbereich_E3_1_1_UNECE_Gen2.RP_IF_MF_Fahrlicht_XIX_Grundumfang_XIX_SAM.DE_MF_Fahrlicht, system-signal=MF_Fahrlicht
        communication-direction=IN, data-element=Grundumfang_XIX_SAM.Geltungsbereich_E3_1_1_UNECE_Gen2.RP_IF_MF_Fernbed_ein_XIX_Grundumfang_XIX_SAM.DE_MF_Fernbed_ein, system-signal=MF_Fernbed_ein
        communication-direction=IN, data-element=Grundumfang_XIX_SAM.Geltungsbereich_E3_1_1_UNECE_Gen2.RP_IF_MF_Frontintervall_XIX_Grundumfang_XIX_SAM.DE_MF_Frontintervall, system-signal=MF_Frontintervall
        communication-direction=IN, data-element=Grundumfang_XIX_SAM.Geltungsbereich_E3_1_1_UNECE_Gen2.RP_IF_MF_Frontwaschen_XIX_Grundumfang_XIX_SAM.DE_MF_Frontwaschen, system-signal=MF_Frontwaschen
        communication-direction=IN, data-element=Grundumfang_XIX_SAM.Geltungsbereich_E3_1_1_UNECE_Gen2.RP_IF_MF_Fussraumbel_XIX_Grundumfang_XIX_SAM.DE_MF_Fussraumbel, system-signal=MF_Fussraumbel
        communication-direction=IN, data-element=Grundumfang_XIX_SAM.Geltungsbereich_E3_1_1_UNECE_Gen2.RP_IF_MF_Heckintervall_XIX_Grundumfang_XIX_SAM.DE_MF_Heckintervall, system-signal=MF_Heckintervall
        communication-direction=IN, data-element=Grundumfang_XIX_SAM.Geltungsbereich_E3_1_1_UNECE_Gen2.RP_IF_MF_Heckwaschen_XIX_Grundumfang_XIX_SAM.DE_MF_Heckwaschen, system-signal=MF_Heckwaschen
        communication-direction=IN, data-element=Grundumfang_XIX_SAM.Geltungsbereich_E3_1_1_UNECE_Gen2.RP_IF_MF_Innenraumbel_XIX_Grundumfang_XIX_SAM.DE_MF_Innenraumbel, system-signal=MF_Innenraumbel
        communication-direction=IN, data-element=Grundumfang_XIX_SAM.Geltungsbereich_E3_1_1_UNECE_Gen2.RP_IF_MF_Innenraumbel_Unterdrueck_XIX_Grundumfang_XIX_SAM.DE_MF_Innenraumbel_Unterdrueck, system-signal=MF_Innenraumbel_Unterdrueck
        communication-direction=IN, data-element=Grundumfang_XIX_SAM.Geltungsbereich_E3_1_1_UNECE_Gen2.RP_IF_MF_Motorweiterlauf_XIX_Grundumfang_XIX_SAM.DE_MF_Motorweiterlauf, system-signal=MF_Motorweiterlauf
        communication-direction=IN, data-element=Grundumfang_XIX_SAM.Geltungsbereich_E3_1_1_UNECE_Gen2.RP_IF_MF_Signalhorn_XIX_Grundumfang_XIX_SAM.DE_MF_Signalhorn, system-signal=MF_Signalhorn
        communication-direction=IN, data-element=Grundumfang_XIX_SAM.Geltungsbereich_E3_1_1_UNECE_Gen2.RP_IF_MF_Tippwischen_XIX_Grundumfang_XIX_SAM.DE_MF_Tippwischen, system-signal=MF_Tippwischen
        communication-direction=IN, data-element=Grundumfang_XIX_SAM.Geltungsbereich_E3_1_1_UNECE_Gen2.RP_IF_MF_Variante_XIX_Grundumfang_XIX_SAM.DE_MF_Variante, system-signal=MF_Variante
        communication-direction=IN, data-element=Grundumfang_XIX_SAM.Geltungsbereich_E3_1_1_UNECE_Gen2.RP_IF_MF_Wischerstufe_1_XIX_Grundumfang_XIX_SAM.DE_MF_Wischerstufe_1, system-signal=MF_Wischerstufe_1
        communication-direction=IN, data-element=Grundumfang_XIX_SAM.Geltungsbereich_E3_1_1_UNECE_Gen2.RP_IF_MF_Wischerstufe_2_XIX_Grundumfang_XIX_SAM.DE_MF_Wischerstufe_2, system-signal=MF_Wischerstufe_2
        communication-direction=IN, data-element=Grundumfang_XIX_SAM.Geltungsbereich_E3_1_1_UNECE_Gen2.RP_IF_MFG_01_BZ_XIX_Grundumfang_XIX_SAM.DE_MFG_01_BZ, system-signal=MFG_01_BZ
        communication-direction=IN, data-element=Grundumfang_XIX_SAM.Geltungsbereich_E3_1_1_UNECE_Gen2.RP_IF_MFG_01_CRC_XIX_Grundumfang_XIX_SAM.DE_MFG_01_CRC, system-signal=MFG_01_CRC
        communication-direction=IN, data-element=Grundumfang_XIX_SAM.Geltungsbereich_E3_1_1_UNECE_Gen2.RP_IF_MFK_ORUData_XIX_Grundumfang_XIX_SAM.DE_MFK_ORUData, system-signal=MFK_ORUData
        communication-direction=IN, data-element=Grundumfang_XIX_SAM.Geltungsbereich_E3_1_1_UNECE_Gen2.RP_IF_MFK_ORUDataIndex_XIX_Grundumfang_XIX_SAM.DE_MFK_ORUDataIndex, system-signal=MFK_ORUDataIndex
        communication-direction=IN, data-element=Grundumfang_XIX_SAM.Geltungsbereich_E3_1_1_UNECE_Gen2.RP_IF_MFL_CAN_ORUData_XIX_Grundumfang_XIX_SAM.DE_MFL_CAN_ORUData, system-signal=MFL_CAN_ORUData
        communication-direction=IN, data-element=Grundumfang_XIX_SAM.Geltungsbereich_E3_1_1_UNECE_Gen2.RP_IF_MFL_CAN_ORUDataIndex_XIX_Grundumfang_XIX_SAM.DE_MFL_CAN_ORUDataIndex, system-signal=MFL_CAN_ORUDataIndex
        communication-direction=IN, data-element=Grundumfang_XIX_SAM.Geltungsbereich_E3_1_1_UNECE_Gen2.RP_IF_MFL_Signalhorn_XIX_Grundumfang_XIX_SAM.DE_MFL_Signalhorn, system-signal=MFL_Signalhorn
        communication-direction=IN, data-element=Grundumfang_XIX_SAM.Geltungsbereich_E3_1_1_UNECE_Gen2.RP_IF_MO_Fahrbereitschaft_XIX_Grundumfang_XIX_SAM.DE_MO_Fahrbereitschaft, system-signal=MO_Fahrbereitschaft
        communication-direction=IN, data-element=Grundumfang_XIX_SAM.Geltungsbereich_E3_1_1_UNECE_Gen2.RP_IF_MO_Fahrpedalrohwert_01_XIX_Grundumfang_XIX_SAM.DE_MO_Fahrpedalrohwert_01, system-signal=MO_Fahrpedalrohwert_01
        communication-direction=IN, data-element=Grundumfang_XIX_SAM.Geltungsbereich_E3_1_1_UNECE_Gen2.RP_IF_MO_HYB_Fahrbereitschaft_XIX_Grundumfang_XIX_SAM.DE_MO_HYB_Fahrbereitschaft, system-signal=MO_HYB_Fahrbereitschaft
        communication-direction=OUT, data-element=Grundumfang_XIX_SAM.Geltungsbereich_E3_1_1_UNECE_Gen2.SP_IF_MO_Kl_75_XIX_Grundumfang_XIX_SAM.DE_MO_Kl_75, system-signal=MO_Kl_75
        communication-direction=IN, data-element=Grundumfang_XIX_SAM.Geltungsbereich_E3_1_1_UNECE_Gen2.RP_IF_Motor_BEV_ORUData_XIX_Grundumfang_XIX_SAM.DE_Motor_BEV_ORUData, system-signal=Motor_BEV_ORUData
        communication-direction=IN, data-element=Grundumfang_XIX_SAM.Geltungsbereich_E3_1_1_UNECE_Gen2.RP_IF_Motor_BEV_ORUDataIndex_XIX_Grundumfang_XIX_SAM.DE_Motor_BEV_ORUDataIndex, system-signal=Motor_BEV_ORUDataIndex
        communication-direction=OUT, data-element=Grundumfang_XIX_SAM.Geltungsbereich_E3_1_1_UNECE_Gen2.SP_IF_NM_BCM1_CAB_V15_XIX_Grundumfang_XIX_SAM.DE_NM_BCM1_CAB_V15, system-signal=NM_BCM1_CAB_V15
        communication-direction=OUT, data-element=Grundumfang_XIX_SAM.Geltungsbereich_E3_1_1_UNECE_Gen2.SP_IF_NM_BCM1_Car_Wakeup_XIX_Grundumfang_XIX_SAM.DE_NM_BCM1_Car_Wakeup, system-signal=NM_BCM1_Car_Wakeup
        communication-direction=OUT, data-element=Grundumfang_XIX_SAM.Geltungsbereich_E3_1_1_UNECE_Gen2.SP_IF_NM_BCM1_CBV_AWB_XIX_Grundumfang_XIX_SAM.DE_NM_BCM1_CBV_AWB, system-signal=NM_BCM1_CBV_AWB
        communication-direction=OUT, data-element=Grundumfang_XIX_SAM.Geltungsbereich_E3_1_1_UNECE_Gen2.SP_IF_NM_BCM1_CBV_CRI_XIX_Grundumfang_XIX_SAM.DE_NM_BCM1_CBV_CRI, system-signal=NM_BCM1_CBV_CRI
        communication-direction=OUT, data-element=Grundumfang_XIX_SAM.Geltungsbereich_E3_1_1_UNECE_Gen2.SP_IF_NM_BCM1_NM_aktiv_Applikation_XIX_Grundumfang_XIX_SAM.DE_NM_BCM1_NM_aktiv_Applikation, system-signal=NM_BCM1_NM_aktiv_Applikation
        communication-direction=OUT, data-element=Grundumfang_XIX_SAM.Geltungsbereich_E3_1_1_UNECE_Gen2.SP_IF_NM_BCM1_NM_aktiv_Aussenlicht_XIX_Grundumfang_XIX_SAM.DE_NM_BCM1_NM_aktiv_Aussenlicht, system-signal=NM_BCM1_NM_aktiv_Aussenlicht
        communication-direction=OUT, data-element=Grundumfang_XIX_SAM.Geltungsbereich_E3_1_1_UNECE_Gen2.SP_IF_NM_BCM1_NM_aktiv_Diagnose_XIX_Grundumfang_XIX_SAM.DE_NM_BCM1_NM_aktiv_Diagnose, system-signal=NM_BCM1_NM_aktiv_Diagnose
        communication-direction=OUT, data-element=Grundumfang_XIX_SAM.Geltungsbereich_E3_1_1_UNECE_Gen2.SP_IF_NM_BCM1_NM_aktiv_DWA_XIX_Grundumfang_XIX_SAM.DE_NM_BCM1_NM_aktiv_DWA, system-signal=NM_BCM1_NM_aktiv_DWA
        communication-direction=OUT, data-element=Grundumfang_XIX_SAM.Geltungsbereich_E3_1_1_UNECE_Gen2.SP_IF_NM_BCM1_NM_aktiv_Funk_XIX_Grundumfang_XIX_SAM.DE_NM_BCM1_NM_aktiv_Funk, system-signal=NM_BCM1_NM_aktiv_Funk
        communication-direction=OUT, data-element=Grundumfang_XIX_SAM.Geltungsbereich_E3_1_1_UNECE_Gen2.SP_IF_NM_BCM1_NM_aktiv_Heizung_XIX_Grundumfang_XIX_SAM.DE_NM_BCM1_NM_aktiv_Heizung, system-signal=NM_BCM1_NM_aktiv_Heizung
        communication-direction=OUT, data-element=Grundumfang_XIX_SAM.Geltungsbereich_E3_1_1_UNECE_Gen2.SP_IF_NM_BCM1_NM_aktiv_Innenlicht_XIX_Grundumfang_XIX_SAM.DE_NM_BCM1_NM_aktiv_Innenlicht, system-signal=NM_BCM1_NM_aktiv_Innenlicht
        communication-direction=OUT, data-element=Grundumfang_XIX_SAM.Geltungsbereich_E3_1_1_UNECE_Gen2.SP_IF_NM_BCM1_NM_aktiv_Kessy_XIX_Grundumfang_XIX_SAM.DE_NM_BCM1_NM_aktiv_Kessy, system-signal=NM_BCM1_NM_aktiv_Kessy
        communication-direction=OUT, data-element=Grundumfang_XIX_SAM.Geltungsbereich_E3_1_1_UNECE_Gen2.SP_IF_NM_BCM1_NM_aktiv_KL15_XIX_Grundumfang_XIX_SAM.DE_NM_BCM1_NM_aktiv_KL15, system-signal=NM_BCM1_NM_aktiv_KL15
        communication-direction=OUT, data-element=Grundumfang_XIX_SAM.Geltungsbereich_E3_1_1_UNECE_Gen2.SP_IF_NM_BCM1_NM_aktiv_Remotestart_XIX_Grundumfang_XIX_SAM.DE_NM_BCM1_NM_aktiv_Remotestart, system-signal=NM_BCM1_NM_aktiv_Remotestart
