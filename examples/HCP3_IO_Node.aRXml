[part 1 of 15: packages /E3_1_2_Premium to /ECU]
AUTOSAR XML (schema 4-3-0)
standard types defined: sint8, sint16, sint32, sint64, uint8, uint16, uint32, uint64, float32, float64, boolean
package /E3_1_2_Premium
  system System: pnc-vector-length=7, pnc-vector-offset=1
    system mapping System_Mappings: data-mappings={client-server-to-signal-mapping={service-instance=ProvSI_IdsCanSensor_Instance3_XIX_HCP3_IONode, call-signal=IdsCanSensor_Methods_undefineCanSensorFeaturesElement0_Request, client-server-operation=Geltungsbereich_E3_1_2_Premium.IDS_Sensors_HCP3_IONode_XIX_IDS_ANH_XIX_HCP3_IONode.PP_IdsCanSensorMethods.undefineCanSensorFeaturesElement0, return-signal=IdsCanSensor_Methods_undefineCanSensorFeaturesElement0_Response}, client-server-to-signal-mapping={service-instance=ProvSI_IdsCanSensor_Instance3_XIX_HCP3_IONode, call-signal=IdsCanSensor_Methods_setCanSensorFeaturesElement0_Request, client-server-operation=Geltungsbereich_E3_1_2_Premium.IDS_Sensors_HCP3_IONode_XIX_IDS_ANH_XIX_HCP3_IONode.PP_IdsCanSensorMethods.setCanSensorFeaturesElement0, return-signal=IdsCanSensor_Methods_setCanSensorFeaturesElement0_Response}, client-server-to-signal-mapping={service-instance=ProvSI_IdsCanSensor_Instance3_XIX_HCP3_IONode, call-signal=IdsCanSensor_MethodsGet_canSensorFeaturesElement0_Request, client-server-operation=Geltungsbereich_E3_1_2_Premium.IDS_Sensors_HCP3_IONode_XIX_IDS_ANH_XIX_HCP3_IONode.PP_IdsCanSensorMethods.getcanSensorFeaturesElement0, return-signal=IdsCanSensor_MethodsGet_canSensorFeaturesElement0_Response}, client-server-to-signal-mapping={service-instance=ProvSI_IdsCanSensor_Instance3_XIX_HCP3_IONode, call-signal=IdsCanSensor_MethodsGet_periodicSignalElement0_Request, client-server-operation=Geltungsbereich_E3_1_2_Premium.IDS_Sensors_HCP3_IONode_XIX_IDS_ANH_XIX_HCP3_IONode.PP_IdsCanSensorMethods.getperiodicSignalElement0, return-signal=IdsCanSensor_MethodsGet_periodicSignalElement0_Response}, sender-receiver-to-signal-mapping={communication-direction=OUT, event-handler=canSensorFeaturesElement0, service-instance=ProvSI_IdsCanSensor_Instance3_XIX_HCP3_IONode, data-element=IDS_Sensors_HCP3_IONode_XIX_IDS_ANH_XIX_HCP3_IONode.Geltungsbereich_E3_1_2_Premium.PP_IdsCanSensorEvents.canSensorFeaturesElement0, system-signal=IdsCanSensor_Events_canSensorFeaturesElement0}, sender-receiver-to-signal-mapping={communication-direction=OUT, event-handler=periodicSignalElement0, service-instance=ProvSI_IdsCanSensor_Instance3_XIX_HCP3_IONode, data-element=IDS_Sensors_HCP3_IONode_XIX_IDS_ANH_XIX_HCP3_IONode.Geltungsbereich_E3_1_2_Premium.PP_IdsCanSensorEvents.periodicSignalElement0, system-signal=IdsCanSensor_Events_periodicSignalElement0}, sender-receiver-to-signal-mapping={communication-direction=OUT, event-handler=securityEvent, service-instance=ProvSI_IDSSecurityEventSmall_Instance3_XIX_HCP3_IONode, data-element=IDS_Sensors_HCP3_IONode_XIX_IDS_ANH_XIX_HCP3_IONode.Geltungsbereich_E3_1_2_Premium.PP_IDSSecurityEventSmallEvents.securityEvent, system-signal=IDSSecurityEventSmall_Events_securityEvent}, client-server-to-signal-mapping={service-instance=ConsSI_SOMEIPTestabilityClient_XIX_HCP3_IONode, call-signal=SOMEIPTestabilityClient_Methods_echoFloat32_Request, client-server-operation=Geltungsbereich_E3_1_2_Premium.Infrastructure_Info_El_XIX_network_infrastructure_XIX_HCP3_IONode.RP_SOMEIPTestabilityClientMethods.echoFloat32, return-signal=SOMEIPTestabilityClient_Methods_echoFloat32_Response}, client-server-to-signal-mapping={service-instance=ConsSI_SOMEIPTestabilityClient_XIX_HCP3_IONode, call-signal=SOMEIPTestabilityClient_Methods_echoUInt8UInt16UInt32_Request, client-server-operation=Geltungsbereich_E3_1_2_Premium.Infrastructure_Info_El_XIX_network_infrastructure_XIX_HCP3_IONode.RP_SOMEIPTestabilityClientMethods.echoUInt8UInt16UInt32, return-signal=SOMEIPTestabilityClient_Methods_echoUInt8UInt16UInt32_Response}, client-server-to-signal-mapping={service-instance=ConsSI_SOMEIPTestabilityClient_XIX_HCP3_IONode, call-signal=SOMEIPTestabilityClient_Methods_echoComplexStruct_Request, client-server-operation=Geltungsbereich_E3_1_2_Premium.Infrastructure_Info_El_XIX_network_infrastructure_XIX_HCP3_IONode.RP_SOMEIPTestabilityClientMethods.echoComplexStruct, return-signal=SOMEIPTestabilityClient_Methods_echoComplexStruct_Response}, client-server-to-signal-mapping={service-instance=ConsSI_SOMEIPTestabilityClient_XIX_HCP3_IONode, call-signal=SOMEIPTestabilityClient_Methods_echoUInt8_Request, client-server-operation=Geltungsbereich_E3_1_2_Premium.Infrastructure_Info_El_XIX_network_infrastructure_XIX_HCP3_IONode.RP_SOMEIPTestabilityClientMethods.echoUInt8, return-signal=SOMEIPTestabilityClient_Methods_echoUInt8_Response}, client-server-to-signal-mapping={service-instance=ConsSI_SOMEIPTestabilityClient_XIX_HCP3_IONode, call-signal=SOMEIPTestabilityClient_Methods_echoComplexDynamicArray_Request, client-server-operation=Geltungsbereich_E3_1_2_Premium.Infrastructure_Info_El_XIX_network_infrastructure_XIX_HCP3_IONode.RP_SOMEIPTestabilityClientMethods.echoComplexDynamicArray, return-signal=SOMEIPTestabilityClient_Methods_echoComplexDynamicArray_Response}, client-server-to-signal-mapping={service-instance=ConsSI_SOMEIPTestabilityClient_XIX_HCP3_IONode, call-signal=SOMEIPTestabilityClient_MethodsGet_TestFieldUInt8_Request, client-server-operation=Geltungsbereich_E3_1_2_Premium.Infrastructure_Info_El_XIX_network_infrastructure_XIX_HCP3_IONode.RP_SOMEIPTestabilityClientMethods.getTestFieldUInt8, return-signal=SOMEIPTestabilityClient_MethodsGet_TestFieldUInt8_Response}, client-server-to-signal-mapping={service-instance=ConsSI_SOMEIPTestabilityClient_XIX_HCP3_IONode, call-signal=SOMEIPTestabilityClient_MethodsSet_TestFieldUInt8_Request, client-server-operation=Geltungsbereich_E3_1_2_Premium.Infrastructure_Info_El_XIX_network_infrastructure_XIX_HCP3_IONode.RP_SOMEIPTestabilityClientMethods.setTestFieldUInt8, return-signal=SOMEIPTestabilityClient_MethodsSet_TestFieldUInt8_Response}, sender-receiver-to-signal-mapping={communication-direction=OUT, service-instance=ConsSI_SOMEIPTestabilityClient_XIX_HCP3_IONode, data-element=Infrastructure_Info_El_XIX_network_infrastructure_XIX_HCP3_IONode.Geltungsbereich_E3_1_2_Premium.PP_SOMEIPTestabilityClientRnRMethods.rnrEchoComplexDynamicArray, system-signal=SOMEIPTestabilityClient_RnRMethods_rnrEchoComplexDynamicArray}, sender-receiver-to-signal-mapping={communication-direction=OUT, service-instance=ConsSI_SOMEIPTestabilityClient_XIX_HCP3_IONode, data-element=Infrastructure_Info_El_XIX_network_infrastructure_XIX_HCP3_IONode.Geltungsbereich_E3_1_2_Premium.PP_SOMEIPTestabilityClientRnRMethods.rnrEchoFloat32, system-signal=SOMEIPTestabilityClient_RnRMethods_rnrEchoFloat32}, sender-receiver-to-signal-mapping={communication-direction=OUT, service-instance=ConsSI_SOMEIPTestabilityClient_XIX_HCP3_IONode, data-element=Infrastructure_Info_El_XIX_network_infrastructure_XIX_HCP3_IONode.Geltungsbereich_E3_1_2_Premium.PP_SOMEIPTestabilityClientRnRMethods.rnrEchoUInt8UInt16UInt32, system-signal=SOMEIPTestabilityClient_RnRMethods_rnrEchoUInt8UInt16UInt32}, sender-receiver-to-signal-mapping={communication-direction=OUT, service-instance=ConsSI_SOMEIPTestabilityClient_XIX_HCP3_IONode, data-element=Infrastructure_Info_El_XIX_network_infrastructure_XIX_HCP3_IONode.Geltungsbereich_E3_1_2_Premium.PP_SOMEIPTestabilityClientRnRMethods.rnrEchoComplexStruct, system-signal=SOMEIPTestabilityClient_RnRMethods_rnrEchoComplexStruct}, sender-receiver-to-signal-mapping={communication-direction=OUT, service-instance=ConsSI_SOMEIPTestabilityClient_XIX_HCP3_IONode, data-element=Infrastructure_Info_El_XIX_network_infrastructure_XIX_HCP3_IONode.Geltungsbereich_E3_1_2_Premium.PP_SOMEIPTestabilityClientRnRMethods.noResponseUInt8, system-signal=SOMEIPTestabilityClient_RnRMethods_noResponseUInt8}, sender-receiver-to-signal-mapping={communication-direction=IN, event-group=ConsSI_SOMEIPTestabilityClient_XIX_HCP3_IONode/testEventUInt8, service-instance=ConsSI_SOMEIPTestabilityClient_XIX_HCP3_IONode, data-element=Infrastructure_Info_El_XIX_network_infrastructure_XIX_HCP3_IONode.Geltungsbereich_E3_1_2_Premium.RP_SOMEIPTestabilityClientEvents.testEventUInt8, system-signal=SOMEIPTestabilityClient_Events_testEventUInt8}, sender-receiver-to-signal-mapping={communication-direction=IN, event-group=ConsSI_SOMEIPTestabilityClient_XIX_HCP3_IONode/TestFieldUInt8, service-instance=ConsSI_SOMEIPTestabilityClient_XIX_HCP3_IONode, data-element=Infrastructure_Info_El_XIX_network_infrastructure_XIX_HCP3_IONode.Geltungsbereich_E3_1_2_Premium.RP_SOMEIPTestabilityClientEvents.TestFieldUInt8, system-signal=SOMEIPTestabilityClient_Events_TestFieldUInt8}, client-server-to-signal-mapping={service-instance=ProvSI_SOMEIPTestabilityReliable_Instance1_XIX_HCP3_IONode, call-signal=SOMEIPTestabilityReliable_Methods_echoUInt8UInt16UInt32_Request, client-server-operation=Geltungsbereich_E3_1_2_Premium.Infrastructure_Info_El_XIX_network_infrastructure_XIX_HCP3_IONode.PP_SOMEIPTestabilityReliableMethods.echoUInt8UInt16UInt32, return-signal=SOMEIPTestabilityReliable_Methods_echoUInt8UInt16UInt32_Response}, client-server-to-signal-mapping={service-instance=ProvSI_SOMEIPTestabilityReliable_Instance1_XIX_HCP3_IONode, call-signal=SOMEIPTestabilityReliable_Methods_echoUInt8_Request, client-server-operation=Geltungsbereich_E3_1_2_Premium.Infrastructure_Info_El_XIX_network_infrastructure_XIX_HCP3_IONode.PP_SOMEIPTestabilityReliableMethods.echoUInt8, return-signal=SOMEIPTestabilityReliable_Methods_echoUInt8_Response}, client-server-to-signal-mapping={service-instance=ProvSI_SOMEIPTestabilityReliable_Instance1_XIX_HCP3_IONode, call-signal=SOMEIPTestabilityReliable_Methods_echoBool_Request, client-server-operation=Geltungsbereich_E3_1_2_Premium.Infrastructure_Info_El_XIX_network_infrastructure_XIX_HCP3_IONode.PP_SOMEIPTestabilityReliableMethods.echoBool, return-signal=SOMEIPTestabilityReliable_Methods_echoBool_Response}, client-server-to-signal-mapping={service-instance=ProvSI_SOMEIPTestabilityReliable_Instance1_XIX_HCP3_IONode, call-signal=SOMEIPTestabilityReliable_Methods_getLastValueFieldMulticast_Request, client-server-operation=Geltungsbereich_E3_1_2_Premium.Infrastructure_Info_El_XIX_network_infrastructure_XIX_HCP3_IONode.PP_SOMEIPTestabilityReliableMethods.getLastValueFieldMulticast, return-signal=SOMEIPTestabilityReliable_Methods_getLastValueFieldMulticast_Response}, client-server-to-signal-mapping={service-instance=ProvSI_SOMEIPTestabilityReliable_Instance1_XIX_HCP3_IONode, call-signal=SOMEIPTestabilityReliable_Methods_echoInverseDynamicArray_Request, client-server-operation=Geltungsbereich_E3_1_2_Premium.Infrastructure_Info_El_XIX_network_infrastructure_XIX_HCP3_IONode.PP_SOMEIPTestabilityReliableMethods.echoInverseDynamicArray, return-signal=SOMEIPTestabilityReliable_Methods_echoInverseDynamicArray_Response}, client-server-to-signal-mapping={service-instance=ProvSI_SOMEIPTestabilityReliable_Instance1_XIX_HCP3_IONode, call-signal=SOMEIPTestabilityReliable_Methods_getLastValueEventUInt8_Request, client-server-operation=Geltungsbereich_E3_1_2_Premium.Infrastructure_Info_El_XIX_network_infrastructure_XIX_HCP3_IONode.PP_SOMEIPTestabilityReliableMethods.getLastValueEventUInt8, return-signal=SOMEIPTestabilityReliable_Methods_getLastValueEventUInt8_Response}, client-server-to-signal-mapping={service-instance=ProvSI_SOMEIPTestabilityReliable_Instance1_XIX_HCP3_IONode, call-signal=SOMEIPTestabilityReliable_Methods_echoUInt64_Request, client-server-operation=Geltungsbereich_E3_1_2_Premium.Infrastructure_Info_El_XIX_network_infrastructure_XIX_HCP3_IONode.PP_SOMEIPTestabilityReliableMethods.echoUInt64, return-signal=SOMEIPTestabilityReliable_Methods_echoUInt64_Response}, client-server-to-signal-mapping={service-instance=ProvSI_SOMEIPTestabilityReliable_Instance1_XIX_HCP3_IONode, call-signal=SOMEIPTestabilityReliable_Methods_echoUInt32_Request, client-server-operation=Geltungsbereich_E3_1_2_Premium.Infrastructure_Info_El_XIX_network_infrastructure_XIX_HCP3_IONode.PP_SOMEIPTestabilityReliableMethods.echoUInt32, return-signal=SOMEIPTestabilityReliable_Methods_echoUInt32_Response}, client-server-to-signal-mapping={service-instance=ProvSI_SOMEIPTestabilityReliable_Instance1_XIX_HCP3_IONode, call-signal=SOMEIPTestabilityReliable_Methods_echoComplexStruct_Request, client-server-operation=Geltungsbereich_E3_1_2_Premium.Infrastructure_Info_El_XIX_network_infrastructure_XIX_HCP3_IONode.PP_SOMEIPTestabilityReliableMethods.echoComplexStruct, return-signal=SOMEIPTestabilityReliable_Methods_echoComplexStruct_Response}, client-server-to-signal-mapping={service-instance=ProvSI_SOMEIPTestabilityReliable_Instance1_XIX_HCP3_IONode, call-signal=SOMEIPTestabilityReliable_Methods_checkByteOrder_Request, client-server-operation=Geltungsbereich_E3_1_2_Premium.Infrastructure_Info_El_XIX_network_infrastructure_XIX_HCP3_IONode.PP_SOMEIPTestabilityReliableMethods.checkByteOrder, return-signal=SOMEIPTestabilityReliable_Methods_checkByteOrder_Response}, client-server-to-signal-mapping={service-instance=ProvSI_SOMEIPTestabilityReliable_Instance1_XIX_HCP3_IONode, call-signal=SOMEIPTestabilityReliable_Methods_getSupportedFunctions_Request, client-server-operation=Geltungsbereich_E3_1_2_Premium.Infrastructure_Info_El_XIX_network_infrastructure_XIX_HCP3_IONode.PP_SOMEIPTestabilityReliableMethods.getSupportedFunctions, return-signal=SOMEIPTestabilityReliable_Methods_getSupportedFunctions_Response}, client-server-to-signal-mapping={service-instance=ProvSI_SOMEIPTestabilityReliable_Instance1_XIX_HCP3_IONode, call-signal=SOMEIPTestabilityReliable_Methods_echoInverseDynamicMultidimensionalArray_Request, client-server-operation=Geltungsbereich_E3_1_2_Premium.Infrastructure_Info_El_XIX_network_infrastructure_XIX_HCP3_IONode.PP_SOMEIPTestabilityReliableMethods.echoInverseDynamicMultidimensionalArray, return-signal=SOMEIPTestabilityReliable_Methods_echoInverseDynamicMultidimensionalArray_Response}, client-server-to-signal-mapping={service-instance=ProvSI_SOMEIPTestabilityReliable_Instance1_XIX_HCP3_IONode, call-signal=SOMEIPTestabilityReliable_Methods_echoFloat32_Request, client-server-operation=Geltungsbereich_E3_1_2_Premium.Infrastructure_Info_El_XIX_network_infrastructure_XIX_HCP3_IONode.PP_SOMEIPTestabilityReliableMethods.echoFloat32, return-signal=SOMEIPTestabilityReliable_Methods_echoFloat32_Response}, client-server-to-signal-mapping={service-instance=ProvSI_SOMEIPTestabilityReliable_Instance1_XIX_HCP3_IONode, call-signal=SOMEIPTestabilityReliable_Methods_echoComplexDynamicArray_Request, client-server-operation=Geltungsbereich_E3_1_2_Premium.Infrastructure_Info_El_XIX_network_infrastructure_XIX_HCP3_IONode.PP_SOMEIPTestabilityReliableMethods.echoComplexDynamicArray, return-signal=SOMEIPTestabilityReliable_Methods_echoComplexDynamicArray_Response}, client-server-to-signal-mapping={service-instance=ProvSI_SOMEIPTestabilityReliable_Instance1_XIX_HCP3_IONode, call-signal=SOMEIPTestabilityReliable_Methods_activateTsClient_Request, client-server-operation=Geltungsbereich_E3_1_2_Premium.Infrastructure_Info_El_XIX_network_infrastructure_XIX_HCP3_IONode.PP_SOMEIPTestabilityReliableMethods.activateTsClient, return-signal=SOMEIPTestabilityReliable_Methods_activateTsClient_Response}, client-server-to-signal-mapping={service-instance=ProvSI_SOMEIPTestabilityReliable_Instance1_XIX_HCP3_IONode, call-signal=SOMEIPTestabilityReliable_Methods_enableSubscription_Request, client-server-operation=Geltungsbereich_E3_1_2_Premium.Infrastructure_Info_El_XIX_network_infrastructure_XIX_HCP3_IONode.PP_SOMEIPTestabilityReliableMethods.enableSubscription, return-signal=SOMEIPTestabilityReliable_Methods_enableSubscription_Response}, client-server-to-signal-mapping={service-instance=ProvSI_SOMEIPTestabilityReliable_Instance1_XIX_HCP3_IONode, call-signal=SOMEIPTestabilityReliable_Methods_echoStructInStruct_Request, client-server-operation=Geltungsbereich_E3_1_2_Premium.Infrastructure_Info_El_XIX_network_infrastructure_XIX_HCP3_IONode.PP_SOMEIPTestabilityReliableMethods.echoStructInStruct, return-signal=SOMEIPTestabilityReliable_Methods_echoStructInStruct_Response}, client-server-to-signal-mapping={service-instance=ProvSI_SOMEIPTestabilityReliable_Instance1_XIX_HCP3_IONode, call-signal=SOMEIPTestabilityReliable_Methods_echoFloat64_Request, client-server-operation=Geltungsbereich_E3_1_2_Premium.Infrastructure_Info_El_XIX_network_infrastructure_XIX_HCP3_IONode.PP_SOMEIPTestabilityReliableMethods.echoFloat64, return-signal=SOMEIPTestabilityReliable_Methods_echoFloat64_Response}, client-server-to-signal-mapping={service-instance=ProvSI_SOMEIPTestabilityReliable_Instance1_XIX_HCP3_IONode, call-signal=SOMEIPTestabilityReliable_Methods_resetInterface_Request, client-server-operation=Geltungsbereich_E3_1_2_Premium.Infrastructure_Info_El_XIX_network_infrastructure_XIX_HCP3_IONode.PP_SOMEIPTestabilityReliableMethods.resetInterface, return-signal=SOMEIPTestabilityReliable_Methods_resetInterface_Response}, client-server-to-signal-mapping={service-instance=ProvSI_SOMEIPTestabilityReliable_Instance1_XIX_HCP3_IONode, call-signal=SOMEIPTestabilityReliable_Methods_echoInverseBitField_Request, client-server-operation=Geltungsbereich_E3_1_2_Premium.Infrastructure_Info_El_XIX_network_infrastructure_XIX_HCP3_IONode.PP_SOMEIPTestabilityReliableMethods.echoInverseBitField, return-signal=SOMEIPTestabilityReliable_Methods_echoInverseBitField_Response}, client-server-to-signal-mapping={service-instance=ProvSI_SOMEIPTestabilityReliable_Instance1_XIX_HCP3_IONode, call-signal=SOMEIPTestabilityReliable_Methods_echoUInt16_Request, client-server-operation=Geltungsbereich_E3_1_2_Premium.Infrastructure_Info_El_XIX_network_infrastructure_XIX_HCP3_IONode.PP_SOMEIPTestabilityReliableMethods.echoUInt16, return-signal=SOMEIPTestabilityReliable_Methods_echoUInt16_Response}, client-server-to-signal-mapping={service-instance=ProvSI_SOMEIPTestabilityReliable_Instance1_XIX_HCP3_IONode, call-signal=SOMEIPTestabilityReliable_Methods_echoSInt32_Request, client-server-operation=Geltungsbereich_E3_1_2_Premium.Infrastructure_Info_El_XIX_network_infrastructure_XIX_HCP3_IONode.PP_SOMEIPTestabilityReliableMethods.echoSInt32, return-signal=SOMEIPTestabilityReliable_Methods_echoSInt32_Response}, client-server-to-signal-mapping={service-instance=ProvSI_SOMEIPTestabilityReliable_Instance1_XIX_HCP3_IONode, call-signal=SOMEIPTestabilityReliable_Methods_echoInverseStruct_Request, client-server-operation=Geltungsbereich_E3_1_2_Premium.Infrastructure_Info_El_XIX_network_infrastructure_XIX_HCP3_IONode.PP_SOMEIPTestabilityReliableMethods.echoInverseStruct, return-signal=SOMEIPTestabilityReliable_Methods_echoInverseStruct_Response}, client-server-to-signal-mapping={service-instance=ProvSI_SOMEIPTestabilityReliable_Instance1_XIX_HCP3_IONode, call-signal=SOMEIPTestabilityReliable_Methods_echoSInt64_Request, client-server-operation=Geltungsbereich_E3_1_2_Premium.Infrastructure_Info_El_XIX_network_infrastructure_XIX_HCP3_IONode.PP_SOMEIPTestabilityReliableMethods.echoSInt64, return-signal=SOMEIPTestabilityReliable_Methods_echoSInt64_Response}, client-server-to-signal-mapping={service-instance=ProvSI_SOMEIPTestabilityReliable_Instance1_XIX_HCP3_IONode, call-signal=SOMEIPTestabilityReliable_Methods_echoSInt16_Request, client-server-operation=Geltungsbereich_E3_1_2_Premium.Infrastructure_Info_El_XIX_network_infrastructure_XIX_HCP3_IONode.PP_SOMEIPTestabilityReliableMethods.echoSInt16, return-signal=SOMEIPTestabilityReliable_Methods_echoSInt16_Response}, client-server-to-signal-mapping={service-instance=ProvSI_SOMEIPTestabilityReliable_Instance1_XIX_HCP3_IONode, call-signal=SOMEIPTestabilityReliable_Methods_echoUTF8String_Request, client-server-operation=Geltungsbereich_E3_1_2_Premium.Infrastructure_Info_El_XIX_network_infrastructure_XIX_HCP3_IONode.PP_SOMEIPTestabilityReliableMethods.echoUTF8String, return-signal=SOMEIPTestabilityReliable_Methods_echoUTF8String_Response}, client-server-to-signal-mapping={service-instance=ProvSI_SOMEIPTestabilityReliable_Instance1_XIX_HCP3_IONode, call-signal=SOMEIPTestabilityReliable_Methods_deactivateTsClient_Request, client-server-operation=Geltungsbereich_E3_1_2_Premium.Infrastructure_Info_El_XIX_network_infrastructure_XIX_HCP3_IONode.PP_SOMEIPTestabilityReliableMethods.deactivateTsClient, return-signal=SOMEIPTestabilityReliable_Methods_deactivateTsClient_Response}, client-server-to-signal-mapping={service-instance=ProvSI_SOMEIPTestabilityReliable_Instance1_XIX_HCP3_IONode, call-signal=SOMEIPTestabilityReliable_Methods_echoSInt8_Request, client-server-operation=Geltungsbereich_E3_1_2_Premium.Infrastructure_Info_El_XIX_network_infrastructure_XIX_HCP3_IONode.PP_SOMEIPTestabilityReliableMethods.echoSInt8, return-signal=SOMEIPTestabilityReliable_Methods_echoSInt8_Response}, client-server-to-signal-mapping={service-instance=ProvSI_SOMEIPTestabilityReliable_Instance1_XIX_HCP3_IONode, call-signal=SOMEIPTestabilityReliable_MethodsGet_TestFieldComplexStruct_Request, client-server-operation=Geltungsbereich_E3_1_2_Premium.Infrastructure_Info_El_XIX_network_infrastructure_XIX_HCP3_IONode.PP_SOMEIPTestabilityReliableMethods.getTestFieldComplexStruct, return-signal=SOMEIPTestabilityReliable_MethodsGet_TestFieldComplexStruct_Response}, client-server-to-signal-mapping={service-instance=ProvSI_SOMEIPTestabilityReliable_Instance1_XIX_HCP3_IONode, call-signal=SOMEIPTestabilityReliable_MethodsSet_TestFieldComplexStruct_Request, client-server-operation=Geltungsbereich_E3_1_2_Premium.Infrastructure_Info_El_XIX_network_infrastructure_XIX_HCP3_IONode.PP_SOMEIPTestabilityReliableMethods.setTestFieldComplexStruct, return-signal=SOMEIPTestabilityReliable_MethodsSet_TestFieldComplexStruct_Response}, client-server-to-signal-mapping={service-instance=ProvSI_SOMEIPTestabilityReliable_Instance1_XIX_HCP3_IONode, call-signal=SOMEIPTestabilityReliable_MethodsGet_TestFieldUInt64_Request, client-server-operation=Geltungsbereich_E3_1_2_Premium.Infrastructure_Info_El_XIX_network_infrastructure_XIX_HCP3_IONode.PP_SOMEIPTestabilityReliableMethods.getTestFieldUInt64, return-signal=SOMEIPTestabilityReliable_MethodsGet_TestFieldUInt64_Response}, client-server-to-signal-mapping={service-instance=ProvSI_SOMEIPTestabilityReliable_Instance1_XIX_HCP3_IONode, call-signal=SOMEIPTestabilityReliable_MethodsGet_TestFieldUInt8_Request, client-server-operation=Geltungsbereich_E3_1_2_Premium.Infrastructure_Info_El_XIX_network_infrastructure_XIX_HCP3_IONode.PP_SOMEIPTestabilityReliableMethods.getTestFieldUInt8, return-signal=SOMEIPTestabilityReliable_MethodsGet_TestFieldUInt8_Response}, client-server-to-signal-mapping={service-instance=ProvSI_SOMEIPTestabilityReliable_Instance1_XIX_HCP3_IONode, call-signal=SOMEIPTestabilityReliable_MethodsSet_TestFieldUInt8_Request, client-server-operation=Geltungsbereich_E3_1_2_Premium.Infrastructure_Info_El_XIX_network_infrastructure_XIX_HCP3_IONode.PP_SOMEIPTestabilityReliableMethods.setTestFieldUInt8, return-signal=SOMEIPTestabilityReliable_MethodsSet_TestFieldUInt8_Response}, sender-receiver-to-signal-mapping={communication-direction=IN, service-instance=ProvSI_SOMEIPTestabilityReliable_Instance1_XIX_HCP3_IONode, data-element=Infrastructure_Info_El_XIX_network_infrastructure_XIX_HCP3_IONode.Geltungsbereich_E3_1_2_Premium.RP_SOMEIPTestabilityReliableRnRMethods.triggerEchoFloat32, system-signal=SOMEIPTestabilityReliable_RnRMethods_triggerEchoFloat32}, sender-receiver-to-signal-mapping={communication-direction=IN, service-instance=ProvSI_SOMEIPTestabilityReliable_Instance1_XIX_HCP3_IONode, data-element=Infrastructure_Info_El_XIX_network_infrastructure_XIX_HCP3_IONode.Geltungsbereich_E3_1_2_Premium.RP_SOMEIPTestabilityReliableRnRMethods.triggerGetterUInt8, system-signal=SOMEIPTestabilityReliable_RnRMethods_triggerGetterUInt8}, sender-receiver-to-signal-mapping={communication-direction=IN, service-instance=ProvSI_SOMEIPTestabilityReliable_Instance1_XIX_HCP3_IONode, data-element=Infrastructure_Info_El_XIX_network_infrastructure_XIX_HCP3_IONode.Geltungsbereich_E3_1_2_Premium.RP_SOMEIPTestabilityReliableRnRMethods.triggerSetterUInt8, system-signal=SOMEIPTestabilityReliable_RnRMethods_triggerSetterUInt8}, sender-receiver-to-signal-mapping={communication-direction=IN, service-instance=ProvSI_SOMEIPTestabilityReliable_Instance1_XIX_HCP3_IONode, data-element=Infrastructure_Info_El_XIX_network_infrastructure_XIX_HCP3_IONode.Geltungsbereich_E3_1_2_Premium.RP_SOMEIPTestabilityReliableRnRMethods.triggerEchoComplexStruct, system-signal=SOMEIPTestabilityReliable_RnRMethods_triggerEchoComplexStruct}, sender-receiver-to-signal-mapping={communication-direction=IN, service-instance=ProvSI_SOMEIPTestabilityReliable_Instance1_XIX_HCP3_IONode, data-element=Infrastructure_Info_El_XIX_network_infrastructure_XIX_HCP3_IONode.Geltungsbereich_E3_1_2_Premium.RP_SOMEIPTestabilityReliableRnRMethods.triggerFireForgetUInt8, system-signal=SOMEIPTestabilityReliable_RnRMethods_triggerFireForgetUInt8}, sender-receiver-to-signal-mapping={communication-direction=IN, service-instance=ProvSI_SOMEIPTestabilityReliable_Instance1_XIX_HCP3_IONode, data-element=Infrastructure_Info_El_XIX_network_infrastructure_XIX_HCP3_IONode.Geltungsbereich_E3_1_2_Premium.RP_SOMEIPTestabilityReliableRnRMethods.triggerEchoLargeDataArray, system-signal=SOMEIPTestabilityReliable_RnRMethods_triggerEchoLargeDataArray}, sender-receiver-to-signal-mapping={communication-direction=IN, service-instance=ProvSI_SOMEIPTestabilityReliable_Instance1_XIX_HCP3_IONode, data-element=Infrastructure_Info_El_XIX_network_infrastructure_XIX_HCP3_IONode.Geltungsbereich_E3_1_2_Premium.RP_SOMEIPTestabilityReliableRnRMethods.triggerFieldMulticast, system-signal=SOMEIPTestabilityReliable_RnRMethods_triggerFieldMulticast}, sender-receiver-to-signal-mapping={communication-direction=IN, service-instance=ProvSI_SOMEIPTestabilityReliable_Instance1_XIX_HCP3_IONode, data-element=Infrastructure_Info_El_XIX_network_infrastructure_XIX_HCP3_IONode.Geltungsbereich_E3_1_2_Premium.RP_SOMEIPTestabilityReliableRnRMethods.triggerEchoUInt8UInt16UInt32, system-signal=SOMEIPTestabilityReliable_RnRMethods_triggerEchoUInt8UInt16UInt32}, sender-receiver-to-signal-mapping={communication-direction=IN, service-instance=ProvSI_SOMEIPTestabilityReliable_Instance1_XIX_HCP3_IONode, data-element=Infrastructure_Info_El_XIX_network_infrastructure_XIX_HCP3_IONode.Geltungsbereich_E3_1_2_Premium.RP_SOMEIPTestabilityReliableRnRMethods.triggerEchoUInt8, system-signal=SOMEIPTestabilityReliable_RnRMethods_triggerEchoUInt8}, sender-receiver-to-signal-mapping={communication-direction=IN, service-instance=ProvSI_SOMEIPTestabilityReliable_Instance1_XIX_HCP3_IONode, data-element=Infrastructure_Info_El_XIX_network_infrastructure_XIX_HCP3_IONode.Geltungsbereich_E3_1_2_Premium.RP_SOMEIPTestabilityReliableRnRMethods.noResponseUInt8, system-signal=SOMEIPTestabilityReliable_RnRMethods_noResponseUInt8}, sender-receiver-to-signal-mapping={communication-direction=IN, service-instance=ProvSI_SOMEIPTestabilityReliable_Instance1_XIX_HCP3_IONode, data-element=Infrastructure_Info_El_XIX_network_infrastructure_XIX_HCP3_IONode.Geltungsbereich_E3_1_2_Premium.RP_SOMEIPTestabilityReliableRnRMethods.triggerEventUInt8, system-signal=SOMEIPTestabilityReliable_RnRMethods_triggerEventUInt8}, sender-receiver-to-signal-mapping={communication-direction=IN, service-instance=ProvSI_SOMEIPTestabilityReliable_Instance1_XIX_HCP3_IONode, data-element=Infrastructure_Info_El_XIX_network_infrastructure_XIX_HCP3_IONode.Geltungsbereich_E3_1_2_Premium.RP_SOMEIPTestabilityReliableRnRMethods.triggerEchoComplexDynamicArray, system-signal=SOMEIPTestabilityReliable_RnRMethods_triggerEchoComplexDynamicArray}, sender-receiver-to-signal-mapping={communication-direction=OUT, event-handler=ProvSI_SOMEIPTestabilityReliable_Instance1_XIX_HCP3_IONode/testEventUInt8, service-instance=ProvSI_SOMEIPTestabilityReliable_Instance1_XIX_HCP3_IONode, data-element=Infrastructure_Info_El_XIX_network_infrastructure_XIX_HCP3_IONode.Geltungsbereich_E3_1_2_Premium.PP_SOMEIPTestabilityReliableEvents.testEventUInt8, system-signal=SOMEIPTestabilityReliable_Events_testEventUInt8}, sender-receiver-to-signal-mapping={communication-direction=OUT, event-handler=TestFieldComplexStruct, service-instance=ProvSI_SOMEIPTestabilityReliable_Instance1_XIX_HCP3_IONode, data-element=Infrastructure_Info_El_XIX_network_infrastructure_XIX_HCP3_IONode.Geltungsbereich_E3_1_2_Premium.PP_SOMEIPTestabilityReliableEvents.TestFieldComplexStruct, system-signal=SOMEIPTestabilityReliable_Events_TestFieldComplexStruct}, sender-receiver-to-signal-mapping={communication-direction=OUT, event-handler=TestFieldUInt64, service-instance=ProvSI_SOMEIPTestabilityReliable_Instance1_XIX_HCP3_IONode, data-element=Infrastructure_Info_El_XIX_network_infrastructure_XIX_HCP3_IONode.Geltungsbereich_E3_1_2_Premium.PP_SOMEIPTestabilityReliableEvents.TestFieldUInt64, system-signal=SOMEIPTestabilityReliable_Events_TestFieldUInt64}, sender-receiver-to-signal-mapping={communication-direction=OUT, event-handler=ProvSI_SOMEIPTestabilityReliable_Instance1_XIX_HCP3_IONode/TestFieldUInt8, service-instance=ProvSI_SOMEIPTestabilityReliable_Instance1_XIX_HCP3_IONode, data-element=Infrastructure_Info_El_XIX_network_infrastructure_XIX_HCP3_IONode.Geltungsbereich_E3_1_2_Premium.PP_SOMEIPTestabilityReliableEvents.TestFieldUInt8, system-signal=SOMEIPTestabilityReliable_Events_TestFieldUInt8}, client-server-to-signal-mapping={service-instance=ConsSI_WakeupclusterConfiguration_XIX_HCP3_IONode, call-signal=WakeupclusterConfiguration_Methods_subscribeConfigurationsByKey_Request, client-server-operation=Geltungsbereich_E3_1_2_Premium.VNSM3_1_XIX_WUSL_XIX_HCP3_IONode.RP_WakeupclusterConfigurationMethods.subscribeConfigurationsByKey, return-signal=WakeupclusterConfiguration_Methods_subscribeConfigurationsByKey_Response}, client-server-to-signal-mapping={service-instance=ConsSI_WakeupclusterConfiguration_XIX_HCP3_IONode, call-signal=WakeupclusterConfiguration_Methods_setConfigurationsElement_Request, client-server-operation=Geltungsbereich_E3_1_2_Premium.VNSM3_1_XIX_WUSL_XIX_HCP3_IONode.RP_WakeupclusterConfigurationMethods.setConfigurationsElement, return-signal=WakeupclusterConfiguration_Methods_setConfigurationsElement_Response}, client-server-to-signal-mapping={service-instance=ConsSI_WakeupclusterConfiguration_XIX_HCP3_IONode, call-signal=WakeupclusterConfiguration_Methods_getConfigurationsElementByKey_Request, client-server-operation=Geltungsbereich_E3_1_2_Premium.VNSM3_1_XIX_WUSL_XIX_HCP3_IONode.RP_WakeupclusterConfigurationMethods.getConfigurationsElementByKey, return-signal=WakeupclusterConfiguration_Methods_getConfigurationsElementByKey_Response}, client-server-to-signal-mapping={service-instance=ConsSI_WakeupclusterConfiguration_XIX_HCP3_IONode, call-signal=WakeupclusterConfiguration_Methods_subscribeConfigurations_Request, client-server-operation=Geltungsbereich_E3_1_2_Premium.VNSM3_1_XIX_WUSL_XIX_HCP3_IONode.RP_WakeupclusterConfigurationMethods.subscribeConfigurations, return-signal=WakeupclusterConfiguration_Methods_subscribeConfigurations_Response}, client-server-to-signal-mapping={service-instance=ConsSI_WakeupclusterConfiguration_XIX_HCP3_IONode, call-signal=WakeupclusterConfiguration_Methods_getConfigurationsElements_Request, client-server-operation=Geltungsbereich_E3_1_2_Premium.VNSM3_1_XIX_WUSL_XIX_HCP3_IONode.RP_WakeupclusterConfigurationMethods.getConfigurationsElements, return-signal=WakeupclusterConfiguration_Methods_getConfigurationsElements_Response}, client-server-to-signal-mapping={service-instance=ConsSI_WakeupclusterConfiguration_XIX_HCP3_IONode, call-signal=WakeupclusterConfiguration_Methods_unsubscribeConfigurations_Request, client-server-operation=Geltungsbereich_E3_1_2_Premium.VNSM3_1_XIX_WUSL_XIX_HCP3_IONode.RP_WakeupclusterConfigurationMethods.unsubscribeConfigurations, return-signal=WakeupclusterConfiguration_Methods_unsubscribeConfigurations_Response}, client-server-to-signal-mapping={service-instance=ConsSI_WakeupclusterConfiguration_XIX_HCP3_IONode, call-signal=WakeupclusterConfiguration_Methods_createConfigurationsElement_Request, client-server-operation=Geltungsbereich_E3_1_2_Premium.VNSM3_1_XIX_WUSL_XIX_HCP3_IONode.RP_WakeupclusterConfigurationMethods.createConfigurationsElement, return-signal=WakeupclusterConfiguration_Methods_createConfigurationsElement_Response}, sender-receiver-to-signal-mapping={communication-direction=IN, event-group=configurationsEvent, service-instance=ConsSI_WakeupclusterConfiguration_XIX_HCP3_IONode, data-element=VNSM3_1_XIX_WUSL_XIX_HCP3_IONode.Geltungsbereich_E3_1_2_Premium.RP_WakeupclusterConfigurationEvents.configurationsEvent, system-signal=WakeupclusterConfiguration_Events_configurationsEvent}, client-server-to-signal-mapping={service-instance=ProvSI_WakeUpMonitorData_Instance3_XIX_HCP3_IONode, call-signal=WakeUpMonitorData_Methods_startCycle_Request, client-server-operation=Geltungsbereich_E3_1_2_Premium.WUM_Client3_XIX_WUM_XIX_HCP3_IONode.PP_WakeUpMonitorDataMethods.startCycle, return-signal=WakeUpMonitorData_Methods_startCycle_Response}, client-server-to-signal-mapping={service-instance=ProvSI_WakeUpMonitorData_Instance3_XIX_HCP3_IONode, call-signal=WakeUpMonitorData_Methods_getTable_Request, client-server-operation=Geltungsbereich_E3_1_2_Premium.WUM_Client3_XIX_WUM_XIX_HCP3_IONode.PP_WakeUpMonitorDataMethods.getTable, return-signal=WakeUpMonitorData_Methods_getTable_Response}, sender-receiver-to-signal-mapping={communication-direction=IN, service-instance=ProvSI_WakeUpMonitorData_Instance3_XIX_HCP3_IONode, data-element=WUM_Client3_XIX_WUM_XIX_HCP3_IONode.Geltungsbereich_E3_1_2_Premium.RP_WakeUpMonitorDataRnRMethods.configuration, system-signal=WakeUpMonitorData_RnRMethods_configuration}, sender-receiver-to-signal-mapping={communication-direction=OUT, data-element=Infrastructure_Info_El_XIX_network_infrastructure_XIX_HCP3_IONode.Geltungsbereich_E3_1_2_Premium.SP_IF_NM_Info_El_FCIB_XIX_Infrastructure_Info_El_XIX_network_infrastructure_XIX_HCP3_IONode.DE_NM_Info_El_FCIB, system-signal=NM_Info_El_FCIB}, sender-receiver-to-signal-mapping={communication-direction=OUT, data-element=Infrastructure_Info_El_XIX_network_infrastructure_XIX_HCP3_IONode.Geltungsbereich_E3_1_2_Premium.SP_IF_NM_Info_El_NM_aktiv_Tmin_XIX_Infrastructure_Info_El_XIX_network_infrastructure_XIX_HCP3_IONode.DE_NM_Info_El_NM_aktiv_Tmin, system-signal=NM_Info_El_NM_aktiv_Tmin}, sender-receiver-to-signal-mapping={communication-direction=OUT, data-element=Infrastructure_Info_El_XIX_network_infrastructure_XIX_HCP3_IONode.Geltungsbereich_E3_1_2_Premium.SP_IF_NM_Info_El_NM_aktiv_CABaktiv_XIX_Infrastructure_Info_El_XIX_network_infrastructure_XIX_HCP3_IONode.DE_NM_Info_El_NM_aktiv_CABaktiv, system-signal=NM_Info_El_NM_aktiv_CABaktiv}, sender-receiver-to-signal-mapping={communication-direction=OUT, data-element=Infrastructure_Info_El_XIX_network_infrastructure_XIX_HCP3_IONode.Geltungsbereich_E3_1_2_Premium.SP_IF_NM_Info_El_NM_aktiv_KL15_XIX_Infrastructure_Info_El_XIX_network_infrastructure_XIX_HCP3_IONode.DE_NM_Info_El_NM_aktiv_KL15, system-signal=NM_Info_El_NM_aktiv_KL15}, sender-receiver-to-signal-mapping={communication-direction=OUT, data-element=Infrastructure_Info_El_XIX_network_infrastructure_XIX_HCP3_IONode.Geltungsbereich_E3_1_2_Premium.SP_IF_NM_Info_El_NM_aktiv_Diag_XIX_Infrastructure_Info_El_XIX_network_infrastructure_XIX_HCP3_IONode.DE_NM_Info_El_NM_aktiv_Diag, system-signal=NM_Info_El_NM_aktiv_Diag}, sender-receiver-to-signal-mapping={communication-direction=OUT, data-element=Infrastructure_Info_El_XIX_network_infrastructure_XIX_HCP3_IONode.Geltungsbereich_E3_1_2_Premium.SP_IF_NM_Info_El_FCAB_XIX_Infrastructure_Info_El_XIX_network_infrastructure_XIX_HCP3_IONode.DE_NM_Info_El_FCAB, system-signal=NM_Info_El_FCAB}, sender-receiver-to-signal-mapping={communication-direction=OUT, data-element=Infrastructure_Info_El_XIX_network_infrastructure_XIX_HCP3_IONode.Geltungsbereich_E3_1_2_Premium.SP_IF_NM_Info_El_UDS_CC_XIX_Infrastructure_Info_El_XIX_network_infrastructure_XIX_HCP3_IONode.DE_NM_Info_El_UDS_CC, system-signal=NM_Info_El_UDS_CC}, sender-receiver-to-signal-mapping={communication-direction=OUT, data-element=Infrastructure_Info_El_XIX_network_infrastructure_XIX_HCP3_IONode.Geltungsbereich_E3_1_2_Premium.SP_IF_NM_Info_El_CBV_AWB_XIX_Infrastructure_Info_El_XIX_network_infrastructure_XIX_HCP3_IONode.DE_NM_Info_El_CBV_AWB, system-signal=NM_Info_El_CBV_AWB}, sender-receiver-to-signal-mapping={communication-direction=OUT, data-element=Infrastructure_Info_El_XIX_network_infrastructure_XIX_HCP3_IONode.Geltungsbereich_E3_1_2_Premium.SP_IF_NM_Info_El_NM_State_XIX_Infrastructure_Info_El_XIX_network_infrastructure_XIX_HCP3_IONode.DE_NM_Info_El_NM_State, system-signal=NM_Info_El_NM_State}, sender-receiver-to-signal-mapping={communication-direction=OUT, data-element=Infrastructure_Info_El_XIX_network_infrastructure_XIX_HCP3_IONode.Geltungsbereich_E3_1_2_Premium.SP_IF_NM_Info_El_CBV_CRI_XIX_Infrastructure_Info_El_XIX_network_infrastructure_XIX_HCP3_IONode.DE_NM_Info_El_CBV_CRI, system-signal=NM_Info_El_CBV_CRI}, sender-receiver-to-signal-mapping={communication-direction=OUT, data-element=Infrastructure_Info_El_XIX_network_infrastructure_XIX_HCP3_IONode.Geltungsbereich_E3_1_2_Premium.SP_IF_KN_Info_El_ECUKnockOutTimer_XIX_Infrastructure_Info_El_XIX_network_infrastructure_XIX_HCP3_IONode.DE_KN_Info_El_ECUKnockOutTimer, system-signal=KN_Info_El_ECUKnockOutTimer}, sender-receiver-to-signal-mapping={communication-direction=OUT, data-element=Infrastructure_Info_El_XIX_network_infrastructure_XIX_HCP3_IONode.Geltungsbereich_E3_1_2_Premium.SP_IF_KN_Info_El_ECUKnockOut_XIX_Infrastructure_Info_El_XIX_network_infrastructure_XIX_HCP3_IONode.DE_KN_Info_El_ECUKnockOut, system-signal=KN_Info_El_ECUKnockOut}, sender-receiver-to-signal-mapping={communication-direction=OUT, data-element=Infrastructure_Info_El_XIX_network_infrastructure_XIX_HCP3_IONode.Geltungsbereich_E3_1_2_Premium.SP_IF_KN_Info_El_BusKnockOut_XIX_Infrastructure_Info_El_XIX_network_infrastructure_XIX_HCP3_IONode.DE_KN_Info_El_BusKnockOut, system-signal=KN_Info_El_BusKnockOut}, sender-receiver-to-signal-group-mapping={communication-direction=IN, data-element=Infrastructure_Info_El_XIX_network_infrastructure_XIX_HCP3_IONode.Geltungsbereich_E3_1_2_Premium.RP_IF_SG_ClampControl_01_XIX_Infrastructure_Info_El_XIX_network_infrastructure_XIX_HCP3_IONode.DE_SG_ClampControl_01, signal-group=SG_ClampControl_01, type-mapping=sender-rec-record-type-mapping=record-element-mappings=[{implementation-record-element=KST_KL_15, system-signal=KST_KL_15}, {implementation-record-element=KST_Kl_S, system-signal=KST_Kl_S}, {implementation-record-element=KST_Kl_50_Startanforderung, system-signal=KST_Kl_50_Startanforderung}, {implementation-record-element=ClampControl_01_BZ, system-signal=ClampControl_01_BZ}, {implementation-record-element=ClampControl_01_CRC, system-signal=ClampControl_01_CRC}, {implementation-record-element=KST_Ausstiegswunsch_Status, system-signal=KST_Ausstiegswunsch_Status}, {implementation-record-element=KST_ComfortReadyStatus, system-signal=KST_ComfortReadyStatus}]}, sender-receiver-to-signal-mapping={communication-direction=OUT, data-element=Infrastructure_Info_El_XIX_network_infrastructure_XIX_HCP3_IONode.Geltungsbereich_E3_1_2_Premium.SP_IF_SI_Bus_Identifikation_XIX_Infrastructure_Info_El_XIX_network_infrastructure_XIX_HCP3_IONode.DE_SI_Bus_Identifikation, system-signal=SI_Bus_Identifikation}, sender-receiver-to-signal-mapping={communication-direction=OUT, data-element=Infrastructure_Info_El_XIX_network_infrastructure_XIX_HCP3_IONode.Geltungsbereich_E3_1_2_Premium.SP_IF_KN_Info_El_BusKnockOutTimer_XIX_Infrastructure_Info_El_XIX_network_infrastructure_XIX_HCP3_IONode.DE_KN_Info_El_BusKnockOutTimer, system-signal=KN_Info_El_BusKnockOutTimer}, sender-receiver-to-signal-mapping={communication-direction=OUT, data-element=Infrastructure_Info_El_XIX_network_infrastructure_XIX_HCP3_IONode.Geltungsbereich_E3_1_2_Premium.SP_IF_NM_Info_El_SNI_10_XIX_Infrastructure_Info_El_XIX_network_infrastructure_XIX_HCP3_IONode.DE_NM_Info_El_SNI_10, system-signal=NM_Info_El_SNI_10}, sender-receiver-to-signal-mapping={communication-direction=IN, data-element=Infrastructure_Info_El_XIX_network_infrastructure_XIX_HCP3_IONode.Geltungsbereich_E3_1_2_Premium.RP_IF_NVEM_Abschaltstufe_XIX_Infrastructure_Info_El_XIX_network_infrastructure_XIX_HCP3_IONode.DE_NVEM_Abschaltstufe, system-signal=NVEM_Abschaltstufe}, sender-receiver-to-signal-mapping={communication-direction=IN, data-element=Infrastructure_Info_El_XIX_network_infrastructure_XIX_HCP3_IONode.Geltungsbereich_E3_1_2_Premium.RP_IF_HUD_Nachlauftyp_XIX_Infrastructure_Info_El_XIX_network_infrastructure_XIX_HCP3_IONode.DE_HUD_Nachlauftyp, system-signal=HUD_Nachlauftyp}, sender-receiver-to-signal-mapping={communication-direction=IN, data-element=Infrastructure_Info_El_XIX_network_infrastructure_XIX_HCP3_IONode.Geltungsbereich_E3_1_2_Premium.RP_IF_AMP_Nachlauftyp_XIX_Infrastructure_Info_El_XIX_network_infrastructure_XIX_HCP3_IONode.DE_AMP_Nachlauftyp, system-signal=AMP_Nachlauftyp}, sender-receiver-to-signal-mapping={communication-direction=OUT, data-element=Infrastructure_Info_El_XIX_network_infrastructure_XIX_HCP3_IONode.Geltungsbereich_E3_1_2_Premium.SP_IF_Info_El_Nachlauftyp_XIX_Infrastructure_Info_El_XIX_network_infrastructure_XIX_HCP3_IONode.DE_Info_El_Nachlauftyp, system-signal=Info_El_Nachlauftyp}, sender-receiver-to-signal-mapping={communication-direction=IN, data-element=Infrastructure_Info_El_XIX_network_infrastructure_XIX_HCP3_IONode.Geltungsbereich_E3_1_2_Premium.RP_IF_WLC2_Nachlauftyp_XIX_Infrastructure_Info_El_XIX_network_infrastructure_XIX_HCP3_IONode.DE_WLC2_Nachlauftyp, system-signal=WLC2_Nachlauftyp}, sender-receiver-to-signal-mapping={communication-direction=IN, data-element=Infrastructure_Info_El_XIX_network_infrastructure_XIX_HCP3_IONode.Geltungsbereich_E3_1_2_Premium.RP_IF_WLC1_Nachlauftyp_XIX_Infrastructure_Info_El_XIX_network_infrastructure_XIX_HCP3_IONode.DE_WLC1_Nachlauftyp, system-signal=WLC1_Nachlauftyp}, sender-receiver-to-signal-mapping={communication-direction=IN, data-element=Infrastructure_Info_El_XIX_network_infrastructure_XIX_HCP3_IONode.Geltungsbereich_E3_1_2_Premium.RP_IF_CID_Nachlauftyp_XIX_Infrastructure_Info_El_XIX_network_infrastructure_XIX_HCP3_IONode.DE_CID_Nachlauftyp, system-signal=CID_Nachlauftyp}, sender-receiver-to-signal-mapping={communication-direction=IN, data-element=Infrastructure_Info_El_XIX_network_infrastructure_XIX_HCP3_IONode.Geltungsbereich_E3_1_2_Premium.RP_IF_PID_Nachlauftyp_XIX_Infrastructure_Info_El_XIX_network_infrastructure_XIX_HCP3_IONode.DE_PID_Nachlauftyp, system-signal=PID_Nachlauftyp}, sender-receiver-to-signal-mapping={communication-direction=OUT, data-element=Infrastructure_Info_El_XIX_network_infrastructure_XIX_HCP3_IONode.Geltungsbereich_E3_1_2_Premium.SP_IF_SI_FCAB_XIX_Infrastructure_Info_El_XIX_network_infrastructure_XIX_HCP3_IONode.DE_SI_FCAB, system-signal=SI_FCAB}, sender-receiver-to-signal-mapping={communication-direction=OUT, data-element=Infrastructure_Info_El_XIX_network_infrastructure_XIX_HCP3_IONode.Geltungsbereich_E3_1_2_Premium.SP_IF_NM_Info_El_Wakeup_V12_XIX_Infrastructure_Info_El_XIX_network_infrastructure_XIX_HCP3_IONode.DE_NM_Info_El_Wakeup_V12, system-signal=NM_Info_El_Wakeup_V12}, sender-receiver-to-signal-mapping={communication-direction=IN, data-element=Infrastructure_Info_El_XIX_network_infrastructure_XIX_HCP3_IONode.Geltungsbereich_E3_1_2_Premium.RP_IF_SI_NWDF_30_XIX_Infrastructure_Info_El_XIX_network_infrastructure_XIX_HCP3_IONode.DE_SI_NWDF_30, system-signal=SI_NWDF_30}, sender-receiver-to-signal-mapping={communication-direction=IN, data-element=Infrastructure_Info_El_XIX_network_infrastructure_XIX_HCP3_IONode.Geltungsbereich_E3_1_2_Premium.RP_IF_SI_NWDF_XIX_Infrastructure_Info_El_XIX_network_infrastructure_XIX_HCP3_IONode.DE_SI_NWDF, system-signal=SI_NWDF}, sender-receiver-to-signal-mapping={communication-direction=OUT, data-element=Infrastructure_Info_El_XIX_network_infrastructure_XIX_HCP3_IONode.Geltungsbereich_E3_1_2_Premium.SP_IF_NM_aktiv_GoodbyeScreen_XIX_Infrastructure_Info_El_XIX_network_infrastructure_XIX_HCP3_IONode.DE_NM_aktiv_GoodbyeScreen, system-signal=NM_aktiv_GoodbyeScreen}, sender-receiver-to-signal-mapping={communication-direction=OUT, data-element=Infrastructure_Info_El_XIX_network_infrastructure_XIX_HCP3_IONode.Geltungsbereich_E3_1_2_Premium.SP_IF_NM_aktiv_SysPartition_2_XIX_Infrastructure_Info_El_XIX_network_infrastructure_XIX_HCP3_IONode.DE_NM_aktiv_SysPartition_2, system-signal=NM_aktiv_SysPartition_2}, sender-receiver-to-signal-mapping={communication-direction=OUT, data-element=Infrastructure_Info_El_XIX_network_infrastructure_XIX_HCP3_IONode.Geltungsbereich_E3_1_2_Premium.SP_IF_NM_aktiv_IVIPartition_3_XIX_Infrastructure_Info_El_XIX_network_infrastructure_XIX_HCP3_IONode.DE_NM_aktiv_IVIPartition_3, system-signal=NM_aktiv_IVIPartition_3}, sender-receiver-to-signal-mapping={communication-direction=OUT, data-element=Infrastructure_Info_El_XIX_network_infrastructure_XIX_HCP3_IONode.Geltungsbereich_E3_1_2_Premium.SP_IF_NM_aktiv_IVIPartition_2_XIX_Infrastructure_Info_El_XIX_network_infrastructure_XIX_HCP3_IONode.DE_NM_aktiv_IVIPartition_2, system-signal=NM_aktiv_IVIPartition_2}, sender-receiver-to-signal-mapping={communication-direction=OUT, data-element=Infrastructure_Info_El_XIX_network_infrastructure_XIX_HCP3_IONode.Geltungsbereich_E3_1_2_Premium.SP_IF_NM_aktiv_SysPartition_1_XIX_Infrastructure_Info_El_XIX_network_infrastructure_XIX_HCP3_IONode.DE_NM_aktiv_SysPartition_1, system-signal=NM_aktiv_SysPartition_1}, sender-receiver-to-signal-mapping={communication-direction=OUT, data-element=Infrastructure_Info_El_XIX_network_infrastructure_XIX_HCP3_IONode.Geltungsbereich_E3_1_2_Premium.SP_IF_NM_aktiv_SysPartition_3_XIX_Infrastructure_Info_El_XIX_network_infrastructure_XIX_HCP3_IONode.DE_NM_aktiv_SysPartition_3, system-signal=NM_aktiv_SysPartition_3}, sender-receiver-to-signal-mapping={communication-direction=OUT, data-element=Infrastructure_Info_El_XIX_network_infrastructure_XIX_HCP3_IONode.Geltungsbereich_E3_1_2_Premium.SP_IF_NM_aktiv_IVIPartition_1_XIX_Infrastructure_Info_El_XIX_network_infrastructure_XIX_HCP3_IONode.DE_NM_aktiv_IVIPartition_1, system-signal=NM_aktiv_IVIPartition_1}, sender-receiver-to-signal-mapping={communication-direction=OUT, data-element=Infrastructure_Info_El_XIX_network_infrastructure_XIX_HCP3_IONode.Geltungsbereich_E3_1_2_Premium.SP_IF_NM_aktiv_Tankinhalt_ermitteln_XIX_Infrastructure_Info_El_XIX_network_infrastructure_XIX_HCP3_IONode.DE_NM_aktiv_Tankinhalt_ermitteln, system-signal=NM_aktiv_Tankinhalt_ermitteln}, sender-receiver-to-signal-mapping={communication-direction=OUT, data-element=Infrastructure_Info_El_XIX_network_infrastructure_XIX_HCP3_IONode.Geltungsbereich_E3_1_2_Premium.SP_IF_NM_aktiv_Internetverbindung_XIX_Infrastructure_Info_El_XIX_network_infrastructure_XIX_HCP3_IONode.DE_NM_aktiv_Internetverbindung, system-signal=NM_aktiv_Internetverbindung}, sender-receiver-to-signal-mapping={communication-direction=OUT, data-element=Infrastructure_Info_El_XIX_network_infrastructure_XIX_HCP3_IONode.Geltungsbereich_E3_1_2_Premium.SP_IF_DS_Info_El_Lokalaktiv_XIX_Infrastructure_Info_El_XIX_network_infrastructure_XIX_HCP3_IONode.DE_DS_Info_El_Lokalaktiv, system-signal=DS_Info_El_Lokalaktiv}, sender-receiver-to-signal-mapping={communication-direction=OUT, data-element=Infrastructure_Info_El_XIX_network_infrastructure_XIX_HCP3_IONode.Geltungsbereich_E3_1_2_Premium.SP_IF_NM_aktiv_SOK_Master_Anf_Info_El_XIX_Infrastructure_Info_El_XIX_network_infrastructure_XIX_HCP3_IONode.DE_NM_aktiv_SOK_Master_Anf_Info_El, system-signal=NM_aktiv_SOK_Master_Anf_Info_El}, sender-receiver-to-signal-mapping={communication-direction=OUT, data-element=Infrastructure_Info_El_XIX_network_infrastructure_XIX_HCP3_IONode.Geltungsbereich_E3_1_2_Premium.SP_IF_NM_aktiv_User_Anmeldung_XIX_Infrastructure_Info_El_XIX_network_infrastructure_XIX_HCP3_IONode.DE_NM_aktiv_User_Anmeldung, system-signal=NM_aktiv_User_Anmeldung}, sender-receiver-to-signal-mapping={communication-direction=OUT, data-element=Infrastructure_Info_El_XIX_network_infrastructure_XIX_HCP3_IONode.Geltungsbereich_E3_1_2_Premium.SP_IF_NM_aktiv_Innenraumerlebnis_XIX_Infrastructure_Info_El_XIX_network_infrastructure_XIX_HCP3_IONode.DE_NM_aktiv_Innenraumerlebnis, system-signal=NM_aktiv_Innenraumerlebnis}, sender-receiver-to-signal-mapping={communication-direction=IN, data-element=Infrastructure_Info_El_XIX_network_infrastructure_XIX_HCP3_IONode.Geltungsbereich_E3_1_2_Premium.RP_IF_Gateway_Nachlauftyp_XIX_Infrastructure_Info_El_XIX_network_infrastructure_XIX_HCP3_IONode.DE_Gateway_Nachlauftyp, system-signal=Gateway_Nachlauftyp}, sender-receiver-to-signal-mapping={communication-direction=IN, data-element=Infrastructure_Info_El_XIX_network_infrastructure_XIX_HCP3_IONode.Geltungsbereich_E3_1_2_Premium.RP_IF_IP_TS_CTO_01_Data_XIX_Infrastructure_Info_El_XIX_network_infrastructure_XIX_HCP3_IONode.DE_IP_TS_CTO_01_Data, system-signal=IP_TS_CTO_01_Data}, sender-receiver-to-signal-mapping={communication-direction=OUT, data-element=Infrastructure_Info_El_XIX_network_infrastructure_XIX_HCP3_IONode.Geltungsbereich_E3_1_2_Premium.SP_IF_TCPServer_IP_TS_DTO_03_Data_XIX_Infrastructure_Info_El_XIX_network_infrastructure_XIX_HCP3_IONode.DE_TCPServer_IP_TS_DTO_03_Data, system-signal=TCPServer_IP_TS_DTO_03_Data}, sender-receiver-to-signal-mapping={communication-direction=OUT, data-element=Infrastructure_Info_El_XIX_network_infrastructure_XIX_HCP3_IONode.Geltungsbereich_E3_1_2_Premium.SP_IF_TCPServer_IP_TS_DTO_02_Data_XIX_Infrastructure_Info_El_XIX_network_infrastructure_XIX_HCP3_IONode.DE_TCPServer_IP_TS_DTO_02_Data, system-signal=TCPServer_IP_TS_DTO_02_Data}, sender-receiver-to-signal-mapping={communication-direction=OUT, data-element=Infrastructure_Info_El_XIX_network_infrastructure_XIX_HCP3_IONode.Geltungsbereich_E3_1_2_Premium.SP_IF_TCPServer_IP_TS_DTO_04_Data_XIX_Infrastructure_Info_El_XIX_network_infrastructure_XIX_HCP3_IONode.DE_TCPServer_IP_TS_DTO_04_Data, system-signal=TCPServer_IP_TS_DTO_04_Data}, sender-receiver-to-signal-mapping={communication-direction=IN, data-element=Infrastructure_Info_El_XIX_network_infrastructure_XIX_HCP3_IONode.Geltungsbereich_E3_1_2_Premium.RP_IF_IP_TS_DTO_04_Data_XIX_Infrastructure_Info_El_XIX_network_infrastructure_XIX_HCP3_IONode.DE_IP_TS_DTO_04_Data, system-signal=IP_TS_DTO_04_Data}, sender-receiver-to-signal-mapping={communication-direction=IN, data-element=Infrastructure_Info_El_XIX_network_infrastructure_XIX_HCP3_IONode.Geltungsbereich_E3_1_2_Premium.RP_IF_IP_TS_DTO_02_Data_XIX_Infrastructure_Info_El_XIX_network_infrastructure_XIX_HCP3_IONode.DE_IP_TS_DTO_02_Data, system-signal=IP_TS_DTO_02_Data}, sender-receiver-to-signal-mapping={communication-direction=OUT, data-element=Infrastructure_Info_El_XIX_network_infrastructure_XIX_HCP3_IONode.Geltungsbereich_E3_1_2_Premium.SP_IF_TCPServer_IP_TS_DTO_01_Data_XIX_Infrastructure_Info_El_XIX_network_infrastructure_XIX_HCP3_IONode.DE_TCPServer_IP_TS_DTO_01_Data, system-signal=TCPServer_IP_TS_DTO_01_Data}, sender-receiver-to-signal-mapping={communication-direction=IN, data-element=Infrastructure_Info_El_XIX_network_infrastructure_XIX_HCP3_IONode.Geltungsbereich_E3_1_2_Premium.RP_IF_IP_TS_DTO_01_Data_XIX_Infrastructure_Info_El_XIX_network_infrastructure_XIX_HCP3_IONode.DE_IP_TS_DTO_01_Data, system-signal=IP_TS_DTO_01_Data}, sender-receiver-to-signal-mapping={communication-direction=IN, data-element=Infrastructure_Info_El_XIX_network_infrastructure_XIX_HCP3_IONode.Geltungsbereich_E3_1_2_Premium.RP_IF_IP_TS_DTO_03_Data_XIX_Infrastructure_Info_El_XIX_network_infrastructure_XIX_HCP3_IONode.DE_IP_TS_DTO_03_Data, system-signal=IP_TS_DTO_03_Data}, sender-receiver-to-signal-mapping={communication-direction=OUT, data-element=Infrastructure_Info_El_XIX_network_infrastructure_XIX_HCP3_IONode.Geltungsbereich_E3_1_2_Premium.SP_IF_NM_aktiv_BAP_Kommunikation_SYS_XIX_Infrastructure_Info_El_XIX_network_infrastructure_XIX_HCP3_IONode.DE_NM_aktiv_BAP_Kommunikation_SYS, system-signal=NM_aktiv_BAP_Kommunikation_SYS}, sender-receiver-to-signal-mapping={communication-direction=IN, data-element=Infrastructure_Info_El_XIX_network_infrastructure_XIX_HCP3_IONode.Geltungsbereich_E3_1_2_Premium.RP_IF_DispKBI_FS_Nachlauftyp_XIX_Infrastructure_Info_El_XIX_network_infrastructure_XIX_HCP3_IONode.DE_DispKBI_FS_Nachlauftyp, system-signal=DispKBI_FS_Nachlauftyp}, sender-receiver-to-signal-mapping={communication-direction=IN, data-element=diagnosis_infrastructure_Info_El_XIX_diagnosis_infrastructure_XIX_HCP3_IONode.Geltungsbereich_E3_1_2_Premium.RP_IF_UH_Monat_XIX_diagnosis_infrastructure_Info_El_XIX_diagnosis_infrastructure_XIX_HCP3_IONode.DE_UH_Monat, system-signal=UH_Monat}, sender-receiver-to-signal-mapping={communication-direction=IN, data-element=diagnosis_infrastructure_Info_El_XIX_diagnosis_infrastructure_XIX_HCP3_IONode.Geltungsbereich_E3_1_2_Premium.RP_IF_UH_Sekunde_XIX_diagnosis_infrastructure_Info_El_XIX_diagnosis_infrastructure_XIX_HCP3_IONode.DE_UH_Sekunde, system-signal=UH_Sekunde}, sender-receiver-to-signal-mapping={communication-direction=IN, data-element=diagnosis_infrastructure_Info_El_XIX_diagnosis_infrastructure_XIX_HCP3_IONode.Geltungsbereich_E3_1_2_Premium.RP_IF_DW_Kilometerstand_XIX_diagnosis_infrastructure_Info_El_XIX_diagnosis_infrastructure_XIX_HCP3_IONode.DE_DW_Kilometerstand, system-signal=DW_Kilometerstand}, sender-receiver-to-signal-mapping={communication-direction=IN, data-element=diagnosis_infrastructure_Info_El_XIX_diagnosis_infrastructure_XIX_HCP3_IONode.Geltungsbereich_E3_1_2_Premium.RP_IF_UH_Minute_XIX_diagnosis_infrastructure_Info_El_XIX_diagnosis_infrastructure_XIX_HCP3_IONode.DE_UH_Minute, system-signal=UH_Minute}, sender-receiver-to-signal-mapping={communication-direction=IN, data-element=diagnosis_infrastructure_Info_El_XIX_diagnosis_infrastructure_XIX_HCP3_IONode.Geltungsbereich_E3_1_2_Premium.RP_IF_UH_Jahr_XIX_diagnosis_infrastructure_Info_El_XIX_diagnosis_infrastructure_XIX_HCP3_IONode.DE_UH_Jahr, system-signal=UH_Jahr}, sender-receiver-to-signal-mapping={communication-direction=IN, data-element=diagnosis_infrastructure_Info_El_XIX_diagnosis_infrastructure_XIX_HCP3_IONode.Geltungsbereich_E3_1_2_Premium.RP_IF_UH_Tag_XIX_diagnosis_infrastructure_Info_El_XIX_diagnosis_infrastructure_XIX_HCP3_IONode.DE_UH_Tag, system-signal=UH_Tag}, sender-receiver-to-signal-mapping={communication-direction=IN, data-element=diagnosis_infrastructure_Info_El_XIX_diagnosis_infrastructure_XIX_HCP3_IONode.Geltungsbereich_E3_1_2_Premium.RP_IF_UH_Stunde_XIX_diagnosis_infrastructure_Info_El_XIX_diagnosis_infrastructure_XIX_HCP3_IONode.DE_UH_Stunde, system-signal=UH_Stunde}, sender-receiver-to-signal-mapping={communication-direction=OUT, data-element=diagnosis_infrastructure_Info_El_XIX_diagnosis_infrastructure_XIX_HCP3_IONode.Geltungsbereich_E3_1_2_Premium.SP_IF_Info_El_KD_Fehler_XIX_diagnosis_infrastructure_Info_El_XIX_diagnosis_infrastructure_XIX_HCP3_IONode.DE_Info_El_KD_Fehler, system-signal=Info_El_KD_Fehler}, sender-receiver-to-signal-mapping={communication-direction=OUT, data-element=diagnosis_infrastructure_Info_El_XIX_diagnosis_infrastructure_XIX_HCP3_IONode.Geltungsbereich_E3_1_2_Premium.SP_IF_DS_Info_El_ConfDTCChanged_XIX_diagnosis_infrastructure_Info_El_XIX_diagnosis_infrastructure_XIX_HCP3_IONode.DE_DS_Info_El_ConfDTCChanged, system-signal=DS_Info_El_ConfDTCChanged}, sender-receiver-to-signal-mapping={communication-direction=OUT, data-element=diagnosis_infrastructure_Info_El_XIX_diagnosis_infrastructure_XIX_HCP3_IONode.Geltungsbereich_E3_1_2_Premium.SP_IF_DS_Info_El_WIRChanged_XIX_diagnosis_infrastructure_Info_El_XIX_diagnosis_infrastructure_XIX_HCP3_IONode.DE_DS_Info_El_WIRChanged, system-signal=DS_Info_El_WIRChanged}, sender-receiver-to-signal-mapping={communication-direction=OUT, data-element=diagnosis_infrastructure_Info_El_XIX_diagnosis_infrastructure_XIX_HCP3_IONode.Geltungsbereich_E3_1_2_Premium.SP_IF_DS_Info_El_StMemChanged_XIX_diagnosis_infrastructure_Info_El_XIX_diagnosis_infrastructure_XIX_HCP3_IONode.DE_DS_Info_El_StMemChanged, system-signal=DS_Info_El_StMemChanged}, sender-receiver-to-signal-mapping={communication-direction=OUT, data-element=diagnosis_infrastructure_Info_El_XIX_diagnosis_infrastructure_XIX_HCP3_IONode.Geltungsbereich_E3_1_2_Premium.SP_IF_DS_Info_El_MemSelChanged_XIX_diagnosis_infrastructure_Info_El_XIX_diagnosis_infrastructure_XIX_HCP3_IONode.DE_DS_Info_El_MemSelChanged, system-signal=DS_Info_El_MemSelChanged}, sender-receiver-to-signal-mapping={communication-direction=OUT, data-element=diagnosis_infrastructure_Info_El_XIX_diagnosis_infrastructure_XIX_HCP3_IONode.Geltungsbereich_E3_1_2_Premium.SP_IF_DS_Info_El_DiagAdr_XIX_diagnosis_infrastructure_Info_El_XIX_diagnosis_infrastructure_XIX_HCP3_IONode.DE_DS_Info_El_DiagAdr, system-signal=DS_Info_El_DiagAdr}, sender-receiver-to-signal-mapping={communication-direction=OUT, data-element=diagnosis_infrastructure_Info_El_XIX_diagnosis_infrastructure_XIX_HCP3_IONode.Geltungsbereich_E3_1_2_Premium.SP_IF_DS_Info_El_TestFailedChanged_XIX_diagnosis_infrastructure_Info_El_XIX_diagnosis_infrastructure_XIX_HCP3_IONode.DE_DS_Info_El_TestFailedChanged, system-signal=DS_Info_El_TestFailedChanged}, sender-receiver-to-signal-mapping={communication-direction=OUT, data-element=diagnosis_infrastructure_Info_El_XIX_diagnosis_infrastructure_XIX_HCP3_IONode.Geltungsbereich_E3_1_2_Premium.SP_IF_DS_Info_El_MemSel10Changed_XIX_diagnosis_infrastructure_Info_El_XIX_diagnosis_infrastructure_XIX_HCP3_IONode.DE_DS_Info_El_MemSel10Changed, system-signal=DS_Info_El_MemSel10Changed}, sender-receiver-to-signal-mapping={communication-direction=OUT, data-element=diagnosis_infrastructure_Info_El_XIX_diagnosis_infrastructure_XIX_HCP3_IONode.Geltungsbereich_E3_1_2_Premium.SP_IF_DS_Info_El_IdentValid_XIX_diagnosis_infrastructure_Info_El_XIX_diagnosis_infrastructure_XIX_HCP3_IONode.DE_DS_Info_El_IdentValid, system-signal=DS_Info_El_IdentValid}, sender-receiver-to-signal-mapping={communication-direction=OUT, data-element=diagnosis_infrastructure_Info_El_XIX_diagnosis_infrastructure_XIX_HCP3_IONode.Geltungsbereich_E3_1_2_Premium.SP_IF_Info_El_SNI_10_XIX_diagnosis_infrastructure_Info_El_XIX_diagnosis_infrastructure_XIX_HCP3_IONode.DE_Info_El_SNI_10, system-signal=Info_El_SNI_10}, sender-receiver-to-signal-mapping={communication-direction=IN, data-element=diagnosis_infrastructure_Info_El_XIX_diagnosis_infrastructure_XIX_HCP3_IONode.Geltungsbereich_E3_1_2_Premium.RP_IF_SI_P_Mode_XIX_diagnosis_infrastructure_Info_El_XIX_diagnosis_infrastructure_XIX_HCP3_IONode.DE_SI_P_Mode, system-signal=SI_P_Mode}, sender-receiver-to-signal-mapping={communication-direction=IN, data-element=diagnosis_infrastructure_Info_El_XIX_diagnosis_infrastructure_XIX_HCP3_IONode.Geltungsbereich_E3_1_2_Premium.RP_IF_SI_P_Mode_gueltig_XIX_diagnosis_infrastructure_Info_El_XIX_diagnosis_infrastructure_XIX_HCP3_IONode.DE_SI_P_Mode_gueltig, system-signal=SI_P_Mode_gueltig}, sender-receiver-to-signal-mapping={communication-direction=IN, data-element=diagnosis_infrastructure_Info_El_XIX_diagnosis_infrastructure_XIX_HCP3_IONode.Geltungsbereich_E3_1_2_Premium.RP_IF_HUD_KD_Fehler_XIX_diagnosis_infrastructure_Info_El_XIX_diagnosis_infrastructure_XIX_HCP3_IONode.DE_HUD_KD_Fehler, system-signal=HUD_KD_Fehler}, sender-receiver-to-signal-mapping={communication-direction=IN, data-element=diagnosis_infrastructure_Info_El_XIX_diagnosis_infrastructure_XIX_HCP3_IONode.Geltungsbereich_E3_1_2_Premium.RP_IF_OBD_Driving_Cycle_XIX_diagnosis_infrastructure_Info_El_XIX_diagnosis_infrastructure_XIX_HCP3_IONode.DE_OBD_Driving_Cycle, system-signal=OBD_Driving_Cycle}, sender-receiver-to-signal-mapping={communication-direction=IN, data-element=diagnosis_infrastructure_Info_El_XIX_diagnosis_infrastructure_XIX_HCP3_IONode.Geltungsbereich_E3_1_2_Premium.RP_IF_OBD_Warm_Up_Cycle_XIX_diagnosis_infrastructure_Info_El_XIX_diagnosis_infrastructure_XIX_HCP3_IONode.DE_OBD_Warm_Up_Cycle, system-signal=OBD_Warm_Up_Cycle}, sender-receiver-to-signal-mapping={communication-direction=IN, data-element=diagnosis_infrastructure_Info_El_XIX_diagnosis_infrastructure_XIX_HCP3_IONode.Geltungsbereich_E3_1_2_Premium.RP_IF_PID_KD_Fehler_XIX_diagnosis_infrastructure_Info_El_XIX_diagnosis_infrastructure_XIX_HCP3_IONode.DE_PID_KD_Fehler, system-signal=PID_KD_Fehler}, sender-receiver-to-signal-mapping={communication-direction=IN, data-element=diagnosis_infrastructure_Info_El_XIX_diagnosis_infrastructure_XIX_HCP3_IONode.Geltungsbereich_E3_1_2_Premium.RP_IF_CID_KD_Fehler_XIX_diagnosis_infrastructure_Info_El_XIX_diagnosis_infrastructure_XIX_HCP3_IONode.DE_CID_KD_Fehler, system-signal=CID_KD_Fehler}, sender-receiver-to-signal-mapping={communication-direction=IN, data-element=diagnosis_infrastructure_Info_El_XIX_diagnosis_infrastructure_XIX_HCP3_IONode.Geltungsbereich_E3_1_2_Premium.RP_IF_WLC1_KD_Fehler_XIX_diagnosis_infrastructure_Info_El_XIX_diagnosis_infrastructure_XIX_HCP3_IONode.DE_WLC1_KD_Fehler, system-signal=WLC1_KD_Fehler}, sender-receiver-to-signal-mapping={communication-direction=IN, data-element=diagnosis_infrastructure_Info_El_XIX_diagnosis_infrastructure_XIX_HCP3_IONode.Geltungsbereich_E3_1_2_Premium.RP_IF_WLC2_KD_Fehler_XIX_diagnosis_infrastructure_Info_El_XIX_diagnosis_infrastructure_XIX_HCP3_IONode.DE_WLC2_KD_Fehler, system-signal=WLC2_KD_Fehler}, sender-receiver-to-signal-mapping={communication-direction=OUT, data-element=diagnosis_infrastructure_Info_El_XIX_diagnosis_infrastructure_XIX_HCP3_IONode.Geltungsbereich_E3_1_2_Premium.SP_IF_SI_Bus_Identifikation_XIX_diagnosis_infrastructure_Info_El_XIX_diagnosis_infrastructure_XIX_HCP3_IONode.DE_SI_Bus_Identifikation, system-signal=SI_Bus_Identifikation}, sender-receiver-to-signal-mapping={communication-direction=IN, data-element=diagnosis_infrastructure_Info_El_XIX_diagnosis_infrastructure_XIX_HCP3_IONode.Geltungsbereich_E3_1_2_Premium.RP_IF_HUD_SNI_10_XIX_diagnosis_infrastructure_Info_El_XIX_diagnosis_infrastructure_XIX_HCP3_IONode.DE_HUD_SNI_10, system-signal=HUD_SNI_10}, sender-receiver-to-signal-mapping={communication-direction=IN, data-element=diagnosis_infrastructure_Info_El_XIX_diagnosis_infrastructure_XIX_HCP3_IONode.Geltungsbereich_E3_1_2_Premium.RP_IF_ICAS3Sys01_SNI_10_XIX_diagnosis_infrastructure_Info_El_XIX_diagnosis_infrastructure_XIX_HCP3_IONode.DE_ICAS3Sys01_SNI_10, system-signal=ICAS3Sys01_SNI_10}, sender-receiver-to-signal-group-mapping={communication-direction=IN, data-element=diagnosis_infrastructure_Info_El_XIX_diagnosis_infrastructure_XIX_HCP3_IONode.Geltungsbereich_E3_1_2_Premium.RP_IF_SG_VDSO_05_XIX_diagnosis_infrastructure_Info_El_XIX_diagnosis_infrastructure_XIX_HCP3_IONode.DE_SG_VDSO_05, signal-group=SG_VDSO_05, type-mapping=sender-rec-record-type-mapping=record-element-mappings=[{implementation-record-element=VDSO_Vx3d, system-signal=VDSO_Vx3d}, {implementation-record-element=VDSO_Vx3dDisp, system-signal=VDSO_Vx3dDisp}, {implementation-record-element=VDSO_05_BZ, system-signal=VDSO_05_BZ}, {implementation-record-element=VDSO_05_CRC, system-signal=VDSO_05_CRC}]}, sender-receiver-to-signal-mapping={communication-direction=IN, data-element=diagnosis_infrastructure_Info_El_XIX_diagnosis_infrastructure_XIX_HCP3_IONode.Geltungsbereich_E3_1_2_Premium.RP_IF_CID_SNI_10_XIX_diagnosis_infrastructure_Info_El_XIX_diagnosis_infrastructure_XIX_HCP3_IONode.DE_CID_SNI_10, system-signal=CID_SNI_10}, sender-receiver-to-signal-mapping={communication-direction=IN, data-element=diagnosis_infrastructure_Info_El_XIX_diagnosis_infrastructure_XIX_HCP3_IONode.Geltungsbereich_E3_1_2_Premium.RP_IF_MM_PropulsionSystemActive_XIX_diagnosis_infrastructure_Info_El_XIX_diagnosis_infrastructure_XIX_HCP3_IONode.DE_MM_PropulsionSystemActive, system-signal=MM_PropulsionSystemActive}, sender-receiver-to-signal-mapping={communication-direction=IN, data-element=diagnosis_infrastructure_Info_El_XIX_diagnosis_infrastructure_XIX_HCP3_IONode.Geltungsbereich_E3_1_2_Premium.RP_IF_ICAS3Sys01_KD_Fehler_XIX_diagnosis_infrastructure_Info_El_XIX_diagnosis_infrastructure_XIX_HCP3_IONode.DE_ICAS3Sys01_KD_Fehler, system-signal=ICAS3Sys01_KD_Fehler}, sender-receiver-to-signal-mapping={communication-direction=IN, data-element=diagnosis_infrastructure_Info_El_XIX_diagnosis_infrastructure_XIX_HCP3_IONode.Geltungsbereich_E3_1_2_Premium.RP_IF_AMP_KD_Fehler_XIX_diagnosis_infrastructure_Info_El_XIX_diagnosis_infrastructure_XIX_HCP3_IONode.DE_AMP_KD_Fehler, system-signal=AMP_KD_Fehler}, sender-receiver-to-signal-group-mapping={communication-direction=IN, data-element=diagnosis_infrastructure_Info_El_XIX_diagnosis_infrastructure_XIX_HCP3_IONode.Geltungsbereich_E3_1_2_Premium.RP_IF_SG_WFS_02_XIX_diagnosis_infrastructure_Info_El_XIX_diagnosis_infrastructure_XIX_HCP3_IONode.DE_SG_WFS_02, signal-group=SG_WFS_02, type-mapping=sender-rec-record-type-mapping=record-element-mappings=[{implementation-record-element=VIN_1, system-signal=VIN_1}, {implementation-record-element=VIN_2, system-signal=VIN_2}, {implementation-record-element=VIN_3, system-signal=VIN_3}, {implementation-record-element=VIN_4, system-signal=VIN_4}, {implementation-record-element=VIN_5, system-signal=VIN_5}, {implementation-record-element=VIN_6, system-signal=VIN_6}, {implementation-record-element=VIN_7, system-signal=VIN_7}, {implementation-record-element=VIN_8, system-signal=VIN_8}, {implementation-record-element=VIN_15, system-signal=VIN_15}, {implementation-record-element=VIN_17, system-signal=VIN_17}, {implementation-record-element=VIN_14, system-signal=VIN_14}, {implementation-record-element=VIN_9, system-signal=VIN_9}, {implementation-record-element=VIN_13, system-signal=VIN_13}, {implementation-record-element=VIN_10, system-signal=VIN_10}, {implementation-record-element=VIN_11, system-signal=VIN_11}, {implementation-record-element=VIN_12, system-signal=VIN_12}, {implementation-record-element=VIN_16, system-signal=VIN_16}]}, sender-receiver-to-signal-mapping={communication-direction=IN, data-element=diagnosis_infrastructure_Info_El_XIX_diagnosis_infrastructure_XIX_HCP3_IONode.Geltungsbereich_E3_1_2_Premium.RP_IF_SI_NWDF_30_XIX_diagnosis_infrastructure_Info_El_XIX_diagnosis_infrastructure_XIX_HCP3_IONode.DE_SI_NWDF_30, system-signal=SI_NWDF_30}, sender-receiver-to-signal-mapping={communication-direction=IN, data-element=diagnosis_infrastructure_Info_El_XIX_diagnosis_infrastructure_XIX_HCP3_IONode.Geltungsbereich_E3_1_2_Premium.RP_IF_SI_NWDF_gueltig_XIX_diagnosis_infrastructure_Info_El_XIX_diagnosis_infrastructure_XIX_HCP3_IONode.DE_SI_NWDF_gueltig, system-signal=SI_NWDF_gueltig}, sender-receiver-to-signal-mapping={communication-direction=IN, data-element=diagnosis_infrastructure_Info_El_XIX_diagnosis_infrastructure_XIX_HCP3_IONode.Geltungsbereich_E3_1_2_Premium.RP_IF_SI_NWDF_XIX_diagnosis_infrastructure_Info_El_XIX_diagnosis_infrastructure_XIX_HCP3_IONode.DE_SI_NWDF, system-signal=SI_NWDF}, sender-receiver-to-signal-mapping={communication-direction=IN, data-element=diagnosis_infrastructure_Info_El_XIX_diagnosis_infrastructure_XIX_HCP3_IONode.Geltungsbereich_E3_1_2_Premium.RP_IF_KN_AMP_DiagPfad_V12_XIX_diagnosis_infrastructure_Info_El_XIX_diagnosis_infrastructure_XIX_HCP3_IONode.DE_KN_AMP_DiagPfad_V12, system-signal=KN_AMP_DiagPfad_V12}, sender-receiver-to-signal-mapping={communication-direction=IN, data-element=diagnosis_infrastructure_Info_El_XIX_diagnosis_infrastructure_XIX_HCP3_IONode.Geltungsbereich_E3_1_2_Premium.RP_IF_AMP_SNI_10_XIX_diagnosis_infrastructure_Info_El_XIX_diagnosis_infrastructure_XIX_HCP3_IONode.DE_AMP_SNI_10, system-signal=AMP_SNI_10}, sender-receiver-to-signal-mapping={communication-direction=OUT, data-element=diagnosis_infrastructure_Info_El_XIX_diagnosis_infrastructure_XIX_HCP3_IONode.Geltungsbereich_E3_1_2_Premium.SP_IF_KN_Info_El_DiagPfad_V12_XIX_diagnosis_infrastructure_Info_El_XIX_diagnosis_infrastructure_XIX_HCP3_IONode.DE_KN_Info_El_DiagPfad_V12, system-signal=KN_Info_El_DiagPfad_V12}, sender-receiver-to-signal-mapping={communication-direction=IN, data-element=diagnosis_infrastructure_Info_El_XIX_diagnosis_infrastructure_XIX_HCP3_IONode.Geltungsbereich_E3_1_2_Premium.RP_IF_KN_WLC1_DiagPfad_V12_XIX_diagnosis_infrastructure_Info_El_XIX_diagnosis_infrastructure_XIX_HCP3_IONode.DE_KN_WLC1_DiagPfad_V12, system-signal=KN_WLC1_DiagPfad_V12}, sender-receiver-to-signal-mapping={communication-direction=IN, data-element=diagnosis_infrastructure_Info_El_XIX_diagnosis_infrastructure_XIX_HCP3_IONode.Geltungsbereich_E3_1_2_Premium.RP_IF_KN_WLC2_DiagPfad_V12_XIX_diagnosis_infrastructure_Info_El_XIX_diagnosis_infrastructure_XIX_HCP3_IONode.DE_KN_WLC2_DiagPfad_V12, system-signal=KN_WLC2_DiagPfad_V12}, sender-receiver-to-signal-mapping={communication-direction=IN, data-element=diagnosis_infrastructure_Info_El_XIX_diagnosis_infrastructure_XIX_HCP3_IONode.Geltungsbereich_E3_1_2_Premium.RP_IF_CCF_SNI_10_XIX_diagnosis_infrastructure_Info_El_XIX_diagnosis_infrastructure_XIX_HCP3_IONode.DE_CCF_SNI_10, system-signal=CCF_SNI_10}, sender-receiver-to-signal-mapping={communication-direction=IN, data-element=diagnosis_infrastructure_Info_El_XIX_diagnosis_infrastructure_XIX_HCP3_IONode.Geltungsbereich_E3_1_2_Premium.RP_IF_KN_HUD_DiagPfad_V12_XIX_diagnosis_infrastructure_Info_El_XIX_diagnosis_infrastructure_XIX_HCP3_IONode.DE_KN_HUD_DiagPfad_V12, system-signal=KN_HUD_DiagPfad_V12}, sender-receiver-to-signal-mapping={communication-direction=IN, data-element=diagnosis_infrastructure_Info_El_XIX_diagnosis_infrastructure_XIX_HCP3_IONode.Geltungsbereich_E3_1_2_Premium.RP_IF_KN_CID_DiagPfad_V12_XIX_diagnosis_infrastructure_Info_El_XIX_diagnosis_infrastructure_XIX_HCP3_IONode.DE_KN_CID_DiagPfad_V12, system-signal=KN_CID_DiagPfad_V12}, sender-receiver-to-signal-mapping={communication-direction=IN, data-element=diagnosis_infrastructure_Info_El_XIX_diagnosis_infrastructure_XIX_HCP3_IONode.Geltungsbereich_E3_1_2_Premium.RP_IF_KN_CCF_DiagPfad_V12_XIX_diagnosis_infrastructure_Info_El_XIX_diagnosis_infrastructure_XIX_HCP3_IONode.DE_KN_CCF_DiagPfad_V12, system-signal=KN_CCF_DiagPfad_V12}, sender-receiver-to-signal-mapping={communication-direction=IN, data-element=diagnosis_infrastructure_Info_El_XIX_diagnosis_infrastructure_XIX_HCP3_IONode.Geltungsbereich_E3_1_2_Premium.RP_IF_KN_ICAS3Sys01_DiagPfad_V12_XIX_diagnosis_infrastructure_Info_El_XIX_diagnosis_infrastructure_XIX_HCP3_IONode.DE_KN_ICAS3Sys01_DiagPfad_V12, system-signal=KN_ICAS3Sys01_DiagPfad_V12}, sender-receiver-to-signal-mapping={communication-direction=IN, data-element=diagnosis_infrastructure_Info_El_XIX_diagnosis_infrastructure_XIX_HCP3_IONode.Geltungsbereich_E3_1_2_Premium.RP_IF_KN_PID_DiagPfad_V12_XIX_diagnosis_infrastructure_Info_El_XIX_diagnosis_infrastructure_XIX_HCP3_IONode.DE_KN_PID_DiagPfad_V12, system-signal=KN_PID_DiagPfad_V12}, sender-receiver-to-signal-mapping={communication-direction=IN, data-element=diagnosis_infrastructure_Info_El_XIX_diagnosis_infrastructure_XIX_HCP3_IONode.Geltungsbereich_E3_1_2_Premium.RP_IF_PID_SNI_10_XIX_diagnosis_infrastructure_Info_El_XIX_diagnosis_infrastructure_XIX_HCP3_IONode.DE_PID_SNI_10, system-signal=PID_SNI_10}, sender-receiver-to-signal-mapping={communication-direction=IN, data-element=diagnosis_infrastructure_Info_El_XIX_diagnosis_infrastructure_XIX_HCP3_IONode.Geltungsbereich_E3_1_2_Premium.RP_IF_WLC1_SNI_10_XIX_diagnosis_infrastructure_Info_El_XIX_diagnosis_infrastructure_XIX_HCP3_IONode.DE_WLC1_SNI_10, system-signal=WLC1_SNI_10}, sender-receiver-to-signal-mapping={communication-direction=IN, data-element=diagnosis_infrastructure_Info_El_XIX_diagnosis_infrastructure_XIX_HCP3_IONode.Geltungsbereich_E3_1_2_Premium.RP_IF_WLC2_SNI_10_XIX_diagnosis_infrastructure_Info_El_XIX_diagnosis_infrastructure_XIX_HCP3_IONode.DE_WLC2_SNI_10, system-signal=WLC2_SNI_10}, sender-receiver-to-signal-mapping={communication-direction=IN, data-element=diagnosis_infrastructure_Info_El_XIX_diagnosis_infrastructure_XIX_HCP3_IONode.Geltungsbereich_E3_1_2_Premium.RP_IF_HCP3Sys03_KD_Fehler_XIX_diagnosis_infrastructure_Info_El_XIX_diagnosis_infrastructure_XIX_HCP3_IONode.DE_HCP3Sys03_KD_Fehler, system-signal=HCP3Sys03_KD_Fehler}, sender-receiver-to-signal-mapping={communication-direction=IN, data-element=diagnosis_infrastructure_Info_El_XIX_diagnosis_infrastructure_XIX_HCP3_IONode.Geltungsbereich_E3_1_2_Premium.RP_IF_CCF_KD_Fehler_XIX_diagnosis_infrastructure_Info_El_XIX_diagnosis_infrastructure_XIX_HCP3_IONode.DE_CCF_KD_Fehler, system-signal=CCF_KD_Fehler}, sender-receiver-to-signal-mapping={communication-direction=IN, data-element=diagnosis_infrastructure_Info_El_XIX_diagnosis_infrastructure_XIX_HCP3_IONode.Geltungsbereich_E3_1_2_Premium.RP_IF_KN_HCP3Sys03_DiagPfad_V12_XIX_diagnosis_infrastructure_Info_El_XIX_diagnosis_infrastructure_XIX_HCP3_IONode.DE_KN_HCP3Sys03_DiagPfad_V12, system-signal=KN_HCP3Sys03_DiagPfad_V12}, sender-receiver-to-signal-mapping={communication-direction=IN, data-element=diagnosis_infrastructure_Info_El_XIX_diagnosis_infrastructure_XIX_HCP3_IONode.Geltungsbereich_E3_1_2_Premium.RP_IF_HCP3Sys03_SNI_10_XIX_diagnosis_infrastructure_Info_El_XIX_diagnosis_infrastructure_XIX_HCP3_IONode.DE_HCP3Sys03_SNI_10, system-signal=HCP3Sys03_SNI_10}, sender-receiver-to-signal-mapping={communication-direction=IN, data-element=diagnosis_infrastructure_Info_El_XIX_diagnosis_infrastructure_XIX_HCP3_IONode.Geltungsbereich_E3_1_2_Premium.RP_IF_DispKBI_FS_KD_Fehler_XIX_diagnosis_infrastructure_Info_El_XIX_diagnosis_infrastructure_XIX_HCP3_IONode.DE_DispKBI_FS_KD_Fehler, system-signal=DispKBI_FS_KD_Fehler}, sender-receiver-to-signal-mapping={communication-direction=IN, data-element=diagnosis_infrastructure_Info_El_XIX_diagnosis_infrastructure_XIX_HCP3_IONode.Geltungsbereich_E3_1_2_Premium.RP_IF_KN_DispKBI_FS_DiagPfad_V12_XIX_diagnosis_infrastructure_Info_El_XIX_diagnosis_infrastructure_XIX_HCP3_IONode.DE_KN_DispKBI_FS_DiagPfad_V12, system-signal=KN_DispKBI_FS_DiagPfad_V12}, sender-receiver-to-signal-mapping={communication-direction=IN, data-element=diagnosis_infrastructure_Info_El_XIX_diagnosis_infrastructure_XIX_HCP3_IONode.Geltungsbereich_E3_1_2_Premium.RP_IF_DispKBI_FS_SNI_10_XIX_diagnosis_infrastructure_Info_El_XIX_diagnosis_infrastructure_XIX_HCP3_IONode.DE_DispKBI_FS_SNI_10, system-signal=DispKBI_FS_SNI_10}, sender-receiver-to-signal-mapping={communication-direction=IN, data-element=PowerManagement_HCP3_IONode_XIX_CockpitInfotainment_Systemfunktionen_XIX_HCP3_IONode.Geltungsbereich_E3_1_2_Premium.RP_IF_SI_T_Mode_XIX_PowerManagement_HCP3_IONode_XIX_CockpitInfotainment_Systemfunktionen_XIX_HCP3_IONode.DE_SI_T_Mode, system-signal=SI_T_Mode}, sender-receiver-to-signal-mapping={communication-direction=IN, data-element=PowerManagement_HCP3_IONode_XIX_CockpitInfotainment_Systemfunktionen_XIX_HCP3_IONode.Geltungsbereich_E3_1_2_Premium.RP_IF_SI_T_Schutz_XIX_PowerManagement_HCP3_IONode_XIX_CockpitInfotainment_Systemfunktionen_XIX_HCP3_IONode.DE_SI_T_Schutz, system-signal=SI_T_Schutz}, sender-receiver-to-signal-mapping={communication-direction=IN, data-element=PowerManagement_HCP3_IONode_XIX_CockpitInfotainment_Systemfunktionen_XIX_HCP3_IONode.Geltungsbereich_E3_1_2_Premium.RP_IF_NVEM_Abschaltstufe_XIX_PowerManagement_HCP3_IONode_XIX_CockpitInfotainment_Systemfunktionen_XIX_HCP3_IONode.DE_NVEM_Abschaltstufe, system-signal=NVEM_Abschaltstufe}, sender-receiver-to-signal-mapping={communication-direction=IN, data-element=PowerManagement_HCP3_IONode_XIX_CockpitInfotainment_Systemfunktionen_XIX_HCP3_IONode.Geltungsbereich_E3_1_2_Premium.RP_IF_CID_LVDS_Status_XIX_PowerManagement_HCP3_IONode_XIX_CockpitInfotainment_Systemfunktionen_XIX_HCP3_IONode.DE_CID_LVDS_Status, system-signal=CID_LVDS_Status}, sender-receiver-to-signal-mapping={communication-direction=IN, data-element=PowerManagement_HCP3_IONode_XIX_CockpitInfotainment_Systemfunktionen_XIX_HCP3_IONode.Geltungsbereich_E3_1_2_Premium.RP_IF_CID_State_XIX_PowerManagement_HCP3_IONode_XIX_CockpitInfotainment_Systemfunktionen_XIX_HCP3_IONode.DE_CID_State, system-signal=CID_State}, sender-receiver-to-signal-mapping={communication-direction=OUT, data-element=PowerManagement_HCP3_IONode_XIX_CockpitInfotainment_Systemfunktionen_XIX_HCP3_IONode.Geltungsbereich_E3_1_2_Premium.SP_IF_ZR_State_CID_XIX_PowerManagement_HCP3_IONode_XIX_CockpitInfotainment_Systemfunktionen_XIX_HCP3_IONode.DE_ZR_State_CID, system-signal=ZR_State_CID}, sender-receiver-to-signal-mapping={communication-direction=IN, data-element=PowerManagement_HCP3_IONode_XIX_CockpitInfotainment_Systemfunktionen_XIX_HCP3_IONode.Geltungsbereich_E3_1_2_Premium.RP_IF_SI_NWDF_XIX_PowerManagement_HCP3_IONode_XIX_CockpitInfotainment_Systemfunktionen_XIX_HCP3_IONode.DE_SI_NWDF, system-signal=SI_NWDF}, sender-receiver-to-signal-mapping={communication-direction=IN, data-element=PowerManagement_HCP3_IONode_XIX_CockpitInfotainment_Systemfunktionen_XIX_HCP3_IONode.Geltungsbereich_E3_1_2_Premium.RP_IF_PID_LVDS_State_XIX_PowerManagement_HCP3_IONode_XIX_CockpitInfotainment_Systemfunktionen_XIX_HCP3_IONode.DE_PID_LVDS_State, system-signal=PID_LVDS_State}, sender-receiver-to-signal-mapping={communication-direction=IN, data-element=PowerManagement_HCP3_IONode_XIX_CockpitInfotainment_Systemfunktionen_XIX_HCP3_IONode.Geltungsbereich_E3_1_2_Premium.RP_IF_PID_State_XIX_PowerManagement_HCP3_IONode_XIX_CockpitInfotainment_Systemfunktionen_XIX_HCP3_IONode.DE_PID_State, system-signal=PID_State}, sender-receiver-to-signal-mapping={communication-direction=OUT, data-element=PowerManagement_HCP3_IONode_XIX_CockpitInfotainment_Systemfunktionen_XIX_HCP3_IONode.Geltungsbereich_E3_1_2_Premium.SP_IF_ZR_State_PID_XIX_PowerManagement_HCP3_IONode_XIX_CockpitInfotainment_Systemfunktionen_XIX_HCP3_IONode.DE_ZR_State_PID, system-signal=ZR_State_PID}, sender-receiver-to-signal-mapping={communication-direction=IN, data-element=PowerManagement_HCP3_IONode_XIX_CockpitInfotainment_Systemfunktionen_XIX_HCP3_IONode.Geltungsbereich_E3_1_2_Premium.RP_IF_FID_LVDS_State_XIX_PowerManagement_HCP3_IONode_XIX_CockpitInfotainment_Systemfunktionen_XIX_HCP3_IONode.DE_FID_LVDS_State, system-signal=FID_LVDS_State}, sender-receiver-to-signal-mapping={communication-direction=IN, data-element=PowerManagement_HCP3_IONode_XIX_CockpitInfotainment_Systemfunktionen_XIX_HCP3_IONode.Geltungsbereich_E3_1_2_Premium.RP_IF_FID_State_XIX_PowerManagement_HCP3_IONode_XIX_CockpitInfotainment_Systemfunktionen_XIX_HCP3_IONode.DE_FID_State, system-signal=FID_State}, sender-receiver-to-signal-mapping={communication-direction=OUT, data-element=PowerManagement_HCP3_IONode_XIX_CockpitInfotainment_Systemfunktionen_XIX_HCP3_IONode.Geltungsbereich_E3_1_2_Premium.SP_IF_ZR_State_FID_XIX_PowerManagement_HCP3_IONode_XIX_CockpitInfotainment_Systemfunktionen_XIX_HCP3_IONode.DE_ZR_State_FID, system-signal=ZR_State_FID}, sender-receiver-to-signal-mapping={communication-direction=IN, data-element=PowerManagement_HCP3_IONode_XIX_CockpitInfotainment_Systemfunktionen_XIX_HCP3_IONode.Geltungsbereich_E3_1_2_Premium.RP_IF_FT_Tuer_Status_XIX_PowerManagement_HCP3_IONode_XIX_CockpitInfotainment_Systemfunktionen_XIX_HCP3_IONode.DE_FT_Tuer_Status, system-signal=FT_Tuer_Status}, sender-receiver-to-signal-mapping={communication-direction=IN, data-element=PowerManagement_HCP3_IONode_XIX_CockpitInfotainment_Systemfunktionen_XIX_HCP3_IONode.Geltungsbereich_E3_1_2_Premium.RP_IF_ZV_verriegelt_extern_ist_02_XIX_PowerManagement_HCP3_IONode_XIX_CockpitInfotainment_Systemfunktionen_XIX_HCP3_IONode.DE_ZV_verriegelt_extern_ist_02, system-signal=ZV_verriegelt_extern_ist_02}, sender-receiver-to-signal-group-mapping={communication-direction=IN, data-element=PowerManagement_HCP3_IONode_XIX_CockpitInfotainment_Systemfunktionen_XIX_HCP3_IONode.Geltungsbereich_E3_1_2_Premium.RP_IF_SG_ClampControl_01_XIX_PowerManagement_HCP3_IONode_XIX_CockpitInfotainment_Systemfunktionen_XIX_HCP3_IONode.DE_SG_ClampControl_01, signal-group=SG_ClampControl_01, type-mapping=sender-rec-record-type-mapping=record-element-mappings=[{implementation-record-element=KST_KL_15, system-signal=KST_KL_15}, {implementation-record-element=KST_Kl_S, system-signal=KST_Kl_S}, {implementation-record-element=KST_Kl_50_Startanforderung, system-signal=KST_Kl_50_Startanforderung}, {implementation-record-element=ClampControl_01_BZ, system-signal=ClampControl_01_BZ}, {implementation-record-element=ClampControl_01_CRC, system-signal=ClampControl_01_CRC}, {implementation-record-element=KST_Ausstiegswunsch_Status, system-signal=KST_Ausstiegswunsch_Status}, {implementation-record-element=KST_ComfortReadyStatus, system-signal=KST_ComfortReadyStatus}]}, sender-receiver-to-signal-mapping={communication-direction=IN, data-element=PowerManagement_HCP3_IONode_XIX_CockpitInfotainment_Systemfunktionen_XIX_HCP3_IONode.Geltungsbereich_E3_1_2_Premium.RP_IF_KL_Geblaese_Status_XIX_PowerManagement_HCP3_IONode_XIX_CockpitInfotainment_Systemfunktionen_XIX_HCP3_IONode.DE_KL_Geblaese_Status, system-signal=KL_Geblaese_Status}, sender-receiver-to-signal-mapping={communication-direction=IN, data-element=PowerManagement_HCP3_IONode_XIX_CockpitInfotainment_Systemfunktionen_XIX_HCP3_IONode.Geltungsbereich_E3_1_2_Premium.RP_IF_SI_NWDF_gueltig_XIX_PowerManagement_HCP3_IONode_XIX_CockpitInfotainment_Systemfunktionen_XIX_HCP3_IONode.DE_SI_NWDF_gueltig, system-signal=SI_NWDF_gueltig}, sender-receiver-to-signal-mapping={communication-direction=IN, data-element=PowerManagement_HCP3_IONode_XIX_CockpitInfotainment_Systemfunktionen_XIX_HCP3_IONode.Geltungsbereich_E3_1_2_Premium.RP_IF_ZV_Tasten_HMI_Anf_XIX_PowerManagement_HCP3_IONode_XIX_CockpitInfotainment_Systemfunktionen_XIX_HCP3_IONode.DE_ZV_Tasten_HMI_Anf, system-signal=ZV_Tasten_HMI_Anf}, sender-receiver-to-signal-group-mapping={communication-direction=IN, data-element=PowerManagement_HCP3_IONode_XIX_CockpitInfotainment_Systemfunktionen_XIX_HCP3_IONode.Geltungsbereich_E3_1_2_Premium.RP_IF_SG_VDSO_05_XIX_PowerManagement_HCP3_IONode_XIX_CockpitInfotainment_Systemfunktionen_XIX_HCP3_IONode.DE_SG_VDSO_05, signal-group=SG_VDSO_05, type-mapping=sender-rec-record-type-mapping=record-element-mappings=[{implementation-record-element=VDSO_Vx3d, system-signal=VDSO_Vx3d}, {implementation-record-element=VDSO_Vx3dDisp, system-signal=VDSO_Vx3dDisp}, {implementation-record-element=VDSO_05_BZ, system-signal=VDSO_05_BZ}, {implementation-record-element=VDSO_05_CRC, system-signal=VDSO_05_CRC}]}, sender-receiver-to-signal-mapping={communication-direction=IN, data-element=PowerManagement_HCP3_IONode_XIX_CockpitInfotainment_Systemfunktionen_XIX_HCP3_IONode.Geltungsbereich_E3_1_2_Premium.RP_IF_SI_NWDF_30_XIX_PowerManagement_HCP3_IONode_XIX_CockpitInfotainment_Systemfunktionen_XIX_HCP3_IONode.DE_SI_NWDF_30, system-signal=SI_NWDF_30}, sender-receiver-to-signal-mapping={communication-direction=IN, data-element=PowerManagement_HCP3_IONode_XIX_CockpitInfotainment_Systemfunktionen_XIX_HCP3_IONode.Geltungsbereich_E3_1_2_Premium.RP_IF_SI_QRS_Mode_XIX_PowerManagement_HCP3_IONode_XIX_CockpitInfotainment_Systemfunktionen_XIX_HCP3_IONode.DE_SI_QRS_Mode, system-signal=SI_QRS_Mode}, sender-receiver-to-signal-mapping={communication-direction=IN, data-element=VehicleComm_HCP3_IONode_XIX_CockpitInfotainment_Systemfunktionen_XIX_HCP3_IONode.Geltungsbereich_E3_1_2_Premium.RP_IF_NVEM_Abschaltstufe_XIX_VehicleComm_HCP3_IONode_XIX_CockpitInfotainment_Systemfunktionen_XIX_HCP3_IONode.DE_NVEM_Abschaltstufe, system-signal=NVEM_Abschaltstufe}, sender-receiver-to-signal-mapping={communication-direction=IN, data-element=VehicleComm_HCP3_IONode_XIX_CockpitInfotainment_Systemfunktionen_XIX_HCP3_IONode.Geltungsbereich_E3_1_2_Premium.RP_IF_FT_Tuer_geoeffnet_XIX_VehicleComm_HCP3_IONode_XIX_CockpitInfotainment_Systemfunktionen_XIX_HCP3_IONode.DE_FT_Tuer_geoeffnet, system-signal=FT_Tuer_geoeffnet}, sender-receiver-to-signal-group-mapping={communication-direction=IN, data-element=VehicleComm_HCP3_IONode_XIX_CockpitInfotainment_Systemfunktionen_XIX_HCP3_IONode.Geltungsbereich_E3_1_2_Premium.RP_IF_SG_WFS_02_XIX_VehicleComm_HCP3_IONode_XIX_CockpitInfotainment_Systemfunktionen_XIX_HCP3_IONode.DE_SG_WFS_02, signal-group=SG_WFS_02, type-mapping=sender-rec-record-type-mapping=record-element-mappings=[{implementation-record-element=VIN_1, system-signal=VIN_1}, {implementation-record-element=VIN_2, system-signal=VIN_2}, {implementation-record-element=VIN_3, system-signal=VIN_3}, {implementation-record-element=VIN_4, system-signal=VIN_4}, {implementation-record-element=VIN_5, system-signal=VIN_5}, {implementation-record-element=VIN_6, system-signal=VIN_6}, {implementation-record-element=VIN_7, system-signal=VIN_7}, {implementation-record-element=VIN_8, system-signal=VIN_8}, {implementation-record-element=VIN_15, system-signal=VIN_15}, {implementation-record-element=VIN_17, system-signal=VIN_17}, {implementation-record-element=VIN_14, system-signal=VIN_14}, {implementation-record-element=VIN_9, system-signal=VIN_9}, {implementation-record-element=VIN_13, system-signal=VIN_13}, {implementation-record-element=VIN_10, system-signal=VIN_10}, {implementation-record-element=VIN_11, system-signal=VIN_11}, {implementation-record-element=VIN_12, system-signal=VIN_12}, {implementation-record-element=VIN_16, system-signal=VIN_16}]}, sender-receiver-to-signal-mapping={communication-direction=OUT, data-element=VehicleComm_HCP3_IONode_XIX_CockpitInfotainment_Systemfunktionen_XIX_HCP3_IONode.Geltungsbereich_E3_1_2_Premium.SP_IF_RA_AM_Tuning_XIX_VehicleComm_HCP3_IONode_XIX_CockpitInfotainment_Systemfunktionen_XIX_HCP3_IONode.DE_RA_AM_Tuning, system-signal=RA_AM_Tuning}, sender-receiver-to-signal-mapping={communication-direction=OUT, data-element=VehicleComm_HCP3_IONode_XIX_CockpitInfotainment_Systemfunktionen_XIX_HCP3_IONode.Geltungsbereich_E3_1_2_Premium.SP_IF_RA_Frequency_XIX_VehicleComm_HCP3_IONode_XIX_CockpitInfotainment_Systemfunktionen_XIX_HCP3_IONode.DE_RA_Frequency, system-signal=RA_Frequency}, sender-receiver-to-signal-mapping={communication-direction=OUT, data-element=VehicleComm_HCP3_IONode_XIX_CockpitInfotainment_Systemfunktionen_XIX_HCP3_IONode.Geltungsbereich_E3_1_2_Premium.SP_IF_RA_Frequency_unit_XIX_VehicleComm_HCP3_IONode_XIX_CockpitInfotainment_Systemfunktionen_XIX_HCP3_IONode.DE_RA_Frequency_unit, system-signal=RA_Frequency_unit}, sender-receiver-to-signal-mapping={communication-direction=OUT, data-element=VehicleComm_HCP3_IONode_XIX_CockpitInfotainment_Systemfunktionen_XIX_HCP3_IONode.Geltungsbereich_E3_1_2_Premium.SP_IF_WLC1_Systemzustand_XIX_VehicleComm_HCP3_IONode_XIX_CockpitInfotainment_Systemfunktionen_XIX_HCP3_IONode.DE_WLC1_Systemzustand, system-signal=WLC1_Systemzustand}, sender-receiver-to-signal-mapping={communication-direction=OUT, data-element=VehicleComm_HCP3_IONode_XIX_CockpitInfotainment_Systemfunktionen_XIX_HCP3_IONode.Geltungsbereich_E3_1_2_Premium.SP_IF_WLC2_Systemzustand_XIX_VehicleComm_HCP3_IONode_XIX_CockpitInfotainment_Systemfunktionen_XIX_HCP3_IONode.DE_WLC2_Systemzustand, system-signal=WLC2_Systemzustand}, sender-receiver-to-signal-mapping={communication-direction=IN, data-element=VehicleComm_HCP3_IONode_XIX_CockpitInfotainment_Systemfunktionen_XIX_HCP3_IONode.Geltungsbereich_E3_1_2_Premium.RP_IF_MFL_Tastencode_1_XIX_VehicleComm_HCP3_IONode_XIX_CockpitInfotainment_Systemfunktionen_XIX_HCP3_IONode.DE_MFL_Tastencode_1, system-signal=MFL_Tastencode_1}, sender-receiver-to-signal-mapping={communication-direction=IN, data-element=VehicleComm_HCP3_IONode_XIX_CockpitInfotainment_Systemfunktionen_XIX_HCP3_IONode.Geltungsbereich_E3_1_2_Premium.RP_IF_MFL_Eventcode_2_XIX_VehicleComm_HCP3_IONode_XIX_CockpitInfotainment_Systemfunktionen_XIX_HCP3_IONode.DE_MFL_Eventcode_2, system-signal=MFL_Eventcode_2}, sender-receiver-to-signal-mapping={communication-direction=IN, data-element=VehicleComm_HCP3_IONode_XIX_CockpitInfotainment_Systemfunktionen_XIX_HCP3_IONode.Geltungsbereich_E3_1_2_Premium.RP_IF_MFL_Tastencode_2_XIX_VehicleComm_HCP3_IONode_XIX_CockpitInfotainment_Systemfunktionen_XIX_HCP3_IONode.DE_MFL_Tastencode_2, system-signal=MFL_Tastencode_2}, sender-receiver-to-signal-mapping={communication-direction=IN, data-element=VehicleComm_HCP3_IONode_XIX_CockpitInfotainment_Systemfunktionen_XIX_HCP3_IONode.Geltungsbereich_E3_1_2_Premium.RP_IF_MFL_Marke_XIX_VehicleComm_HCP3_IONode_XIX_CockpitInfotainment_Systemfunktionen_XIX_HCP3_IONode.DE_MFL_Marke, system-signal=MFL_Marke}, sender-receiver-to-signal-mapping={communication-direction=IN, data-element=VehicleComm_HCP3_IONode_XIX_CockpitInfotainment_Systemfunktionen_XIX_HCP3_IONode.Geltungsbereich_E3_1_2_Premium.RP_IF_MFL_Variante_XIX_VehicleComm_HCP3_IONode_XIX_CockpitInfotainment_Systemfunktionen_XIX_HCP3_IONode.DE_MFL_Variante, system-signal=MFL_Variante}, sender-receiver-to-signal-mapping={communication-direction=IN, data-element=VehicleComm_HCP3_IONode_XIX_CockpitInfotainment_Systemfunktionen_XIX_HCP3_IONode.Geltungsbereich_E3_1_2_Premium.RP_IF_MFL_Eventcode_1_XIX_VehicleComm_HCP3_IONode_XIX_CockpitInfotainment_Systemfunktionen_XIX_HCP3_IONode.DE_MFL_Eventcode_1, system-signal=MFL_Eventcode_1}, sender-receiver-to-signal-mapping={communication-direction=IN, data-element=VehicleComm_HCP3_IONode_XIX_CockpitInfotainment_Systemfunktionen_XIX_HCP3_IONode.Geltungsbereich_E3_1_2_Premium.RP_IF_FID_SW_inconsistent_XIX_VehicleComm_HCP3_IONode_XIX_CockpitInfotainment_Systemfunktionen_XIX_HCP3_IONode.DE_FID_SW_inconsistent, system-signal=FID_SW_inconsistent}, sender-receiver-to-signal-mapping={communication-direction=IN, data-element=VehicleComm_HCP3_IONode_XIX_CockpitInfotainment_Systemfunktionen_XIX_HCP3_IONode.Geltungsbereich_E3_1_2_Premium.RP_IF_FID_LVDS_Errorstate_XIX_VehicleComm_HCP3_IONode_XIX_CockpitInfotainment_Systemfunktionen_XIX_HCP3_IONode.DE_FID_LVDS_Errorstate, system-signal=FID_LVDS_Errorstate}, sender-receiver-to-signal-mapping={communication-direction=IN, data-element=VehicleComm_HCP3_IONode_XIX_CockpitInfotainment_Systemfunktionen_XIX_HCP3_IONode.Geltungsbereich_E3_1_2_Premium.RP_IF_MFL_Paddle_Verbau_XIX_VehicleComm_HCP3_IONode_XIX_CockpitInfotainment_Systemfunktionen_XIX_HCP3_IONode.DE_MFL_Paddle_Verbau, system-signal=MFL_Paddle_Verbau}, sender-receiver-to-signal-mapping={communication-direction=IN, data-element=VehicleComm_HCP3_IONode_XIX_CockpitInfotainment_Systemfunktionen_XIX_HCP3_IONode.Geltungsbereich_E3_1_2_Premium.RP_IF_LSR_SW_inconsistent_TNCTOC_XIX_VehicleComm_HCP3_IONode_XIX_CockpitInfotainment_Systemfunktionen_XIX_HCP3_IONode.DE_LSR_SW_inconsistent_TNCTOC, system-signal=LSR_SW_inconsistent_TNCTOC}, sender-receiver-to-signal-mapping={communication-direction=IN, data-element=VehicleComm_HCP3_IONode_XIX_CockpitInfotainment_Systemfunktionen_XIX_HCP3_IONode.Geltungsbereich_E3_1_2_Premium.RP_IF_LSR_EEPROM_Error_TNCTOC_XIX_VehicleComm_HCP3_IONode_XIX_CockpitInfotainment_Systemfunktionen_XIX_HCP3_IONode.DE_LSR_EEPROM_Error_TNCTOC, system-signal=LSR_EEPROM_Error_TNCTOC}, sender-receiver-to-signal-mapping={communication-direction=IN, data-element=VehicleComm_HCP3_IONode_XIX_CockpitInfotainment_Systemfunktionen_XIX_HCP3_IONode.Geltungsbereich_E3_1_2_Premium.RP_IF_LSR_SW_inconsistent_TF_XIX_VehicleComm_HCP3_IONode_XIX_CockpitInfotainment_Systemfunktionen_XIX_HCP3_IONode.DE_LSR_SW_inconsistent_TF, system-signal=LSR_SW_inconsistent_TF}, sender-receiver-to-signal-mapping={communication-direction=IN, data-element=VehicleComm_HCP3_IONode_XIX_CockpitInfotainment_Systemfunktionen_XIX_HCP3_IONode.Geltungsbereich_E3_1_2_Premium.RP_IF_LSR_EEPROM_Error_TF_XIX_VehicleComm_HCP3_IONode_XIX_CockpitInfotainment_Systemfunktionen_XIX_HCP3_IONode.DE_LSR_EEPROM_Error_TF, system-signal=LSR_EEPROM_Error_TF}, sender-receiver-to-signal-mapping={communication-direction=OUT, data-element=VehicleComm_HCP3_IONode_XIX_CockpitInfotainment_Systemfunktionen_XIX_HCP3_IONode.Geltungsbereich_E3_1_2_Premium.SP_IF_ZR_VA_Challenge_PID_XIX_VehicleComm_HCP3_IONode_XIX_CockpitInfotainment_Systemfunktionen_XIX_HCP3_IONode.DE_ZR_VA_Challenge_PID, system-signal=ZR_VA_Challenge_PID}, sender-receiver-to-signal-mapping={communication-direction=OUT, data-element=VehicleComm_HCP3_IONode_XIX_CockpitInfotainment_Systemfunktionen_XIX_HCP3_IONode.Geltungsbereich_E3_1_2_Premium.SP_IF_ZR_VA_Communication_Init_FID_XIX_VehicleComm_HCP3_IONode_XIX_CockpitInfotainment_Systemfunktionen_XIX_HCP3_IONode.DE_ZR_VA_Communication_Init_FID, system-signal=ZR_VA_Communication_Init_FID}, sender-receiver-to-signal-mapping={communication-direction=OUT, data-element=VehicleComm_HCP3_IONode_XIX_CockpitInfotainment_Systemfunktionen_XIX_HCP3_IONode.Geltungsbereich_E3_1_2_Premium.SP_IF_ZR_VA_Challenge_FID_XIX_VehicleComm_HCP3_IONode_XIX_CockpitInfotainment_Systemfunktionen_XIX_HCP3_IONode.DE_ZR_VA_Challenge_FID, system-signal=ZR_VA_Challenge_FID}, sender-receiver-to-signal-mapping={communication-direction=OUT, data-element=VehicleComm_HCP3_IONode_XIX_CockpitInfotainment_Systemfunktionen_XIX_HCP3_IONode.Geltungsbereich_E3_1_2_Premium.SP_IF_ZR_VA_Challenge_CID_XIX_VehicleComm_HCP3_IONode_XIX_CockpitInfotainment_Systemfunktionen_XIX_HCP3_IONode.DE_ZR_VA_Challenge_CID, system-signal=ZR_VA_Challenge_CID}, sender-receiver-to-signal-mapping={communication-direction=OUT, data-element=VehicleComm_HCP3_IONode_XIX_CockpitInfotainment_Systemfunktionen_XIX_HCP3_IONode.Geltungsbereich_E3_1_2_Premium.SP_IF_ZR_VA_Communication_Init_CID_XIX_VehicleComm_HCP3_IONode_XIX_CockpitInfotainment_Systemfunktionen_XIX_HCP3_IONode.DE_ZR_VA_Communication_Init_CID, system-signal=ZR_VA_Communication_Init_CID}, sender-receiver-to-signal-mapping={communication-direction=OUT, data-element=VehicleComm_HCP3_IONode_XIX_CockpitInfotainment_Systemfunktionen_XIX_HCP3_IONode.Geltungsbereich_E3_1_2_Premium.SP_IF_ZR_VA_Communication_Init_PID_XIX_VehicleComm_HCP3_IONode_XIX_CockpitInfotainment_Systemfunktionen_XIX_HCP3_IONode.DE_ZR_VA_Communication_Init_PID, system-signal=ZR_VA_Communication_Init_PID}, sender-receiver-to-signal-mapping={communication-direction=IN, data-element=VehicleComm_HCP3_IONode_XIX_CockpitInfotainment_Systemfunktionen_XIX_HCP3_IONode.Geltungsbereich_E3_1_2_Premium.RP_IF_PID_VA_Communication_Init_Ack_XIX_VehicleComm_HCP3_IONode_XIX_CockpitInfotainment_Systemfunktionen_XIX_HCP3_IONode.DE_PID_VA_Communication_Init_Ack, system-signal=PID_VA_Communication_Init_Ack}, sender-receiver-to-signal-mapping={communication-direction=IN, data-element=VehicleComm_HCP3_IONode_XIX_CockpitInfotainment_Systemfunktionen_XIX_HCP3_IONode.Geltungsbereich_E3_1_2_Premium.RP_IF_FID_VA_Response_XIX_VehicleComm_HCP3_IONode_XIX_CockpitInfotainment_Systemfunktionen_XIX_HCP3_IONode.DE_FID_VA_Response, system-signal=FID_VA_Response}, sender-receiver-to-signal-mapping={communication-direction=IN, data-element=VehicleComm_HCP3_IONode_XIX_CockpitInfotainment_Systemfunktionen_XIX_HCP3_IONode.Geltungsbereich_E3_1_2_Premium.RP_IF_PID_VA_Response_XIX_VehicleComm_HCP3_IONode_XIX_CockpitInfotainment_Systemfunktionen_XIX_HCP3_IONode.DE_PID_VA_Response, system-signal=PID_VA_Response}, sender-receiver-to-signal-mapping={communication-direction=IN, data-element=VehicleComm_HCP3_IONode_XIX_CockpitInfotainment_Systemfunktionen_XIX_HCP3_IONode.Geltungsbereich_E3_1_2_Premium.RP_IF_FID_VA_Communication_Init_Ack_XIX_VehicleComm_HCP3_IONode_XIX_CockpitInfotainment_Systemfunktionen_XIX_HCP3_IONode.DE_FID_VA_Communication_Init_Ack, system-signal=FID_VA_Communication_Init_Ack}, sender-receiver-to-signal-mapping={communication-direction=IN, data-element=VehicleComm_HCP3_IONode_XIX_CockpitInfotainment_Systemfunktionen_XIX_HCP3_IONode.Geltungsbereich_E3_1_2_Premium.RP_IF_CID_VA_Response_XIX_VehicleComm_HCP3_IONode_XIX_CockpitInfotainment_Systemfunktionen_XIX_HCP3_IONode.DE_CID_VA_Response, system-signal=CID_VA_Response}, sender-receiver-to-signal-mapping={communication-direction=IN, data-element=VehicleComm_HCP3_IONode_XIX_CockpitInfotainment_Systemfunktionen_XIX_HCP3_IONode.Geltungsbereich_E3_1_2_Premium.RP_IF_CID_VA_Communication_Init_Ack_XIX_VehicleComm_HCP3_IONode_XIX_CockpitInfotainment_Systemfunktionen_XIX_HCP3_IONode.DE_CID_VA_Communication_Init_Ack, system-signal=CID_VA_Communication_Init_Ack}, sender-receiver-to-signal-group-mapping={communication-direction=IN, data-element=VehicleComm_HCP3_IONode_XIX_CockpitInfotainment_Systemfunktionen_XIX_HCP3_IONode.Geltungsbereich_E3_1_2_Premium.RP_IF_SG_HWP_01_XIX_VehicleComm_HCP3_IONode_XIX_CockpitInfotainment_Systemfunktionen_XIX_HCP3_IONode.DE_SG_HWP_01, signal-group=SG_HWP_01, type-mapping=sender-rec-record-type-mapping=record-element-mappings=[{implementation-record-element=HWP_01_BZ, system-signal=HWP_01_BZ}, {implementation-record-element=HWP_01_CRC, system-signal=HWP_01_CRC}, {implementation-record-element=HWP_HMI_ASIL_Color, system-signal=HWP_HMI_ASIL_Color}]}, sender-receiver-to-signal-mapping={communication-direction=IN, data-element=VehicleComm_HCP3_IONode_XIX_CockpitInfotainment_Systemfunktionen_XIX_HCP3_IONode.Geltungsbereich_E3_1_2_Premium.RP_IF_HWP_HMI_State_XIX_VehicleComm_HCP3_IONode_XIX_CockpitInfotainment_Systemfunktionen_XIX_HCP3_IONode.DE_HWP_HMI_State, system-signal=HWP_HMI_State}, sender-receiver-to-signal-mapping={communication-direction=IN, data-element=VehicleComm_HCP3_IONode_XIX_CockpitInfotainment_Systemfunktionen_XIX_HCP3_IONode.Geltungsbereich_E3_1_2_Premium.RP_IF_VDSO_DKmtg_Auth_XIX_VehicleComm_HCP3_IONode_XIX_CockpitInfotainment_Systemfunktionen_XIX_HCP3_IONode.DE_VDSO_DKmtg_Auth, system-signal=VDSO_DKmtg_Auth}, sender-receiver-to-signal-mapping={communication-direction=IN, data-element=VehicleComm_HCP3_IONode_XIX_CockpitInfotainment_Systemfunktionen_XIX_HCP3_IONode.Geltungsbereich_E3_1_2_Premium.RP_IF_WLC1_ChargingEfficiency_XIX_VehicleComm_HCP3_IONode_XIX_CockpitInfotainment_Systemfunktionen_XIX_HCP3_IONode.DE_WLC1_ChargingEfficiency, system-signal=WLC1_ChargingEfficiency}, sender-receiver-to-signal-mapping={communication-direction=IN, data-element=VehicleComm_HCP3_IONode_XIX_CockpitInfotainment_Systemfunktionen_XIX_HCP3_IONode.Geltungsbereich_E3_1_2_Premium.RP_IF_WLC2_ChargingEfficiency_XIX_VehicleComm_HCP3_IONode_XIX_CockpitInfotainment_Systemfunktionen_XIX_HCP3_IONode.DE_WLC2_ChargingEfficiency, system-signal=WLC2_ChargingEfficiency}, sender-receiver-to-signal-mapping={communication-direction=IN, data-element=VehicleComm_HCP3_IONode_XIX_CockpitInfotainment_Systemfunktionen_XIX_HCP3_IONode.Geltungsbereich_E3_1_2_Premium.RP_IF_WLC2_ChargingStatus_XIX_VehicleComm_HCP3_IONode_XIX_CockpitInfotainment_Systemfunktionen_XIX_HCP3_IONode.DE_WLC2_ChargingStatus, system-signal=WLC2_ChargingStatus}, sender-receiver-to-signal-mapping={communication-direction=IN, data-element=VehicleComm_HCP3_IONode_XIX_CockpitInfotainment_Systemfunktionen_XIX_HCP3_IONode.Geltungsbereich_E3_1_2_Premium.RP_IF_WLC2_UsedChargingStandard_XIX_VehicleComm_HCP3_IONode_XIX_CockpitInfotainment_Systemfunktionen_XIX_HCP3_IONode.DE_WLC2_UsedChargingStandard, system-signal=WLC2_UsedChargingStandard}, sender-receiver-to-signal-mapping={communication-direction=IN, data-element=VehicleComm_HCP3_IONode_XIX_CockpitInfotainment_Systemfunktionen_XIX_HCP3_IONode.Geltungsbereich_E3_1_2_Premium.RP_IF_WLC1_UsedChargingStandard_XIX_VehicleComm_HCP3_IONode_XIX_CockpitInfotainment_Systemfunktionen_XIX_HCP3_IONode.DE_WLC1_UsedChargingStandard, system-signal=WLC1_UsedChargingStandard}, sender-receiver-to-signal-mapping={communication-direction=IN, data-element=VehicleComm_HCP3_IONode_XIX_CockpitInfotainment_Systemfunktionen_XIX_HCP3_IONode.Geltungsbereich_E3_1_2_Premium.RP_IF_WLC1_ChargingStatus_XIX_VehicleComm_HCP3_IONode_XIX_CockpitInfotainment_Systemfunktionen_XIX_HCP3_IONode.DE_WLC1_ChargingStatus, system-signal=WLC1_ChargingStatus}, sender-receiver-to-signal-mapping={communication-direction=IN, data-element=VehicleComm_HCP3_IONode_XIX_CockpitInfotainment_Systemfunktionen_XIX_HCP3_IONode.Geltungsbereich_E3_1_2_Premium.RP_IF_FT_Tuer_Status_XIX_VehicleComm_HCP3_IONode_XIX_CockpitInfotainment_Systemfunktionen_XIX_HCP3_IONode.DE_FT_Tuer_Status, system-signal=FT_Tuer_Status}, sender-receiver-to-signal-mapping={communication-direction=OUT,
    ... data-element=VehicleComm_HCP3_IONode_XIX_CockpitInfotainment_Systemfunktionen_XIX_HCP3_IONode.Geltungsbereich_E3_1_2_Premium.SP_IF_ZR_VA_Communication_Init_Ack_FID_XIX_VehicleComm_HCP3_IONode_XIX_CockpitInfotainment_Systemfunktionen_XIX_HCP3_IONode.DE_ZR_VA_Communication_Init_Ack_FID, system-signal=ZR_VA_Communication_Init_Ack_FID}, sender-receiver-to-signal-mapping={communication-direction=OUT, data-element=VehicleComm_HCP3_IONode_XIX_CockpitInfotainment_Systemfunktionen_XIX_HCP3_IONode.Geltungsbereich_E3_1_2_Premium.SP_IF_ZR_VA_Communication_Init_Ack_PID_XIX_VehicleComm_HCP3_IONode_XIX_CockpitInfotainment_Systemfunktionen_XIX_HCP3_IONode.DE_ZR_VA_Communication_Init_Ack_PID, system-signal=ZR_VA_Communication_Init_Ack_PID}, sender-receiver-to-signal-mapping={communication-direction=OUT, data-element=VehicleComm_HCP3_IONode_XIX_CockpitInfotainment_Systemfunktionen_XIX_HCP3_IONode.Geltungsbereich_E3_1_2_Premium.SP_IF_ZR_VA_Communication_Init_Ack_CID_XIX_VehicleComm_HCP3_IONode_XIX_CockpitInfotainment_Systemfunktionen_XIX_HCP3_IONode.DE_ZR_VA_Communication_Init_Ack_CID, system-signal=ZR_VA_Communication_Init_Ack_CID}, sender-receiver-to-signal-mapping={communication-direction=IN, data-element=VehicleComm_HCP3_IONode_XIX_CockpitInfotainment_Systemfunktionen_XIX_HCP3_IONode.Geltungsbereich_E3_1_2_Premium.RP_IF_CID_VA_Communication_Init_XIX_VehicleComm_HCP3_IONode_XIX_CockpitInfotainment_Systemfunktionen_XIX_HCP3_IONode.DE_CID_VA_Communication_Init, system-signal=CID_VA_Communication_Init}, sender-receiver-to-signal-mapping={communication-direction=IN, data-element=VehicleComm_HCP3_IONode_XIX_CockpitInfotainment_Systemfunktionen_XIX_HCP3_IONode.Geltungsbereich_E3_1_2_Premium.RP_IF_FID_VA_Communication_Init_XIX_VehicleComm_HCP3_IONode_XIX_CockpitInfotainment_Systemfunktionen_XIX_HCP3_IONode.DE_FID_VA_Communication_Init, system-signal=FID_VA_Communication_Init}, sender-receiver-to-signal-mapping={communication-direction=IN, data-element=VehicleComm_HCP3_IONode_XIX_CockpitInfotainment_Systemfunktionen_XIX_HCP3_IONode.Geltungsbereich_E3_1_2_Premium.RP_IF_PID_VA_Communication_Init_XIX_VehicleComm_HCP3_IONode_XIX_CockpitInfotainment_Systemfunktionen_XIX_HCP3_IONode.DE_PID_VA_Communication_Init, system-signal=PID_VA_Communication_Init}, sender-receiver-to-signal-mapping={communication-direction=IN, data-element=VehicleComm_HCP3_IONode_XIX_CockpitInfotainment_Systemfunktionen_XIX_HCP3_IONode.Geltungsbereich_E3_1_2_Premium.RP_IF_BT_Tuer_Status_XIX_VehicleComm_HCP3_IONode_XIX_CockpitInfotainment_Systemfunktionen_XIX_HCP3_IONode.DE_BT_Tuer_Status, system-signal=BT_Tuer_Status}, sender-receiver-to-signal-mapping={communication-direction=IN, data-element=VehicleComm_HCP3_IONode_XIX_CockpitInfotainment_Systemfunktionen_XIX_HCP3_IONode.Geltungsbereich_E3_1_2_Premium.RP_IF_HBFS_Tuer_Status_XIX_VehicleComm_HCP3_IONode_XIX_CockpitInfotainment_Systemfunktionen_XIX_HCP3_IONode.DE_HBFS_Tuer_Status, system-signal=HBFS_Tuer_Status}, sender-receiver-to-signal-mapping={communication-direction=IN, data-element=VehicleComm_HCP3_IONode_XIX_CockpitInfotainment_Systemfunktionen_XIX_HCP3_IONode.Geltungsbereich_E3_1_2_Premium.RP_IF_HFS_Tuer_Status_XIX_VehicleComm_HCP3_IONode_XIX_CockpitInfotainment_Systemfunktionen_XIX_HCP3_IONode.DE_HFS_Tuer_Status, system-signal=HFS_Tuer_Status}, sender-receiver-to-signal-mapping={communication-direction=IN, data-element=VehicleComm_HCP3_IONode_XIX_CockpitInfotainment_Systemfunktionen_XIX_HCP3_IONode.Geltungsbereich_E3_1_2_Premium.RP_IF_ZV_Heck_offen_XIX_VehicleComm_HCP3_IONode_XIX_CockpitInfotainment_Systemfunktionen_XIX_HCP3_IONode.DE_ZV_Heck_offen, system-signal=ZV_Heck_offen}, sender-receiver-to-signal-mapping={communication-direction=IN, data-element=VehicleComm_HCP3_IONode_XIX_CockpitInfotainment_Systemfunktionen_XIX_HCP3_IONode.Geltungsbereich_E3_1_2_Premium.RP_IF_ACA_HMI_Color_XIX_VehicleComm_HCP3_IONode_XIX_CockpitInfotainment_Systemfunktionen_XIX_HCP3_IONode.DE_ACA_HMI_Color, system-signal=ACA_HMI_Color}, sender-receiver-to-signal-group-mapping={communication-direction=IN, data-element=VehicleComm_HCP3_IONode_XIX_CockpitInfotainment_Systemfunktionen_XIX_HCP3_IONode.Geltungsbereich_E3_1_2_Premium.RP_IF_SG_VDSO_05_XIX_VehicleComm_HCP3_IONode_XIX_CockpitInfotainment_Systemfunktionen_XIX_HCP3_IONode.DE_SG_VDSO_05, signal-group=SG_VDSO_05, type-mapping=sender-rec-record-type-mapping=record-element-mappings=[{implementation-record-element=VDSO_Vx3d, system-signal=VDSO_Vx3d}, {implementation-record-element=VDSO_Vx3dDisp, system-signal=VDSO_Vx3dDisp}, {implementation-record-element=VDSO_05_BZ, system-signal=VDSO_05_BZ}, {implementation-record-element=VDSO_05_CRC, system-signal=VDSO_05_CRC}]}, sender-receiver-to-signal-group-mapping={communication-direction=IN, data-element=VehicleComm_HCP3_IONode_XIX_CockpitInfotainment_Systemfunktionen_XIX_HCP3_IONode.Geltungsbereich_E3_1_2_Premium.RP_IF_SG_ClampControl_01_XIX_VehicleComm_HCP3_IONode_XIX_CockpitInfotainment_Systemfunktionen_XIX_HCP3_IONode.DE_SG_ClampControl_01, signal-group=SG_ClampControl_01, type-mapping=sender-rec-record-type-mapping=record-element-mappings=[{implementation-record-element=KST_KL_15, system-signal=KST_KL_15}, {implementation-record-element=KST_Kl_S, system-signal=KST_Kl_S}, {implementation-record-element=KST_Kl_50_Startanforderung, system-signal=KST_Kl_50_Startanforderung}, {implementation-record-element=ClampControl_01_BZ, system-signal=ClampControl_01_BZ}, {implementation-record-element=ClampControl_01_CRC, system-signal=ClampControl_01_CRC}, {implementation-record-element=KST_Ausstiegswunsch_Status, system-signal=KST_Ausstiegswunsch_Status}, {implementation-record-element=KST_ComfortReadyStatus, system-signal=KST_ComfortReadyStatus}]}, sender-receiver-to-signal-mapping={communication-direction=IN, data-element=VehicleComm_HCP3_IONode_XIX_CockpitInfotainment_Systemfunktionen_XIX_HCP3_IONode.Geltungsbereich_E3_1_2_Premium.RP_IF_SI_P_Mode_XIX_VehicleComm_HCP3_IONode_XIX_CockpitInfotainment_Systemfunktionen_XIX_HCP3_IONode.DE_SI_P_Mode, system-signal=SI_P_Mode}, sender-receiver-to-signal-mapping={communication-direction=IN, data-element=VehicleComm_HCP3_IONode_XIX_CockpitInfotainment_Systemfunktionen_XIX_HCP3_IONode.Geltungsbereich_E3_1_2_Premium.RP_IF_SI_P_Mode_gueltig_XIX_VehicleComm_HCP3_IONode_XIX_CockpitInfotainment_Systemfunktionen_XIX_HCP3_IONode.DE_SI_P_Mode_gueltig, system-signal=SI_P_Mode_gueltig}, sender-receiver-to-signal-mapping={communication-direction=IN, data-element=VehicleComm_HCP3_IONode_XIX_CockpitInfotainment_Systemfunktionen_XIX_HCP3_IONode.Geltungsbereich_E3_1_2_Premium.RP_IF_VDSO_DKmtg_XIX_VehicleComm_HCP3_IONode_XIX_CockpitInfotainment_Systemfunktionen_XIX_HCP3_IONode.DE_VDSO_DKmtg, system-signal=VDSO_DKmtg}, sender-receiver-to-signal-mapping={communication-direction=IN, data-element=VehicleComm_HCP3_IONode_XIX_CockpitInfotainment_Systemfunktionen_XIX_HCP3_IONode.Geltungsbereich_E3_1_2_Premium.RP_IF_PTAcvSrv_StPwrMd_XIX_VehicleComm_HCP3_IONode_XIX_CockpitInfotainment_Systemfunktionen_XIX_HCP3_IONode.DE_PTAcvSrv_StPwrMd, system-signal=PTAcvSrv_StPwrMd}, sender-receiver-to-signal-mapping={communication-direction=IN, data-element=VehicleComm_HCP3_IONode_XIX_CockpitInfotainment_Systemfunktionen_XIX_HCP3_IONode.Geltungsbereich_E3_1_2_Premium.RP_IF_PTAcvSrv_StDrvMd_XIX_VehicleComm_HCP3_IONode_XIX_CockpitInfotainment_Systemfunktionen_XIX_HCP3_IONode.DE_PTAcvSrv_StDrvMd, system-signal=PTAcvSrv_StDrvMd}, sender-receiver-to-signal-mapping={communication-direction=IN, data-element=VNSM3_1_XIX_WUSL_XIX_HCP3_IONode.Geltungsbereich_E3_1_2_Premium.RP_IF_NM_HUD_FCIB_XIX_VNSM3_1_XIX_WUSL_XIX_HCP3_IONode.DE_NM_HUD_FCIB, system-signal=NM_HUD_FCIB}, sender-receiver-to-signal-mapping={communication-direction=IN, data-element=VNSM3_1_XIX_WUSL_XIX_HCP3_IONode.Geltungsbereich_E3_1_2_Premium.RP_IF_NM_WLC1_FCIB_XIX_VNSM3_1_XIX_WUSL_XIX_HCP3_IONode.DE_NM_WLC1_FCIB, system-signal=NM_WLC1_FCIB}, sender-receiver-to-signal-mapping={communication-direction=IN, data-element=VNSM3_1_XIX_WUSL_XIX_HCP3_IONode.Geltungsbereich_E3_1_2_Premium.RP_IF_NM_WLC2_FCIB_XIX_VNSM3_1_XIX_WUSL_XIX_HCP3_IONode.DE_NM_WLC2_FCIB, system-signal=NM_WLC2_FCIB}, sender-receiver-to-signal-mapping={communication-direction=IN, data-element=VNSM3_1_XIX_WUSL_XIX_HCP3_IONode.Geltungsbereich_E3_1_2_Premium.RP_IF_NM_PID_FCIB_XIX_VNSM3_1_XIX_WUSL_XIX_HCP3_IONode.DE_NM_PID_FCIB, system-signal=NM_PID_FCIB}, sender-receiver-to-signal-mapping={communication-direction=IN, data-element=VNSM3_1_XIX_WUSL_XIX_HCP3_IONode.Geltungsbereich_E3_1_2_Premium.RP_IF_NM_CCF_FCIB_XIX_VNSM3_1_XIX_WUSL_XIX_HCP3_IONode.DE_NM_CCF_FCIB, system-signal=NM_CCF_FCIB}, sender-receiver-to-signal-mapping={communication-direction=IN, data-element=VNSM3_1_XIX_WUSL_XIX_HCP3_IONode.Geltungsbereich_E3_1_2_Premium.RP_IF_NM_Gateway_FCIB_XIX_VNSM3_1_XIX_WUSL_XIX_HCP3_IONode.DE_NM_Gateway_FCIB, system-signal=NM_Gateway_FCIB}, sender-receiver-to-signal-mapping={communication-direction=IN, data-element=VNSM3_1_XIX_WUSL_XIX_HCP3_IONode.Geltungsbereich_E3_1_2_Premium.RP_IF_NM_CID_FCIB_XIX_VNSM3_1_XIX_WUSL_XIX_HCP3_IONode.DE_NM_CID_FCIB, system-signal=NM_CID_FCIB}, sender-receiver-to-signal-mapping={communication-direction=IN, data-element=VNSM3_1_XIX_WUSL_XIX_HCP3_IONode.Geltungsbereich_E3_1_2_Premium.RP_IF_NM_AMP_FCIB_XIX_VNSM3_1_XIX_WUSL_XIX_HCP3_IONode.DE_NM_AMP_FCIB, system-signal=NM_AMP_FCIB}, sender-receiver-to-signal-mapping={communication-direction=IN, data-element=VNSM3_1_XIX_WUSL_XIX_HCP3_IONode.Geltungsbereich_E3_1_2_Premium.RP_IF_NM_DispKBI_FS_FCIB_XIX_VNSM3_1_XIX_WUSL_XIX_HCP3_IONode.DE_NM_DispKBI_FS_FCIB, system-signal=NM_DispKBI_FS_FCIB}, sender-receiver-to-signal-mapping={communication-direction=IN, data-element=TankAlgorithm_XIX_Tank_XIX_HCP3_IONode.Geltungsbereich_E3_1_2_Premium.RP_IF_TG_Geber_3_Stand_XIX_TankAlgorithm_XIX_Tank_XIX_HCP3_IONode.DE_TG_Geber_3_Stand, system-signal=TG_Geber_3_Stand}, sender-receiver-to-signal-mapping={communication-direction=IN, data-element=TankAlgorithm_XIX_Tank_XIX_HCP3_IONode.Geltungsbereich_E3_1_2_Premium.RP_IF_TG_QBit_Geber_1_XIX_TankAlgorithm_XIX_Tank_XIX_HCP3_IONode.DE_TG_QBit_Geber_1, system-signal=TG_QBit_Geber_1}, sender-receiver-to-signal-mapping={communication-direction=IN, data-element=TankAlgorithm_XIX_Tank_XIX_HCP3_IONode.Geltungsbereich_E3_1_2_Premium.RP_IF_TG_Geber_1_Stand_XIX_TankAlgorithm_XIX_Tank_XIX_HCP3_IONode.DE_TG_Geber_1_Stand, system-signal=TG_Geber_1_Stand}, sender-receiver-to-signal-mapping={communication-direction=IN, data-element=TankAlgorithm_XIX_Tank_XIX_HCP3_IONode.Geltungsbereich_E3_1_2_Premium.RP_IF_TG_Geber_2_Stand_XIX_TankAlgorithm_XIX_Tank_XIX_HCP3_IONode.DE_TG_Geber_2_Stand, system-signal=TG_Geber_2_Stand}, sender-receiver-to-signal-mapping={communication-direction=IN, data-element=TankAlgorithm_XIX_Tank_XIX_HCP3_IONode.Geltungsbereich_E3_1_2_Premium.RP_IF_TG_QBit_Geber_4_XIX_TankAlgorithm_XIX_Tank_XIX_HCP3_IONode.DE_TG_QBit_Geber_4, system-signal=TG_QBit_Geber_4}, sender-receiver-to-signal-mapping={communication-direction=IN, data-element=TankAlgorithm_XIX_Tank_XIX_HCP3_IONode.Geltungsbereich_E3_1_2_Premium.RP_IF_TG_Geber_4_Stand_XIX_TankAlgorithm_XIX_Tank_XIX_HCP3_IONode.DE_TG_Geber_4_Stand, system-signal=TG_Geber_4_Stand}, sender-receiver-to-signal-mapping={communication-direction=IN, data-element=TankAlgorithm_XIX_Tank_XIX_HCP3_IONode.Geltungsbereich_E3_1_2_Premium.RP_IF_TG_QBit_Geber_3_XIX_TankAlgorithm_XIX_Tank_XIX_HCP3_IONode.DE_TG_QBit_Geber_3, system-signal=TG_QBit_Geber_3}, sender-receiver-to-signal-mapping={communication-direction=IN, data-element=TankAlgorithm_XIX_Tank_XIX_HCP3_IONode.Geltungsbereich_E3_1_2_Premium.RP_IF_TG_QBit_Geber_2_XIX_TankAlgorithm_XIX_Tank_XIX_HCP3_IONode.DE_TG_QBit_Geber_2, system-signal=TG_QBit_Geber_2}, sender-receiver-to-signal-mapping={communication-direction=IN, data-element=TankAlgorithm_XIX_Tank_XIX_HCP3_IONode.Geltungsbereich_E3_1_2_Premium.RP_IF_TG_Geber_1_Mittelwert_XIX_TankAlgorithm_XIX_Tank_XIX_HCP3_IONode.DE_TG_Geber_1_Mittelwert, system-signal=TG_Geber_1_Mittelwert}, sender-receiver-to-signal-mapping={communication-direction=IN, data-element=TankAlgorithm_XIX_Tank_XIX_HCP3_IONode.Geltungsbereich_E3_1_2_Premium.RP_IF_TG_Geber_2_Mittelwert_XIX_TankAlgorithm_XIX_Tank_XIX_HCP3_IONode.DE_TG_Geber_2_Mittelwert, system-signal=TG_Geber_2_Mittelwert}, sender-receiver-to-signal-mapping={communication-direction=IN, data-element=TankAlgorithm_XIX_Tank_XIX_HCP3_IONode.Geltungsbereich_E3_1_2_Premium.RP_IF_TG_Geber_3_Mittelwert_XIX_TankAlgorithm_XIX_Tank_XIX_HCP3_IONode.DE_TG_Geber_3_Mittelwert, system-signal=TG_Geber_3_Mittelwert}, sender-receiver-to-signal-mapping={communication-direction=IN, data-element=TankAlgorithm_XIX_Tank_XIX_HCP3_IONode.Geltungsbereich_E3_1_2_Premium.RP_IF_TG_Geber_4_Mittelwert_XIX_TankAlgorithm_XIX_Tank_XIX_HCP3_IONode.DE_TG_Geber_4_Mittelwert, system-signal=TG_Geber_4_Mittelwert}, sender-receiver-to-signal-mapping={communication-direction=OUT, data-element=TankAlgorithm_XIX_Tank_XIX_HCP3_IONode.Geltungsbereich_E3_1_2_Premium.SP_IF_TNK_FStatus_Tank_XIX_TankAlgorithm_XIX_Tank_XIX_HCP3_IONode.DE_TNK_FStatus_Tank, system-signal=TNK_FStatus_Tank}, sender-receiver-to-signal-mapping={communication-direction=OUT, data-element=TankAlgorithm_XIX_Tank_XIX_HCP3_IONode.Geltungsbereich_E3_1_2_Premium.SP_IF_TNK_Max_Tankinhalt_XIX_TankAlgorithm_XIX_Tank_XIX_HCP3_IONode.DE_TNK_Max_Tankinhalt, system-signal=TNK_Max_Tankinhalt}, sender-receiver-to-signal-mapping={communication-direction=OUT, data-element=TankAlgorithm_XIX_Tank_XIX_HCP3_IONode.Geltungsbereich_E3_1_2_Premium.SP_IF_TNK_Nachtanken_erkannt_XIX_TankAlgorithm_XIX_Tank_XIX_HCP3_IONode.DE_TNK_Nachtanken_erkannt, system-signal=TNK_Nachtanken_erkannt}, sender-receiver-to-signal-mapping={communication-direction=OUT, data-element=TankAlgorithm_XIX_Tank_XIX_HCP3_IONode.Geltungsbereich_E3_1_2_Premium.SP_IF_TNK_Tankinhalt_hochaufl_XIX_TankAlgorithm_XIX_Tank_XIX_HCP3_IONode.DE_TNK_Tankinhalt_hochaufl, system-signal=TNK_Tankinhalt_hochaufl}, sender-receiver-to-signal-mapping={communication-direction=OUT, data-element=TankAlgorithm_XIX_Tank_XIX_HCP3_IONode.Geltungsbereich_E3_1_2_Premium.SP_IF_TNK_Kraftstoffvorrat_XIX_TankAlgorithm_XIX_Tank_XIX_HCP3_IONode.DE_TNK_Kraftstoffvorrat, system-signal=TNK_Kraftstoffvorrat}, sender-receiver-to-signal-mapping={communication-direction=OUT, data-element=TankAlgorithm_XIX_Tank_XIX_HCP3_IONode.Geltungsbereich_E3_1_2_Premium.SP_IF_TNK_Tankwarnung_XIX_TankAlgorithm_XIX_Tank_XIX_HCP3_IONode.DE_TNK_Tankwarnung, system-signal=TNK_Tankwarnung}, sender-receiver-to-signal-mapping={communication-direction=OUT, data-element=TankAlgorithm_XIX_Tank_XIX_HCP3_IONode.Geltungsbereich_E3_1_2_Premium.SP_IF_TNK_Min_Tankinhalt_XIX_TankAlgorithm_XIX_Tank_XIX_HCP3_IONode.DE_TNK_Min_Tankinhalt, system-signal=TNK_Min_Tankinhalt}, sender-receiver-to-signal-mapping={communication-direction=OUT, data-element=TankAlgorithm_XIX_Tank_XIX_HCP3_IONode.Geltungsbereich_E3_1_2_Premium.SP_IF_TNK_Tankwarnung_ungueltig_XIX_TankAlgorithm_XIX_Tank_XIX_HCP3_IONode.DE_TNK_Tankwarnung_ungueltig, system-signal=TNK_Tankwarnung_ungueltig}, sender-receiver-to-signal-mapping={communication-direction=OUT, data-element=TankAlgorithm_XIX_Tank_XIX_HCP3_IONode.Geltungsbereich_E3_1_2_Premium.SP_IF_TNK_Tankinhalt_roh_XIX_TankAlgorithm_XIX_Tank_XIX_HCP3_IONode.DE_TNK_Tankinhalt_roh, system-signal=TNK_Tankinhalt_roh}, sender-receiver-to-signal-mapping={communication-direction=OUT, data-element=TankAlgorithm_XIX_Tank_XIX_HCP3_IONode.Geltungsbereich_E3_1_2_Premium.SP_IF_TNK_Tankanzeigefreigabe_XIX_TankAlgorithm_XIX_Tank_XIX_HCP3_IONode.DE_TNK_Tankanzeigefreigabe, system-signal=TNK_Tankanzeigefreigabe}, sender-receiver-to-signal-mapping={communication-direction=IN, data-element=TankAlgorithm_XIX_Tank_XIX_HCP3_IONode.Geltungsbereich_E3_1_2_Premium.RP_IF_CE_FlgOvf_VolCns_XIX_TankAlgorithm_XIX_Tank_XIX_HCP3_IONode.DE_CE_FlgOvf_VolCns, system-signal=CE_FlgOvf_VolCns}, sender-receiver-to-signal-mapping={communication-direction=IN, data-element=TankAlgorithm_XIX_Tank_XIX_HCP3_IONode.Geltungsbereich_E3_1_2_Premium.RP_IF_STH_KVS_Ueberlauf_XIX_TankAlgorithm_XIX_Tank_XIX_HCP3_IONode.DE_STH_KVS_Ueberlauf, system-signal=STH_KVS_Ueberlauf}, sender-receiver-to-signal-mapping={communication-direction=IN, data-element=TankAlgorithm_XIX_Tank_XIX_HCP3_IONode.Geltungsbereich_E3_1_2_Premium.RP_IF_STH_KVS_XIX_TankAlgorithm_XIX_Tank_XIX_HCP3_IONode.DE_STH_KVS, system-signal=STH_KVS}, sender-receiver-to-signal-mapping={communication-direction=OUT, data-element=TankAlgorithm_XIX_Tank_XIX_HCP3_IONode.Geltungsbereich_E3_1_2_Premium.SP_IF_TNK_Wegstrecke_Hinweis_XIX_TankAlgorithm_XIX_Tank_XIX_HCP3_IONode.DE_TNK_Wegstrecke_Hinweis, system-signal=TNK_Wegstrecke_Hinweis}, sender-receiver-to-signal-mapping={communication-direction=IN, data-element=TankAlgorithm_XIX_Tank_XIX_HCP3_IONode.Geltungsbereich_E3_1_2_Premium.RP_IF_CE_VolCns_XIX_TankAlgorithm_XIX_Tank_XIX_HCP3_IONode.DE_CE_VolCns, system-signal=CE_VolCns}, sender-receiver-to-signal-mapping={communication-direction=IN, data-element=TankAlgorithm_XIX_Tank_XIX_HCP3_IONode.Geltungsbereich_E3_1_2_Premium.RP_IF_DTSO_StPTEgySrc_XIX_TankAlgorithm_XIX_Tank_XIX_HCP3_IONode.DE_DTSO_StPTEgySrc, system-signal=DTSO_StPTEgySrc}, sender-receiver-to-signal-mapping={communication-direction=IN, data-element=TankAlgorithm_XIX_Tank_XIX_HCP3_IONode.Geltungsbereich_E3_1_2_Premium.RP_IF_DTSO_StPrpUnitAcvWhl_XIX_TankAlgorithm_XIX_Tank_XIX_HCP3_IONode.DE_DTSO_StPrpUnitAcvWhl, system-signal=DTSO_StPrpUnitAcvWhl}, sender-receiver-to-signal-mapping={communication-direction=IN, data-element=Tracing_HCP3_IONode_XIX_CockpitInfotainment_Systemfunktionen_XIX_HCP3_IONode.Geltungsbereich_E3_1_2_Premium.RP_IF_PID_OperatingTime_hr_XIX_Tracing_HCP3_IONode_XIX_CockpitInfotainment_Systemfunktionen_XIX_HCP3_IONode.DE_PID_OperatingTime_hr, system-signal=PID_OperatingTime_hr}, sender-receiver-to-signal-mapping={communication-direction=IN, data-element=Tracing_HCP3_IONode_XIX_CockpitInfotainment_Systemfunktionen_XIX_HCP3_IONode.Geltungsbereich_E3_1_2_Premium.RP_IF_PID_HDCP_Status_XIX_Tracing_HCP3_IONode_XIX_CockpitInfotainment_Systemfunktionen_XIX_HCP3_IONode.DE_PID_HDCP_Status, system-signal=PID_HDCP_Status}, sender-receiver-to-signal-mapping={communication-direction=IN, data-element=Tracing_HCP3_IONode_XIX_CockpitInfotainment_Systemfunktionen_XIX_HCP3_IONode.Geltungsbereich_E3_1_2_Premium.RP_IF_PID_LVDS_Errorstate_XIX_Tracing_HCP3_IONode_XIX_CockpitInfotainment_Systemfunktionen_XIX_HCP3_IONode.DE_PID_LVDS_Errorstate, system-signal=PID_LVDS_Errorstate}, sender-receiver-to-signal-mapping={communication-direction=IN, data-element=Tracing_HCP3_IONode_XIX_CockpitInfotainment_Systemfunktionen_XIX_HCP3_IONode.Geltungsbereich_E3_1_2_Premium.RP_IF_PID_VW_SL_App_SW_Version_Nr_XIX_Tracing_HCP3_IONode_XIX_CockpitInfotainment_Systemfunktionen_XIX_HCP3_IONode.DE_PID_VW_SL_App_SW_Version_Nr, system-signal=PID_VW_SL_App_SW_Version_Nr}, sender-receiver-to-signal-mapping={communication-direction=IN, data-element=Tracing_HCP3_IONode_XIX_CockpitInfotainment_Systemfunktionen_XIX_HCP3_IONode.Geltungsbereich_E3_1_2_Premium.RP_IF_PID_Haptik_Errorstate_XIX_Tracing_HCP3_IONode_XIX_CockpitInfotainment_Systemfunktionen_XIX_HCP3_IONode.DE_PID_Haptik_Errorstate, system-signal=PID_Haptik_Errorstate}, sender-receiver-to-signal-mapping={communication-direction=IN, data-element=Tracing_HCP3_IONode_XIX_CockpitInfotainment_Systemfunktionen_XIX_HCP3_IONode.Geltungsbereich_E3_1_2_Premium.RP_IF_PID_ShutterFoil_Errorstate_XIX_Tracing_HCP3_IONode_XIX_CockpitInfotainment_Systemfunktionen_XIX_HCP3_IONode.DE_PID_ShutterFoil_Errorstate, system-signal=PID_ShutterFoil_Errorstate}, sender-receiver-to-signal-mapping={communication-direction=IN, data-element=Tracing_HCP3_IONode_XIX_CockpitInfotainment_Systemfunktionen_XIX_HCP3_IONode.Geltungsbereich_E3_1_2_Premium.RP_IF_PID_CL_30F_XIX_Tracing_HCP3_IONode_XIX_CockpitInfotainment_Systemfunktionen_XIX_HCP3_IONode.DE_PID_CL_30F, system-signal=PID_CL_30F}, sender-receiver-to-signal-mapping={communication-direction=IN, data-element=Tracing_HCP3_IONode_XIX_CockpitInfotainment_Systemfunktionen_XIX_HCP3_IONode.Geltungsbereich_E3_1_2_Premium.RP_IF_PID_SW_inconsistent_XIX_Tracing_HCP3_IONode_XIX_CockpitInfotainment_Systemfunktionen_XIX_HCP3_IONode.DE_PID_SW_inconsistent, system-signal=PID_SW_inconsistent}, sender-receiver-to-signal-mapping={communication-direction=IN, data-element=Tracing_HCP3_IONode_XIX_CockpitInfotainment_Systemfunktionen_XIX_HCP3_IONode.Geltungsbereich_E3_1_2_Premium.RP_IF_PID_VW_SL_Spare_Part_Nr_MittelNr_XIX_Tracing_HCP3_IONode_XIX_CockpitInfotainment_Systemfunktionen_XIX_HCP3_IONode.DE_PID_VW_SL_Spare_Part_Nr_MittelNr, system-signal=PID_VW_SL_Spare_Part_Nr_MittelNr}, sender-receiver-to-signal-mapping={communication-direction=IN, data-element=Tracing_HCP3_IONode_XIX_CockpitInfotainment_Systemfunktionen_XIX_HCP3_IONode.Geltungsbereich_E3_1_2_Premium.RP_IF_PID_TempSensor_XIX_Tracing_HCP3_IONode_XIX_CockpitInfotainment_Systemfunktionen_XIX_HCP3_IONode.DE_PID_TempSensor, system-signal=PID_TempSensor}, sender-receiver-to-signal-mapping={communication-direction=IN, data-element=Tracing_HCP3_IONode_XIX_CockpitInfotainment_Systemfunktionen_XIX_HCP3_IONode.Geltungsbereich_E3_1_2_Premium.RP_IF_PID_OperatingTime_min_XIX_Tracing_HCP3_IONode_XIX_CockpitInfotainment_Systemfunktionen_XIX_HCP3_IONode.DE_PID_OperatingTime_min, system-signal=PID_OperatingTime_min}, sender-receiver-to-signal-mapping={communication-direction=IN, data-element=Tracing_HCP3_IONode_XIX_CockpitInfotainment_Systemfunktionen_XIX_HCP3_IONode.Geltungsbereich_E3_1_2_Premium.RP_IF_PID_TempSensorMax_XIX_Tracing_HCP3_IONode_XIX_CockpitInfotainment_Systemfunktionen_XIX_HCP3_IONode.DE_PID_TempSensorMax, system-signal=PID_TempSensorMax}, sender-receiver-to-signal-mapping={communication-direction=IN, data-element=Tracing_HCP3_IONode_XIX_CockpitInfotainment_Systemfunktionen_XIX_HCP3_IONode.Geltungsbereich_E3_1_2_Premium.RP_IF_PID_Backlight_ShortCircuit_XIX_Tracing_HCP3_IONode_XIX_CockpitInfotainment_Systemfunktionen_XIX_HCP3_IONode.DE_PID_Backlight_ShortCircuit, system-signal=PID_Backlight_ShortCircuit}, sender-receiver-to-signal-mapping={communication-direction=IN, data-element=Tracing_HCP3_IONode_XIX_CockpitInfotainment_Systemfunktionen_XIX_HCP3_IONode.Geltungsbereich_E3_1_2_Premium.RP_IF_CID_VW_SL_Spare_Part_Nr_Index_XIX_Tracing_HCP3_IONode_XIX_CockpitInfotainment_Systemfunktionen_XIX_HCP3_IONode.DE_CID_VW_SL_Spare_Part_Nr_Index, system-signal=CID_VW_SL_Spare_Part_Nr_Index}, sender-receiver-to-signal-mapping={communication-direction=IN, data-element=Tracing_HCP3_IONode_XIX_CockpitInfotainment_Systemfunktionen_XIX_HCP3_IONode.Geltungsbereich_E3_1_2_Premium.RP_IF_PID_Touch_Errorstate_XIX_Tracing_HCP3_IONode_XIX_CockpitInfotainment_Systemfunktionen_XIX_HCP3_IONode.DE_PID_Touch_Errorstate, system-signal=PID_Touch_Errorstate}, sender-receiver-to-signal-mapping={communication-direction=IN, data-element=Tracing_HCP3_IONode_XIX_CockpitInfotainment_Systemfunktionen_XIX_HCP3_IONode.Geltungsbereich_E3_1_2_Premium.RP_IF_PID_Backlight_OpenCircuit_XIX_Tracing_HCP3_IONode_XIX_CockpitInfotainment_Systemfunktionen_XIX_HCP3_IONode.DE_PID_Backlight_OpenCircuit, system-signal=PID_Backlight_OpenCircuit}, sender-receiver-to-signal-mapping={communication-direction=IN, data-element=Tracing_HCP3_IONode_XIX_CockpitInfotainment_Systemfunktionen_XIX_HCP3_IONode.Geltungsbereich_E3_1_2_Premium.RP_IF_PID_Proximity_Errorstate_XIX_Tracing_HCP3_IONode_XIX_CockpitInfotainment_Systemfunktionen_XIX_HCP3_IONode.DE_PID_Proximity_Errorstate, system-signal=PID_Proximity_Errorstate}, sender-receiver-to-signal-mapping={communication-direction=IN, data-element=Tracing_HCP3_IONode_XIX_CockpitInfotainment_Systemfunktionen_XIX_HCP3_IONode.Geltungsbereich_E3_1_2_Premium.RP_IF_PID_PCB_TempSensor_XIX_Tracing_HCP3_IONode_XIX_CockpitInfotainment_Systemfunktionen_XIX_HCP3_IONode.DE_PID_PCB_TempSensor, system-signal=PID_PCB_TempSensor}, sender-receiver-to-signal-mapping={communication-direction=IN, data-element=Tracing_HCP3_IONode_XIX_CockpitInfotainment_Systemfunktionen_XIX_HCP3_IONode.Geltungsbereich_E3_1_2_Premium.RP_IF_CID_VW_SL_Spare_Part_Nr_EndNr_XIX_Tracing_HCP3_IONode_XIX_CockpitInfotainment_Systemfunktionen_XIX_HCP3_IONode.DE_CID_VW_SL_Spare_Part_Nr_EndNr, system-signal=CID_VW_SL_Spare_Part_Nr_EndNr}, sender-receiver-to-signal-mapping={communication-direction=IN, data-element=Tracing_HCP3_IONode_XIX_CockpitInfotainment_Systemfunktionen_XIX_HCP3_IONode.Geltungsbereich_E3_1_2_Premium.RP_IF_PID_LVDS_Splitter_Errorstate_XIX_Tracing_HCP3_IONode_XIX_CockpitInfotainment_Systemfunktionen_XIX_HCP3_IONode.DE_PID_LVDS_Splitter_Errorstate, system-signal=PID_LVDS_Splitter_Errorstate}, sender-receiver-to-signal-mapping={communication-direction=IN, data-element=Tracing_HCP3_IONode_XIX_CockpitInfotainment_Systemfunktionen_XIX_HCP3_IONode.Geltungsbereich_E3_1_2_Premium.RP_IF_PID_VW_SL_Spare_Part_Nr_Index_XIX_Tracing_HCP3_IONode_XIX_CockpitInfotainment_Systemfunktionen_XIX_HCP3_IONode.DE_PID_VW_SL_Spare_Part_Nr_Index, system-signal=PID_VW_SL_Spare_Part_Nr_Index}, sender-receiver-to-signal-mapping={communication-direction=IN, data-element=Tracing_HCP3_IONode_XIX_CockpitInfotainment_Systemfunktionen_XIX_HCP3_IONode.Geltungsbereich_E3_1_2_Premium.RP_IF_PID_SystemMode_XIX_Tracing_HCP3_IONode_XIX_CockpitInfotainment_Systemfunktionen_XIX_HCP3_IONode.DE_PID_SystemMode, system-signal=PID_SystemMode}, sender-receiver-to-signal-mapping={communication-direction=IN, data-element=Tracing_HCP3_IONode_XIX_CockpitInfotainment_Systemfunktionen_XIX_HCP3_IONode.Geltungsbereich_E3_1_2_Premium.RP_IF_PID_VW_SL_HW_Version_Nr_XIX_Tracing_HCP3_IONode_XIX_CockpitInfotainment_Systemfunktionen_XIX_HCP3_IONode.DE_PID_VW_SL_HW_Version_Nr, system-signal=PID_VW_SL_HW_Version_Nr}, sender-receiver-to-signal-mapping={communication-direction=IN, data-element=Tracing_HCP3_IONode_XIX_CockpitInfotainment_Systemfunktionen_XIX_HCP3_IONode.Geltungsbereich_E3_1_2_Premium.RP_IF_CID_VW_SL_Spare_Part_Nr_MittelNr_XIX_Tracing_HCP3_IONode_XIX_CockpitInfotainment_Systemfunktionen_XIX_HCP3_IONode.DE_CID_VW_SL_Spare_Part_Nr_MittelNr, system-signal=CID_VW_SL_Spare_Part_Nr_MittelNr}, sender-receiver-to-signal-mapping={communication-direction=IN, data-element=Tracing_HCP3_IONode_XIX_CockpitInfotainment_Systemfunktionen_XIX_HCP3_IONode.Geltungsbereich_E3_1_2_Premium.RP_IF_PID_PCB_Temp_Error_XIX_Tracing_HCP3_IONode_XIX_CockpitInfotainment_Systemfunktionen_XIX_HCP3_IONode.DE_PID_PCB_Temp_Error, system-signal=PID_PCB_Temp_Error}, sender-receiver-to-signal-mapping={communication-direction=IN, data-element=Tracing_HCP3_IONode_XIX_CockpitInfotainment_Systemfunktionen_XIX_HCP3_IONode.Geltungsbereich_E3_1_2_Premium.RP_IF_PID_DispDerating_XIX_Tracing_HCP3_IONode_XIX_CockpitInfotainment_Systemfunktionen_XIX_HCP3_IONode.DE_PID_DispDerating, system-signal=PID_DispDerating}, sender-receiver-to-signal-mapping={communication-direction=IN, data-element=Tracing_HCP3_IONode_XIX_CockpitInfotainment_Systemfunktionen_XIX_HCP3_IONode.Geltungsbereich_E3_1_2_Premium.RP_IF_PID_PCB_TempSensorMax_XIX_Tracing_HCP3_IONode_XIX_CockpitInfotainment_Systemfunktionen_XIX_HCP3_IONode.DE_PID_PCB_TempSensorMax, system-signal=PID_PCB_TempSensorMax}, sender-receiver-to-signal-mapping={communication-direction=IN, data-element=Tracing_HCP3_IONode_XIX_CockpitInfotainment_Systemfunktionen_XIX_HCP3_IONode.Geltungsbereich_E3_1_2_Premium.RP_IF_PID_CL30_Overvoltage_Error_XIX_Tracing_HCP3_IONode_XIX_CockpitInfotainment_Systemfunktionen_XIX_HCP3_IONode.DE_PID_CL30_Overvoltage_Error, system-signal=PID_CL30_Overvoltage_Error}, sender-receiver-to-signal-mapping={communication-direction=IN, data-element=Tracing_HCP3_IONode_XIX_CockpitInfotainment_Systemfunktionen_XIX_HCP3_IONode.Geltungsbereich_E3_1_2_Premium.RP_IF_CID_VW_SL_Spare_Part_Nr_TMA_XIX_Tracing_HCP3_IONode_XIX_CockpitInfotainment_Systemfunktionen_XIX_HCP3_IONode.DE_CID_VW_SL_Spare_Part_Nr_TMA, system-signal=CID_VW_SL_Spare_Part_Nr_TMA}, sender-receiver-to-signal-mapping={communication-direction=IN, data-element=Tracing_HCP3_IONode_XIX_CockpitInfotainment_Systemfunktionen_XIX_HCP3_IONode.Geltungsbereich_E3_1_2_Premium.RP_IF_PID_VW_SL_Spare_Part_Nr_EndNr_XIX_Tracing_HCP3_IONode_XIX_CockpitInfotainment_Systemfunktionen_XIX_HCP3_IONode.DE_PID_VW_SL_Spare_Part_Nr_EndNr, system-signal=PID_VW_SL_Spare_Part_Nr_EndNr}, sender-receiver-to-signal-mapping={communication-direction=IN, data-element=Tracing_HCP3_IONode_XIX_CockpitInfotainment_Systemfunktionen_XIX_HCP3_IONode.Geltungsbereich_E3_1_2_Premium.RP_IF_PID_Photosensor_XIX_Tracing_HCP3_IONode_XIX_CockpitInfotainment_Systemfunktionen_XIX_HCP3_IONode.DE_PID_Photosensor, system-signal=PID_Photosensor}, sender-receiver-to-signal-mapping={communication-direction=IN, data-element=Tracing_HCP3_IONode_XIX_CockpitInfotainment_Systemfunktionen_XIX_HCP3_IONode.Geltungsbereich_E3_1_2_Premium.RP_IF_PID_Temp_Error_XIX_Tracing_HCP3_IONode_XIX_CockpitInfotainment_Systemfunktionen_XIX_HCP3_IONode.DE_PID_Temp_Error, system-signal=PID_Temp_Error}, sender-receiver-to-signal-mapping={communication-direction=IN, data-element=Tracing_HCP3_IONode_XIX_CockpitInfotainment_Systemfunktionen_XIX_HCP3_IONode.Geltungsbereich_E3_1_2_Premium.RP_IF_PID_FanSpeed_XIX_Tracing_HCP3_IONode_XIX_CockpitInfotainment_Systemfunktionen_XIX_HCP3_IONode.DE_PID_FanSpeed, system-signal=PID_FanSpeed}, sender-receiver-to-signal-mapping={communication-direction=IN, data-element=Tracing_HCP3_IONode_XIX_CockpitInfotainment_Systemfunktionen_XIX_HCP3_IONode.Geltungsbereich_E3_1_2_Premium.RP_IF_PID_Slider_Errorstate_XIX_Tracing_HCP3_IONode_XIX_CockpitInfotainment_Systemfunktionen_XIX_HCP3_IONode.DE_PID_Slider_Errorstate, system-signal=PID_Slider_Errorstate}, sender-receiver-to-signal-mapping={communication-direction=IN, data-element=Tracing_HCP3_IONode_XIX_CockpitInfotainment_Systemfunktionen_XIX_HCP3_IONode.Geltungsbereich_E3_1_2_Premium.RP_IF_PID_EEPROM_Error_XIX_Tracing_HCP3_IONode_XIX_CockpitInfotainment_Systemfunktionen_XIX_HCP3_IONode.DE_PID_EEPROM_Error, system-signal=PID_EEPROM_Error}, sender-receiver-to-signal-mapping={communication-direction=IN, data-element=Tracing_HCP3_IONode_XIX_CockpitInfotainment_Systemfunktionen_XIX_HCP3_IONode.Geltungsbereich_E3_1_2_Premium.RP_IF_PID_CL30_Undervoltage_Error_XIX_Tracing_HCP3_IONode_XIX_CockpitInfotainment_Systemfunktionen_XIX_HCP3_IONode.DE_PID_CL30_Undervoltage_Error, system-signal=PID_CL30_Undervoltage_Error}, sender-receiver-to-signal-mapping={communication-direction=IN, data-element=Tracing_HCP3_IONode_XIX_CockpitInfotainment_Systemfunktionen_XIX_HCP3_IONode.Geltungsbereich_E3_1_2_Premium.RP_IF_PID_VW_SL_Spare_Part_Nr_TMA_XIX_Tracing_HCP3_IONode_XIX_CockpitInfotainment_Systemfunktionen_XIX_HCP3_IONode.DE_PID_VW_SL_Spare_Part_Nr_TMA, system-signal=PID_VW_SL_Spare_Part_Nr_TMA}, sender-receiver-to-signal-mapping={communication-direction=IN, data-element=Tracing_HCP3_IONode_XIX_CockpitInfotainment_Systemfunktionen_XIX_HCP3_IONode.Geltungsbereich_E3_1_2_Premium.RP_IF_CID_Haptik_Errorstate_XIX_Tracing_HCP3_IONode_XIX_CockpitInfotainment_Systemfunktionen_XIX_HCP3_IONode.DE_CID_Haptik_Errorstate, system-signal=CID_Haptik_Errorstate}, sender-receiver-to-signal-mapping={communication-direction=IN, data-element=Tracing_HCP3_IONode_XIX_CockpitInfotainment_Systemfunktionen_XIX_HCP3_IONode.Geltungsbereich_E3_1_2_Premium.RP_IF_LSR_VW_SL_Spare_Part_Nr_EndNr_XIX_Tracing_HCP3_IONode_XIX_CockpitInfotainment_Systemfunktionen_XIX_HCP3_IONode.DE_LSR_VW_SL_Spare_Part_Nr_EndNr, system-signal=LSR_VW_SL_Spare_Part_Nr_EndNr}, sender-receiver-to-signal-mapping={communication-direction=IN, data-element=Tracing_HCP3_IONode_XIX_CockpitInfotainment_Systemfunktionen_XIX_HCP3_IONode.Geltungsbereich_E3_1_2_Premium.RP_IF_LSR_VW_SL_Spare_Part_Nr_MittelNr_XIX_Tracing_HCP3_IONode_XIX_CockpitInfotainment_Systemfunktionen_XIX_HCP3_IONode.DE_LSR_VW_SL_Spare_Part_Nr_MittelNr, system-signal=LSR_VW_SL_Spare_Part_Nr_MittelNr}, sender-receiver-to-signal-mapping={communication-direction=IN, data-element=Tracing_HCP3_IONode_XIX_CockpitInfotainment_Systemfunktionen_XIX_HCP3_IONode.Geltungsbereich_E3_1_2_Premium.RP_IF_LSR_VW_SL_Spare_Part_Nr_Index_XIX_Tracing_HCP3_IONode_XIX_CockpitInfotainment_Systemfunktionen_XIX_HCP3_IONode.DE_LSR_VW_SL_Spare_Part_Nr_Index, system-signal=LSR_VW_SL_Spare_Part_Nr_Index}, sender-receiver-to-signal-mapping={communication-direction=IN, data-element=Tracing_HCP3_IONode_XIX_CockpitInfotainment_Systemfunktionen_XIX_HCP3_IONode.Geltungsbereich_E3_1_2_Premium.RP_IF_CID_Proximity_Errorstate_XIX_Tracing_HCP3_IONode_XIX_CockpitInfotainment_Systemfunktionen_XIX_HCP3_IONode.DE_CID_Proximity_Errorstate, system-signal=CID_Proximity_Errorstate}, sender-receiver-to-signal-mapping={communication-direction=IN, data-element=Tracing_HCP3_IONode_XIX_CockpitInfotainment_Systemfunktionen_XIX_HCP3_IONode.Geltungsbereich_E3_1_2_Premium.RP_IF_CID_SW_inconsistent_XIX_Tracing_HCP3_IONode_XIX_CockpitInfotainment_Systemfunktionen_XIX_HCP3_IONode.DE_CID_SW_inconsistent, system-signal=CID_SW_inconsistent}, sender-receiver-to-signal-mapping={communication-direction=IN, data-element=Tracing_HCP3_IONode_XIX_CockpitInfotainment_Systemfunktionen_XIX_HCP3_IONode.Geltungsbereich_E3_1_2_Premium.RP_IF_CID_PCB_TempSensorMax_XIX_Tracing_HCP3_IONode_XIX_CockpitInfotainment_Systemfunktionen_XIX_HCP3_IONode.DE_CID_PCB_TempSensorMax, system-signal=CID_PCB_TempSensorMax}, sender-receiver-to-signal-mapping={communication-direction=IN, data-element=Tracing_HCP3_IONode_XIX_CockpitInfotainment_Systemfunktionen_XIX_HCP3_IONode.Geltungsbereich_E3_1_2_Premium.RP_IF_CID_Backlight_ShortCircuit_XIX_Tracing_HCP3_IONode_XIX_CockpitInfotainment_Systemfunktionen_XIX_HCP3_IONode.DE_CID_Backlight_ShortCircuit, system-signal=CID_Backlight_ShortCircuit}, sender-receiver-to-signal-mapping={communication-direction=IN, data-element=Tracing_HCP3_IONode_XIX_CockpitInfotainment_Systemfunktionen_XIX_HCP3_IONode.Geltungsbereich_E3_1_2_Premium.RP_IF_CID_TempSensor_XIX_Tracing_HCP3_IONode_XIX_CockpitInfotainment_Systemfunktionen_XIX_HCP3_IONode.DE_CID_TempSensor, system-signal=CID_TempSensor}, sender-receiver-to-signal-mapping={communication-direction=IN, data-element=Tracing_HCP3_IONode_XIX_CockpitInfotainment_Systemfunktionen_XIX_HCP3_IONode.Geltungsbereich_E3_1_2_Premium.RP_IF_CID_Touch_Errorstate_XIX_Tracing_HCP3_IONode_XIX_CockpitInfotainment_Systemfunktionen_XIX_HCP3_IONode.DE_CID_Touch_Errorstate, system-signal=CID_Touch_Errorstate}, sender-receiver-to-signal-mapping={communication-direction=IN, data-element=Tracing_HCP3_IONode_XIX_CockpitInfotainment_Systemfunktionen_XIX_HCP3_IONode.Geltungsbereich_E3_1_2_Premium.RP_IF_CID_DispDerating_XIX_Tracing_HCP3_IONode_XIX_CockpitInfotainment_Systemfunktionen_XIX_HCP3_IONode.DE_CID_DispDerating, system-signal=CID_DispDerating}, sender-receiver-to-signal-mapping={communication-direction=IN, data-element=Tracing_HCP3_IONode_XIX_CockpitInfotainment_Systemfunktionen_XIX_HCP3_IONode.Geltungsbereich_E3_1_2_Premium.RP_IF_LSR_VW_SL_HW_Version_Nr_XIX_Tracing_HCP3_IONode_XIX_CockpitInfotainment_Systemfunktionen_XIX_HCP3_IONode.DE_LSR_VW_SL_HW_Version_Nr, system-signal=LSR_VW_SL_HW_Version_Nr}, sender-receiver-to-signal-mapping={communication-direction=IN, data-element=Tracing_HCP3_IONode_XIX_CockpitInfotainment_Systemfunktionen_XIX_HCP3_IONode.Geltungsbereich_E3_1_2_Premium.RP_IF_LSR_VW_SL_Spare_Part_Nr_TMA_XIX_Tracing_HCP3_IONode_XIX_CockpitInfotainment_Systemfunktionen_XIX_HCP3_IONode.DE_LSR_VW_SL_Spare_Part_Nr_TMA, system-signal=LSR_VW_SL_Spare_Part_Nr_TMA}, sender-receiver-to-signal-mapping={communication-direction=IN, data-element=Tracing_HCP3_IONode_XIX_CockpitInfotainment_Systemfunktionen_XIX_HCP3_IONode.Geltungsbereich_E3_1_2_Premium.RP_IF_CID_LVDS_Errorstate_XIX_Tracing_HCP3_IONode_XIX_CockpitInfotainment_Systemfunktionen_XIX_HCP3_IONode.DE_CID_LVDS_Errorstate, system-signal=CID_LVDS_Errorstate}, sender-receiver-to-signal-mapping={communication-direction=IN, data-element=Tracing_HCP3_IONode_XIX_CockpitInfotainment_Systemfunktionen_XIX_HCP3_IONode.Geltungsbereich_E3_1_2_Premium.RP_IF_CID_TempSensorMax_XIX_Tracing_HCP3_IONode_XIX_CockpitInfotainment_Systemfunktionen_XIX_HCP3_IONode.DE_CID_TempSensorMax, system-signal=CID_TempSensorMax}, sender-receiver-to-signal-mapping={communication-direction=IN, data-element=Tracing_HCP3_IONode_XIX_CockpitInfotainment_Systemfunktionen_XIX_HCP3_IONode.Geltungsbereich_E3_1_2_Premium.RP_IF_CID_Slider_Errorstate_XIX_Tracing_HCP3_IONode_XIX_CockpitInfotainment_Systemfunktionen_XIX_HCP3_IONode.DE_CID_Slider_Errorstate, system-signal=CID_Slider_Errorstate}, sender-receiver-to-signal-mapping={communication-direction=IN, data-element=Tracing_HCP3_IONode_XIX_CockpitInfotainment_Systemfunktionen_XIX_HCP3_IONode.Geltungsbereich_E3_1_2_Premium.RP_IF_CID_LVDS_Splitter_Errorstate_XIX_Tracing_HCP3_IONode_XIX_CockpitInfotainment_Systemfunktionen_XIX_HCP3_IONode.DE_CID_LVDS_Splitter_Errorstate, system-signal=CID_LVDS_Splitter_Errorstate}, sender-receiver-to-signal-mapping={communication-direction=IN, data-element=Tracing_HCP3_IONode_XIX_CockpitInfotainment_Systemfunktionen_XIX_HCP3_IONode.Geltungsbereich_E3_1_2_Premium.RP_IF_CID_OperatingTime_hr_XIX_Tracing_HCP3_IONode_XIX_CockpitInfotainment_Systemfunktionen_XIX_HCP3_IONode.DE_CID_OperatingTime_hr, system-signal=CID_OperatingTime_hr}, sender-receiver-to-signal-mapping={communication-direction=IN, data-element=Tracing_HCP3_IONode_XIX_CockpitInfotainment_Systemfunktionen_XIX_HCP3_IONode.Geltungsbereich_E3_1_2_Premium.RP_IF_CID_Backlight_OpenCircuit_XIX_Tracing_HCP3_IONode_XIX_CockpitInfotainment_Systemfunktionen_XIX_HCP3_IONode.DE_CID_Backlight_OpenCircuit, system-signal=CID_Backlight_OpenCircuit}, sender-receiver-to-signal-mapping={communication-direction=IN, data-element=Tracing_HCP3_IONode_XIX_CockpitInfotainment_Systemfunktionen_XIX_HCP3_IONode.Geltungsbereich_E3_1_2_Premium.RP_IF_CID_Temp_Error_XIX_Tracing_HCP3_IONode_XIX_CockpitInfotainment_Systemfunktionen_XIX_HCP3_IONode.DE_CID_Temp_Error, system-signal=CID_Temp_Error}, sender-receiver-to-signal-mapping={communication-direction=IN, data-element=Tracing_HCP3_IONode_XIX_CockpitInfotainment_Systemfunktionen_XIX_HCP3_IONode.Geltungsbereich_E3_1_2_Premium.RP_IF_LSR_VW_SL_App_SW_Version_Nr_XIX_Tracing_HCP3_IONode_XIX_CockpitInfotainment_Systemfunktionen_XIX_HCP3_IONode.DE_LSR_VW_SL_App_SW_Version_Nr, system-signal=LSR_VW_SL_App_SW_Version_Nr}, sender-receiver-to-signal-mapping={communication-direction=IN, data-element=Tracing_HCP3_IONode_XIX_CockpitInfotainment_Systemfunktionen_XIX_HCP3_IONode.Geltungsbereich_E3_1_2_Premium.RP_IF_CID_PCB_TempSensor_XIX_Tracing_HCP3_IONode_XIX_CockpitInfotainment_Systemfunktionen_XIX_HCP3_IONode.DE_CID_PCB_TempSensor, system-signal=CID_PCB_TempSensor}, sender-receiver-to-signal-mapping={communication-direction=IN, data-element=Tracing_HCP3_IONode_XIX_CockpitInfotainment_Systemfunktionen_XIX_HCP3_IONode.Geltungsbereich_E3_1_2_Premium.RP_IF_CID_CL30_Undervolt_Error_XIX_Tracing_HCP3_IONode_XIX_CockpitInfotainment_Systemfunktionen_XIX_HCP3_IONode.DE_CID_CL30_Undervolt_Error, system-signal=CID_CL30_Undervolt_Error}, sender-receiver-to-signal-mapping={communication-direction=IN, data-element=Tracing_HCP3_IONode_XIX_CockpitInfotainment_Systemfunktionen_XIX_HCP3_IONode.Geltungsbereich_E3_1_2_Premium.RP_IF_CID_PCB_Temp_Error_XIX_Tracing_HCP3_IONode_XIX_CockpitInfotainment_Systemfunktionen_XIX_HCP3_IONode.DE_CID_PCB_Temp_Error, system-signal=CID_PCB_Temp_Error}, sender-receiver-to-signal-mapping={communication-direction=IN, data-element=Tracing_HCP3_IONode_XIX_CockpitInfotainment_Systemfunktionen_XIX_HCP3_IONode.Geltungsbereich_E3_1_2_Premium.RP_IF_CID_HDCP_Status_XIX_Tracing_HCP3_IONode_XIX_CockpitInfotainment_Systemfunktionen_XIX_HCP3_IONode.DE_CID_HDCP_Status, system-signal=CID_HDCP_Status}, sender-receiver-to-signal-mapping={communication-direction=IN, data-element=Tracing_HCP3_IONode_XIX_CockpitInfotainment_Systemfunktionen_XIX_HCP3_IONode.Geltungsbereich_E3_1_2_Premium.RP_IF_CID_EEPROM_Error_XIX_Tracing_HCP3_IONode_XIX_CockpitInfotainment_Systemfunktionen_XIX_HCP3_IONode.DE_CID_EEPROM_Error, system-signal=CID_EEPROM_Error}, sender-receiver-to-signal-mapping={communication-direction=IN, data-element=Tracing_HCP3_IONode_XIX_CockpitInfotainment_Systemfunktionen_XIX_HCP3_IONode.Geltungsbereich_E3_1_2_Premium.RP_IF_CID_CL_30F_XIX_Tracing_HCP3_IONode_XIX_CockpitInfotainment_Systemfunktionen_XIX_HCP3_IONode.DE_CID_CL_30F, system-signal=CID_CL_30F}, sender-receiver-to-signal-mapping={communication-direction=IN, data-element=Tracing_HCP3_IONode_XIX_CockpitInfotainment_Systemfunktionen_XIX_HCP3_IONode.Geltungsbereich_E3_1_2_Premium.RP_IF_CID_FanSpeed_XIX_Tracing_HCP3_IONode_XIX_CockpitInfotainment_Systemfunktionen_XIX_HCP3_IONode.DE_CID_FanSpeed, system-signal=CID_FanSpeed}, sender-receiver-to-signal-mapping={communication-direction=IN, data-element=Tracing_HCP3_IONode_XIX_CockpitInfotainment_Systemfunktionen_XIX_HCP3_IONode.Geltungsbereich_E3_1_2_Premium.RP_IF_CID_SystemMode_XIX_Tracing_HCP3_IONode_XIX_CockpitInfotainment_Systemfunktionen_XIX_HCP3_IONode.DE_CID_SystemMode, system-signal=CID_SystemMode}, sender-receiver-to-signal-mapping={communication-direction=IN, data-element=Tracing_HCP3_IONode_XIX_CockpitInfotainment_Systemfunktionen_XIX_HCP3_IONode.Geltungsbereich_E3_1_2_Premium.RP_IF_CID_CL30_Overvolt_Error_XIX_Tracing_HCP3_IONode_XIX_CockpitInfotainment_Systemfunktionen_XIX_HCP3_IONode.DE_CID_CL30_Overvolt_Error, system-signal=CID_CL30_Overvolt_Error}, sender-receiver-to-signal-mapping={communication-direction=IN, data-element=Tracing_HCP3_IONode_XIX_CockpitInfotainment_Systemfunktionen_XIX_HCP3_IONode.Geltungsbereich_E3_1_2_Premium.RP_IF_CID_VW_SL_App_SW_Version_Nr_XIX_Tracing_HCP3_IONode_XIX_CockpitInfotainment_Systemfunktionen_XIX_HCP3_IONode.DE_CID_VW_SL_App_SW_Version_Nr, system-signal=CID_VW_SL_App_SW_Version_Nr}, sender-receiver-to-signal-mapping={communication-direction=IN, data-element=Tracing_HCP3_IONode_XIX_CockpitInfotainment_Systemfunktionen_XIX_HCP3_IONode.Geltungsbereich_E3_1_2_Premium.RP_IF_CID_VW_SL_HW_Version_Nr_XIX_Tracing_HCP3_IONode_XIX_CockpitInfotainment_Systemfunktionen_XIX_HCP3_IONode.DE_CID_VW_SL_HW_Version_Nr, system-signal=CID_VW_SL_HW_Version_Nr}, sender-receiver-to-signal-mapping={communication-direction=IN, data-element=Tracing_HCP3_IONode_XIX_CockpitInfotainment_Systemfunktionen_XIX_HCP3_IONode.Geltungsbereich_E3_1_2_Premium.RP_IF_CID_ShutterFoil_Errorstate_XIX_Tracing_HCP3_IONode_XIX_CockpitInfotainment_Systemfunktionen_XIX_HCP3_IONode.DE_CID_ShutterFoil_Errorstate, system-signal=CID_ShutterFoil_Errorstate}, sender-receiver-to-signal-mapping={communication-direction=IN, data-element=Tracing_HCP3_IONode_XIX_CockpitInfotainment_Systemfunktionen_XIX_HCP3_IONode.Geltungsbereich_E3_1_2_Premium.RP_IF_CID_OperatingTime_min_XIX_Tracing_HCP3_IONode_XIX_CockpitInfotainment_Systemfunktionen_XIX_HCP3_IONode.DE_CID_OperatingTime_min, system-signal=CID_OperatingTime_min}, sender-receiver-to-signal-mapping={communication-direction=IN, data-element=Tracing_HCP3_IONode_XIX_CockpitInfotainment_Systemfunktionen_XIX_HCP3_IONode.Geltungsbereich_E3_1_2_Premium.RP_IF_CID_Photosensor_XIX_Tracing_HCP3_IONode_XIX_CockpitInfotainment_Systemfunktionen_XIX_HCP3_IONode.DE_CID_Photosensor, system-signal=CID_Photosensor}, sender-receiver-to-signal-mapping={communication-direction=OUT, data-element=Tracing_HCP3_IONode_XIX_CockpitInfotainment_Systemfunktionen_XIX_HCP3_IONode.Geltungsbereich_E3_1_2_Premium.SP_IF_ZR_CL_Mode_XIX_Tracing_HCP3_IONode_XIX_CockpitInfotainment_Systemfunktionen_XIX_HCP3_IONode.DE_ZR_CL_Mode, system-signal=ZR_CL_Mode}, sender-receiver-to-signal-mapping={communication-direction=OUT, data-element=Tracing_HCP3_IONode_XIX_CockpitInfotainment_Systemfunktionen_XIX_HCP3_IONode.Geltungsbereich_E3_1_2_Premium.SP_IF_ZR_HUD_Mode_XIX_Tracing_HCP3_IONode_XIX_CockpitInfotainment_Systemfunktionen_XIX_HCP3_IONode.DE_ZR_HUD_Mode, system-signal=ZR_HUD_Mode}, sender-receiver-to-signal-mapping={communication-direction=OUT, data-element=Tracing_HCP3_IONode_XIX_CockpitInfotainment_Systemfunktionen_XIX_HCP3_IONode.Geltungsbereich_E3_1_2_Premium.SP_IF_ZR_SYS1_Mode_XIX_Tracing_HCP3_IONode_XIX_CockpitInfotainment_Systemfunktionen_XIX_HCP3_IONode.DE_ZR_SYS1_Mode, system-signal=ZR_SYS1_Mode}, sender-receiver-to-signal-mapping={communication-direction=OUT, data-element=Tracing_HCP3_IONode_XIX_CockpitInfotainment_Systemfunktionen_XIX_HCP3_IONode.Geltungsbereich_E3_1_2_Premium.SP_IF_ZR_IVI1_Mode_XIX_Tracing_HCP3_IONode_XIX_CockpitInfotainment_Systemfunktionen_XIX_HCP3_IONode.DE_ZR_IVI1_Mode, system-signal=ZR_IVI1_Mode}, sender-receiver-to-signal-mapping={communication-direction=OUT, data-element=Tracing_HCP3_IONode_XIX_CockpitInfotainment_Systemfunktionen_XIX_HCP3_IONode.Geltungsbereich_E3_1_2_Premium.SP_IF_ZR_IOC_Mode_XIX_Tracing_HCP3_IONode_XIX_CockpitInfotainment_Systemfunktionen_XIX_HCP3_IONode.DE_ZR_IOC_Mode, system-signal=ZR_IOC_Mode}, sender-receiver-to-signal-mapping={communication-direction=IN, data-element=Tracing_HCP3_IONode_XIX_CockpitInfotainment_Systemfunktionen_XIX_HCP3_IONode.Geltungsbereich_E3_1_2_Premium.RP_IF_FID_PCB_Temp_Error_XIX_Tracing_HCP3_IONode_XIX_CockpitInfotainment_Systemfunktionen_XIX_HCP3_IONode.DE_FID_PCB_Temp_Error, system-signal=FID_PCB_Temp_Error}, sender-receiver-to-signal-mapping={communication-direction=IN, data-element=Tracing_HCP3_IONode_XIX_CockpitInfotainment_Systemfunktionen_XIX_HCP3_IONode.Geltungsbereich_E3_1_2_Premium.RP_IF_FID_PCB_TempSensorMax_XIX_Tracing_HCP3_IONode_XIX_CockpitInfotainment_Systemfunktionen_XIX_HCP3_IONode.DE_FID_PCB_TempSensorMax, system-signal=FID_PCB_TempSensorMax}, sender-receiver-to-signal-mapping={communication-direction=IN, data-element=Tracing_HCP3_IONode_XIX_CockpitInfotainment_Systemfunktionen_XIX_HCP3_IONode.Geltungsbereich_E3_1_2_Premium.RP_IF_FID_TempSensorMax_XIX_Tracing_HCP3_IONode_XIX_CockpitInfotainment_Systemfunktionen_XIX_HCP3_IONode.DE_FID_TempSensorMax, system-signal=FID_TempSensorMax}, sender-receiver-to-signal-mapping={communication-direction=IN, data-element=Tracing_HCP3_IONode_XIX_CockpitInfotainment_Systemfunktionen_XIX_HCP3_IONode.Geltungsbereich_E3_1_2_Premium.RP_IF_FID_DispDerating_XIX_Tracing_HCP3_IONode_XIX_CockpitInfotainment_Systemfunktionen_XIX_HCP3_IONode.DE_FID_DispDerating, system-signal=FID_DispDerating}, sender-receiver-to-signal-mapping={communication-direction=IN, data-element=Tracing_HCP3_IONode_XIX_CockpitInfotainment_Systemfunktionen_XIX_HCP3_IONode.Geltungsbereich_E3_1_2_Premium.RP_IF_FID_EEPROM_Error_XIX_Tracing_HCP3_IONode_XIX_CockpitInfotainment_Systemfunktionen_XIX_HCP3_IONode.DE_FID_EEPROM_Error, system-signal=FID_EEPROM_Error}, sender-receiver-to-signal-mapping={communication-direction=IN, data-element=Tracing_HCP3_IONode_XIX_CockpitInfotainment_Systemfunktionen_XIX_HCP3_IONode.Geltungsbereich_E3_1_2_Premium.RP_IF_FID_CL30_Undervolt_Error_XIX_Tracing_HCP3_IONode_XIX_CockpitInfotainment_Systemfunktionen_XIX_HCP3_IONode.DE_FID_CL30_Undervolt_Error, system-signal=FID_CL30_Undervolt_Error}, sender-receiver-to-signal-mapping={communication-direction=IN, data-element=Tracing_HCP3_IONode_XIX_CockpitInfotainment_Systemfunktionen_XIX_HCP3_IONode.Geltungsbereich_E3_1_2_Premium.RP_IF_FID_OperatingTime_min_XIX_Tracing_HCP3_IONode_XIX_CockpitInfotainment_Systemfunktionen_XIX_HCP3_IONode.DE_FID_OperatingTime_min, system-signal=FID_OperatingTime_min}, sender-receiver-to-signal-mapping={communication-direction=IN, data-element=Tracing_HCP3_IONode_XIX_CockpitInfotainment_Systemfunktionen_XIX_HCP3_IONode.Geltungsbereich_E3_1_2_Premium.RP_IF_FID_CL_30F_XIX_Tracing_HCP3_IONode_XIX_CockpitInfotainment_Systemfunktionen_XIX_HCP3_IONode.DE_FID_CL_30F, system-signal=FID_CL_30F}, sender-receiver-to-signal-mapping={communication-direction=IN, data-element=Tracing_HCP3_IONode_XIX_CockpitInfotainment_Systemfunktionen_XIX_HCP3_IONode.Geltungsbereich_E3_1_2_Premium.RP_IF_FID_OperatingTime_hr_XIX_Tracing_HCP3_IONode_XIX_CockpitInfotainment_Systemfunktionen_XIX_HCP3_IONode.DE_FID_OperatingTime_hr, system-signal=FID_OperatingTime_hr}, sender-receiver-to-signal-mapping={communication-direction=IN, data-element=Tracing_HCP3_IONode_XIX_CockpitInfotainment_Systemfunktionen_XIX_HCP3_IONode.Geltungsbereich_E3_1_2_Premium.RP_IF_FID_Temp_Error_XIX_Tracing_HCP3_IONode_XIX_CockpitInfotainment_Systemfunktionen_XIX_HCP3_IONode.DE_FID_Temp_Error, system-signal=FID_Temp_Error}, sender-receiver-to-signal-mapping={communication-direction=IN, data-element=Tracing_HCP3_IONode_XIX_CockpitInfotainment_Systemfunktionen_XIX_HCP3_IONode.Geltungsbereich_E3_1_2_Premium.RP_IF_FID_TempSensor_XIX_Tracing_HCP3_IONode_XIX_CockpitInfotainment_Systemfunktionen_XIX_HCP3_IONode.DE_FID_TempSensor, system-signal=FID_TempSensor}, sender-receiver-to-signal-mapping={communication-direction=IN, data-element=Tracing_HCP3_IONode_XIX_CockpitInfotainment_Systemfunktionen_XIX_HCP3_IONode.Geltungsbereich_E3_1_2_Premium.RP_IF_FID_Photosensor_XIX_Tracing_HCP3_IONode_XIX_CockpitInfotainment_Systemfunktionen_XIX_HCP3_IONode.DE_FID_Photosensor, system-signal=FID_Photosensor}, sender-receiver-to-signal-mapping={communication-direction=IN, data-element=Tracing_HCP3_IONode_XIX_CockpitInfotainment_Systemfunktionen_XIX_HCP3_IONode.Geltungsbereich_E3_1_2_Premium.RP_IF_FID_PCB_TempSensor_XIX_Tracing_HCP3_IONode_XIX_CockpitInfotainment_Systemfunktionen_XIX_HCP3_IONode.DE_FID_PCB_TempSensor, system-signal=FID_PCB_TempSensor}, sender-receiver-to-signal-mapping={communication-direction=IN, data-element=Tracing_HCP3_IONode_XIX_CockpitInfotainment_Systemfunktionen_XIX_HCP3_IONode.Geltungsbereich_E3_1_2_Premium.RP_IF_FID_SystemMode_XIX_Tracing_HCP3_IONode_XIX_CockpitInfotainment_Systemfunktionen_XIX_HCP3_IONode.DE_FID_SystemMode, system-signal=FID_SystemMode}, sender-receiver-to-signal-mapping={communication-direction=IN, data-element=Tracing_HCP3_IONode_XIX_CockpitInfotainment_Systemfunktionen_XIX_HCP3_IONode.Geltungsbereich_E3_1_2_Premium.RP_IF_FID_Backlight_OpenCircuit_XIX_Tracing_HCP3_IONode_XIX_CockpitInfotainment_Systemfunktionen_XIX_HCP3_IONode.DE_FID_Backlight_OpenCircuit, system-signal=FID_Backlight_OpenCircuit}, sender-receiver-to-signal-mapping={communication-direction=IN, data-element=Tracing_HCP3_IONode_XIX_CockpitInfotainment_Systemfunktionen_XIX_HCP3_IONode.Geltungsbereich_E3_1_2_Premium.RP_IF_FID_Backlight_ShortCircuit_XIX_Tracing_HCP3_IONode_XIX_CockpitInfotainment_Systemfunktionen_XIX_HCP3_IONode.DE_FID_Backlight_ShortCircuit, system-signal=FID_Backlight_ShortCircuit}, sender-receiver-to-signal-mapping={communication-direction=IN, data-element=Tracing_HCP3_IONode_XIX_CockpitInfotainment_Systemfunktionen_XIX_HCP3_IONode.Geltungsbereich_E3_1_2_Premium.RP_IF_FID_CL30_Overvolt_Error_XIX_Tracing_HCP3_IONode_XIX_CockpitInfotainment_Systemfunktionen_XIX_HCP3_IONode.DE_FID_CL30_Overvolt_Error, system-signal=FID_CL30_Overvolt_Error}, sender-receiver-to-signal-mapping={communication-direction=IN, data-element=Tracing_HCP3_IONode_XIX_CockpitInfotainment_Systemfunktionen_XIX_HCP3_IONode.Geltungsbereich_E3_1_2_Premium.RP_IF_FID_SW_inconsistent_XIX_Tracing_HCP3_IONode_XIX_CockpitInfotainment_Systemfunktionen_XIX_HCP3_IONode.DE_FID_SW_inconsistent, system-signal=FID_SW_inconsistent}, sender-receiver-to-signal-mapping={communication-direction=IN, data-element=Tracing_HCP3_IONode_XIX_CockpitInfotainment_Systemfunktionen_XIX_HCP3_IONode.Geltungsbereich_E3_1_2_Premium.RP_IF_FID_LVDS_Errorstate_XIX_Tracing_HCP3_IONode_XIX_CockpitInfotainment_Systemfunktionen_XIX_HCP3_IONode.DE_FID_LVDS_Errorstate, system-signal=FID_LVDS_Errorstate}, sender-receiver-to-signal-mapping={communication-direction=IN, data-element=Tracing_HCP3_IONode_XIX_CockpitInfotainment_Systemfunktionen_XIX_HCP3_IONode.Geltungsbereich_E3_1_2_Premium.RP_IF_LSR_SystemMode_XIX_Tracing_HCP3_IONode_XIX_CockpitInfotainment_Systemfunktionen_XIX_HCP3_IONode.DE_LSR_SystemMode, system-signal=LSR_SystemMode}, sender-receiver-to-signal-mapping={communication-direction=IN, data-element=Tracing_HCP3_IONode_XIX_CockpitInfotainment_Systemfunktionen_XIX_HCP3_IONode.Geltungsbereich_E3_1_2_Premium.RP_IF_LSR_CL30_Overvolt_Error_XIX_Tracing_HCP3_IONode_XIX_CockpitInfotainment_Systemfunktionen_XIX_HCP3_IONode.DE_LSR_CL30_Overvolt_Error, system-signal=LSR_CL30_Overvolt_Error}, sender-receiver-to-signal-mapping={communication-direction=IN, data-element=Tracing_HCP3_IONode_XIX_CockpitInfotainment_Systemfunktionen_XIX_HCP3_IONode.Geltungsbereich_E3_1_2_Premium.RP_IF_LSR_CL30_Undervoltage_Error_XIX_Tracing_HCP3_IONode_XIX_CockpitInfotainment_Systemfunktionen_XIX_HCP3_IONode.DE_LSR_CL30_Undervoltage_Error, system-signal=LSR_CL30_Undervoltage_Error}, sender-receiver-to-signal-mapping={communication-direction=IN, data-element=Tracing_HCP3_IONode_XIX_CockpitInfotainment_Systemfunktionen_XIX_HCP3_IONode.Geltungsbereich_E3_1_2_Premium.RP_IF_LSR_dimming_PWM_XIX_Tracing_HCP3_IONode_XIX_CockpitInfotainment_Systemfunktionen_XIX_HCP3_IONode.DE_LSR_dimming_PWM, system-signal=LSR_dimming_PWM}, sender-receiver-to-signal-mapping={communication-direction=IN, data-element=Tracing_HCP3_IONode_XIX_CockpitInfotainment_Systemfunktionen_XIX_HCP3_IONode.Geltungsbereich_E3_1_2_Premium.RP_IF_LSR_dimming_post_carriage_XIX_Tracing_HCP3_IONode_XIX_CockpitInfotainment_Systemfunktionen_XIX_HCP3_IONode.DE_LSR_dimming_post_carriage, system-signal=LSR_dimming_post_carriage}, sender-receiver-to-signal-mapping={communication-direction=IN, data-element=Tracing_HCP3_IONode_XIX_CockpitInfotainment_Systemfunktionen_XIX_HCP3_IONode.Geltungsbereich_E3_1_2_Premium.RP_IF_CID_Touchstate_XIX_Tracing_HCP3_IONode_XIX_CockpitInfotainment_Systemfunktionen_XIX_HCP3_IONode.DE_CID_Touchstate, system-signal=CID_Touchstate}, sender-receiver-to-signal-mapping={communication-direction=IN, data-element=Tracing_HCP3_IONode_XIX_CockpitInfotainment_Systemfunktionen_XIX_HCP3_IONode.Geltungsbereich_E3_1_2_Premium.RP_IF_PID_Touchstate_XIX_Tracing_HCP3_IONode_XIX_CockpitInfotainment_Systemfunktionen_XIX_HCP3_IONode.DE_PID_Touchstate, system-signal=PID_Touchstate}, sender-receiver-to-signal-mapping={communication-direction=IN, data-element=Tracing_HCP3_IONode_XIX_CockpitInfotainment_Systemfunktionen_XIX_HCP3_IONode.Geltungsbereich_E3_1_2_Premium.RP_IF_CID_HID_FetchAll_XIX_Tracing_HCP3_IONode_XIX_CockpitInfotainment_Systemfunktionen_XIX_HCP3_IONode.DE_CID_HID_FetchAll, system-signal=CID_HID_FetchAll}, sender-receiver-to-signal-group-mapping={communication-direction=IN, data-element=WUM_Client3_XIX_WUM_XIX_HCP3_IONode.Geltungsbereich_E3_1_2_Premium.RP_IF_SG_ClampControl_01_XIX_WUM_Client3_XIX_WUM_XIX_HCP3_IONode.DE_SG_ClampControl_01, signal-group=SG_ClampControl_01, type-mapping=sender-rec-record-type-mapping=record-element-mappings=[{implementation-record-element=KST_KL_15, system-signal=KST_KL_15}, {implementation-record-element=KST_Kl_S, system-signal=KST_Kl_S}, {implementation-record-element=KST_Kl_50_Startanforderung, system-signal=KST_Kl_50_Startanforderung}, {implementation-record-element=ClampControl_01_BZ, system-signal=ClampControl_01_BZ}, {implementation-record-element=ClampControl_01_CRC, system-signal=ClampControl_01_CRC}, {implementation-record-element=KST_Ausstiegswunsch_Status, system-signal=KST_Ausstiegswunsch_Status}, {implementation-record-element=KST_ComfortReadyStatus, system-signal=KST_ComfortReadyStatus}]}, sender-receiver-to-signal-mapping={communication-direction=IN, data-element=WUM_Client3_XIX_WUM_XIX_HCP3_IONode.Geltungsbereich_E3_1_2_Premium.RP_IF_NVEM_Abschaltstufe_XIX_WUM_Client3_XIX_WUM_XIX_HCP3_IONode.DE_NVEM_Abschaltstufe, system-signal=NVEM_Abschaltstufe}, sender-receiver-to-signal-group-mapping={communication-direction=IN, data-element=FoDSlave_HCP3_XIX_FoD_XIX_HCP3_IONode.Geltungsbereich_E3_1_2_Premium.RP_IF_SG_ClampControl_01_XIX_FoDSlave_HCP3_XIX_FoD_XIX_HCP3_IONode.DE_SG_ClampControl_01, signal-group=SG_ClampControl_01, type-mapping=sender-rec-record-type-mapping=record-element-mappings=[{implementation-record-element=KST_KL_15, system-signal=KST_KL_15}, {implementation-record-element=KST_Kl_S, system-signal=KST_Kl_S}, {implementation-record-element=KST_Kl_50_Startanforderung, system-signal=KST_Kl_50_Startanforderung}, {implementation-record-element=ClampControl_01_BZ, system-signal=ClampControl_01_BZ}, {implementation-record-element=ClampControl_01_CRC, system-signal=ClampControl_01_CRC}, {implementation-record-element=KST_Ausstiegswunsch_Status, system-signal=KST_Ausstiegswunsch_Status}, {implementation-record-element=KST_ComfortReadyStatus, system-signal=KST_ComfortReadyStatus}]}, sender-receiver-to-signal-mapping={communication-direction=OUT, data-element=FoDSlave_HCP3_XIX_FoD_XIX_HCP3_IONode.Geltungsbereich_E3_1_2_Premium.SP_IF_FoD_Info_El_Resp_Eth_Data_XIX_FoDSlave_HCP3_XIX_FoD_XIX_HCP3_IONode.DE_FoD_Info_El_Resp_Eth_Data, system-signal=FoD_Info_El_Resp_Eth_Data}, sender-receiver-to-signal-mapping={communication-direction=IN, data-element=FoDSlave_HCP3_XIX_FoD_XIX_HCP3_IONode.Geltungsbereich_E3_1_2_Premium.RP_IF_FoD_Info_El_Req_Eth_Data_XIX_FoDSlave_HCP3_XIX_FoD_XIX_HCP3_IONode.DE_FoD_Info_El_Req_Eth_Data, system-signal=FoD_Info_El_Req_Eth_Data}, sender-receiver-to-signal-mapping={communication-direction=OUT, data-element=FoDSlave_HCP3_XIX_FoD_XIX_HCP3_IONode.Geltungsbereich_E3_1_2_Premium.SP_IF_SOK_FoD_Info_El_Resp_Eth_Challen_XIX_FoDSlave_HCP3_XIX_FoD_XIX_HCP3_IONode.DE_SOK_FoD_Info_El_Resp_Eth_Challen, system-signal=SOK_FoD_Info_El_Resp_Eth_Challen}, sender-receiver-to-signal-mapping={communication-direction=IN, data-element=FoDSlave_HCP3_XIX_FoD_XIX_HCP3_IONode.Geltungsbereich_E3_1_2_Premium.RP_IF_SOK_FoD_Info_El_Req_Eth_Challeng_XIX_FoDSlave_HCP3_XIX_FoD_XIX_HCP3_IONode.DE_SOK_FoD_Info_El_Req_Eth_Challeng, system-signal=SOK_FoD_Info_El_Req_Eth_Challeng}, sender-receiver-to-signal-mapping={communication-direction=IN, data-element=SOK_Participant_HCP3_IONode_XIX_SOK_XIX_HCP3_IONode.Geltungsbereich_E3_1_2_Premium.RP_IF_SOK_ungeschuetzte_Zeit_XIX_SOK_Participant_HCP3_IONode_XIX_SOK_XIX_HCP3_IONode.DE_SOK_ungeschuetzte_Zeit, system-signal=SOK_ungeschuetzte_Zeit}, sender-receiver-to-signal-mapping={communication-direction=OUT, data-element=SOK_Participant_HCP3_IONode_XIX_SOK_XIX_HCP3_IONode.Geltungsbereich_E3_1_2_Premium.SP_IF_SOK_Zeit_Info_El_Challenge_XIX_SOK_Participant_HCP3_IONode_XIX_SOK_XIX_HCP3_IONode.DE_SOK_Zeit_Info_El_Challenge, system-signal=SOK_Zeit_Info_El_Challenge}, sender-receiver-to-signal-mapping={communication-direction=IN, data-element=SOK_Participant_HCP3_IONode_XIX_SOK_XIX_HCP3_IONode.Geltungsbereich_E3_1_2_Premium.RP_IF_SOK_Zeit_Info_El_Zeit_XIX_SOK_Participant_HCP3_IONode_XIX_SOK_XIX_HCP3_IONode.DE_SOK_Zeit_Info_El_Zeit, system-signal=SOK_Zeit_Info_El_Zeit}, sender-receiver-to-signal-group-mapping={communication-direction=IN, data-element=OTA_Infrastructure_HCP3_XIX_OTAMC_XIX_HCP3_IONode.Geltungsbereich_E3_1_2_Premium.RP_IF_SG_ORU_Control_A_01_XIX_OTA_Infrastructure_HCP3_XIX_OTAMC_XIX_HCP3_IONode.DE_SG_ORU_Control_A_01, signal-group=SG_ORU_Control_A_01, type-mapping=sender-rec-record-type-mapping=record-element-mappings=[{implementation-record-element=OruVehicleLockRequestA, system-signal=OruVehicleLockRequestA}, {implementation-record-element=ORU_Control_A_01_CRC, system-signal=ORU_Control_A_01_CRC}, {implementation-record-element=ORU_Control_A_01_BZ, system-signal=ORU_Control_A_01_BZ}, {implementation-record-element=OnlineRemoteUpdateControlA, system-signal=OnlineRemoteUpdateControlA}, {implementation-record-element=OnlineRemoteUpdateControlOldA, system-signal=OnlineRemoteUpdateControlOldA}]}, sender-receiver-to-signal-group-mapping={communication-direction=IN, data-element=OTA_Infrastructure_HCP3_XIX_OTAMC_XIX_HCP3_IONode.Geltungsbereich_E3_1_2_Premium.RP_IF_SG_ORU_Control_D_01_XIX_OTA_Infrastructure_HCP3_XIX_OTAMC_XIX_HCP3_IONode.DE_SG_ORU_Control_D_01, signal-group=SG_ORU_Control_D_01, type-mapping=sender-rec-record-type-mapping=record-element-mappings=[{implementation-record-element=OnlineRemoteUpdateControlOldD, system-signal=OnlineRemoteUpdateControlOldD}, {implementation-record-element=OnlineRemoteUpdateControlD, system-signal=OnlineRemoteUpdateControlD}, {implementation-record-element=ORU_Control_D_01_BZ, system-signal=ORU_Control_D_01_BZ}, {implementation-record-element=ORU_Control_D_01_CRC, system-signal=ORU_Control_D_01_CRC}]}, sender-receiver-to-signal-group-mapping={communication-direction=IN, data-element=OTA_Infrastructure_HCP3_XIX_OTAMC_XIX_HCP3_IONode.Geltungsbereich_E3_1_2_Premium.RP_IF_SG_OTAMC_D_01_XIX_OTA_Infrastructure_HCP3_XIX_OTAMC_XIX_HCP3_IONode.DE_SG_OTAMC_D_01, signal-group=SG_OTAMC_D_01, type-mapping=sender-rec-record-type-mapping=record-element-mappings=[{implementation-record-element=VehicleProtectedEnvironment_D, system-signal=VehicleProtectedEnvironment_D}, {implementation-record-element=OTAMC_D_01_CRC, system-signal=OTAMC_D_01_CRC}, {implementation-record-element=OTAMC_D_01_BZ, system-signal=OTAMC_D_01_BZ}]}, sender-receiver-to-signal-mapping={communication-direction=IN, data-element=OTA_Infrastructure_HCP3_XIX_OTAMC_XIX_HCP3_IONode.Geltungsbereich_E3_1_2_Premium.RP_IF_ORU_Status_XIX_OTA_Infrastructure_HCP3_XIX_OTAMC_XIX_HCP3_IONode.DE_ORU_Status, system-signal=ORU_Status}, sender-receiver-to-signal-mapping={communication-direction=IN, data-element=ORU_Infrastructure_Info_El_XIX_ORU6_XIX_HCP3_IONode.Geltungsbereich_E3_1_2_Premium.RP_IF_ORU_Status_XIX_ORU_Infrastructure_Info_El_XIX_ORU6_XIX_HCP3_IONode.DE_ORU_Status, system-signal=ORU_Status}, sender-receiver-to-signal-group-mapping={communication-direction=IN, data-element=OTA_Infrastructure_Info_El_XIX_RP_XIX_HCP3_IONode.Geltungsbereich_E3_1_2_Premium.RP_IF_SG_ORU_Control_A_01_XIX_OTA_Infrastructure_Info_El_XIX_RP_XIX_HCP3_IONode.DE_SG_ORU_Control_A_01, signal-group=SG_ORU_Control_A_01, type-mapping=sender-rec-record-type-mapping=record-element-mappings=[{implementation-record-element=OruVehicleLockRequestA, system-signal=OruVehicleLockRequestA}, {implementation-record-element=ORU_Control_A_01_CRC, system-signal=ORU_Control_A_01_CRC}, {implementation-record-element=ORU_Control_A_01_BZ, system-signal=ORU_Control_A_01_BZ}, {implementation-record-element=OnlineRemoteUpdateControlA, system-signal=OnlineRemoteUpdateControlA}, {implementation-record-element=OnlineRemoteUpdateControlOldA, system-signal=OnlineRemoteUpdateControlOldA}]}, sender-receiver-to-signal-group-mapping={communication-direction=IN, data-element=OTA_Infrastructure_Info_El_XIX_RP_XIX_HCP3_IONode.Geltungsbereich_E3_1_2_Premium.RP_IF_SG_ORU_Control_D_01_XIX_OTA_Infrastructure_Info_El_XIX_RP_XIX_HCP3_IONode.DE_SG_ORU_Control_D_01, signal-group=SG_ORU_Control_D_01, type-mapping=sender-rec-record-type-mapping=record-element-mappings=[{implementation-record-element=OnlineRemoteUpdateControlOldD, system-signal=OnlineRemoteUpdateControlOldD}, {implementation-record-element=OnlineRemoteUpdateControlD, system-signal=OnlineRemoteUpdateControlD}, {implementation-record-element=ORU_Control_D_01_BZ, system-signal=ORU_Control_D_01_BZ}, {implementation-record-element=ORU_Control_D_01_CRC, system-signal=ORU_Control_D_01_CRC}]}, sender-receiver-to-signal-group-mapping={communication-direction=IN, data-element=OTA_Infrastructure_Info_El_XIX_RP_XIX_HCP3_IONode.Geltungsbereich_E3_1_2_Premium.RP_IF_SG_OTAMC_D_01_XIX_OTA_Infrastructure_Info_El_XIX_RP_XIX_HCP3_IONode.DE_SG_OTAMC_D_01, signal-group=SG_OTAMC_D_01, type-mapping=sender-rec-record-type-mapping=record-element-mappings=[{implementation-record-element=VehicleProtectedEnvironment_D, system-signal=VehicleProtectedEnvironment_D}, {implementation-record-element=OTAMC_D_01_CRC, system-signal=OTAMC_D_01_CRC}, {implementation-record-element=OTAMC_D_01_BZ, system-signal=OTAMC_D_01_BZ}]}}
      pnc-mapping pnc-group=[HCP3_IONode_XIX_PNC_01_CarWakeUp_Rx, HCP3_IONode_XIX_PNC_01_CarWakeUp_Tx], pnc-identifier=8, wakeup-frame=[FT_NM_CID, FT_NM_HUD, CHNL/FT_NM_Info_El, FT_NM_PID, FT_NM_Gateway, CHNL/FT_NM_Info_El]:
        ident PNC_01_CarWakeUp
      pnc-mapping pnc-identifier=9, wakeup-frame=[CHNL/FT_NM_Info_El, FT_NM_Gateway, CHNL/FT_NM_Info_El]:
        ident PNC_02_Basefunction_Powertrain
      pnc-mapping pnc-identifier=10, wakeup-frame=[CHNL/FT_NM_Info_El, FT_NM_Gateway, CHNL/FT_NM_Info_El]:
        ident PNC_03_Basefunction_Chassis
      pnc-mapping pnc-identifier=11, wakeup-frame=[CHNL/FT_NM_Info_El, FT_NM_Gateway, CHNL/FT_NM_Info_El]:
        ident PNC_04_Basefunction_DrivingAssistance
      pnc-mapping pnc-identifier=12, wakeup-frame=[CHNL/FT_NM_Info_El, FT_NM_Gateway, CHNL/FT_NM_Info_El]:
        ident PNC_05_Basefunction_Infotainment
      pnc-mapping pnc-identifier=13, wakeup-frame=[CHNL/FT_NM_Info_El, FT_NM_Gateway, CHNL/FT_NM_Info_El]:
        ident PNC_06_Basefunction_ComfortLight
      pnc-mapping pnc-identifier=14, wakeup-frame=[CHNL/FT_NM_Info_El, FT_NM_Gateway, CHNL/FT_NM_Info_El]:
        ident PNC_07_Basefunction_CrossSection
      pnc-mapping pnc-identifier=15, wakeup-frame=[CHNL/FT_NM_Info_El, FT_NM_Gateway, CHNL/FT_NM_Info_El]:
        ident PNC_08_Basefunction_Connectivity
      pnc-mapping pnc-identifier=17, wakeup-frame=[CHNL/FT_NM_Info_El, FT_NM_Gateway, CHNL/FT_NM_Info_El]:
        ident PNC_10_Powertrain
      pnc-mapping pnc-identifier=18, wakeup-frame=[CHNL/FT_NM_Info_El, FT_NM_Gateway, CHNL/FT_NM_Info_El]:
        ident PNC_11_Chassis
      pnc-mapping pnc-identifier=19, wakeup-frame=[CHNL/FT_NM_Info_El, FT_NM_Gateway, CHNL/FT_NM_Info_El]:
        ident PNC_12_GearSelector
      pnc-mapping pnc-identifier=20, wakeup-frame=[CHNL/FT_NM_Info_El, FT_NM_Gateway, CHNL/FT_NM_Info_El]:
        ident PNC_13_Airbag
      pnc-mapping pnc-identifier=21, wakeup-frame=[CHNL/FT_NM_Info_El, FT_NM_Gateway, CHNL/FT_NM_Info_El]:
        ident PNC_14_InfotainmentExtensions
      pnc-mapping pnc-identifier=22, wakeup-frame=[CHNL/FT_NM_Info_El, FT_NM_Gateway, CHNL/FT_NM_Info_El]:
        ident PNC_15_InstrumentclusterDisplay
      pnc-mapping pnc-group=HCP3_IONode_XIX_PNC_16_InfotainmentDisplay_Rx, pnc-identifier=23, wakeup-frame=[CHNL/FT_NM_Info_El, FT_NM_Gateway, CHNL/FT_NM_Info_El]:
        ident PNC_16_InfotainmentDisplay
      pnc-mapping pnc-identifier=24, wakeup-frame=[CHNL/FT_NM_Info_El, FT_NM_Gateway, CHNL/FT_NM_Info_El]:
        ident PNC_17_Audio
      pnc-mapping pnc-identifier=25, wakeup-frame=[CHNL/FT_NM_Info_El, FT_NM_Gateway, CHNL/FT_NM_Info_El]:
        ident PNC_18_VirtualSideMirrors
      pnc-mapping pnc-identifier=26, wakeup-frame=[CHNL/FT_NM_Info_El, FT_NM_Gateway, CHNL/FT_NM_Info_El]:
        ident PNC_19_Doors_Hatches
      pnc-mapping pnc-identifier=27, wakeup-frame=[CHNL/FT_NM_Info_El, FT_NM_Gateway, CHNL/FT_NM_Info_El]:
        ident PNC_20_OptionalComfort
      pnc-mapping pnc-identifier=28, wakeup-frame=[CHNL/FT_NM_Info_El, FT_NM_Gateway, CHNL/FT_NM_Info_El]:
        ident PNC_21_AirSuspension
      pnc-mapping pnc-identifier=29, wakeup-frame=[CHNL/FT_NM_Info_El, FT_NM_Gateway, CHNL/FT_NM_Info_El]:
        ident PNC_22_ExteriorLights
      pnc-mapping pnc-identifier=30, wakeup-frame=[CHNL/FT_NM_Info_El, FT_NM_Gateway, CHNL/FT_NM_Info_El]:
        ident PNC_23_Climate
      pnc-mapping pnc-identifier=31, wakeup-frame=[CHNL/FT_NM_Info_El, FT_NM_Gateway, CHNL/FT_NM_Info_El]:
        ident PNC_24_ThermoManagement
      pnc-mapping pnc-identifier=32, wakeup-frame=[CHNL/FT_NM_Info_El, FT_NM_Gateway, CHNL/FT_NM_Info_El]:
        ident PNC_25_AccessSystemSensors
      pnc-mapping pnc-identifier=33, wakeup-frame=[CHNL/FT_NM_Info_El, FT_NM_Gateway, CHNL/FT_NM_Info_El]:
        ident PNC_26_HighVoltage_Charging
      pnc-mapping pnc-identifier=34, wakeup-frame=[CHNL/FT_NM_Info_El, FT_NM_Gateway, CHNL/FT_NM_Info_El]:
        ident PNC_27_Timemaster_Timer
      pnc-mapping pnc-identifier=35, wakeup-frame=[CHNL/FT_NM_Info_El, FT_NM_Gateway, CHNL/FT_NM_Info_El]:
        ident PNC_28_OnboardTester_DataCollector
      pnc-mapping pnc-identifier=36, wakeup-frame=[CHNL/FT_NM_Info_El, FT_NM_Gateway, CHNL/FT_NM_Info_El]:
        ident PNC_29_SteeringColumnLock
      pnc-mapping pnc-identifier=37, wakeup-frame=[CHNL/FT_NM_Info_El, FT_NM_Gateway, CHNL/FT_NM_Info_El]:
        ident PNC_30_EnergyManagement
      pnc-mapping pnc-group=HCP3_IONode_XIX_PNC_31_MultifunctionalSteeringWheel_Rx, pnc-identifier=38, wakeup-frame=[CHNL/FT_NM_Info_El, FT_NM_Gateway, CHNL/FT_NM_Info_El]:
        ident PNC_31_MultifunctionalSteeringWheel
      pnc-mapping pnc-identifier=39, wakeup-frame=[CHNL/FT_NM_Info_El, FT_NM_Gateway, CHNL/FT_NM_Info_El]:
        ident PNC_32_OnlineAccess
      pnc-mapping pnc-identifier=40, wakeup-frame=[CHNL/FT_NM_Info_El, FT_NM_Gateway, CHNL/FT_NM_Info_El]:
        ident PNC_33_ExternalWirelessCommunication
      pnc-mapping pnc-identifier=41, wakeup-frame=[CHNL/FT_NM_Info_El, FT_NM_Gateway, CHNL/FT_NM_Info_El]:
        ident PNC_34_GPS_Lokalization
      pnc-mapping pnc-identifier=42, wakeup-frame=[CHNL/FT_NM_Info_El, FT_NM_Gateway, CHNL/FT_NM_Info_El]:
        ident PNC_35_ExteriorSound
      pnc-mapping pnc-identifier=43, wakeup-frame=[CHNL/FT_NM_Info_El, FT_NM_Gateway, CHNL/FT_NM_Info_El]:
        ident PNC_36_Preheater
      pnc-mapping pnc-identifier=44, wakeup-frame=[CHNL/FT_NM_Info_El, FT_NM_Gateway, CHNL/FT_NM_Info_El]:
        ident PNC_37_HighVoltage_WirelessChargingStation
      pnc-mapping pnc-identifier=47, wakeup-frame=[CHNL/FT_NM_Info_El, FT_NM_Gateway, CHNL/FT_NM_Info_El]:
        ident PNC_40_Diagnosis_Energy
      pnc-mapping pnc-identifier=48, wakeup-frame=[CHNL/FT_NM_Info_El, FT_NM_Gateway, CHNL/FT_NM_Info_El]:
        ident PNC_41_Diagnosis_Powertrain
      pnc-mapping pnc-identifier=49, wakeup-frame=[CHNL/FT_NM_Info_El, FT_NM_Gateway, CHNL/FT_NM_Info_El]:
        ident PNC_42_Diagnosis_FlexRay
      pnc-mapping pnc-identifier=50, wakeup-frame=[CHNL/FT_NM_Info_El, FT_NM_Gateway, CHNL/FT_NM_Info_El]:
        ident PNC_43_Diagnosis_DrivingAssistance
      pnc-mapping pnc-group=HCP3_IONode_XIX_PNC_44_Diagnosis_Infotainment_Rx, pnc-identifier=51, wakeup-frame=[CHNL/FT_NM_Info_El, FT_NM_Gateway, CHNL/FT_NM_Info_El]:
        ident PNC_44_Diagnosis_Infotainment
      pnc-mapping pnc-identifier=52, wakeup-frame=[CHNL/FT_NM_Info_El, FT_NM_Gateway, CHNL/FT_NM_Info_El]:
        ident PNC_45_Diagnosis_Comfort
      pnc-mapping pnc-identifier=53, wakeup-frame=[CHNL/FT_NM_Info_El, FT_NM_Gateway, CHNL/FT_NM_Info_El]:
        ident PNC_46_Diagnosis_Light
      pnc-mapping pnc-identifier=54, wakeup-frame=[CHNL/FT_NM_Info_El, FT_NM_Gateway, CHNL/FT_NM_Info_El]:
        ident PNC_47_Diagnosis_ComfortLINs
      pnc-mapping pnc-identifier=55, wakeup-frame=[CHNL/FT_NM_Info_El, FT_NM_Gateway, CHNL/FT_NM_Info_El]:
        ident PNC_48_Diagnosis_ClimateTmeLINs
      pnc-mapping pnc-identifier=60, wakeup-frame=[CHNL/FT_NM_Info_El, FT_NM_Gateway, CHNL/FT_NM_Info_El]:
        ident PNC_53_Lock_Unlock
      pnc-mapping pnc-identifier=62, wakeup-frame=[CHNL/FT_NM_Info_El, FT_NM_Gateway, CHNL/FT_NM_Info_El]:
        ident PNC_55_Dimming
      pnc-mapping pnc-identifier=63, wakeup-frame=[CHNL/FT_NM_Info_El, FT_NM_Gateway, CHNL/FT_NM_Info_El]:
        ident PNC_56_Charging_Status
      sw-mappings:
        13 x swc to ecu mapping, all with ecu-instance=HCP3_IONode:
          MAPPING_Infrastructure_Info_El_XIX_network_infrastructure_XIX_HCP3_IONode: component=Geltungsbereich_E3_1_2_Premium.Infrastructure_Info_El_XIX_network_infrastructure_XIX_HCP3_IONode
          MAPPING_diagnosis_infrastructure_Info_El_XIX_diagnosis_infrastructure_XIX_HCP3_IONode: component=Geltungsbereich_E3_1_2_Premium.diagnosis_infrastructure_Info_El_XIX_diagnosis_infrastructure_XIX_HCP3_IONode
          MAPPING_PowerManagement_HCP3_IONode_XIX_CockpitInfotainment_Systemfunktionen_XIX_HCP3_IONode: component=Geltungsbereich_E3_1_2_Premium.PowerManagement_HCP3_IONode_XIX_CockpitInfotainment_Systemfunktionen_XIX_HCP3_IONode
          MAPPING_VehicleComm_HCP3_IONode_XIX_CockpitInfotainment_Systemfunktionen_XIX_HCP3_IONode: component=Geltungsbereich_E3_1_2_Premium.VehicleComm_HCP3_IONode_XIX_CockpitInfotainment_Systemfunktionen_XIX_HCP3_IONode
          MAPPING_VNSM3_1_XIX_WUSL_XIX_HCP3_IONode: component=Geltungsbereich_E3_1_2_Premium.VNSM3_1_XIX_WUSL_XIX_HCP3_IONode
          MAPPING_TankAlgorithm_XIX_Tank_XIX_HCP3_IONode: component=Geltungsbereich_E3_1_2_Premium.TankAlgorithm_XIX_Tank_XIX_HCP3_IONode
          MAPPING_Tracing_HCP3_IONode_XIX_CockpitInfotainment_Systemfunktionen_XIX_HCP3_IONode: component=Geltungsbereich_E3_1_2_Premium.Tracing_HCP3_IONode_XIX_CockpitInfotainment_Systemfunktionen_XIX_HCP3_IONode
          MAPPING_WUM_Client3_XIX_WUM_XIX_HCP3_IONode: component=Geltungsbereich_E3_1_2_Premium.WUM_Client3_XIX_WUM_XIX_HCP3_IONode
          MAPPING_FoDSlave_HCP3_XIX_FoD_XIX_HCP3_IONode: component=Geltungsbereich_E3_1_2_Premium.FoDSlave_HCP3_XIX_FoD_XIX_HCP3_IONode
          MAPPING_SOK_Participant_HCP3_IONode_XIX_SOK_XIX_HCP3_IONode: component=Geltungsbereich_E3_1_2_Premium.SOK_Participant_HCP3_IONode_XIX_SOK_XIX_HCP3_IONode
          MAPPING_OTA_Infrastructure_HCP3_XIX_OTAMC_XIX_HCP3_IONode: component=Geltungsbereich_E3_1_2_Premium.OTA_Infrastructure_HCP3_XIX_OTAMC_XIX_HCP3_IONode
          MAPPING_ORU_Infrastructure_Info_El_XIX_ORU6_XIX_HCP3_IONode: component=Geltungsbereich_E3_1_2_Premium.ORU_Infrastructure_Info_El_XIX_ORU6_XIX_HCP3_IONode
          MAPPING_OTA_Infrastructure_Info_El_XIX_RP_XIX_HCP3_IONode: component=Geltungsbereich_E3_1_2_Premium.OTA_Infrastructure_Info_El_XIX_RP_XIX_HCP3_IONode
    root-software-compositions:
      root sw composition prototype Geltungsbereich_E3_1_2_Premium: software-composition=Geltungsbereich_E3_1_2_Premium
package /ECU
  ecu instance HCP3_IONode:  # Cross Domain & Interior & Cockpit DFL-Kürzel: Info_El Zentralrechner Infotainment
    associated-com-i-pdu-group=[HCP3_IONode_XIX_WU_HCP3_CANFD_Tx, HCP3_IONode_XIX_WU_HCP3_CANFD_Rx, HCP3_IONode_XIX_HCP3_CANFD01_Tx, HCP3_IONode_XIX_HCP3_CANFD01_Rx, HCP3_IONode_XIX_VLAN_Cockpit_Tx, HCP3_IONode_XIX_VLAN_Cockpit_Rx, HCP3_IONode_XIX_PNC_01_CarWakeUp_Tx, HCP3_IONode_XIX_PNC_01_CarWakeUp_Rx, HCP3_IONode_XIX_PNC_02_Basefunction_Powertrain_Rx, HCP3_IONode_XIX_PNC_04_Basefunction_DrivingAssistance_Rx, HCP3_IONode_XIX_PNC_05_Basefunction_Infotainment_Tx, HCP3_IONode_XIX_PNC_05_Basefunction_Infotainment_Rx, HCP3_IONode_XIX_PNC_07_Basefunction_CrossSection_Rx, HCP3_IONode_XIX_PNC_06_Basefunction_ComfortLight_Rx, HCP3_IONode_XIX_PNC_10_Powertrain_Rx, HCP3_IONode_XIX_PNC_11_Chassis_Rx, HCP3_IONode_XIX_PNC_15_InstrumentclusterDisplay_Rx, HCP3_IONode_XIX_PNC_16_InfotainmentDisplay_Rx, HCP3_IONode_XIX_PNC_19_Doors_Hatches_Rx, HCP3_IONode_XIX_PNC_23_Climate_Rx, HCP3_IONode_XIX_PNC_30_EnergyManagement_Rx, HCP3_IONode_XIX_PNC_27_Timemaster_Timer_Rx, HCP3_IONode_XIX_PNC_31_MultifunctionalSteeringWheel_Rx, HCP3_IONode_XIX_PNC_08_Basefunction_Connectivity_Rx, HCP3_IONode_XIX_PNC_36_Preheater_Rx, HCP3_IONode_XIX_PNC_44_Diagnosis_Infotainment_Rx]
    diagnostic-address=95
    pn-reset-time=0.5
    pnc-prepare-sleep-timer=0
    sleep-mode-supported=true
    wake-up-over-bus-supported=true
    can communication controller CT_WU_HCP3_CANFD: wake-up-by-controller-supported=true, can-controller-attributes=can-controller-configuration-requirements={can-controller-fd-requirements={max-number-of-time-quanta-per-bit=20, max-sample-point=70.0, max-sync-jump-width=30.0, max-trcv-delay-compensation-offset=7E-08, min-number-of-time-quanta-per-bit=20, min-sample-point=70.0, min-sync-jump-width=30.0, min-trcv-delay-compensation-offset=7E-08, tx-bit-rate-switch=true}, max-number-of-time-quanta-per-bit=80, max-sample-point=80.0, max-sync-jump-width=20.0, min-number-of-time-quanta-per-bit=80, min-sample-point=80.0, min-sync-jump-width=20.0}
    can communication controller CT_HCP3_CANFD01: wake-up-by-controller-supported=true, can-controller-attributes=can-controller-configuration-requirements={can-controller-fd-requirements={max-number-of-time-quanta-per-bit=20, max-sample-point=70.0, max-sync-jump-width=30.0, max-trcv-delay-compensation-offset=7E-08, min-number-of-time-quanta-per-bit=20, min-sample-point=70.0, min-sync-jump-width=30.0, min-trcv-delay-compensation-offset=7E-08, tx-bit-rate-switch=true}, max-number-of-time-quanta-per-bit=40, max-sample-point=80.0, max-sync-jump-width=20.0, min-number-of-time-quanta-per-bit=40, min-sample-point=80.0, min-sync-jump-width=20.0}
    ethernet communication controller CT_VLAN_Cockpit: wake-up-by-controller-supported=true
      coupling port CP_HCP3_IONode_XIX_HCP3_IONode_CPUPort1: connection-negotiation-behavior=SLAVE, physical-layer-type=1000BASE-T1, vlan-membership{send-activity=SENT-TAGGED, vlan=VLAN_Cockpit}
        coupling-port-details last-egress-scheduler=Schedule_HCP3_IONode_CPUPort1_7:
          coupling-port-structural-elements:
            8 x coupling port fifo:
              Fifo_HCP3_IONode_CPUPort1_{0..7}
            8 x coupling port scheduler, all with port-scheduler=STRICT-PRIORITY:
              Schedule_HCP3_IONode_CPUPort1_{0..7}
          8 x ethernet priority regeneration:
            IngressPrio_HCP3_IONode_CPUPort1_{0..7}: ingress-priority={0..7}, regenerated-priority={0..7}
    can communication connector CN_WU_HCP3_CANFD: comm-controller=CT_WU_HCP3_CANFD, pnc-gateway-type=PASSIVE, pnc-wakeup-data-mask=0xFFFFFFFFFFFFFF
    can communication connector CN_HCP3_CANFD01: comm-controller=CT_HCP3_CANFD01, pnc-gateway-type=ACTIVE, pnc-wakeup-data-mask=0xFFFFFFFFFFFFFF
    ethernet communication connector CN_VLAN_Cockpit:
      comm-controller=CT_VLAN_Cockpit
      maximum-transmission-unit=1500
      network-endpoint=[NE_ff14_0000_0000_0000_0000_0000_0000_004b, NE_ff14_0000_0000_0000_0000_0000_0000_003a, NE_ff14_0000_0000_0000_0000_0000_0000_004a, NE_ff14_0000_0000_0000_0000_0000_0000_006f, NE_ff14_0000_0000_0000_0000_0000_0000_004c, NE_ff14_0000_0000_0000_0000_0000_0000_003b, NE_ff14_0000_0000_0000_0000_0000_0000_007f, NE_fd53_7cb8_0383_000e_0000_0000_0000_0073, NE_ff14_0000_0000_0000_0000_0000_0000_002c, NE_ff14_0000_0000_0000_0000_0000_0000_003f, NE_ff14_0000_0000_0000_0000_0000_0000_0064, NE_ff14_0000_0000_0000_0000_0000_0000_0063, NE_ff14_0000_0000_0000_0000_0000_0000_0055, NE_ff14_0000_0000_0000_0000_0000_0000_0065, NE_ff14_0000_0000_0000_0000_0000_0000_0071, NE_ff14_0000_0000_0000_0000_0000_0000_0062, NE_ff14_0000_0000_0000_0000_0000_0000_0051, NE_ff14_0000_0000_0000_0000_0000_0000_0061, NE_ff14_0000_0000_0000_0000_0000_0000_0005, NE_ff14_0000_0000_0000_0000_0000_0000_0069, NE_SDMulticast, NE_SSOAMulticast, NE_ff02_0000_0000_0000_0000_0000_0000_0001]
