[part 11 of 15: package /PDU]
AUTOSAR XML (schema 4-3-0)
package /PDU  (continued)
  pdu SOMEIPTestabilityClient_Methods_echoUInt8_Request_XIX_SomeIP_ServiceProvider_Testability_TestSysIP_Info_El_XIX_VLAN_Cockpit: length=11, transmission-mode-true-timing=event-controlled-timing={number-of-repetitions=0, repetition-period=0.0}, unused-bit-pattern=0
    signal SOMEIPTestabilityClient_Methods_echoUInt8_Request_XIX_SomeIP_ServiceProvider_Testability_TestSysIP_Info_El_XIX_VLAN_Cockpit: start 0, 88 bit, opaque, data-transformations=SOMEIPOnlyTransformerChain, data-type-policy=TRANSFORMING-I-SIGNAL, i-signal-type=ARRAY, someip-transformation-i-signal-props{cs-error-reaction=AUTONOMOUS, transformer=TransformationTechnologySOMEIP, interface-version=1, message-type=REQUEST, size-of-array-length-fields=1, size-of-struct-length-fields=1, size-of-union-length-fields=1}, dynamic-length=true, transfer-property=TRIGGERED  # SOMEIPTestabilityClient Implementierung Dieser Service muss an allen uC ECUs die einen SOMEIP Client implementiert haben (Service Empfänger).
  pdu SOMEIPTestabilityClient_Methods_echoUInt8_Response_XIX_SomeIP_ServiceProvider_Testability_TestSysIP_Info_El_XIX_VLAN_Cockpit: length=11, transmission-mode-true-timing=event-controlled-timing={number-of-repetitions=0, repetition-period=0.0}, unused-bit-pattern=0
    signal SOMEIPTestabilityClient_Methods_echoUInt8_Response_XIX_SomeIP_ServiceProvider_Testability_TestSysIP_Info_El_XIX_VLAN_Cockpit: start 0, 88 bit, opaque, data-transformations=SOMEIPOnlyTransformerChain, data-type-policy=TRANSFORMING-I-SIGNAL, i-signal-type=ARRAY, someip-transformation-i-signal-props{cs-error-reaction=AUTONOMOUS, transformer=TransformationTechnologySOMEIP, interface-version=1, message-type=RESPONSE, size-of-array-length-fields=1, size-of-struct-length-fields=1, size-of-union-length-fields=1}, dynamic-length=true, transfer-property=TRIGGERED, to HCP3_IONode  # SOMEIPTestabilityClient Implementierung Dieser Service muss an allen uC ECUs die einen SOMEIP Client implementiert haben (Service Empfänger).
  pdu SOMEIPTestabilityClient_Methods_echoUInt8UInt16UInt32_Request_XIX_SomeIP_ServiceProvider_Testab_65F6305093B81CAD3D38CF0A1637314A: length=21, transmission-mode-true-timing=event-controlled-timing={number-of-repetitions=0, repetition-period=0.0}, unused-bit-pattern=0  # SOMEIPTestabilityClient_Methods_echoUInt8UInt16UInt32_Request_XIX_SomeIP_ServiceProvider_Testability_TestSysIP_Info_El_XIX_VLAN_Cockpit
    signal SOMEIPTestabilityClient_Methods_echoUInt8UInt16UInt32_Request_XIX_SomeIP_ServiceProvider_Testab_65F6305093B81CAD3D38CF0A1637314A: start 0, 168 bit, opaque, data-transformations=SOMEIPOnlyTransformerChain, data-type-policy=TRANSFORMING-I-SIGNAL, i-signal-type=ARRAY, someip-transformation-i-signal-props{cs-error-reaction=AUTONOMOUS, transformer=TransformationTechnologySOMEIP, interface-version=1, message-type=REQUEST, size-of-array-length-fields=1, size-of-struct-length-fields=1, size-of-union-length-fields=1}, dynamic-length=true, transfer-property=TRIGGERED  # SOMEIPTestabilityClient_Methods_echoUInt8UInt16UInt32_Request_XIX_SomeIP_ServiceProvider_Testability_TestSysIP_Info_El_XIX_VLAN_Cockpit  # SOMEIPTestabilityClient Implementierung Dieser Service muss an allen uC ECUs die einen SOMEIP Client implementiert haben (Service Empfänger).
  pdu SOMEIPTestabilityClient_Methods_echoUInt8UInt16UInt32_Response_XIX_SomeIP_ServiceProvider_Testa_F130EBE8645A8C8B63C32950E8FD95F1: length=21, transmission-mode-true-timing=event-controlled-timing={number-of-repetitions=0, repetition-period=0.0}, unused-bit-pattern=0  # SOMEIPTestabilityClient_Methods_echoUInt8UInt16UInt32_Response_XIX_SomeIP_ServiceProvider_Testability_TestSysIP_Info_El_XIX_VLAN_Cockpit
    signal SOMEIPTestabilityClient_Methods_echoUInt8UInt16UInt32_Response_XIX_SomeIP_ServiceProvider_Testa_F130EBE8645A8C8B63C32950E8FD95F1: start 0, 168 bit, opaque, data-transformations=SOMEIPOnlyTransformerChain, data-type-policy=TRANSFORMING-I-SIGNAL, i-signal-type=ARRAY, someip-transformation-i-signal-props{cs-error-reaction=AUTONOMOUS, transformer=TransformationTechnologySOMEIP, interface-version=1, message-type=RESPONSE, size-of-array-length-fields=1, size-of-struct-length-fields=1, size-of-union-length-fields=1}, dynamic-length=true, transfer-property=TRIGGERED, to HCP3_IONode  # SOMEIPTestabilityClient_Methods_echoUInt8UInt16UInt32_Response_XIX_SomeIP_ServiceProvider_Testability_TestSysIP_Info_El_XIX_VLAN_Cockpit  # SOMEIPTestabilityClient Implementierung Dieser Service muss an allen uC ECUs die einen SOMEIP Client implementiert haben (Service Empfänger).
  pdu SOMEIPTestabilityClient_MethodsGet_TestFieldUInt8_Request_XIX_SomeIP_ServiceProvider_Testabilit_774024A6124BD6528741A00398ABA277: length=8, transmission-mode-true-timing=event-controlled-timing={number-of-repetitions=0, repetition-period=0.0}, unused-bit-pattern=0  # SOMEIPTestabilityClient_MethodsGet_TestFieldUInt8_Request_XIX_SomeIP_ServiceProvider_Testability_TestSysIP_Info_El_XIX_VLAN_Cockpit
    signal SOMEIPTestabilityClient_MethodsGet_TestFieldUInt8_Request_XIX_SomeIP_ServiceProvider_Testabilit_774024A6124BD6528741A00398ABA277: start 0, 64 bit, opaque, data-transformations=SOMEIPOnlyTransformerChain, data-type-policy=TRANSFORMING-I-SIGNAL, i-signal-type=ARRAY, someip-transformation-i-signal-props{cs-error-reaction=AUTONOMOUS, transformer=TransformationTechnologySOMEIP, interface-version=1, message-type=REQUEST}, dynamic-length=true, transfer-property=TRIGGERED  # SOMEIPTestabilityClient_MethodsGet_TestFieldUInt8_Request_XIX_SomeIP_ServiceProvider_Testability_TestSysIP_Info_El_XIX_VLAN_Cockpit  # SOMEIPTestabilityClient Implementierung Dieser Service muss an allen uC ECUs die einen SOMEIP Client implementiert haben (Service Empfänger).
  pdu SOMEIPTestabilityClient_MethodsGet_TestFieldUInt8_Response_XIX_SomeIP_ServiceProvider_Testabili_6F3892C45E71BA79D69AA01185614DF6: length=9, transmission-mode-true-timing=event-controlled-timing={number-of-repetitions=0, repetition-period=0.0}, unused-bit-pattern=0  # SOMEIPTestabilityClient_MethodsGet_TestFieldUInt8_Response_XIX_SomeIP_ServiceProvider_Testability_TestSysIP_Info_El_XIX_VLAN_Cockpit
    signal SOMEIPTestabilityClient_MethodsGet_TestFieldUInt8_Response_XIX_SomeIP_ServiceProvider_Testabili_6F3892C45E71BA79D69AA01185614DF6: start 0, 72 bit, opaque, data-transformations=SOMEIPOnlyTransformerChain, data-type-policy=TRANSFORMING-I-SIGNAL, i-signal-type=ARRAY, someip-transformation-i-signal-props{cs-error-reaction=AUTONOMOUS, transformer=TransformationTechnologySOMEIP, interface-version=1, message-type=RESPONSE}, dynamic-length=true, transfer-property=TRIGGERED, to HCP3_IONode  # SOMEIPTestabilityClient_MethodsGet_TestFieldUInt8_Response_XIX_SomeIP_ServiceProvider_Testability_TestSysIP_Info_El_XIX_VLAN_Cockpit  # SOMEIPTestabilityClient Implementierung Dieser Service muss an allen uC ECUs die einen SOMEIP Client implementiert haben (Service Empfänger).
  pdu SOMEIPTestabilityClient_MethodsSet_TestFieldUInt8_Request_XIX_SomeIP_ServiceProvider_Testabilit_F141CC37CD94C1CB5D7BF6F6989D75BD: length=9, transmission-mode-true-timing=event-controlled-timing={number-of-repetitions=0, repetition-period=0.0}, unused-bit-pattern=0  # SOMEIPTestabilityClient_MethodsSet_TestFieldUInt8_Request_XIX_SomeIP_ServiceProvider_Testability_TestSysIP_Info_El_XIX_VLAN_Cockpit
    signal SOMEIPTestabilityClient_MethodsSet_TestFieldUInt8_Request_XIX_SomeIP_ServiceProvider_Testabilit_F141CC37CD94C1CB5D7BF6F6989D75BD: start 0, 72 bit, opaque, data-transformations=SOMEIPOnlyTransformerChain, data-type-policy=TRANSFORMING-I-SIGNAL, i-signal-type=ARRAY, someip-transformation-i-signal-props{cs-error-reaction=AUTONOMOUS, transformer=TransformationTechnologySOMEIP, interface-version=1, message-type=REQUEST}, dynamic-length=true, transfer-property=TRIGGERED  # SOMEIPTestabilityClient_MethodsSet_TestFieldUInt8_Request_XIX_SomeIP_ServiceProvider_Testability_TestSysIP_Info_El_XIX_VLAN_Cockpit  # SOMEIPTestabilityClient Implementierung Dieser Service muss an allen uC ECUs die einen SOMEIP Client implementiert haben (Service Empfänger).
  pdu SOMEIPTestabilityClient_MethodsSet_TestFieldUInt8_Response_XIX_SomeIP_ServiceProvider_Testabili_3796B9B168685FBB71A6262D54431B54: length=9, transmission-mode-true-timing=event-controlled-timing={number-of-repetitions=0, repetition-period=0.0}, unused-bit-pattern=0  # SOMEIPTestabilityClient_MethodsSet_TestFieldUInt8_Response_XIX_SomeIP_ServiceProvider_Testability_TestSysIP_Info_El_XIX_VLAN_Cockpit
    signal SOMEIPTestabilityClient_MethodsSet_TestFieldUInt8_Response_XIX_SomeIP_ServiceProvider_Testabili_3796B9B168685FBB71A6262D54431B54: start 0, 72 bit, opaque, data-transformations=SOMEIPOnlyTransformerChain, data-type-policy=TRANSFORMING-I-SIGNAL, i-signal-type=ARRAY, someip-transformation-i-signal-props{cs-error-reaction=AUTONOMOUS, transformer=TransformationTechnologySOMEIP, interface-version=1, message-type=RESPONSE}, dynamic-length=true, transfer-property=TRIGGERED, to HCP3_IONode  # SOMEIPTestabilityClient_MethodsSet_TestFieldUInt8_Response_XIX_SomeIP_ServiceProvider_Testability_TestSysIP_Info_El_XIX_VLAN_Cockpit  # SOMEIPTestabilityClient Implementierung Dieser Service muss an allen uC ECUs die einen SOMEIP Client implementiert haben (Service Empfänger).
  pdu SOMEIPTestabilityClient_RnRMethods_noResponseUInt8_XIX_SomeIP_ServiceProvider_Testability_TestSysIP_Info_El_XIX_VLAN_Cockpit: length=9, transmission-mode-true-timing=event-controlled-timing={number-of-repetitions=0, repetition-period=0.0}, unused-bit-pattern=0
    signal SOMEIPTestabilityClient_RnRMethods_noResponseUInt8_XIX_SomeIP_ServiceProvider_Testability_TestSysIP_Info_El_XIX_VLAN_Cockpit: start 0, 72 bit, opaque, data-transformations=SOMEIPOnlyTransformerChain, data-type-policy=TRANSFORMING-I-SIGNAL, i-signal-type=ARRAY, someip-transformation-i-signal-props{transformer=TransformationTechnologySOMEIP, interface-version=1, message-type=REQUEST-NO-RETURN, size-of-array-length-fields=1, size-of-struct-length-fields=1, size-of-union-length-fields=1}, dynamic-length=true, transfer-property=TRIGGERED  # SOMEIPTestabilityClient Implementierung Dieser Service muss an allen uC ECUs die einen SOMEIP Client implementiert haben (Service Empfänger).
  pdu SOMEIPTestabilityClient_RnRMethods_rnrEchoComplexDynamicArray_XIX_SomeIP_ServiceProvider_Testab_19E4CC73C2D5EF5F86A76E798A9DFB06: length=49, transmission-mode-true-timing=event-controlled-timing={number-of-repetitions=0, repetition-period=0.0}, unused-bit-pattern=0  # SOMEIPTestabilityClient_RnRMethods_rnrEchoComplexDynamicArray_XIX_SomeIP_ServiceProvider_Testability_TestSysIP_Info_El_XIX_VLAN_Cockpit
    signal SOMEIPTestabilityClient_RnRMethods_rnrEchoComplexDynamicArray_XIX_SomeIP_ServiceProvider_Testab_19E4CC73C2D5EF5F86A76E798A9DFB06: start 0, 392 bit, opaque, data-transformations=SOMEIPOnlyTransformerChain, data-type-policy=TRANSFORMING-I-SIGNAL, i-signal-type=ARRAY, someip-transformation-i-signal-props{transformer=TransformationTechnologySOMEIP, interface-version=1, message-type=REQUEST-NO-RETURN, size-of-array-length-fields=1, size-of-struct-length-fields=1, size-of-union-length-fields=1}, dynamic-length=true, transfer-property=TRIGGERED  # SOMEIPTestabilityClient_RnRMethods_rnrEchoComplexDynamicArray_XIX_SomeIP_ServiceProvider_Testability_TestSysIP_Info_El_XIX_VLAN_Cockpit  # SOMEIPTestabilityClient Implementierung Dieser Service muss an allen uC ECUs die einen SOMEIP Client implementiert haben (Service Empfänger).
  pdu SOMEIPTestabilityClient_RnRMethods_rnrEchoComplexStruct_XIX_SomeIP_ServiceProvider_Testability_B845B48FBA5A8201DBD37C907E043B16: length=87, transmission-mode-true-timing=event-controlled-timing={number-of-repetitions=0, repetition-period=0.0}, unused-bit-pattern=0  # SOMEIPTestabilityClient_RnRMethods_rnrEchoComplexStruct_XIX_SomeIP_ServiceProvider_Testability_TestSysIP_Info_El_XIX_VLAN_Cockpit
    signal SOMEIPTestabilityClient_RnRMethods_rnrEchoComplexStruct_XIX_SomeIP_ServiceProvider_Testability_B845B48FBA5A8201DBD37C907E043B16: start 0, 696 bit, opaque, data-transformations=SOMEIPOnlyTransformerChain, data-type-policy=TRANSFORMING-I-SIGNAL, i-signal-type=ARRAY, someip-transformation-i-signal-props{transformer=TransformationTechnologySOMEIP, interface-version=1, message-type=REQUEST-NO-RETURN, size-of-array-length-fields=1, size-of-struct-length-fields=1, size-of-union-length-fields=1}, dynamic-length=true, transfer-property=TRIGGERED  # SOMEIPTestabilityClient_RnRMethods_rnrEchoComplexStruct_XIX_SomeIP_ServiceProvider_Testability_TestSysIP_Info_El_XIX_VLAN_Cockpit  # SOMEIPTestabilityClient Implementierung Dieser Service muss an allen uC ECUs die einen SOMEIP Client implementiert haben (Service Empfänger).
  pdu SOMEIPTestabilityClient_RnRMethods_rnrEchoFloat32_XIX_SomeIP_ServiceProvider_Testability_TestSysIP_Info_El_XIX_VLAN_Cockpit: length=12, transmission-mode-true-timing=event-controlled-timing={number-of-repetitions=0, repetition-period=0.0}, unused-bit-pattern=0
    signal SOMEIPTestabilityClient_RnRMethods_rnrEchoFloat32_XIX_SomeIP_ServiceProvider_Testability_TestSysIP_Info_El_XIX_VLAN_Cockpit: start 0, 96 bit, opaque, data-transformations=SOMEIPOnlyTransformerChain, data-type-policy=TRANSFORMING-I-SIGNAL, i-signal-type=ARRAY, someip-transformation-i-signal-props{transformer=TransformationTechnologySOMEIP, interface-version=1, message-type=REQUEST-NO-RETURN, size-of-array-length-fields=1, size-of-struct-length-fields=1, size-of-union-length-fields=1}, dynamic-length=true, transfer-property=TRIGGERED  # SOMEIPTestabilityClient Implementierung Dieser Service muss an allen uC ECUs die einen SOMEIP Client implementiert haben (Service Empfänger).
  pdu SOMEIPTestabilityClient_RnRMethods_rnrEchoUInt8UInt16UInt32_XIX_SomeIP_ServiceProvider_Testabil_227449E5AB814CE5EDD5836CB7A76091: length=22, transmission-mode-true-timing=event-controlled-timing={number-of-repetitions=0, repetition-period=0.0}, unused-bit-pattern=0  # SOMEIPTestabilityClient_RnRMethods_rnrEchoUInt8UInt16UInt32_XIX_SomeIP_ServiceProvider_Testability_TestSysIP_Info_El_XIX_VLAN_Cockpit
    signal SOMEIPTestabilityClient_RnRMethods_rnrEchoUInt8UInt16UInt32_XIX_SomeIP_ServiceProvider_Testabil_227449E5AB814CE5EDD5836CB7A76091: start 0, 176 bit, opaque, data-transformations=SOMEIPOnlyTransformerChain, data-type-policy=TRANSFORMING-I-SIGNAL, i-signal-type=ARRAY, someip-transformation-i-signal-props{transformer=TransformationTechnologySOMEIP, interface-version=1, message-type=REQUEST-NO-RETURN, size-of-array-length-fields=1, size-of-struct-length-fields=1, size-of-union-length-fields=1}, dynamic-length=true, transfer-property=TRIGGERED  # SOMEIPTestabilityClient_RnRMethods_rnrEchoUInt8UInt16UInt32_XIX_SomeIP_ServiceProvider_Testability_TestSysIP_Info_El_XIX_VLAN_Cockpit  # SOMEIPTestabilityClient Implementierung Dieser Service muss an allen uC ECUs die einen SOMEIP Client implementiert haben (Service Empfänger).
  pdu SOMEIPTestabilityReliable_Events_testEventUInt8: length=9, transmission-mode-true-timing=event-controlled-timing={number-of-repetitions=0, repetition-period=0.0}, unused-bit-pattern=0
    signal SOMEIPTestabilityReliable_Events_testEventUInt8: start 0, 72 bit, opaque, data-transformations=SOMEIPOnlyTransformerChain, data-type-policy=TRANSFORMING-I-SIGNAL, i-signal-type=ARRAY, someip-transformation-i-signal-props{transformer=TransformationTechnologySOMEIP, interface-version=1, message-type=NOTIFICATION}, dynamic-length=true, transfer-property=TRIGGERED
  pdu SOMEIPTestabilityReliable_Events_TestFieldComplexStruct: length=87, transmission-mode-true-timing=event-controlled-timing={number-of-repetitions=0, repetition-period=0.0}, unused-bit-pattern=0
    signal SOMEIPTestabilityReliable_Events_TestFieldComplexStruct: start 0, 696 bit, opaque, data-transformations=SOMEIPOnlyTransformerChain, data-type-policy=TRANSFORMING-I-SIGNAL, i-signal-type=ARRAY, someip-transformation-i-signal-props{transformer=TransformationTechnologySOMEIP, interface-version=1, message-type=NOTIFICATION, size-of-array-length-fields=1, size-of-struct-length-fields=1, size-of-union-length-fields=1}, dynamic-length=true, transfer-property=TRIGGERED
  pdu SOMEIPTestabilityReliable_Events_TestFieldUInt64: length=16, transmission-mode-true-timing=event-controlled-timing={number-of-repetitions=0, repetition-period=0.0}, unused-bit-pattern=0
    signal SOMEIPTestabilityReliable_Events_TestFieldUInt64: start 0, 128 bit, opaque, data-transformations=SOMEIPOnlyTransformerChain, data-type-policy=TRANSFORMING-I-SIGNAL, i-signal-type=ARRAY, someip-transformation-i-signal-props{transformer=TransformationTechnologySOMEIP, interface-version=1, message-type=NOTIFICATION}, dynamic-length=true, transfer-property=TRIGGERED
  pdu SOMEIPTestabilityReliable_Events_TestFieldUInt8: length=9, transmission-mode-true-timing=event-controlled-timing={number-of-repetitions=0, repetition-period=0.0}, unused-bit-pattern=0
    signal SOMEIPTestabilityReliable_Events_TestFieldUInt8: start 0, 72 bit, opaque, data-transformations=SOMEIPOnlyTransformerChain, data-type-policy=TRANSFORMING-I-SIGNAL, i-signal-type=ARRAY, someip-transformation-i-signal-props{transformer=TransformationTechnologySOMEIP, interface-version=1, message-type=NOTIFICATION}, dynamic-length=true, transfer-property=TRIGGERED
  pdu SOMEIPTestabilityReliable_Methods_activateTsClient_Request_XIX_TCPServer_SomeIP_Testability_Info_El_TestSysIP_XIX_VLAN_Cockpit: length=14, transmission-mode-true-timing=event-controlled-timing={number-of-repetitions=0, repetition-period=0.0}, unused-bit-pattern=0
    signal SOMEIPTestabilityReliable_Methods_activateTsClient_Request_XIX_TCPServer_SomeIP_Testability_Info_El_TestSysIP_XIX_VLAN_Cockpit: start 0, 112 bit, opaque, data-transformations=SOMEIPOnlyTransformerChain, data-type-policy=TRANSFORMING-I-SIGNAL, i-signal-type=ARRAY, someip-transformation-i-signal-props{cs-error-reaction=AUTONOMOUS, transformer=TransformationTechnologySOMEIP, interface-version=1, message-type=REQUEST, size-of-array-length-fields=1, size-of-struct-length-fields=1, size-of-union-length-fields=1}, dynamic-length=true, transfer-property=TRIGGERED, to HCP3_IONode
  pdu SOMEIPTestabilityReliable_Methods_activateTsClient_Response_XIX_TCPServer_SomeIP_Testability_Info_El_TestSysIP_XIX_VLAN_Cockpit: length=8, transmission-mode-true-timing=event-controlled-timing={number-of-repetitions=0, repetition-period=0.0}, unused-bit-pattern=0
    signal SOMEIPTestabilityReliable_Methods_activateTsClient_Response_XIX_TCPServer_SomeIP_Testability_Info_El_TestSysIP_XIX_VLAN_Cockpit: start 0, 64 bit, opaque, data-transformations=SOMEIPOnlyTransformerChain, data-type-policy=TRANSFORMING-I-SIGNAL, i-signal-type=ARRAY, someip-transformation-i-signal-props{cs-error-reaction=AUTONOMOUS, transformer=TransformationTechnologySOMEIP, interface-version=1, message-type=RESPONSE, size-of-array-length-fields=1, size-of-struct-length-fields=1, size-of-union-length-fields=1}, dynamic-length=true, transfer-property=TRIGGERED
  pdu SOMEIPTestabilityReliable_Methods_checkByteOrder_Request_XIX_TCPServer_SomeIP_Testability_Info_El_TestSysIP_XIX_VLAN_Cockpit: length=21, transmission-mode-true-timing=event-controlled-timing={number-of-repetitions=0, repetition-period=0.0}, unused-bit-pattern=0
    signal SOMEIPTestabilityReliable_Methods_checkByteOrder_Request_XIX_TCPServer_SomeIP_Testability_Info_El_TestSysIP_XIX_VLAN_Cockpit: start 0, 168 bit, opaque, data-transformations=SOMEIPOnlyTransformerChain, data-type-policy=TRANSFORMING-I-SIGNAL, i-signal-type=ARRAY, someip-transformation-i-signal-props{cs-error-reaction=AUTONOMOUS, transformer=TransformationTechnologySOMEIP, interface-version=1, message-type=REQUEST, size-of-array-length-fields=1, size-of-struct-length-fields=1, size-of-union-length-fields=1}, dynamic-length=true, transfer-property=TRIGGERED, to HCP3_IONode
  pdu SOMEIPTestabilityReliable_Methods_checkByteOrder_Response_XIX_TCPServer_SomeIP_Testability_Info_El_TestSysIP_XIX_VLAN_Cockpit: length=18, transmission-mode-true-timing=event-controlled-timing={number-of-repetitions=0, repetition-period=0.0}, unused-bit-pattern=0
    signal SOMEIPTestabilityReliable_Methods_checkByteOrder_Response_XIX_TCPServer_SomeIP_Testability_Info_El_TestSysIP_XIX_VLAN_Cockpit: start 0, 144 bit, opaque, data-transformations=SOMEIPOnlyTransformerChain, data-type-policy=TRANSFORMING-I-SIGNAL, i-signal-type=ARRAY, someip-transformation-i-signal-props{cs-error-reaction=AUTONOMOUS, transformer=TransformationTechnologySOMEIP, interface-version=1, message-type=RESPONSE, size-of-array-length-fields=1, size-of-struct-length-fields=1, size-of-union-length-fields=1}, dynamic-length=true, transfer-property=TRIGGERED
  pdu SOMEIPTestabilityReliable_Methods_deactivateTsClient_Request_XIX_TCPServer_SomeIP_Testability_Info_El_TestSysIP_XIX_VLAN_Cockpit: length=14, transmission-mode-true-timing=event-controlled-timing={number-of-repetitions=0, repetition-period=0.0}, unused-bit-pattern=0
    signal SOMEIPTestabilityReliable_Methods_deactivateTsClient_Request_XIX_TCPServer_SomeIP_Testability_Info_El_TestSysIP_XIX_VLAN_Cockpit: start 0, 112 bit, opaque, data-transformations=SOMEIPOnlyTransformerChain, data-type-policy=TRANSFORMING-I-SIGNAL, i-signal-type=ARRAY, someip-transformation-i-signal-props{cs-error-reaction=AUTONOMOUS, transformer=TransformationTechnologySOMEIP, interface-version=1, message-type=REQUEST, size-of-array-length-fields=1, size-of-struct-length-fields=1, size-of-union-length-fields=1}, dynamic-length=true, transfer-property=TRIGGERED, to HCP3_IONode
  pdu SOMEIPTestabilityReliable_Methods_deactivateTsClient_Response_XIX_TCPServer_SomeIP_Testability_B089AA1EA4E40519D5795365FA65B779: length=8, transmission-mode-true-timing=event-controlled-timing={number-of-repetitions=0, repetition-period=0.0}, unused-bit-pattern=0  # SOMEIPTestabilityReliable_Methods_deactivateTsClient_Response_XIX_TCPServer_SomeIP_Testability_Info_El_TestSysIP_XIX_VLAN_Cockpit
    signal SOMEIPTestabilityReliable_Methods_deactivateTsClient_Response_XIX_TCPServer_SomeIP_Testability_B089AA1EA4E40519D5795365FA65B779: start 0, 64 bit, opaque, data-transformations=SOMEIPOnlyTransformerChain, data-type-policy=TRANSFORMING-I-SIGNAL, i-signal-type=ARRAY, someip-transformation-i-signal-props{cs-error-reaction=AUTONOMOUS, transformer=TransformationTechnologySOMEIP, interface-version=1, message-type=RESPONSE, size-of-array-length-fields=1, size-of-struct-length-fields=1, size-of-union-length-fields=1}, dynamic-length=true, transfer-property=TRIGGERED  # SOMEIPTestabilityReliable_Methods_deactivateTsClient_Response_XIX_TCPServer_SomeIP_Testability_Info_El_TestSysIP_XIX_VLAN_Cockpit
  pdu SOMEIPTestabilityReliable_Methods_echoBool_Request_XIX_TCPServer_SomeIP_Testability_Info_El_TestSysIP_XIX_VLAN_Cockpit: length=11, transmission-mode-true-timing=event-controlled-timing={number-of-repetitions=0, repetition-period=0.0}, unused-bit-pattern=0
    signal SOMEIPTestabilityReliable_Methods_echoBool_Request_XIX_TCPServer_SomeIP_Testability_Info_El_TestSysIP_XIX_VLAN_Cockpit: start 0, 88 bit, opaque, data-transformations=SOMEIPOnlyTransformerChain, data-type-policy=TRANSFORMING-I-SIGNAL, i-signal-type=ARRAY, someip-transformation-i-signal-props{cs-error-reaction=AUTONOMOUS, transformer=TransformationTechnologySOMEIP, interface-version=1, message-type=REQUEST, size-of-array-length-fields=1, size-of-struct-length-fields=1, size-of-union-length-fields=1}, dynamic-length=true, transfer-property=TRIGGERED, to HCP3_IONode
  pdu SOMEIPTestabilityReliable_Methods_echoBool_Response_XIX_TCPServer_SomeIP_Testability_Info_El_TestSysIP_XIX_VLAN_Cockpit: length=11, transmission-mode-true-timing=event-controlled-timing={number-of-repetitions=0, repetition-period=0.0}, unused-bit-pattern=0
    signal SOMEIPTestabilityReliable_Methods_echoBool_Response_XIX_TCPServer_SomeIP_Testability_Info_El_TestSysIP_XIX_VLAN_Cockpit: start 0, 88 bit, opaque, data-transformations=SOMEIPOnlyTransformerChain, data-type-policy=TRANSFORMING-I-SIGNAL, i-signal-type=ARRAY, someip-transformation-i-signal-props{cs-error-reaction=AUTONOMOUS, transformer=TransformationTechnologySOMEIP, interface-version=1, message-type=RESPONSE, size-of-array-length-fields=1, size-of-struct-length-fields=1, size-of-union-length-fields=1}, dynamic-length=true, transfer-property=TRIGGERED
  pdu SOMEIPTestabilityReliable_Methods_echoComplexDynamicArray_Request_XIX_TCPServer_SomeIP_Testabil_5C81E8A88956CADC3224246876A9A0C1: length=51, transmission-mode-true-timing=event-controlled-timing={number-of-repetitions=0, repetition-period=0.0}, unused-bit-pattern=0  # SOMEIPTestabilityReliable_Methods_echoComplexDynamicArray_Request_XIX_TCPServer_SomeIP_Testability_Info_El_TestSysIP_XIX_VLAN_Cockpit
    signal SOMEIPTestabilityReliable_Methods_echoComplexDynamicArray_Request_XIX_TCPServer_SomeIP_Testabil_5C81E8A88956CADC3224246876A9A0C1: start 0, 408 bit, opaque, data-transformations=SOMEIPOnlyTransformerChain, data-type-policy=TRANSFORMING-I-SIGNAL, i-signal-type=ARRAY, someip-transformation-i-signal-props{cs-error-reaction=AUTONOMOUS, transformer=TransformationTechnologySOMEIP, interface-version=1, message-type=REQUEST, size-of-array-length-fields=1, size-of-struct-length-fields=1, size-of-union-length-fields=1}, dynamic-length=true, transfer-property=TRIGGERED, to HCP3_IONode  # SOMEIPTestabilityReliable_Methods_echoComplexDynamicArray_Request_XIX_TCPServer_SomeIP_Testability_Info_El_TestSysIP_XIX_VLAN_Cockpit
  pdu SOMEIPTestabilityReliable_Methods_echoComplexDynamicArray_Response_XIX_TCPServer_SomeIP_Testabi_D2162A0B62BA000ECE607E0E1322ED57: length=51, transmission-mode-true-timing=event-controlled-timing={number-of-repetitions=0, repetition-period=0.0}, unused-bit-pattern=0  # SOMEIPTestabilityReliable_Methods_echoComplexDynamicArray_Response_XIX_TCPServer_SomeIP_Testability_Info_El_TestSysIP_XIX_VLAN_Cockpit
    signal SOMEIPTestabilityReliable_Methods_echoComplexDynamicArray_Response_XIX_TCPServer_SomeIP_Testabi_D2162A0B62BA000ECE607E0E1322ED57: start 0, 408 bit, opaque, data-transformations=SOMEIPOnlyTransformerChain, data-type-policy=TRANSFORMING-I-SIGNAL, i-signal-type=ARRAY, someip-transformation-i-signal-props{cs-error-reaction=AUTONOMOUS, transformer=TransformationTechnologySOMEIP, interface-version=1, message-type=RESPONSE, size-of-array-length-fields=1, size-of-struct-length-fields=1, size-of-union-length-fields=1}, dynamic-length=true, transfer-property=TRIGGERED  # SOMEIPTestabilityReliable_Methods_echoComplexDynamicArray_Response_XIX_TCPServer_SomeIP_Testability_Info_El_TestSysIP_XIX_VLAN_Cockpit
  pdu SOMEIPTestabilityReliable_Methods_echoComplexStruct_Request_XIX_TCPServer_SomeIP_Testability_Info_El_TestSysIP_XIX_VLAN_Cockpit: length=89, transmission-mode-true-timing=event-controlled-timing={number-of-repetitions=0, repetition-period=0.0}, unused-bit-pattern=0
    signal SOMEIPTestabilityReliable_Methods_echoComplexStruct_Request_XIX_TCPServer_SomeIP_Testability_Info_El_TestSysIP_XIX_VLAN_Cockpit: start 0, 712 bit, opaque, data-transformations=SOMEIPOnlyTransformerChain, data-type-policy=TRANSFORMING-I-SIGNAL, i-signal-type=ARRAY, someip-transformation-i-signal-props{cs-error-reaction=AUTONOMOUS, transformer=TransformationTechnologySOMEIP, interface-version=1, message-type=REQUEST, size-of-array-length-fields=1, size-of-struct-length-fields=1, size-of-union-length-fields=1}, dynamic-length=true, transfer-property=TRIGGERED, to HCP3_IONode
  pdu SOMEIPTestabilityReliable_Methods_echoComplexStruct_Response_XIX_TCPServer_SomeIP_Testability_Info_El_TestSysIP_XIX_VLAN_Cockpit: length=89, transmission-mode-true-timing=event-controlled-timing={number-of-repetitions=0, repetition-period=0.0}, unused-bit-pattern=0
    signal SOMEIPTestabilityReliable_Methods_echoComplexStruct_Response_XIX_TCPServer_SomeIP_Testability_Info_El_TestSysIP_XIX_VLAN_Cockpit: start 0, 712 bit, opaque, data-transformations=SOMEIPOnlyTransformerChain, data-type-policy=TRANSFORMING-I-SIGNAL, i-signal-type=ARRAY, someip-transformation-i-signal-props{cs-error-reaction=AUTONOMOUS, transformer=TransformationTechnologySOMEIP, interface-version=1, message-type=RESPONSE, size-of-array-length-fields=1, size-of-struct-length-fields=1, size-of-union-length-fields=1}, dynamic-length=true, transfer-property=TRIGGERED
  pdu SOMEIPTestabilityReliable_Methods_echoFloat32_Request_XIX_TCPServer_SomeIP_Testability_Info_El_TestSysIP_XIX_VLAN_Cockpit: length=14, transmission-mode-true-timing=event-controlled-timing={number-of-repetitions=0, repetition-period=0.0}, unused-bit-pattern=0
    signal SOMEIPTestabilityReliable_Methods_echoFloat32_Request_XIX_TCPServer_SomeIP_Testability_Info_El_TestSysIP_XIX_VLAN_Cockpit: start 0, 112 bit, opaque, data-transformations=SOMEIPOnlyTransformerChain, data-type-policy=TRANSFORMING-I-SIGNAL, i-signal-type=ARRAY, someip-transformation-i-signal-props{cs-error-reaction=AUTONOMOUS, transformer=TransformationTechnologySOMEIP, interface-version=1, message-type=REQUEST, size-of-array-length-fields=1, size-of-struct-length-fields=1, size-of-union-length-fields=1}, dynamic-length=true, transfer-property=TRIGGERED, to HCP3_IONode
  pdu SOMEIPTestabilityReliable_Methods_echoFloat32_Response_XIX_TCPServer_SomeIP_Testability_Info_El_TestSysIP_XIX_VLAN_Cockpit: length=14, transmission-mode-true-timing=event-controlled-timing={number-of-repetitions=0, repetition-period=0.0}, unused-bit-pattern=0
    signal SOMEIPTestabilityReliable_Methods_echoFloat32_Response_XIX_TCPServer_SomeIP_Testability_Info_El_TestSysIP_XIX_VLAN_Cockpit: start 0, 112 bit, opaque, data-transformations=SOMEIPOnlyTransformerChain, data-type-policy=TRANSFORMING-I-SIGNAL, i-signal-type=ARRAY, someip-transformation-i-signal-props{cs-error-reaction=AUTONOMOUS, transformer=TransformationTechnologySOMEIP, interface-version=1, message-type=RESPONSE, size-of-array-length-fields=1, size-of-struct-length-fields=1, size-of-union-length-fields=1}, dynamic-length=true, transfer-property=TRIGGERED
  pdu SOMEIPTestabilityReliable_Methods_echoFloat64_Request_XIX_TCPServer_SomeIP_Testability_Info_El_TestSysIP_XIX_VLAN_Cockpit: length=18, transmission-mode-true-timing=event-controlled-timing={number-of-repetitions=0, repetition-period=0.0}, unused-bit-pattern=0
    signal SOMEIPTestabilityReliable_Methods_echoFloat64_Request_XIX_TCPServer_SomeIP_Testability_Info_El_TestSysIP_XIX_VLAN_Cockpit: start 0, 144 bit, opaque, data-transformations=SOMEIPOnlyTransformerChain, data-type-policy=TRANSFORMING-I-SIGNAL, i-signal-type=ARRAY, someip-transformation-i-signal-props{cs-error-reaction=AUTONOMOUS, transformer=TransformationTechnologySOMEIP, interface-version=1, message-type=REQUEST, size-of-array-length-fields=1, size-of-struct-length-fields=1, size-of-union-length-fields=1}, dynamic-length=true, transfer-property=TRIGGERED, to HCP3_IONode
  pdu SOMEIPTestabilityReliable_Methods_echoFloat64_Response_XIX_TCPServer_SomeIP_Testability_Info_El_TestSysIP_XIX_VLAN_Cockpit: length=18, transmission-mode-true-timing=event-controlled-timing={number-of-repetitions=0, repetition-period=0.0}, unused-bit-pattern=0
    signal SOMEIPTestabilityReliable_Methods_echoFloat64_Response_XIX_TCPServer_SomeIP_Testability_Info_El_TestSysIP_XIX_VLAN_Cockpit: start 0, 144 bit, opaque, data-transformations=SOMEIPOnlyTransformerChain, data-type-policy=TRANSFORMING-I-SIGNAL, i-signal-type=ARRAY, someip-transformation-i-signal-props{cs-error-reaction=AUTONOMOUS, transformer=TransformationTechnologySOMEIP, interface-version=1, message-type=RESPONSE, size-of-array-length-fields=1, size-of-struct-length-fields=1, size-of-union-length-fields=1}, dynamic-length=true, transfer-property=TRIGGERED
  pdu SOMEIPTestabilityReliable_Methods_echoInverseBitField_Request_XIX_TCPServer_SomeIP_Testability_9810139930AA6602913F8587B779818E: length=14, transmission-mode-true-timing=event-controlled-timing={number-of-repetitions=0, repetition-period=0.0}, unused-bit-pattern=0  # SOMEIPTestabilityReliable_Methods_echoInverseBitField_Request_XIX_TCPServer_SomeIP_Testability_Info_El_TestSysIP_XIX_VLAN_Cockpit
    signal SOMEIPTestabilityReliable_Methods_echoInverseBitField_Request_XIX_TCPServer_SomeIP_Testability_9810139930AA6602913F8587B779818E: start 0, 112 bit, opaque, data-transformations=SOMEIPOnlyTransformerChain, data-type-policy=TRANSFORMING-I-SIGNAL, i-signal-type=ARRAY, someip-transformation-i-signal-props{cs-error-reaction=AUTONOMOUS, transformer=TransformationTechnologySOMEIP, interface-version=1, message-type=REQUEST, size-of-array-length-fields=1, size-of-struct-length-fields=1, size-of-union-length-fields=1}, dynamic-length=true, transfer-property=TRIGGERED, to HCP3_IONode  # SOMEIPTestabilityReliable_Methods_echoInverseBitField_Request_XIX_TCPServer_SomeIP_Testability_Info_El_TestSysIP_XIX_VLAN_Cockpit
  pdu SOMEIPTestabilityReliable_Methods_echoInverseBitField_Response_XIX_TCPServer_SomeIP_Testability_47ADD3912D3BA99B8C4BA1F58AB1BA9B: length=14, transmission-mode-true-timing=event-controlled-timing={number-of-repetitions=0, repetition-period=0.0}, unused-bit-pattern=0  # SOMEIPTestabilityReliable_Methods_echoInverseBitField_Response_XIX_TCPServer_SomeIP_Testability_Info_El_TestSysIP_XIX_VLAN_Cockpit
    signal SOMEIPTestabilityReliable_Methods_echoInverseBitField_Response_XIX_TCPServer_SomeIP_Testability_47ADD3912D3BA99B8C4BA1F58AB1BA9B: start 0, 112 bit, opaque, data-transformations=SOMEIPOnlyTransformerChain, data-type-policy=TRANSFORMING-I-SIGNAL, i-signal-type=ARRAY, someip-transformation-i-signal-props{cs-error-reaction=AUTONOMOUS, transformer=TransformationTechnologySOMEIP, interface-version=1, message-type=RESPONSE, size-of-array-length-fields=1, size-of-struct-length-fields=1, size-of-union-length-fields=1}, dynamic-length=true, transfer-property=TRIGGERED  # SOMEIPTestabilityReliable_Methods_echoInverseBitField_Response_XIX_TCPServer_SomeIP_Testability_Info_El_TestSysIP_XIX_VLAN_Cockpit
  pdu SOMEIPTestabilityReliable_Methods_echoInverseDynamicArray_Request_XIX_TCPServer_SomeIP_Testabil_2251AB4E56559A475C48178E53B5E5EB: length=16, transmission-mode-true-timing=event-controlled-timing={number-of-repetitions=0, repetition-period=0.0}, unused-bit-pattern=0  # SOMEIPTestabilityReliable_Methods_echoInverseDynamicArray_Request_XIX_TCPServer_SomeIP_Testability_Info_El_TestSysIP_XIX_VLAN_Cockpit
    signal SOMEIPTestabilityReliable_Methods_echoInverseDynamicArray_Request_XIX_TCPServer_SomeIP_Testabil_2251AB4E56559A475C48178E53B5E5EB: start 0, 128 bit, opaque, data-transformations=SOMEIPOnlyTransformerChain, data-type-policy=TRANSFORMING-I-SIGNAL, i-signal-type=ARRAY, someip-transformation-i-signal-props{cs-error-reaction=AUTONOMOUS, transformer=TransformationTechnologySOMEIP, interface-version=1, message-type=REQUEST, size-of-array-length-fields=1, size-of-struct-length-fields=1, size-of-union-length-fields=1}, dynamic-length=true, transfer-property=TRIGGERED, to HCP3_IONode  # SOMEIPTestabilityReliable_Methods_echoInverseDynamicArray_Request_XIX_TCPServer_SomeIP_Testability_Info_El_TestSysIP_XIX_VLAN_Cockpit
  pdu SOMEIPTestabilityReliable_Methods_echoInverseDynamicArray_Response_XIX_TCPServer_SomeIP_Testabi_D70AD9E9EA8C9EC9D33463A790B744DA: length=16, transmission-mode-true-timing=event-controlled-timing={number-of-repetitions=0, repetition-period=0.0}, unused-bit-pattern=0  # SOMEIPTestabilityReliable_Methods_echoInverseDynamicArray_Response_XIX_TCPServer_SomeIP_Testability_Info_El_TestSysIP_XIX_VLAN_Cockpit
    signal SOMEIPTestabilityReliable_Methods_echoInverseDynamicArray_Response_XIX_TCPServer_SomeIP_Testabi_D70AD9E9EA8C9EC9D33463A790B744DA: start 0, 128 bit, opaque, data-transformations=SOMEIPOnlyTransformerChain, data-type-policy=TRANSFORMING-I-SIGNAL, i-signal-type=ARRAY, someip-transformation-i-signal-props{cs-error-reaction=AUTONOMOUS, transformer=TransformationTechnologySOMEIP, interface-version=1, message-type=RESPONSE, size-of-array-length-fields=1, size-of-struct-length-fields=1, size-of-union-length-fields=1}, dynamic-length=true, transfer-property=TRIGGERED  # SOMEIPTestabilityReliable_Methods_echoInverseDynamicArray_Response_XIX_TCPServer_SomeIP_Testability_Info_El_TestSysIP_XIX_VLAN_Cockpit
  pdu SOMEIPTestabilityReliable_Methods_echoInverseDynamicMultidimensionalArray_Request_XIX_TCPServer_9D1508085278F533916397EA2D85A645: length=41, transmission-mode-true-timing=event-controlled-timing={number-of-repetitions=0, repetition-period=0.0}, unused-bit-pattern=0  # SOMEIPTestabilityReliable_Methods_echoInverseDynamicMultidimensionalArray_Request_XIX_TCPServer_SomeIP_Testability_Info_El_TestSysIP_XIX_VLAN_Cockpit
    signal SOMEIPTestabilityReliable_Methods_echoInverseDynamicMultidimensionalArray_Request_XIX_TCPServer_9D1508085278F533916397EA2D85A645: start 0, 328 bit, opaque, data-transformations=SOMEIPOnlyTransformerChain, data-type-policy=TRANSFORMING-I-SIGNAL, i-signal-type=ARRAY, someip-transformation-i-signal-props{cs-error-reaction=AUTONOMOUS, transformer=TransformationTechnologySOMEIP, interface-version=1, message-type=REQUEST, size-of-array-length-fields=1, size-of-struct-length-fields=1, size-of-union-length-fields=1}, dynamic-length=true, transfer-property=TRIGGERED, to HCP3_IONode  # SOMEIPTestabilityReliable_Methods_echoInverseDynamicMultidimensionalArray_Request_XIX_TCPServer_SomeIP_Testability_Info_El_TestSysIP_XIX_VLAN_Cockpit
  pdu SOMEIPTestabilityReliable_Methods_echoInverseDynamicMultidimensionalArray_Response_XIX_TCPServe_F17F02095D8D19E65FFCFAE2CFA6F4BF: length=41, transmission-mode-true-timing=event-controlled-timing={number-of-repetitions=0, repetition-period=0.0}, unused-bit-pattern=0  # SOMEIPTestabilityReliable_Methods_echoInverseDynamicMultidimensionalArray_Response_XIX_TCPServer_SomeIP_Testability_Info_El_TestSysIP_XIX_VLAN_Cockpit
    signal SOMEIPTestabilityReliable_Methods_echoInverseDynamicMultidimensionalArray_Response_XIX_TCPServe_F17F02095D8D19E65FFCFAE2CFA6F4BF: start 0, 328 bit, opaque, data-transformations=SOMEIPOnlyTransformerChain, data-type-policy=TRANSFORMING-I-SIGNAL, i-signal-type=ARRAY, someip-transformation-i-signal-props{cs-error-reaction=AUTONOMOUS, transformer=TransformationTechnologySOMEIP, interface-version=1, message-type=RESPONSE, size-of-array-length-fields=1, size-of-struct-length-fields=1, size-of-union-length-fields=1}, dynamic-length=true, transfer-property=TRIGGERED  # SOMEIPTestabilityReliable_Methods_echoInverseDynamicMultidimensionalArray_Response_XIX_TCPServer_SomeIP_Testability_Info_El_TestSysIP_XIX_VLAN_Cockpit
  pdu SOMEIPTestabilityReliable_Methods_echoInverseStruct_Request_XIX_TCPServer_SomeIP_Testability_Info_El_TestSysIP_XIX_VLAN_Cockpit: length=18, transmission-mode-true-timing=event-controlled-timing={number-of-repetitions=0, repetition-period=0.0}, unused-bit-pattern=0
    signal SOMEIPTestabilityReliable_Methods_echoInverseStruct_Request_XIX_TCPServer_SomeIP_Testability_Info_El_TestSysIP_XIX_VLAN_Cockpit: start 0, 144 bit, opaque, data-transformations=SOMEIPOnlyTransformerChain, data-type-policy=TRANSFORMING-I-SIGNAL, i-signal-type=ARRAY, someip-transformation-i-signal-props{cs-error-reaction=AUTONOMOUS, transformer=TransformationTechnologySOMEIP, interface-version=1, message-type=REQUEST, size-of-array-length-fields=1, size-of-struct-length-fields=1, size-of-union-length-fields=1}, dynamic-length=true, transfer-property=TRIGGERED, to HCP3_IONode
  pdu SOMEIPTestabilityReliable_Methods_echoInverseStruct_Response_XIX_TCPServer_SomeIP_Testability_Info_El_TestSysIP_XIX_VLAN_Cockpit: length=18, transmission-mode-true-timing=event-controlled-timing={number-of-repetitions=0, repetition-period=0.0}, unused-bit-pattern=0
    signal SOMEIPTestabilityReliable_Methods_echoInverseStruct_Response_XIX_TCPServer_SomeIP_Testability_Info_El_TestSysIP_XIX_VLAN_Cockpit: start 0, 144 bit, opaque, data-transformations=SOMEIPOnlyTransformerChain, data-type-policy=TRANSFORMING-I-SIGNAL, i-signal-type=ARRAY, someip-transformation-i-signal-props{cs-error-reaction=AUTONOMOUS, transformer=TransformationTechnologySOMEIP, interface-version=1, message-type=RESPONSE, size-of-array-length-fields=1, size-of-struct-length-fields=1, size-of-union-length-fields=1}, dynamic-length=true, transfer-property=TRIGGERED
  pdu SOMEIPTestabilityReliable_Methods_echoSInt16_Request_XIX_TCPServer_SomeIP_Testability_Info_El_TestSysIP_XIX_VLAN_Cockpit: length=12, transmission-mode-true-timing=event-controlled-timing={number-of-repetitions=0, repetition-period=0.0}, unused-bit-pattern=0
    signal SOMEIPTestabilityReliable_Methods_echoSInt16_Request_XIX_TCPServer_SomeIP_Testability_Info_El_TestSysIP_XIX_VLAN_Cockpit: start 0, 96 bit, opaque, data-transformations=SOMEIPOnlyTransformerChain, data-type-policy=TRANSFORMING-I-SIGNAL, i-signal-type=ARRAY, someip-transformation-i-signal-props{cs-error-reaction=AUTONOMOUS, transformer=TransformationTechnologySOMEIP, interface-version=1, message-type=REQUEST, size-of-array-length-fields=1, size-of-struct-length-fields=1, size-of-union-length-fields=1}, dynamic-length=true, transfer-property=TRIGGERED, to HCP3_IONode
  pdu SOMEIPTestabilityReliable_Methods_echoSInt16_Response_XIX_TCPServer_SomeIP_Testability_Info_El_TestSysIP_XIX_VLAN_Cockpit: length=12, transmission-mode-true-timing=event-controlled-timing={number-of-repetitions=0, repetition-period=0.0}, unused-bit-pattern=0
    signal SOMEIPTestabilityReliable_Methods_echoSInt16_Response_XIX_TCPServer_SomeIP_Testability_Info_El_TestSysIP_XIX_VLAN_Cockpit: start 0, 96 bit, opaque, data-transformations=SOMEIPOnlyTransformerChain, data-type-policy=TRANSFORMING-I-SIGNAL, i-signal-type=ARRAY, someip-transformation-i-signal-props{cs-error-reaction=AUTONOMOUS, transformer=TransformationTechnologySOMEIP, interface-version=1, message-type=RESPONSE, size-of-array-length-fields=1, size-of-struct-length-fields=1, size-of-union-length-fields=1}, dynamic-length=true, transfer-property=TRIGGERED
  pdu SOMEIPTestabilityReliable_Methods_echoSInt32_Request_XIX_TCPServer_SomeIP_Testability_Info_El_TestSysIP_XIX_VLAN_Cockpit: length=14, transmission-mode-true-timing=event-controlled-timing={number-of-repetitions=0, repetition-period=0.0}, unused-bit-pattern=0
    signal SOMEIPTestabilityReliable_Methods_echoSInt32_Request_XIX_TCPServer_SomeIP_Testability_Info_El_TestSysIP_XIX_VLAN_Cockpit: start 0, 112 bit, opaque, data-transformations=SOMEIPOnlyTransformerChain, data-type-policy=TRANSFORMING-I-SIGNAL, i-signal-type=ARRAY, someip-transformation-i-signal-props{cs-error-reaction=AUTONOMOUS, transformer=TransformationTechnologySOMEIP, interface-version=1, message-type=REQUEST, size-of-array-length-fields=1, size-of-struct-length-fields=1, size-of-union-length-fields=1}, dynamic-length=true, transfer-property=TRIGGERED, to HCP3_IONode
  pdu SOMEIPTestabilityReliable_Methods_echoSInt32_Response_XIX_TCPServer_SomeIP_Testability_Info_El_TestSysIP_XIX_VLAN_Cockpit: length=14, transmission-mode-true-timing=event-controlled-timing={number-of-repetitions=0, repetition-period=0.0}, unused-bit-pattern=0
    signal SOMEIPTestabilityReliable_Methods_echoSInt32_Response_XIX_TCPServer_SomeIP_Testability_Info_El_TestSysIP_XIX_VLAN_Cockpit: start 0, 112 bit, opaque, data-transformations=SOMEIPOnlyTransformerChain, data-type-policy=TRANSFORMING-I-SIGNAL, i-signal-type=ARRAY, someip-transformation-i-signal-props{cs-error-reaction=AUTONOMOUS, transformer=TransformationTechnologySOMEIP, interface-version=1, message-type=RESPONSE, size-of-array-length-fields=1, size-of-struct-length-fields=1, size-of-union-length-fields=1}, dynamic-length=true, transfer-property=TRIGGERED
  pdu SOMEIPTestabilityReliable_Methods_echoSInt64_Request_XIX_TCPServer_SomeIP_Testability_Info_El_TestSysIP_XIX_VLAN_Cockpit: length=18, transmission-mode-true-timing=event-controlled-timing={number-of-repetitions=0, repetition-period=0.0}, unused-bit-pattern=0
    signal SOMEIPTestabilityReliable_Methods_echoSInt64_Request_XIX_TCPServer_SomeIP_Testability_Info_El_TestSysIP_XIX_VLAN_Cockpit: start 0, 144 bit, opaque, data-transformations=SOMEIPOnlyTransformerChain, data-type-policy=TRANSFORMING-I-SIGNAL, i-signal-type=ARRAY, someip-transformation-i-signal-props{cs-error-reaction=AUTONOMOUS, transformer=TransformationTechnologySOMEIP, interface-version=1, message-type=REQUEST, size-of-array-length-fields=1, size-of-struct-length-fields=1, size-of-union-length-fields=1}, dynamic-length=true, transfer-property=TRIGGERED, to HCP3_IONode
  pdu SOMEIPTestabilityReliable_Methods_echoSInt64_Response_XIX_TCPServer_SomeIP_Testability_Info_El_TestSysIP_XIX_VLAN_Cockpit: length=18, transmission-mode-true-timing=event-controlled-timing={number-of-repetitions=0, repetition-period=0.0}, unused-bit-pattern=0
    signal SOMEIPTestabilityReliable_Methods_echoSInt64_Response_XIX_TCPServer_SomeIP_Testability_Info_El_TestSysIP_XIX_VLAN_Cockpit: start 0, 144 bit, opaque, data-transformations=SOMEIPOnlyTransformerChain, data-type-policy=TRANSFORMING-I-SIGNAL, i-signal-type=ARRAY, someip-transformation-i-signal-props{cs-error-reaction=AUTONOMOUS, transformer=TransformationTechnologySOMEIP, interface-version=1, message-type=RESPONSE, size-of-array-length-fields=1, size-of-struct-length-fields=1, size-of-union-length-fields=1}, dynamic-length=true, transfer-property=TRIGGERED
  pdu SOMEIPTestabilityReliable_Methods_echoSInt8_Request_XIX_TCPServer_SomeIP_Testability_Info_El_TestSysIP_XIX_VLAN_Cockpit: length=11, transmission-mode-true-timing=event-controlled-timing={number-of-repetitions=0, repetition-period=0.0}, unused-bit-pattern=0
    signal SOMEIPTestabilityReliable_Methods_echoSInt8_Request_XIX_TCPServer_SomeIP_Testability_Info_El_TestSysIP_XIX_VLAN_Cockpit: start 0, 88 bit, opaque, data-transformations=SOMEIPOnlyTransformerChain, data-type-policy=TRANSFORMING-I-SIGNAL, i-signal-type=ARRAY, someip-transformation-i-signal-props{cs-error-reaction=AUTONOMOUS, transformer=TransformationTechnologySOMEIP, interface-version=1, message-type=REQUEST, size-of-array-length-fields=1, size-of-struct-length-fields=1, size-of-union-length-fields=1}, dynamic-length=true, transfer-property=TRIGGERED, to HCP3_IONode
  pdu SOMEIPTestabilityReliable_Methods_echoSInt8_Response_XIX_TCPServer_SomeIP_Testability_Info_El_TestSysIP_XIX_VLAN_Cockpit: length=11, transmission-mode-true-timing=event-controlled-timing={number-of-repetitions=0, repetition-period=0.0}, unused-bit-pattern=0
    signal SOMEIPTestabilityReliable_Methods_echoSInt8_Response_XIX_TCPServer_SomeIP_Testability_Info_El_TestSysIP_XIX_VLAN_Cockpit: start 0, 88 bit, opaque, data-transformations=SOMEIPOnlyTransformerChain, data-type-policy=TRANSFORMING-I-SIGNAL, i-signal-type=ARRAY, someip-transformation-i-signal-props{cs-error-reaction=AUTONOMOUS, transformer=TransformationTechnologySOMEIP, interface-version=1, message-type=RESPONSE, size-of-array-length-fields=1, size-of-struct-length-fields=1, size-of-union-length-fields=1}, dynamic-length=true, transfer-property=TRIGGERED
  pdu SOMEIPTestabilityReliable_Methods_echoStructInStruct_Request_XIX_TCPServer_SomeIP_Testability_Info_El_TestSysIP_XIX_VLAN_Cockpit: length=42, transmission-mode-true-timing=event-controlled-timing={number-of-repetitions=0, repetition-period=0.0}, unused-bit-pattern=0
    signal SOMEIPTestabilityReliable_Methods_echoStructInStruct_Request_XIX_TCPServer_SomeIP_Testability_Info_El_TestSysIP_XIX_VLAN_Cockpit: start 0, 336 bit, opaque, data-transformations=SOMEIPOnlyTransformerChain, data-type-policy=TRANSFORMING-I-SIGNAL, i-signal-type=ARRAY, someip-transformation-i-signal-props{cs-error-reaction=AUTONOMOUS, transformer=TransformationTechnologySOMEIP, interface-version=1, message-type=REQUEST, size-of-array-length-fields=2, size-of-struct-length-fields=2, size-of-union-length-fields=2}, dynamic-length=true, transfer-property=TRIGGERED, to HCP3_IONode
  pdu SOMEIPTestabilityReliable_Methods_echoStructInStruct_Response_XIX_TCPServer_SomeIP_Testability_C119ADB5B460ADBD6A690F61A4D3EB22: length=42, transmission-mode-true-timing=event-controlled-timing={number-of-repetitions=0, repetition-period=0.0}, unused-bit-pattern=0  # SOMEIPTestabilityReliable_Methods_echoStructInStruct_Response_XIX_TCPServer_SomeIP_Testability_Info_El_TestSysIP_XIX_VLAN_Cockpit
    signal SOMEIPTestabilityReliable_Methods_echoStructInStruct_Response_XIX_TCPServer_SomeIP_Testability_C119ADB5B460ADBD6A690F61A4D3EB22: start 0, 336 bit, opaque, data-transformations=SOMEIPOnlyTransformerChain, data-type-policy=TRANSFORMING-I-SIGNAL, i-signal-type=ARRAY, someip-transformation-i-signal-props{cs-error-reaction=AUTONOMOUS, transformer=TransformationTechnologySOMEIP, interface-version=1, message-type=RESPONSE, size-of-array-length-fields=2, size-of-struct-length-fields=2, size-of-union-length-fields=2}, dynamic-length=true, transfer-property=TRIGGERED  # SOMEIPTestabilityReliable_Methods_echoStructInStruct_Response_XIX_TCPServer_SomeIP_Testability_Info_El_TestSysIP_XIX_VLAN_Cockpit
  pdu SOMEIPTestabilityReliable_Methods_echoUInt16_Request_XIX_TCPServer_SomeIP_Testability_Info_El_TestSysIP_XIX_VLAN_Cockpit: length=12, transmission-mode-true-timing=event-controlled-timing={number-of-repetitions=0, repetition-period=0.0}, unused-bit-pattern=0
    signal SOMEIPTestabilityReliable_Methods_echoUInt16_Request_XIX_TCPServer_SomeIP_Testability_Info_El_TestSysIP_XIX_VLAN_Cockpit: start 0, 96 bit, opaque, data-transformations=SOMEIPOnlyTransformerChain, data-type-policy=TRANSFORMING-I-SIGNAL, i-signal-type=ARRAY, someip-transformation-i-signal-props{cs-error-reaction=AUTONOMOUS, transformer=TransformationTechnologySOMEIP, interface-version=1, message-type=REQUEST, size-of-array-length-fields=1, size-of-struct-length-fields=1, size-of-union-length-fields=1}, dynamic-length=true, transfer-property=TRIGGERED, to HCP3_IONode
  pdu SOMEIPTestabilityReliable_Methods_echoUInt16_Response_XIX_TCPServer_SomeIP_Testability_Info_El_TestSysIP_XIX_VLAN_Cockpit: length=12, transmission-mode-true-timing=event-controlled-timing={number-of-repetitions=0, repetition-period=0.0}, unused-bit-pattern=0
    signal SOMEIPTestabilityReliable_Methods_echoUInt16_Response_XIX_TCPServer_SomeIP_Testability_Info_El_TestSysIP_XIX_VLAN_Cockpit: start 0, 96 bit, opaque, data-transformations=SOMEIPOnlyTransformerChain, data-type-policy=TRANSFORMING-I-SIGNAL, i-signal-type=ARRAY, someip-transformation-i-signal-props{cs-error-reaction=AUTONOMOUS, transformer=TransformationTechnologySOMEIP, interface-version=1, message-type=RESPONSE, size-of-array-length-fields=1, size-of-struct-length-fields=1, size-of-union-length-fields=1}, dynamic-length=true, transfer-property=TRIGGERED
  pdu SOMEIPTestabilityReliable_Methods_echoUInt32_Request_XIX_TCPServer_SomeIP_Testability_Info_El_TestSysIP_XIX_VLAN_Cockpit: length=14, transmission-mode-true-timing=event-controlled-timing={number-of-repetitions=0, repetition-period=0.0}, unused-bit-pattern=0
    signal SOMEIPTestabilityReliable_Methods_echoUInt32_Request_XIX_TCPServer_SomeIP_Testability_Info_El_TestSysIP_XIX_VLAN_Cockpit: start 0, 112 bit, opaque, data-transformations=SOMEIPOnlyTransformerChain, data-type-policy=TRANSFORMING-I-SIGNAL, i-signal-type=ARRAY, someip-transformation-i-signal-props{cs-error-reaction=AUTONOMOUS, transformer=TransformationTechnologySOMEIP, interface-version=1, message-type=REQUEST, size-of-array-length-fields=1, size-of-struct-length-fields=1, size-of-union-length-fields=1}, dynamic-length=true, transfer-property=TRIGGERED, to HCP3_IONode
  pdu SOMEIPTestabilityReliable_Methods_echoUInt32_Response_XIX_TCPServer_SomeIP_Testability_Info_El_TestSysIP_XIX_VLAN_Cockpit: length=14, transmission-mode-true-timing=event-controlled-timing={number-of-repetitions=0, repetition-period=0.0}, unused-bit-pattern=0
    signal SOMEIPTestabilityReliable_Methods_echoUInt32_Response_XIX_TCPServer_SomeIP_Testability_Info_El_TestSysIP_XIX_VLAN_Cockpit: start 0, 112 bit, opaque, data-transformations=SOMEIPOnlyTransformerChain, data-type-policy=TRANSFORMING-I-SIGNAL, i-signal-type=ARRAY, someip-transformation-i-signal-props{cs-error-reaction=AUTONOMOUS, transformer=TransformationTechnologySOMEIP, interface-version=1, message-type=RESPONSE, size-of-array-length-fields=1, size-of-struct-length-fields=1, size-of-union-length-fields=1}, dynamic-length=true, transfer-property=TRIGGERED
  pdu SOMEIPTestabilityReliable_Methods_echoUInt64_Request_XIX_TCPServer_SomeIP_Testability_Info_El_TestSysIP_XIX_VLAN_Cockpit: length=18, transmission-mode-true-timing=event-controlled-timing={number-of-repetitions=0, repetition-period=0.0}, unused-bit-pattern=0
    signal SOMEIPTestabilityReliable_Methods_echoUInt64_Request_XIX_TCPServer_SomeIP_Testability_Info_El_TestSysIP_XIX_VLAN_Cockpit: start 0, 144 bit, opaque, data-transformations=SOMEIPOnlyTransformerChain, data-type-policy=TRANSFORMING-I-SIGNAL, i-signal-type=ARRAY, someip-transformation-i-signal-props{cs-error-reaction=AUTONOMOUS, transformer=TransformationTechnologySOMEIP, interface-version=1, message-type=REQUEST, size-of-array-length-fields=1, size-of-struct-length-fields=1, size-of-union-length-fields=1}, dynamic-length=true, transfer-property=TRIGGERED, to HCP3_IONode
  pdu SOMEIPTestabilityReliable_Methods_echoUInt64_Response_XIX_TCPServer_SomeIP_Testability_Info_El_TestSysIP_XIX_VLAN_Cockpit: length=18, transmission-mode-true-timing=event-controlled-timing={number-of-repetitions=0, repetition-period=0.0}, unused-bit-pattern=0
    signal SOMEIPTestabilityReliable_Methods_echoUInt64_Response_XIX_TCPServer_SomeIP_Testability_Info_El_TestSysIP_XIX_VLAN_Cockpit: start 0, 144 bit, opaque, data-transformations=SOMEIPOnlyTransformerChain, data-type-policy=TRANSFORMING-I-SIGNAL, i-signal-type=ARRAY, someip-transformation-i-signal-props{cs-error-reaction=AUTONOMOUS, transformer=TransformationTechnologySOMEIP, interface-version=1, message-type=RESPONSE, size-of-array-length-fields=1, size-of-struct-length-fields=1, size-of-union-length-fields=1}, dynamic-length=true, transfer-property=TRIGGERED
  pdu SOMEIPTestabilityReliable_Methods_echoUInt8_Request_XIX_TCPServer_SomeIP_Testability_Info_El_TestSysIP_XIX_VLAN_Cockpit: length=11, transmission-mode-true-timing=event-controlled-timing={number-of-repetitions=0, repetition-period=0.0}, unused-bit-pattern=0
    signal SOMEIPTestabilityReliable_Methods_echoUInt8_Request_XIX_TCPServer_SomeIP_Testability_Info_El_TestSysIP_XIX_VLAN_Cockpit: start 0, 88 bit, opaque, data-transformations=SOMEIPOnlyTransformerChain, data-type-policy=TRANSFORMING-I-SIGNAL, i-signal-type=ARRAY, someip-transformation-i-signal-props{cs-error-reaction=AUTONOMOUS, transformer=TransformationTechnologySOMEIP, interface-version=1, message-type=REQUEST, size-of-array-length-fields=1, size-of-struct-length-fields=1, size-of-union-length-fields=1}, dynamic-length=true, transfer-property=TRIGGERED, to HCP3_IONode
  pdu SOMEIPTestabilityReliable_Methods_echoUInt8_Response_XIX_TCPServer_SomeIP_Testability_Info_El_TestSysIP_XIX_VLAN_Cockpit: length=11, transmission-mode-true-timing=event-controlled-timing={number-of-repetitions=0, repetition-period=0.0}, unused-bit-pattern=0
    signal SOMEIPTestabilityReliable_Methods_echoUInt8_Response_XIX_TCPServer_SomeIP_Testability_Info_El_TestSysIP_XIX_VLAN_Cockpit: start 0, 88 bit, opaque, data-transformations=SOMEIPOnlyTransformerChain, data-type-policy=TRANSFORMING-I-SIGNAL, i-signal-type=ARRAY, someip-transformation-i-signal-props{cs-error-reaction=AUTONOMOUS, transformer=TransformationTechnologySOMEIP, interface-version=1, message-type=RESPONSE, size-of-array-length-fields=1, size-of-struct-length-fields=1, size-of-union-length-fields=1}, dynamic-length=true, transfer-property=TRIGGERED
  pdu SOMEIPTestabilityReliable_Methods_echoUInt8UInt16UInt32_Request_XIX_TCPServer_SomeIP_Testabilit_69C56E707EDB2DE5B6A25F8F8A314E62: length=21, transmission-mode-true-timing=event-controlled-timing={number-of-repetitions=0, repetition-period=0.0}, unused-bit-pattern=0  # SOMEIPTestabilityReliable_Methods_echoUInt8UInt16UInt32_Request_XIX_TCPServer_SomeIP_Testability_Info_El_TestSysIP_XIX_VLAN_Cockpit
    signal SOMEIPTestabilityReliable_Methods_echoUInt8UInt16UInt32_Request_XIX_TCPServer_SomeIP_Testabilit_69C56E707EDB2DE5B6A25F8F8A314E62: start 0, 168 bit, opaque, data-transformations=SOMEIPOnlyTransformerChain, data-type-policy=TRANSFORMING-I-SIGNAL, i-signal-type=ARRAY, someip-transformation-i-signal-props{cs-error-reaction=AUTONOMOUS, transformer=TransformationTechnologySOMEIP, interface-version=1, message-type=REQUEST, size-of-array-length-fields=1, size-of-struct-length-fields=1, size-of-union-length-fields=1}, dynamic-length=true, transfer-property=TRIGGERED, to HCP3_IONode  # SOMEIPTestabilityReliable_Methods_echoUInt8UInt16UInt32_Request_XIX_TCPServer_SomeIP_Testability_Info_El_TestSysIP_XIX_VLAN_Cockpit
  pdu SOMEIPTestabilityReliable_Methods_echoUInt8UInt16UInt32_Response_XIX_TCPServer_SomeIP_Testabili_080176D85C95E78B40C5018645211CD9: length=21, transmission-mode-true-timing=event-controlled-timing={number-of-repetitions=0, repetition-period=0.0}, unused-bit-pattern=0  # SOMEIPTestabilityReliable_Methods_echoUInt8UInt16UInt32_Response_XIX_TCPServer_SomeIP_Testability_Info_El_TestSysIP_XIX_VLAN_Cockpit
    signal SOMEIPTestabilityReliable_Methods_echoUInt8UInt16UInt32_Response_XIX_TCPServer_SomeIP_Testabili_080176D85C95E78B40C5018645211CD9: start 0, 168 bit, opaque, data-transformations=SOMEIPOnlyTransformerChain, data-type-policy=TRANSFORMING-I-SIGNAL, i-signal-type=ARRAY, someip-transformation-i-signal-props{cs-error-reaction=AUTONOMOUS, transformer=TransformationTechnologySOMEIP, interface-version=1, message-type=RESPONSE, size-of-array-length-fields=1, size-of-struct-length-fields=1, size-of-union-length-fields=1}, dynamic-length=true, transfer-property=TRIGGERED  # SOMEIPTestabilityReliable_Methods_echoUInt8UInt16UInt32_Response_XIX_TCPServer_SomeIP_Testability_Info_El_TestSysIP_XIX_VLAN_Cockpit
  pdu SOMEIPTestabilityReliable_Methods_echoUTF8String_Request_XIX_TCPServer_SomeIP_Testability_Info_El_TestSysIP_XIX_VLAN_Cockpit: length=75, transmission-mode-true-timing=event-controlled-timing={number-of-repetitions=0, repetition-period=0.0}, unused-bit-pattern=0
    signal SOMEIPTestabilityReliable_Methods_echoUTF8String_Request_XIX_TCPServer_SomeIP_Testability_Info_El_TestSysIP_XIX_VLAN_Cockpit: start 0, 600 bit, opaque, data-transformations=SOMEIPOnlyTransformerChain, data-type-policy=TRANSFORMING-I-SIGNAL, i-signal-type=ARRAY, someip-transformation-i-signal-props{cs-error-reaction=AUTONOMOUS, transformer=TransformationTechnologySOMEIP, interface-version=1, message-type=REQUEST, size-of-array-length-fields=1, size-of-struct-length-fields=1, size-of-union-length-fields=1}, dynamic-length=true, transfer-property=TRIGGERED, to HCP3_IONode
  pdu SOMEIPTestabilityReliable_Methods_echoUTF8String_Response_XIX_TCPServer_SomeIP_Testability_Info_El_TestSysIP_XIX_VLAN_Cockpit: length=75, transmission-mode-true-timing=event-controlled-timing={number-of-repetitions=0, repetition-period=0.0}, unused-bit-pattern=0
    signal SOMEIPTestabilityReliable_Methods_echoUTF8String_Response_XIX_TCPServer_SomeIP_Testability_Info_El_TestSysIP_XIX_VLAN_Cockpit: start 0, 600 bit, opaque, data-transformations=SOMEIPOnlyTransformerChain, data-type-policy=TRANSFORMING-I-SIGNAL, i-signal-type=ARRAY, someip-transformation-i-signal-props{cs-error-reaction=AUTONOMOUS, transformer=TransformationTechnologySOMEIP, interface-version=1, message-type=RESPONSE, size-of-array-length-fields=1, size-of-struct-length-fields=1, size-of-union-length-fields=1}, dynamic-length=true, transfer-property=TRIGGERED
  pdu SOMEIPTestabilityReliable_Methods_enableSubscription_Request_XIX_TCPServer_SomeIP_Testability_Info_El_TestSysIP_XIX_VLAN_Cockpit: length=15, transmission-mode-true-timing=event-controlled-timing={number-of-repetitions=0, repetition-period=0.0}, unused-bit-pattern=0
    signal SOMEIPTestabilityReliable_Methods_enableSubscription_Request_XIX_TCPServer_SomeIP_Testability_Info_El_TestSysIP_XIX_VLAN_Cockpit: start 0, 120 bit, opaque, data-transformations=SOMEIPOnlyTransformerChain, data-type-policy=TRANSFORMING-I-SIGNAL, i-signal-type=ARRAY, someip-transformation-i-signal-props{cs-error-reaction=AUTONOMOUS, transformer=TransformationTechnologySOMEIP, interface-version=1, message-type=REQUEST, size-of-array-length-fields=1, size-of-struct-length-fields=1, size-of-union-length-fields=1}, dynamic-length=true, transfer-property=TRIGGERED, to HCP3_IONode
  pdu SOMEIPTestabilityReliable_Methods_enableSubscription_Response_XIX_TCPServer_SomeIP_Testability_574FC24CB182E41708BE342C1436842C: length=8, transmission-mode-true-timing=event-controlled-timing={number-of-repetitions=0, repetition-period=0.0}, unused-bit-pattern=0  # SOMEIPTestabilityReliable_Methods_enableSubscription_Response_XIX_TCPServer_SomeIP_Testability_Info_El_TestSysIP_XIX_VLAN_Cockpit
    signal SOMEIPTestabilityReliable_Methods_enableSubscription_Response_XIX_TCPServer_SomeIP_Testability_574FC24CB182E41708BE342C1436842C: start 0, 64 bit, opaque, data-transformations=SOMEIPOnlyTransformerChain, data-type-policy=TRANSFORMING-I-SIGNAL, i-signal-type=ARRAY, someip-transformation-i-signal-props{cs-error-reaction=AUTONOMOUS, transformer=TransformationTechnologySOMEIP, interface-version=1, message-type=RESPONSE, size-of-array-length-fields=1, size-of-struct-length-fields=1, size-of-union-length-fields=1}, dynamic-length=true, transfer-property=TRIGGERED  # SOMEIPTestabilityReliable_Methods_enableSubscription_Response_XIX_TCPServer_SomeIP_Testability_Info_El_TestSysIP_XIX_VLAN_Cockpit
  pdu SOMEIPTestabilityReliable_Methods_getLastValueEventUInt8_Request_XIX_TCPServer_SomeIP_Testabili_871CD559971D9D0FC9EB1A3CDE066A3E: length=8, transmission-mode-true-timing=event-controlled-timing={number-of-repetitions=0, repetition-period=0.0}, unused-bit-pattern=0  # SOMEIPTestabilityReliable_Methods_getLastValueEventUInt8_Request_XIX_TCPServer_SomeIP_Testability_Info_El_TestSysIP_XIX_VLAN_Cockpit
    signal SOMEIPTestabilityReliable_Methods_getLastValueEventUInt8_Request_XIX_TCPServer_SomeIP_Testabili_871CD559971D9D0FC9EB1A3CDE066A3E: start 0, 64 bit, opaque, data-transformations=SOMEIPOnlyTransformerChain, data-type-policy=TRANSFORMING-I-SIGNAL, i-signal-type=ARRAY, someip-transformation-i-signal-props{cs-error-reaction=AUTONOMOUS, transformer=TransformationTechnologySOMEIP, interface-version=1, message-type=REQUEST, size-of-array-length-fields=1, size-of-struct-length-fields=1, size-of-union-length-fields=1}, dynamic-length=true, transfer-property=TRIGGERED, to HCP3_IONode  # SOMEIPTestabilityReliable_Methods_getLastValueEventUInt8_Request_XIX_TCPServer_SomeIP_Testability_Info_El_TestSysIP_XIX_VLAN_Cockpit
  pdu SOMEIPTestabilityReliable_Methods_getLastValueEventUInt8_Response_XIX_TCPServer_SomeIP_Testabil_34B0B086E60CC6D10CEF44811CCBF0BA: length=14, transmission-mode-true-timing=event-controlled-timing={number-of-repetitions=0, repetition-period=0.0}, unused-bit-pattern=0  # SOMEIPTestabilityReliable_Methods_getLastValueEventUInt8_Response_XIX_TCPServer_SomeIP_Testability_Info_El_TestSysIP_XIX_VLAN_Cockpit
    signal SOMEIPTestabilityReliable_Methods_getLastValueEventUInt8_Response_XIX_TCPServer_SomeIP_Testabil_34B0B086E60CC6D10CEF44811CCBF0BA: start 0, 112 bit, opaque, data-transformations=SOMEIPOnlyTransformerChain, data-type-policy=TRANSFORMING-I-SIGNAL, i-signal-type=ARRAY, someip-transformation-i-signal-props{cs-error-reaction=AUTONOMOUS, transformer=TransformationTechnologySOMEIP, interface-version=1, message-type=RESPONSE, size-of-array-length-fields=1, size-of-struct-length-fields=1, size-of-union-length-fields=1}, dynamic-length=true, transfer-property=TRIGGERED  # SOMEIPTestabilityReliable_Methods_getLastValueEventUInt8_Response_XIX_TCPServer_SomeIP_Testability_Info_El_TestSysIP_XIX_VLAN_Cockpit
  pdu SOMEIPTestabilityReliable_Methods_getLastValueFieldMulticast_Request_XIX_TCPServer_SomeIP_Testa_BD9AA0588327A8EEAF8039E934CA774B: length=11, transmission-mode-true-timing=event-controlled-timing={number-of-repetitions=0, repetition-period=0.0}, unused-bit-pattern=0  # SOMEIPTestabilityReliable_Methods_getLastValueFieldMulticast_Request_XIX_TCPServer_SomeIP_Testability_Info_El_TestSysIP_XIX_VLAN_Cockpit
    signal SOMEIPTestabilityReliable_Methods_getLastValueFieldMulticast_Request_XIX_TCPServer_SomeIP_Testa_BD9AA0588327A8EEAF8039E934CA774B: start 0, 88 bit, opaque, data-transformations=SOMEIPOnlyTransformerChain, data-type-policy=TRANSFORMING-I-SIGNAL, i-signal-type=ARRAY, someip-transformation-i-signal-props{cs-error-reaction=AUTONOMOUS, transformer=TransformationTechnologySOMEIP, interface-version=1, message-type=REQUEST, size-of-array-length-fields=1, size-of-struct-length-fields=1, size-of-union-length-fields=1}, dynamic-length=true, transfer-property=TRIGGERED, to HCP3_IONode  # SOMEIPTestabilityReliable_Methods_getLastValueFieldMulticast_Request_XIX_TCPServer_SomeIP_Testability_Info_El_TestSysIP_XIX_VLAN_Cockpit
  pdu SOMEIPTestabilityReliable_Methods_getLastValueFieldMulticast_Response_XIX_TCPServer_SomeIP_Test_96EE0D57336F6629D301D80B1DF9BA66: length=12, transmission-mode-true-timing=event-controlled-timing={number-of-repetitions=0, repetition-period=0.0}, unused-bit-pattern=0  # SOMEIPTestabilityReliable_Methods_getLastValueFieldMulticast_Response_XIX_TCPServer_SomeIP_Testability_Info_El_TestSysIP_XIX_VLAN_Cockpit
    signal SOMEIPTestabilityReliable_Methods_getLastValueFieldMulticast_Response_XIX_TCPServer_SomeIP_Test_96EE0D57336F6629D301D80B1DF9BA66: start 0, 96 bit, opaque, data-transformations=SOMEIPOnlyTransformerChain, data-type-policy=TRANSFORMING-I-SIGNAL, i-signal-type=ARRAY, someip-transformation-i-signal-props{cs-error-reaction=AUTONOMOUS, transformer=TransformationTechnologySOMEIP, interface-version=1, message-type=RESPONSE, size-of-array-length-fields=1, size-of-struct-length-fields=1, size-of-union-length-fields=1}, dynamic-length=true, transfer-property=TRIGGERED  # SOMEIPTestabilityReliable_Methods_getLastValueFieldMulticast_Response_XIX_TCPServer_SomeIP_Testability_Info_El_TestSysIP_XIX_VLAN_Cockpit
  pdu SOMEIPTestabilityReliable_Methods_getSupportedFunctions_Request_XIX_TCPServer_SomeIP_Testabilit_AF9B756A63B7DD83A0F5FC37C48635BF: length=8, transmission-mode-true-timing=event-controlled-timing={number-of-repetitions=0, repetition-period=0.0}, unused-bit-pattern=0  # SOMEIPTestabilityReliable_Methods_getSupportedFunctions_Request_XIX_TCPServer_SomeIP_Testability_Info_El_TestSysIP_XIX_VLAN_Cockpit
    signal SOMEIPTestabilityReliable_Methods_getSupportedFunctions_Request_XIX_TCPServer_SomeIP_Testabilit_AF9B756A63B7DD83A0F5FC37C48635BF: start 0, 64 bit, opaque, data-transformations=SOMEIPOnlyTransformerChain, data-type-policy=TRANSFORMING-I-SIGNAL, i-signal-type=ARRAY, someip-transformation-i-signal-props{cs-error-reaction=AUTONOMOUS, transformer=TransformationTechnologySOMEIP, interface-version=1, message-type=REQUEST, size-of-array-length-fields=2, size-of-struct-length-fields=2, size-of-union-length-fields=2}, dynamic-length=true, transfer-property=TRIGGERED, to HCP3_IONode  # SOMEIPTestabilityReliable_Methods_getSupportedFunctions_Request_XIX_TCPServer_SomeIP_Testability_Info_El_TestSysIP_XIX_VLAN_Cockpit
  pdu SOMEIPTestabilityReliable_Methods_getSupportedFunctions_Response_XIX_TCPServer_SomeIP_Testabili_B0116466194258F67CE8BCCEA84907B0: length=268, transmission-mode-true-timing=event-controlled-timing={number-of-repetitions=0, repetition-period=0.0}, unused-bit-pattern=0  # SOMEIPTestabilityReliable_Methods_getSupportedFunctions_Response_XIX_TCPServer_SomeIP_Testability_Info_El_TestSysIP_XIX_VLAN_Cockpit
    signal SOMEIPTestabilityReliable_Methods_getSupportedFunctions_Response_XIX_TCPServer_SomeIP_Testabili_B0116466194258F67CE8BCCEA84907B0: start 0, 2144 bit, opaque, data-transformations=SOMEIPOnlyTransformerChain, data-type-policy=TRANSFORMING-I-SIGNAL, i-signal-type=ARRAY, someip-transformation-i-signal-props{cs-error-reaction=AUTONOMOUS, transformer=TransformationTechnologySOMEIP, interface-version=1, message-type=RESPONSE, size-of-array-length-fields=2, size-of-struct-length-fields=2, size-of-union-length-fields=2}, dynamic-length=true, transfer-property=TRIGGERED  # SOMEIPTestabilityReliable_Methods_getSupportedFunctions_Response_XIX_TCPServer_SomeIP_Testability_Info_El_TestSysIP_XIX_VLAN_Cockpit
  pdu SOMEIPTestabilityReliable_Methods_resetInterface_Request_XIX_TCPServer_SomeIP_Testability_Info_El_TestSysIP_XIX_VLAN_Cockpit: length=11, transmission-mode-true-timing=event-controlled-timing={number-of-repetitions=0, repetition-period=0.0}, unused-bit-pattern=0
    signal SOMEIPTestabilityReliable_Methods_resetInterface_Request_XIX_TCPServer_SomeIP_Testability_Info_El_TestSysIP_XIX_VLAN_Cockpit: start 0, 88 bit, opaque, data-transformations=SOMEIPOnlyTransformerChain, data-type-policy=TRANSFORMING-I-SIGNAL, i-signal-type=ARRAY, someip-transformation-i-signal-props{cs-error-reaction=AUTONOMOUS, transformer=TransformationTechnologySOMEIP, interface-version=1, message-type=REQUEST, size-of-array-length-fields=1, size-of-struct-length-fields=1, size-of-union-length-fields=1}, dynamic-length=true, transfer-property=TRIGGERED, to HCP3_IONode
  pdu SOMEIPTestabilityReliable_Methods_resetInterface_Response_XIX_TCPServer_SomeIP_Testability_Info_El_TestSysIP_XIX_VLAN_Cockpit: length=8, transmission-mode-true-timing=event-controlled-timing={number-of-repetitions=0, repetition-period=0.0}, unused-bit-pattern=0
    signal SOMEIPTestabilityReliable_Methods_resetInterface_Response_XIX_TCPServer_SomeIP_Testability_Info_El_TestSysIP_XIX_VLAN_Cockpit: start 0, 64 bit, opaque, data-transformations=SOMEIPOnlyTransformerChain, data-type-policy=TRANSFORMING-I-SIGNAL, i-signal-type=ARRAY, someip-transformation-i-signal-props{cs-error-reaction=AUTONOMOUS, transformer=TransformationTechnologySOMEIP, interface-version=1, message-type=RESPONSE, size-of-array-length-fields=1, size-of-struct-length-fields=1, size-of-union-length-fields=1}, dynamic-length=true, transfer-property=TRIGGERED
  pdu SOMEIPTestabilityReliable_MethodsGet_TestFieldComplexStruct_Request_XIX_TCPServer_SomeIP_Testab_2145344557D3AC120245B93E17DBF805: length=8, transmission-mode-true-timing=event-controlled-timing={number-of-repetitions=0, repetition-period=0.0}, unused-bit-pattern=0  # SOMEIPTestabilityReliable_MethodsGet_TestFieldComplexStruct_Request_XIX_TCPServer_SomeIP_Testability_Info_El_TestSysIP_XIX_VLAN_Cockpit
    signal SOMEIPTestabilityReliable_MethodsGet_TestFieldComplexStruct_Request_XIX_TCPServer_SomeIP_Testab_2145344557D3AC120245B93E17DBF805: start 0, 64 bit, opaque, data-transformations=SOMEIPOnlyTransformerChain, data-type-policy=TRANSFORMING-I-SIGNAL, i-signal-type=ARRAY, someip-transformation-i-signal-props{cs-error-reaction=AUTONOMOUS, transformer=TransformationTechnologySOMEIP, interface-version=1, message-type=REQUEST, size-of-array-length-fields=1, size-of-struct-length-fields=1, size-of-union-length-fields=1}, dynamic-length=true, transfer-property=TRIGGERED, to HCP3_IONode  # SOMEIPTestabilityReliable_MethodsGet_TestFieldComplexStruct_Request_XIX_TCPServer_SomeIP_Testability_Info_El_TestSysIP_XIX_VLAN_Cockpit
  pdu SOMEIPTestabilityReliable_MethodsGet_TestFieldComplexStruct_Response_XIX_TCPServer_SomeIP_Testa_2C2CF55E67EFDC04A641F3B716BC1318: length=87, transmission-mode-true-timing=event-controlled-timing={number-of-repetitions=0, repetition-period=0.0}, unused-bit-pattern=0  # SOMEIPTestabilityReliable_MethodsGet_TestFieldComplexStruct_Response_XIX_TCPServer_SomeIP_Testability_Info_El_TestSysIP_XIX_VLAN_Cockpit
    signal SOMEIPTestabilityReliable_MethodsGet_TestFieldComplexStruct_Response_XIX_TCPServer_SomeIP_Testa_2C2CF55E67EFDC04A641F3B716BC1318: start 0, 696 bit, opaque, data-transformations=SOMEIPOnlyTransformerChain, data-type-policy=TRANSFORMING-I-SIGNAL, i-signal-type=ARRAY, someip-transformation-i-signal-props{cs-error-reaction=AUTONOMOUS, transformer=TransformationTechnologySOMEIP, interface-version=1, message-type=RESPONSE, size-of-array-length-fields=1, size-of-struct-length-fields=1, size-of-union-length-fields=1}, dynamic-length=true, transfer-property=TRIGGERED  # SOMEIPTestabilityReliable_MethodsGet_TestFieldComplexStruct_Response_XIX_TCPServer_SomeIP_Testability_Info_El_TestSysIP_XIX_VLAN_Cockpit
  pdu SOMEIPTestabilityReliable_MethodsGet_TestFieldUInt64_Request_XIX_TCPServer_SomeIP_Testability_Info_El_TestSysIP_XIX_VLAN_Cockpit: length=8, transmission-mode-true-timing=event-controlled-timing={number-of-repetitions=0, repetition-period=0.0}, unused-bit-pattern=0
    signal SOMEIPTestabilityReliable_MethodsGet_TestFieldUInt64_Request_XIX_TCPServer_SomeIP_Testability_Info_El_TestSysIP_XIX_VLAN_Cockpit: start 0, 64 bit, opaque, data-transformations=SOMEIPOnlyTransformerChain, data-type-policy=TRANSFORMING-I-SIGNAL, i-signal-type=ARRAY, someip-transformation-i-signal-props{cs-error-reaction=AUTONOMOUS, transformer=TransformationTechnologySOMEIP, interface-version=1, message-type=REQUEST}, dynamic-length=true, transfer-property=TRIGGERED, to HCP3_IONode
  pdu SOMEIPTestabilityReliable_MethodsGet_TestFieldUInt64_Response_XIX_TCPServer_SomeIP_Testability_8D4D4D29F496710EEE40DBDA8E8211EC: length=16, transmission-mode-true-timing=event-controlled-timing={number-of-repetitions=0, repetition-period=0.0}, unused-bit-pattern=0  # SOMEIPTestabilityReliable_MethodsGet_TestFieldUInt64_Response_XIX_TCPServer_SomeIP_Testability_Info_El_TestSysIP_XIX_VLAN_Cockpit
    signal SOMEIPTestabilityReliable_MethodsGet_TestFieldUInt64_Response_XIX_TCPServer_SomeIP_Testability_8D4D4D29F496710EEE40DBDA8E8211EC: start 0, 128 bit, opaque, data-transformations=SOMEIPOnlyTransformerChain, data-type-policy=TRANSFORMING-I-SIGNAL, i-signal-type=ARRAY, someip-transformation-i-signal-props{cs-error-reaction=AUTONOMOUS, transformer=TransformationTechnologySOMEIP, interface-version=1, message-type=RESPONSE}, dynamic-length=true, transfer-property=TRIGGERED  # SOMEIPTestabilityReliable_MethodsGet_TestFieldUInt64_Response_XIX_TCPServer_SomeIP_Testability_Info_El_TestSysIP_XIX_VLAN_Cockpit
  pdu SOMEIPTestabilityReliable_MethodsGet_TestFieldUInt8_Request_XIX_TCPServer_SomeIP_Testability_Info_El_TestSysIP_XIX_VLAN_Cockpit: length=8, transmission-mode-true-timing=event-controlled-timing={number-of-repetitions=0, repetition-period=0.0}, unused-bit-pattern=0
    signal SOMEIPTestabilityReliable_MethodsGet_TestFieldUInt8_Request_XIX_TCPServer_SomeIP_Testability_Info_El_TestSysIP_XIX_VLAN_Cockpit: start 0, 64 bit, opaque, data-transformations=SOMEIPOnlyTransformerChain, data-type-policy=TRANSFORMING-I-SIGNAL, i-signal-type=ARRAY, someip-transformation-i-signal-props{cs-error-reaction=AUTONOMOUS, transformer=TransformationTechnologySOMEIP, interface-version=1, message-type=REQUEST}, dynamic-length=true, transfer-property=TRIGGERED, to HCP3_IONode
  pdu SOMEIPTestabilityReliable_MethodsGet_TestFieldUInt8_Response_XIX_TCPServer_SomeIP_Testability_Info_El_TestSysIP_XIX_VLAN_Cockpit: length=9, transmission-mode-true-timing=event-controlled-timing={number-of-repetitions=0, repetition-period=0.0}, unused-bit-pattern=0
    signal SOMEIPTestabilityReliable_MethodsGet_TestFieldUInt8_Response_XIX_TCPServer_SomeIP_Testability_Info_El_TestSysIP_XIX_VLAN_Cockpit: start 0, 72 bit, opaque, data-transformations=SOMEIPOnlyTransformerChain, data-type-policy=TRANSFORMING-I-SIGNAL, i-signal-type=ARRAY, someip-transformation-i-signal-props{cs-error-reaction=AUTONOMOUS, transformer=TransformationTechnologySOMEIP, interface-version=1, message-type=RESPONSE}, dynamic-length=true, transfer-property=TRIGGERED
  pdu SOMEIPTestabilityReliable_MethodsSet_TestFieldComplexStruct_Request_XIX_TCPServer_SomeIP_Testab_549DD3A42476EEB162C512D39F7492C4: length=87, transmission-mode-true-timing=event-controlled-timing={number-of-repetitions=0, repetition-period=0.0}, unused-bit-pattern=0  # SOMEIPTestabilityReliable_MethodsSet_TestFieldComplexStruct_Request_XIX_TCPServer_SomeIP_Testability_Info_El_TestSysIP_XIX_VLAN_Cockpit
    signal SOMEIPTestabilityReliable_MethodsSet_TestFieldComplexStruct_Request_XIX_TCPServer_SomeIP_Testab_549DD3A42476EEB162C512D39F7492C4: start 0, 696 bit, opaque, data-transformations=SOMEIPOnlyTransformerChain, data-type-policy=TRANSFORMING-I-SIGNAL, i-signal-type=ARRAY, someip-transformation-i-signal-props{cs-error-reaction=AUTONOMOUS, transformer=TransformationTechnologySOMEIP, interface-version=1, message-type=REQUEST, size-of-array-length-fields=1, size-of-struct-length-fields=1, size-of-union-length-fields=1}, dynamic-length=true, transfer-property=TRIGGERED, to HCP3_IONode  # SOMEIPTestabilityReliable_MethodsSet_TestFieldComplexStruct_Request_XIX_TCPServer_SomeIP_Testability_Info_El_TestSysIP_XIX_VLAN_Cockpit
  pdu SOMEIPTestabilityReliable_MethodsSet_TestFieldComplexStruct_Response_XIX_TCPServer_SomeIP_Testa_83CD490315339B1D24B1C4726608531D: length=87, transmission-mode-true-timing=event-controlled-timing={number-of-repetitions=0, repetition-period=0.0}, unused-bit-pattern=0  # SOMEIPTestabilityReliable_MethodsSet_TestFieldComplexStruct_Response_XIX_TCPServer_SomeIP_Testability_Info_El_TestSysIP_XIX_VLAN_Cockpit
    signal SOMEIPTestabilityReliable_MethodsSet_TestFieldComplexStruct_Response_XIX_TCPServer_SomeIP_Testa_83CD490315339B1D24B1C4726608531D: start 0, 696 bit, opaque, data-transformations=SOMEIPOnlyTransformerChain, data-type-policy=TRANSFORMING-I-SIGNAL, i-signal-type=ARRAY, someip-transformation-i-signal-props{cs-error-reaction=AUTONOMOUS, transformer=TransformationTechnologySOMEIP, interface-version=1, message-type=RESPONSE, size-of-array-length-fields=1, size-of-struct-length-fields=1, size-of-union-length-fields=1}, dynamic-length=true, transfer-property=TRIGGERED  # SOMEIPTestabilityReliable_MethodsSet_TestFieldComplexStruct_Response_XIX_TCPServer_SomeIP_Testability_Info_El_TestSysIP_XIX_VLAN_Cockpit
  pdu SOMEIPTestabilityReliable_MethodsSet_TestFieldUInt8_Request_XIX_TCPServer_SomeIP_Testability_Info_El_TestSysIP_XIX_VLAN_Cockpit: length=9, transmission-mode-true-timing=event-controlled-timing={number-of-repetitions=0, repetition-period=0.0}, unused-bit-pattern=0
    signal SOMEIPTestabilityReliable_MethodsSet_TestFieldUInt8_Request_XIX_TCPServer_SomeIP_Testability_Info_El_TestSysIP_XIX_VLAN_Cockpit: start 0, 72 bit, opaque, data-transformations=SOMEIPOnlyTransformerChain, data-type-policy=TRANSFORMING-I-SIGNAL, i-signal-type=ARRAY, someip-transformation-i-signal-props{cs-error-reaction=AUTONOMOUS, transformer=TransformationTechnologySOMEIP, interface-version=1, message-type=REQUEST}, dynamic-length=true, transfer-property=TRIGGERED, to HCP3_IONode
  pdu SOMEIPTestabilityReliable_MethodsSet_TestFieldUInt8_Response_XIX_TCPServer_SomeIP_Testability_Info_El_TestSysIP_XIX_VLAN_Cockpit: length=9, transmission-mode-true-timing=event-controlled-timing={number-of-repetitions=0, repetition-period=0.0}, unused-bit-pattern=0
    signal SOMEIPTestabilityReliable_MethodsSet_TestFieldUInt8_Response_XIX_TCPServer_SomeIP_Testability_Info_El_TestSysIP_XIX_VLAN_Cockpit: start 0, 72 bit, opaque, data-transformations=SOMEIPOnlyTransformerChain, data-type-policy=TRANSFORMING-I-SIGNAL, i-signal-type=ARRAY, someip-transformation-i-signal-props{cs-error-reaction=AUTONOMOUS, transformer=TransformationTechnologySOMEIP, interface-version=1, message-type=RESPONSE}, dynamic-length=true, transfer-property=TRIGGERED
  pdu SOMEIPTestabilityReliable_RnRMethods_noResponseUInt8_XIX_TCPServer_SomeIP_Testability_Info_El_TestSysIP_XIX_VLAN_Cockpit: length=9, transmission-mode-true-timing=event-controlled-timing={number-of-repetitions=0, repetition-period=0.0}, unused-bit-pattern=0
    signal SOMEIPTestabilityReliable_RnRMethods_noResponseUInt8_XIX_TCPServer_SomeIP_Testability_Info_El_TestSysIP_XIX_VLAN_Cockpit: start 0, 72 bit, opaque, data-transformations=SOMEIPOnlyTransformerChain, data-type-policy=TRANSFORMING-I-SIGNAL, i-signal-type=ARRAY, someip-transformation-i-signal-props{transformer=TransformationTechnologySOMEIP, interface-version=1, message-type=REQUEST-NO-RETURN, size-of-array-length-fields=1, size-of-struct-length-fields=1, size-of-union-length-fields=1}, dynamic-length=true, transfer-property=TRIGGERED, to HCP3_IONode
  pdu SOMEIPTestabilityReliable_RnRMethods_triggerEchoComplexDynamicArray_XIX_TCPServer_SomeIP_Testab_E8FBD0BF52742CD4B95686D3C9201F76: length=49, transmission-mode-true-timing=event-controlled-timing={number-of-repetitions=0, repetition-period=0.0}, unused-bit-pattern=0  # SOMEIPTestabilityReliable_RnRMethods_triggerEchoComplexDynamicArray_XIX_TCPServer_SomeIP_Testability_Info_El_TestSysIP_XIX_VLAN_Cockpit
    signal SOMEIPTestabilityReliable_RnRMethods_triggerEchoComplexDynamicArray_XIX_TCPServer_SomeIP_Testab_E8FBD0BF52742CD4B95686D3C9201F76: start 0, 392 bit, opaque, data-transformations=SOMEIPOnlyTransformerChain, data-type-policy=TRANSFORMING-I-SIGNAL, i-signal-type=ARRAY, someip-transformation-i-signal-props{transformer=TransformationTechnologySOMEIP, interface-version=1, message-type=REQUEST-NO-RETURN, size-of-array-length-fields=1, size-of-struct-length-fields=1, size-of-union-length-fields=1}, dynamic-length=true, transfer-property=TRIGGERED, to HCP3_IONode  # SOMEIPTestabilityReliable_RnRMethods_triggerEchoComplexDynamicArray_XIX_TCPServer_SomeIP_Testability_Info_El_TestSysIP_XIX_VLAN_Cockpit
  pdu SOMEIPTestabilityReliable_RnRMethods_triggerEchoComplexStruct_XIX_TCPServer_SomeIP_Testability_66441691A56525584C1C972BF61F7737: length=87, transmission-mode-true-timing=event-controlled-timing={number-of-repetitions=0, repetition-period=0.0}, unused-bit-pattern=0  # SOMEIPTestabilityReliable_RnRMethods_triggerEchoComplexStruct_XIX_TCPServer_SomeIP_Testability_Info_El_TestSysIP_XIX_VLAN_Cockpit
    signal SOMEIPTestabilityReliable_RnRMethods_triggerEchoComplexStruct_XIX_TCPServer_SomeIP_Testability_66441691A56525584C1C972BF61F7737: start 0, 696 bit, opaque, data-transformations=SOMEIPOnlyTransformerChain, data-type-policy=TRANSFORMING-I-SIGNAL, i-signal-type=ARRAY, someip-transformation-i-signal-props{transformer=TransformationTechnologySOMEIP, interface-version=1, message-type=REQUEST-NO-RETURN, size-of-array-length-fields=1, size-of-struct-length-fields=1, size-of-union-length-fields=1}, dynamic-length=true, transfer-property=TRIGGERED, to HCP3_IONode  # SOMEIPTestabilityReliable_RnRMethods_triggerEchoComplexStruct_XIX_TCPServer_SomeIP_Testability_Info_El_TestSysIP_XIX_VLAN_Cockpit
  pdu SOMEIPTestabilityReliable_RnRMethods_triggerEchoFloat32_XIX_TCPServer_SomeIP_Testability_Info_El_TestSysIP_XIX_VLAN_Cockpit: length=12, transmission-mode-true-timing=event-controlled-timing={number-of-repetitions=0, repetition-period=0.0}, unused-bit-pattern=0
    signal SOMEIPTestabilityReliable_RnRMethods_triggerEchoFloat32_XIX_TCPServer_SomeIP_Testability_Info_El_TestSysIP_XIX_VLAN_Cockpit: start 0, 96 bit, opaque, data-transformations=SOMEIPOnlyTransformerChain, data-type-policy=TRANSFORMING-I-SIGNAL, i-signal-type=ARRAY, someip-transformation-i-signal-props{transformer=TransformationTechnologySOMEIP, interface-version=1, message-type=REQUEST-NO-RETURN, size-of-array-length-fields=1, size-of-struct-length-fields=1, size-of-union-length-fields=1}, dynamic-length=true, transfer-property=TRIGGERED, to HCP3_IONode
  pdu SOMEIPTestabilityReliable_RnRMethods_triggerEchoLargeDataArray_XIX_TCPServer_SomeIP_Testability_EAA76D6BE112DC3CEB9E9F874869F052: length=16, transmission-mode-true-timing=event-controlled-timing={number-of-repetitions=0, repetition-period=0.0}, unused-bit-pattern=0  # SOMEIPTestabilityReliable_RnRMethods_triggerEchoLargeDataArray_XIX_TCPServer_SomeIP_Testability_Info_El_TestSysIP_XIX_VLAN_Cockpit
    signal SOMEIPTestabilityReliable_RnRMethods_triggerEchoLargeDataArray_XIX_TCPServer_SomeIP_Testability_EAA76D6BE112DC3CEB9E9F874869F052: start 0, 128 bit, opaque, data-transformations=SOMEIPOnlyTransformerChain, data-type-policy=TRANSFORMING-I-SIGNAL, i-signal-type=ARRAY, someip-transformation-i-signal-props{transformer=TransformationTechnologySOMEIP, interface-version=1, message-type=REQUEST-NO-RETURN, size-of-array-length-fields=1, size-of-struct-length-fields=1, size-of-union-length-fields=1}, dynamic-length=true, transfer-property=TRIGGERED, to HCP3_IONode  # SOMEIPTestabilityReliable_RnRMethods_triggerEchoLargeDataArray_XIX_TCPServer_SomeIP_Testability_Info_El_TestSysIP_XIX_VLAN_Cockpit
  pdu SOMEIPTestabilityReliable_RnRMethods_triggerEchoUInt8_XIX_TCPServer_SomeIP_Testability_Info_El_TestSysIP_XIX_VLAN_Cockpit: length=9, transmission-mode-true-timing=event-controlled-timing={number-of-repetitions=0, repetition-period=0.0}, unused-bit-pattern=0
    signal SOMEIPTestabilityReliable_RnRMethods_triggerEchoUInt8_XIX_TCPServer_SomeIP_Testability_Info_El_TestSysIP_XIX_VLAN_Cockpit: start 0, 72 bit, opaque, data-transformations=SOMEIPOnlyTransformerChain, data-type-policy=TRANSFORMING-I-SIGNAL, i-signal-type=ARRAY, someip-transformation-i-signal-props{transformer=TransformationTechnologySOMEIP, interface-version=1, message-type=REQUEST-NO-RETURN, size-of-array-length-fields=1, size-of-struct-length-fields=1, size-of-union-length-fields=1}, dynamic-length=true, transfer-property=TRIGGERED, to HCP3_IONode
  pdu SOMEIPTestabilityReliable_RnRMethods_triggerEchoUInt8UInt16UInt32_XIX_TCPServer_SomeIP_Testabil_94225595C9A15EA1DA0DA88498470107: length=22, transmission-mode-true-timing=event-controlled-timing={number-of-repetitions=0, repetition-period=0.0}, unused-bit-pattern=0  # SOMEIPTestabilityReliable_RnRMethods_triggerEchoUInt8UInt16UInt32_XIX_TCPServer_SomeIP_Testability_Info_El_TestSysIP_XIX_VLAN_Cockpit
    signal SOMEIPTestabilityReliable_RnRMethods_triggerEchoUInt8UInt16UInt32_XIX_TCPServer_SomeIP_Testabil_94225595C9A15EA1DA0DA88498470107: start 0, 176 bit, opaque, data-transformations=SOMEIPOnlyTransformerChain, data-type-policy=TRANSFORMING-I-SIGNAL, i-signal-type=ARRAY, someip-transformation-i-signal-props{transformer=TransformationTechnologySOMEIP, interface-version=1, message-type=REQUEST-NO-RETURN, size-of-array-length-fields=1, size-of-struct-length-fields=1, size-of-union-length-fields=1}, dynamic-length=true, transfer-property=TRIGGERED, to HCP3_IONode  # SOMEIPTestabilityReliable_RnRMethods_triggerEchoUInt8UInt16UInt32_XIX_TCPServer_SomeIP_Testability_Info_El_TestSysIP_XIX_VLAN_Cockpit
  pdu SOMEIPTestabilityReliable_RnRMethods_triggerEventUInt8_XIX_TCPServer_SomeIP_Testability_Info_El_TestSysIP_XIX_VLAN_Cockpit: length=9, transmission-mode-true-timing=event-controlled-timing={number-of-repetitions=0, repetition-period=0.0}, unused-bit-pattern=0
    signal SOMEIPTestabilityReliable_RnRMethods_triggerEventUInt8_XIX_TCPServer_SomeIP_Testability_Info_El_TestSysIP_XIX_VLAN_Cockpit: start 0, 72 bit, opaque, data-transformations=SOMEIPOnlyTransformerChain, data-type-policy=TRANSFORMING-I-SIGNAL, i-signal-type=ARRAY, someip-transformation-i-signal-props{transformer=TransformationTechnologySOMEIP, interface-version=1, message-type=REQUEST-NO-RETURN, size-of-array-length-fields=1, size-of-struct-length-fields=1, size-of-union-length-fields=1}, dynamic-length=true, transfer-property=TRIGGERED, to HCP3_IONode
  pdu SOMEIPTestabilityReliable_RnRMethods_triggerFieldMulticast_XIX_TCPServer_SomeIP_Testability_Info_El_TestSysIP_XIX_VLAN_Cockpit: length=10, transmission-mode-true-timing=event-controlled-timing={number-of-repetitions=0, repetition-period=0.0}, unused-bit-pattern=0
    signal SOMEIPTestabilityReliable_RnRMethods_triggerFieldMulticast_XIX_TCPServer_SomeIP_Testability_Info_El_TestSysIP_XIX_VLAN_Cockpit: start 0, 80 bit, opaque, data-transformations=SOMEIPOnlyTransformerChain, data-type-policy=TRANSFORMING-I-SIGNAL, i-signal-type=ARRAY, someip-transformation-i-signal-props{transformer=TransformationTechnologySOMEIP, interface-version=1, message-type=REQUEST-NO-RETURN, size-of-array-length-fields=1, size-of-struct-length-fields=1, size-of-union-length-fields=1}, dynamic-length=true, transfer-property=TRIGGERED, to HCP3_IONode
  pdu SOMEIPTestabilityReliable_RnRMethods_triggerFireForgetUInt8_XIX_TCPServer_SomeIP_Testability_Info_El_TestSysIP_XIX_VLAN_Cockpit: length=9, transmission-mode-true-timing=event-controlled-timing={number-of-repetitions=0, repetition-period=0.0}, unused-bit-pattern=0
    signal SOMEIPTestabilityReliable_RnRMethods_triggerFireForgetUInt8_XIX_TCPServer_SomeIP_Testability_Info_El_TestSysIP_XIX_VLAN_Cockpit: start 0, 72 bit, opaque, data-transformations=SOMEIPOnlyTransformerChain, data-type-policy=TRANSFORMING-I-SIGNAL, i-signal-type=ARRAY, someip-transformation-i-signal-props{transformer=TransformationTechnologySOMEIP, interface-version=1, message-type=REQUEST-NO-RETURN, size-of-array-length-fields=1, size-of-struct-length-fields=1, size-of-union-length-fields=1}, dynamic-length=true, transfer-property=TRIGGERED, to HCP3_IONode
  pdu SOMEIPTestabilityReliable_RnRMethods_triggerGetterUInt8_XIX_TCPServer_SomeIP_Testability_Info_El_TestSysIP_XIX_VLAN_Cockpit: length=9, transmission-mode-true-timing=event-controlled-timing={number-of-repetitions=0, repetition-period=0.0}, unused-bit-pattern=0
    signal SOMEIPTestabilityReliable_RnRMethods_triggerGetterUInt8_XIX_TCPServer_SomeIP_Testability_Info_El_TestSysIP_XIX_VLAN_Cockpit: start 0, 72 bit, opaque, data-transformations=SOMEIPOnlyTransformerChain, data-type-policy=TRANSFORMING-I-SIGNAL, i-signal-type=ARRAY, someip-transformation-i-signal-props{transformer=TransformationTechnologySOMEIP, interface-version=1, message-type=REQUEST-NO-RETURN, size-of-array-length-fields=1, size-of-struct-length-fields=1, size-of-union-length-fields=1}, dynamic-length=true, transfer-property=TRIGGERED, to HCP3_IONode
  pdu SOMEIPTestabilityReliable_RnRMethods_triggerSetterUInt8_XIX_TCPServer_SomeIP_Testability_Info_El_TestSysIP_XIX_VLAN_Cockpit: length=9, transmission-mode-true-timing=event-controlled-timing={number-of-repetitions=0, repetition-period=0.0}, unused-bit-pattern=0
    signal SOMEIPTestabilityReliable_RnRMethods_triggerSetterUInt8_XIX_TCPServer_SomeIP_Testability_Info_El_TestSysIP_XIX_VLAN_Cockpit: start 0, 72 bit, opaque, data-transformations=SOMEIPOnlyTransformerChain, data-type-policy=TRANSFORMING-I-SIGNAL, i-signal-type=ARRAY, someip-transformation-i-signal-props{transformer=TransformationTechnologySOMEIP, interface-version=1, message-type=REQUEST-NO-RETURN, size-of-array-length-fields=1, size-of-struct-length-fields=1, size-of-union-length-fields=1}, dynamic-length=true, transfer-property=TRIGGERED, to HCP3_IONode
  pdu STH_01_XIX_VLAN_Cockpit: length=8, transmission-mode-true-timing=cyclic-timing={time-offset=0.0, time-period=0.2}, unused-bit-pattern=0
    signal STH_Funk_ein_XIX_STH_01_XIX_VLAN_Cockpit: start 0, 1 bit, little-endian, data-type-policy=OVERRIDE, i-signal-type=PRIMITIVE, init-value=0, base-type=BT_STH_Funk_ein, compu {1=Cx1_Funkbefehl_zum_Einschalten_erhalten (CM_STH_Funk_ein_Cx1_Funkbefehl_zum_Einschalten_erhalten) (Funkbefehl zum Einschalten erhalten), 0=Cx0_kein_Funkbefehl_zum_Einschalten (CM_STH_Funk_ein_Cx0_kein_Funkbefehl_zum_Einschalten) (kein Funkbefehl zum Einschalten)}, range raw 0..1, transfer-property=PENDING  # Funkbefehl über Funkfernbedienung zum Einschalten Standheizung
    signal STH_Funk_aus_XIX_STH_01_XIX_VLAN_Cockpit: start 1, 1 bit, little-endian, data-type-policy=OVERRIDE, i-signal-type=PRIMITIVE, init-value=0, base-type=BT_STH_Funk_aus, compu {1=Cx1_Funkbefehl_zum_Ausschalten_erhalten (CM_STH_Funk_aus_Cx1_Funkbefehl_zum_Ausschalten_erhalten) (Funkbefehl zum Ausschalten erhalten), 0=Cx0_kein_Funkbefehl (CM_STH_Funk_aus_Cx0_kein_Funkbefehl) (kein Funkbefehl)}, range raw 0..1, transfer-property=PENDING  # Funkbefehl über Funkfernbedienung zum Ausschalten Standheizung
    signal STH_Zusatzheizung_XIX_STH_01_XIX_VLAN_Cockpit: start 2, 1 bit, little-endian, data-type-policy=OVERRIDE, i-signal-type=PRIMITIVE, init-value=0, base-type=BT_STH_Zusatzheizung, compu {0=Cx0_Zuheizer_aus (CM_STH_Zusatzheizung_Cx0_Zuheizer_aus) (Zuheizer aus), 1=Cx1_Zuheizer_ein (CM_STH_Zusatzheizung_Cx1_Zuheizer_ein) (Zuheizer ein)}, range raw 0..1, transfer-property=PENDING  # Kraftstoffzuheizer aktiv
    signal STH_LED_XIX_STH_01_XIX_VLAN_Cockpit: start 3, 1 bit, little-endian, data-type-policy=OVERRIDE, i-signal-type=PRIMITIVE, init-value=0, base-type=BT_STH_LED, compu {1=Cx1_Rueckmeldung_Standheizung_in_Betrieb (CM_STH_LED_Cx1_Rueckmeldung_Standheizung_in_Betrieb) (Rueckmeldung Standheizung in Betrieb), 0=Cx0_keine_Rueckmeldung (CM_STH_LED_Cx0_keine_Rueckmeldung) (keine Rückmeldung)}, range raw 0..1, transfer-property=PENDING  # Funktionslampe
    signal STH_Pumpe_ein_XIX_STH_01_XIX_VLAN_Cockpit: start 4, 1 bit, little-endian, data-type-policy=OVERRIDE, i-signal-type=PRIMITIVE, init-value=0, base-type=BT_STH_Pumpe_ein, compu {phys=raw for raw 0..1}, range phys 0..1, raw 0..1, transfer-property=PENDING
    signal STH_Geblaese_XIX_STH_01_XIX_VLAN_Cockpit: start 5, 1 bit, little-endian, data-type-policy=OVERRIDE, i-signal-type=PRIMITIVE, init-value=0, base-type=BT_STH_Geblaese, compu {0=Cx0_kein_Einschaltbefehl_an_die_Klimaanlage_Geblaese (CM_STH_Geblaese_Cx0_kein_Einschaltbefehl_an_die_Klimaanlage_Geblaese) (kein Einschaltbefehl an die Klimaanlage, Gebläse), 1=Cx1_Einschaltbefehl_an_die_Klimaanlage_Geblaese (CM_STH_Geblaese_Cx1_Einschaltbefehl_an_die_Klimaanlage_Geblaese) (Einschaltbefehl an die Klimaanlage, Gebläse)}, range raw 0..1, transfer-property=PENDING  # Ein-/ Ausschaltbefehl an die Klimaanlage, Gebläse
    signal STH_Start_folgt_XIX_STH_01_XIX_VLAN_Cockpit: start 7, 1 bit, little-endian, data-type-policy=OVERRIDE, i-signal-type=PRIMITIVE, init-value=0, base-type=BT_STH_Start_folgt, compu {0=Cx0_kein_Start_folgt (CM_STH_Start_folgt_Cx0_kein_Start_folgt), 1=Cx1_Start_folgt (CM_STH_Start_folgt_Cx1_Start_folgt)}, range raw 0..1, transfer-property=PENDING  # Thema Start/Stop: Im Stop-Modus muß das KBT einen Wiederstart anfordern, da ein STH-Start notwendig ist.
    signal STH_Ventiloeffnungszeit_XIX_STH_01_XIX_VLAN_Cockpit: start 8, 6 bit, little-endian, data-type-policy=OVERRIDE, i-signal-type=PRIMITIVE, init-value=0, base-type=BT_STH_Ventiloeffnungszeit, compu {phys=raw for raw 0..63; unit Unit_Minut}, range phys 0..63 Unit_Minut, raw 0..63, unit=Unit_Minut, transfer-property=PENDING  # Die Standheizung sendet an den Motor die Information darüber wie lange das Magnetventil die Wasserkreisläufe von "klein" aus "gross" geschaltet hat.
    signal STH_Ventil_Status_XIX_STH_01_XIX_VLAN_Cockpit: start 14, 1 bit, little-endian, data-type-policy=OVERRIDE, i-signal-type=PRIMITIVE, init-value=0, base-type=BT_STH_Ventil_Status, compu {1=Cx1_Ventil_geschlossen_kleiner_Kreislauf (CM_STH_Ventil_Status_Cx1_Ventil_geschlossen_kleiner_Kreislauf) (Ventil_geschlossen__kleiner_Kreislauf), 0=Cx0_Ventil_offen_grosser_Kreislauf (CM_STH_Ventil_Status_Cx0_Ventil_offen_grosser_Kreislauf) (Ventil_offen__grosser_Kreislauf)}, range raw 0..1, transfer-property=PENDING  # Statusrückmeldung Ansteuerung 3/2 Wege-Ventil
    signal STH_Fehler_ElWaPu_XIX_STH_01_XIX_VLAN_Cockpit: start 15, 1 bit, little-endian, data-type-policy=OVERRIDE, i-signal-type=PRIMITIVE, init-value=0, base-type=BT_STH_Fehler_ElWaPu, invalid-value=Invalid_STH_Fehler_ElWaPu_XIX_STH_01_XIX_VLAN_Cockpit:1, compu {1=Cx1_Fehler (CM_STH_Fehler_ElWaPu_Cx1_Fehler), 0=Cx0_kein_Fehler (CM_STH_Fehler_ElWaPu_Cx0_kein_Fehler)}, range raw 0..1, transfer-property=PENDING  # Fehler der el. Zusatzwasserpumpe der zur Deaktivierung der Wasserpumpe führt
    signal STH_Waermeeintrag_XIX_STH_01_XIX_VLAN_Cockpit: start 16, 6 bit, little-endian, data-type-policy=OVERRIDE, i-signal-type=PRIMITIVE, init-value=0, base-type=BT_STH_Waermeeintrag, compu {phys=raw for raw 0..63; unit Unit_None}, range phys 0..63 Unit_None, raw 0..63, unit=Unit_None, transfer-property=PENDING  # Signal enthält die Brenndauer in 1min-Schritten, über welche die Standheizung gelaufen ist
    signal STH_Pumpen_Anf_extern_XIX_STH_01_XIX_VLAN_Cockpit: start 22, 1 bit, little-endian, data-type-policy=OVERRIDE, i-signal-type=PRIMITIVE, init-value=0, base-type=BT_STH_Pumpen_Anf_extern, compu {0=Cx0_nicht_angefordert (CM_STH_Pumpen_Anf_extern_Cx0_nicht_angefordert), 1=Cx1_angefordert (CM_STH_Pumpen_Anf_extern_Cx1_angefordert)}, range raw 0..1, transfer-property=PENDING  # Anforderung der motorseitigen elektr. (externen) Wasserpumpe zur Kreislaufunterstützung im Standheizbetrieb
    signal STH_KVS_XIX_STH_01_XIX_VLAN_Cockpit: start 24, 13 bit, little-endian, data-type-policy=OVERRIDE, i-signal-type=PRIMITIVE, init-value=0, base-type=BT_STH_KVS, compu {phys=raw for raw 0..8191; unit Unit_MilliLiter}, range phys 0..8191 Unit_MilliLiter, raw 0..8191, unit=Unit_MilliLiter, transfer-property=PENDING, to HCP3_IONode(timeout 2 s)  # Kraftstoffverbrauch
    signal STH_Fehlerstatus_XIX_STH_01_XIX_VLAN_Cockpit: start 37, 3 bit, little-endian, data-type-policy=OVERRIDE, i-signal-type=PRIMITIVE, init-value=0, base-type=BT_STH_Fehlerstatus, compu {5=Cx5_Fehler_Betrieb_nicht_verhindert (CM_STH_Fehlerstatus_Cx5_Fehler_Betrieb_nicht_verhindert), 0=Cx0_kein_Fehler (CM_STH_Fehlerstatus_Cx0_kein_Fehler), 3=Cx3_Fehler_Betrieb_verhindert (CM_STH_Fehlerstatus_Cx3_Fehler_Betrieb_verhindert), 4=Cx4_Heizgeraet_verriegelt (CM_STH_Fehlerstatus_Cx4_Heizgeraet_verriegelt), 6=Cx6_Emissionsueberschreitung (CM_STH_Fehlerstatus_Cx6_Emissionsueberschreitung) (Emissionsüberschreitung), 2=Cx2_Tankfuellstand_zu_gering (CM_STH_Fehlerstatus_Cx2_Tankfuellstand_zu_gering), 1=Cx1_Unterspannung (CM_STH_Fehlerstatus_Cx1_Unterspannung)}, range raw 0..6, transfer-property=PENDING  # Übermittlung der unterschiedlichen Fehlerzustände der Standheizung
    signal STH_Heizleistung_XIX_STH_01_XIX_VLAN_Cockpit: start 40, 8 bit, little-endian, data-type-policy=OVERRIDE, i-signal-type=PRIMITIVE, init-value=0, base-type=BT_STH_Heizleistung, compu {phys=raw for raw 0..255}, range phys 0..255, raw 0..255, transfer-property=PENDING  # Heizleistung in %
    signal STH_Wassertemp_XIX_STH_01_XIX_VLAN_Cockpit: start 48, 8 bit, little-endian, data-type-policy=OVERRIDE, i-signal-type=PRIMITIVE, init-value=254, base-type=BT_STH_Wassertemp, invalid-value=Invalid_STH_Wassertemp_XIX_STH_01_XIX_VLAN_Cockpit:255, compu {phys=raw*0.75-40 for raw 0..243, 255=Cxff_Fehler (CM_STH_Wassertemp_Cxff_Fehler), 254=Cxfe_Init (CM_STH_Wassertemp_Cxfe_Init); unit Unit_DegreCelsi}, range phys -40..142.25 Unit_DegreCelsi, raw 0..255, unit=Unit_DegreCelsi, transfer-property=PENDING  # Kühlmitteltemperatur der Standheizung
    signal STH_Texte_XIX_STH_01_XIX_VLAN_Cockpit: start 56, 3 bit, little-endian, data-type-policy=OVERRIDE, i-signal-type=PRIMITIVE, init-value=0, base-type=BT_STH_Texte, compu {3=Cx3_interner_Systemfehler (CM_STH_Texte_Cx3_interner_Systemfehler), 4=Cx4_Heizzeitueberschreitung (CM_STH_Texte_Cx4_Heizzeitueberschreitung), 0=Cx0_keine_Anzeige (CM_STH_Texte_Cx0_keine_Anzeige), 1=Cx1_Batteriemanagementeinschraenkung (CM_STH_Texte_Cx1_Batteriemanagementeinschraenkung), 2=Cx2_Kraftstoffmangel (CM_STH_Texte_Cx2_Kraftstoffmangel)}, range raw 0..4, transfer-property=PENDING  # Anforderung der unterschiedlichen Anzeigetexte im Mitteldisplay des Kombi. 0: Keine Anzeige 1: Kein Standheizungs- bzw Lueftungsbetrieb wegen Batteriemanagementeinschraenkung 2: Kein Standheizungs- bzw Lueftungsbetrieb wegen Kraftstoffmangels 3: Kein Standheizungs- bzw Lueftungsbetrieb wegen internem Systemfehler 4: Kein Standheizungs- bzw Lueftungsbetrieb wegen Heizzeitueberschreitung
    signal STH_Motorvorwaermung_XIX_STH_01_XIX_VLAN_Cockpit: start 59, 1 bit, little-endian, data-type-policy=OVERRIDE, i-signal-type=PRIMITIVE, init-value=0, base-type=BT_STH_Motorvorwaermung, compu {0=Cx0_keine_Motorvorwaermung_erfolgt (CM_STH_Motorvorwaermung_Cx0_keine_Motorvorwaermung_erfolgt) (keine Motorvorwärmung erfolgt), 1=Cx1_Aufheizung_mit_Motorvorwaermung_erfolgt (CM_STH_Motorvorwaermung_Cx1_Aufheizung_mit_Motorvorwaermung_erfolgt) (Aufheizung mit Motorvorwärmung erfolgt)}, range raw 0..1, transfer-property=PENDING  # Info an der Motor, dass der Aufheizvorgang mit Motorvorwärmung erfolgt ist
    signal STH_Servicemode_XIX_STH_01_XIX_VLAN_Cockpit: start 60, 1 bit, little-endian, data-type-policy=OVERRIDE, i-signal-type=PRIMITIVE, init-value=0, base-type=BT_STH_Servicemode, compu {0=Cx0_Servicemode_nicht_aktiv (CM_STH_Servicemode_Cx0_Servicemode_nicht_aktiv) (Servicemode nicht aktiv), 1=Cx1_Servicemode_aktiv (CM_STH_Servicemode_Cx1_Servicemode_aktiv) (Servicemode aktiv)}, range raw 0..1, transfer-property=PENDING  # Rückmeldung, dass die Standheizung sich gerade im Diagnosemodus befindet, gestartet über Diagnosetester
    signal STH_war_aktiv_XIX_STH_01_XIX_VLAN_Cockpit: start 61, 1 bit, little-endian, data-type-policy=OVERRIDE, i-signal-type=PRIMITIVE, init-value=0, base-type=BT_STH_war_aktiv, compu {0=Cx0_war_inaktiv (CM_STH_war_aktiv_Cx0_war_inaktiv) (war inaktiv), 1=Cx1_Standheizung_war_letzte_halbe_Stunde_aktiv (CM_STH_war_aktiv_Cx1_Standheizung_war_letzte_halbe_Stunde_aktiv) (Standheizung war letzte halbe Stunde aktiv)}, range raw 0..1, transfer-property=PENDING  # Bit beeinhaltet die Info, dass die Standheizung während der letzten halbe Stunde aktiv war.
    signal STH_KVS_Ueberlauf_XIX_STH_01_XIX_VLAN_Cockpit: start 62, 1 bit, little-endian, data-type-policy=OVERRIDE, i-signal-type=PRIMITIVE, init-value=0, base-type=BT_STH_KVS_Ueberlauf, compu {1=Cx1_Kraftstoffverbrauchssignal_mindestens_ein_ueberlauf_hat_stattgefunden (CM_STH_KVS_Ueberlauf_Cx1_Kraftstoffverbrauchssignal_mindestens_ein_ueberlauf_hat_stattgefunden) (Kraftstoffverbrauchssignal, mindestens ein Überlauf hat stattgefunden), 0=Cx0_kein_ueberlauf (CM_STH_KVS_Ueberlauf_Cx0_kein_ueberlauf) (kein Überlauf)}, range raw 0..1, transfer-property=PENDING, to HCP3_IONode(timeout 2 s)  # Kraftstoffverbrauch, Überlauf hat stattgefunden
    signal STH_FlgFuPmp_XIX_STH_01_XIX_VLAN_Cockpit: start 63, 1 bit, little-endian, data-type-policy=OVERRIDE, i-signal-type=PRIMITIVE, init-value=0, base-type=BT_STH_FlgFuPmp, compu {0=Cx0_EKP_nicht_ansteuern (CM_STH_FlgFuPmp_Cx0_EKP_nicht_ansteuern), 1=Cx1_EKP_ansteuern (CM_STH_FlgFuPmp_Cx1_EKP_ansteuern)}, range raw 0..1, transfer-property=PENDING  # STH sendet die Anforderung zur EKP-Ansteuerung
  pdu Tank_01_XIX_VLAN_Cockpit: length=8, minimum-delay=0.05, transmission-mode-true-timing={cyclic-timing={time-offset=0.0, time-period=0.5}, event-controlled-timing={number-of-repetitions=0, repetition-period=0.0}}, unused-bit-pattern=0
    signal TNK_Wegstrecke_Hinweis_XIX_Tank_01_XIX_VLAN_Cockpit: start 0, 1 bit, little-endian, data-type-policy=OVERRIDE, i-signal-type=PRIMITIVE, init-value=0, base-type=BT_TNK_Wegstrecke_Hinweis, compu {0=Cx0_Inaktiv (CM_TNK_Wegstrecke_Hinweis_Cx0_Inaktiv), 1=Cx1_Aktiv (CM_TNK_Wegstrecke_Hinweis_Cx1_Aktiv)}, range raw 0..1, transfer-property=TRIGGERED-ON-CHANGE-WITHOUT-REPETITION  # Das Signal Triggert ein Pop-up ins Kombi, über das die Wegstrecke resetiert sein kann.
    signal TNK_Tankanzeigefreigabe_XIX_Tank_01_XIX_VLAN_Cockpit: start 1, 1 bit, little-endian, data-type-policy=OVERRIDE, i-signal-type=PRIMITIVE, init-value=0, base-type=BT_TNK_Tankanzeigefreigabe, compu {0=Cx0_nicht_freigegeben (CM_TNK_Tankanzeigefreigabe_Cx0_nicht_freigegeben), 1=Cx1_freigegeben (CM_TNK_Tankanzeigefreigabe_Cx1_freigegeben)}, range raw 0..1, transfer-property=PENDING  # Freigabe der Kraftstoffvorratsanzeige
    signal TNK_Kraftstoffvorrat_XIX_Tank_01_XIX_VLAN_Cockpit: start 2, 10 bit, little-endian, data-type-policy=OVERRIDE, i-signal-type=PRIMITIVE, init-value=1022, base-type=BT_TNK_Kraftstoffvorrat, invalid-value=Invalid_TNK_Kraftstoffvorrat_XIX_Tank_01_XIX_VLAN_Cockpit:1023, compu {phys=raw*0.1 for raw 0..1000, 1023=Cx3ff_Fehler (CM_TNK_Kraftstoffvorrat_Cx3ff_Fehler), 1021=Cx3fd_nicht_verbaut (CM_TNK_Kraftstoffvorrat_Cx3fd_nicht_verbaut), 1022=Cx3fe_Init (CM_TNK_Kraftstoffvorrat_Cx3fe_Init); unit Unit_PerCent}, range phys 0..100 Unit_PerCent, raw 0..1023, unit=Unit_PerCent, transfer-property=PENDING  # Kraftstoffvorrat in %, Wert aus Anzeigekennlinie. Keine numerische Anzeige.
    signal TNK_Tankinhalt_roh_XIX_Tank_01_XIX_VLAN_Cockpit: start 12, 11 bit, little-endian, data-type-policy=OVERRIDE, i-signal-type=PRIMITIVE, init-value=2046, base-type=BT_TNK_Tankinhalt_roh, invalid-value=Invalid_TNK_Tankinhalt_roh_XIX_Tank_01_XIX_VLAN_Cockpit:2047, compu {phys=raw*0.1 for raw 0..2045, 2047=Cx7ff_Fehler (CM_TNK_Tankinhalt_roh_Cx7ff_Fehler), 2046=Cx7fe_Init (CM_TNK_Tankinhalt_roh_Cx7fe_Init); unit Unit_Liter}, range phys 0..204.5 Unit_Liter, raw 0..2047, unit=Unit_Liter, transfer-property=PENDING  # Überträgt den ungefilterten und kalibrierten Tankinhalt (incl. Überhub im Vollbereich). Die Bereitstellung des Signale erfolgt nicht nach OBD Richtlinien. Die OBD konforme Verarbeitung erfolgt im Empfänger
    signal TNK_FStatus_Tank_XIX_Tank_01_XIX_VLAN_Cockpit: start 23, 1 bit, little-endian, data-type-policy=OVERRIDE, i-signal-type=PRIMITIVE, init-value=0, base-type=BT_TNK_FStatus_Tank, compu {0=Cx0_Tankfuellstand_i_O (CM_TNK_FStatus_Tank_Cx0_Tankfuellstand_i_O) (Tankfüllstand i.O.), 1=Cx1_Tankfuellstand_n_i_O (CM_TNK_FStatus_Tank_Cx1_Tankfuellstand_n_i_O) (Tankfüllstand n.i.O.)}, range raw 0..1, transfer-property=TRIGGERED-ON-CHANGE-WITHOUT-REPETITION  # Signal wird gesetzt: a) Während der Fehlerentprellzeit (20 s Entprellung) b) Bei erkanntem Fehler wird der Tankinhalt während der laufenden KL15-Phase über den Verbrauch zurückgerechnet. In dieser Zeit ist das Bit ebenfalls gesetzt. Nach einem
    signal TNK_Tankwarnung_ungueltig_XIX_Tank_01_XIX_VLAN_Cockpit: start 24, 1 bit, little-endian, data-type-policy=OVERRIDE, i-signal-type=PRIMITIVE, init-value=0, base-type=BT_TNK_Tankwarnung_ungueltig, compu {1=Cx1_TNK_Tankwarnung_ungueltig (CM_TNK_Tankwarnung_ungueltig_Cx1_TNK_Tankwarnung_ungueltig), 0=Cx0_TNK_Tankwarnung_gueltig (CM_TNK_Tankwarnung_ungueltig_Cx0_TNK_Tankwarnung_gueltig)}, range raw 0..1, transfer-property=TRIGGERED-ON-CHANGE-WITHOUT-REPETITION  # Validiert den Inhalt des Signales TNK_Tankwarnung
    signal TNK_Tankwarnung_XIX_Tank_01_XIX_VLAN_Cockpit: start 25, 1 bit, little-endian, data-type-policy=OVERRIDE, i-signal-type=PRIMITIVE, init-value=0, base-type=BT_TNK_Tankwarnung, compu {1=Cx1_Warnung_ein (CM_TNK_Tankwarnung_Cx1_Warnung_ein), 0=Cx0_Warnung_aus (CM_TNK_Tankwarnung_Cx0_Warnung_aus)}, range raw 0..1, transfer-property=TRIGGERED-ON-CHANGE-WITHOUT-REPETITION  # Kraftstoffstand: Reservebereich ist erreicht. Fzg.spezifische Warnschwelle. Signal im Fehlerfall und bei Requalifizierung letzer Wert.
    signal TNK_Tankinhalt_hochaufl_XIX_Tank_01_XIX_VLAN_Cockpit: start 26, 14 bit, little-endian, data-type-policy=OVERRIDE, i-signal-type=PRIMITIVE, init-value=16382, base-type=BT_TNK_Tankinhalt_hochaufl, invalid-value=Invalid_TNK_Tankinhalt_hochaufl_XIX_Tank_01_XIX_VLAN_Cockpit:16383, compu {phys=raw*0.01 for raw 0..16381, 16383=Cx3fff_Fehler (CM_TNK_Tankinhalt_hochaufl_Cx3fff_Fehler), 16382=Cx3ffe_init (CM_TNK_Tankinhalt_hochaufl_Cx3ffe_init); unit Unit_Liter}, range phys 0..163.81 Unit_Liter, raw 0..16383, unit=Unit_Liter, transfer-property=PENDING  # Angezeigter Tankinhalt hochauflösend
    signal TNK_Max_Tankinhalt_XIX_Tank_01_XIX_VLAN_Cockpit: start 40, 8 bit, little-endian, data-type-policy=OVERRIDE, i-signal-type=PRIMITIVE, init-value=254, base-type=BT_TNK_Max_Tankinhalt, invalid-value=Invalid_TNK_Max_Tankinhalt_XIX_Tank_01_XIX_VLAN_Cockpit:255, compu {phys=raw*0.5 for raw 0..253, 255=Cxff_Fehler (CM_TNK_Max_Tankinhalt_Cxff_Fehler), 254=Cxfe_init (CM_TNK_Max_Tankinhalt_Cxfe_init); unit Unit_Liter}, range phys 0..126.5 Unit_Liter, raw 0..255, unit=Unit_Liter, transfer-property=PENDING  # Mitteilung des maximalen Tankinhalts an das Reichweitenmodul
    signal TNK_Min_Tankinhalt_XIX_Tank_01_XIX_VLAN_Cockpit: start 48, 7 bit, little-endian, data-type-policy=OVERRIDE, i-signal-type=PRIMITIVE, init-value=126, base-type=BT_TNK_Min_Tankinhalt, invalid-value=Invalid_TNK_Min_Tankinhalt_XIX_Tank_01_XIX_VLAN_Cockpit:127, compu {phys=raw*0.1 for raw 0..125, 127=Cx7f_Fehler (CM_TNK_Min_Tankinhalt_Cx7f_Fehler), 126=Cx7e_init (CM_TNK_Min_Tankinhalt_Cx7e_init); unit Unit_Liter}, range phys 0..12.5 Unit_Liter, raw 0..127, unit=Unit_Liter, transfer-property=PENDING  # Tankanzeigeleerwert für Reichweitenberechnung, kein reales Kraftstoffvolumen
    signal TNK_Nachtanken_erkannt_XIX_Tank_01_XIX_VLAN_Cockpit: start 56, 1 bit, little-endian, data-type-policy=OVERRIDE, i-signal-type=PRIMITIVE, init-value=0, base-type=BT_TNK_Nachtanken_erkannt, compu {0=Cx0_Geberbetrieb (CM_TNK_Nachtanken_erkannt_Cx0_Geberbetrieb), 1=Cx1_Nachtankmodus (CM_TNK_Nachtanken_erkannt_Cx1_Nachtankmodus)}, range raw 0..1, transfer-property=TRIGGERED-ON-CHANGE-WITHOUT-REPETITION  # Statusinformation Nachtankmodus
  pdu Tankgeber_02_XIX_VLAN_Cockpit: length=24, transmission-mode-true-timing=cyclic-timing={time-offset=0.0, time-period=0.5}, unused-bit-pattern=0
    signal TG_QBit_Geber_1_XIX_Tankgeber_02_XIX_VLAN_Cockpit: start 12, 1 bit, little-endian, data-type-policy=OVERRIDE, i-signal-type=PRIMITIVE, init-value=1, base-type=BT_TG_QBit_Geber_1, compu {0=Cx0_gueltiger_Wert (CM_TG_QBit_Geber_1_Cx0_gueltiger_Wert), 1=Cx1_Ersatz_Init_oder_Fehlerwert (CM_TG_QBit_Geber_1_Cx1_Ersatz_Init_oder_Fehlerwert)}, range raw 0..1, transfer-property=PENDING, to HCP3_IONode(timeout 5 s)  # QBit des Tankgebers. Gesetzt bei niedriger Messwertguete, Init oder Fehler.
    signal TG_QBit_Geber_2_XIX_Tankgeber_02_XIX_VLAN_Cockpit: start 13, 1 bit, little-endian, data-type-policy=OVERRIDE, i-signal-type=PRIMITIVE, init-value=1, base-type=BT_TG_QBit_Geber_2, compu {0=Cx0_gueltiger_Wert (CM_TG_QBit_Geber_2_Cx0_gueltiger_Wert), 1=Cx1_Ersatz_Init_oder_Fehlerwert (CM_TG_QBit_Geber_2_Cx1_Ersatz_Init_oder_Fehlerwert)}, range raw 0..1, transfer-property=PENDING, to HCP3_IONode(timeout 5 s)  # QBit des Tankgebers. Gesetzt bei niedriger Messwertguete, Init oder Fehler.
    signal TG_QBit_Geber_3_XIX_Tankgeber_02_XIX_VLAN_Cockpit: start 14, 1 bit, little-endian, data-type-policy=OVERRIDE, i-signal-type=PRIMITIVE, init-value=1, base-type=BT_TG_QBit_Geber_3, compu {1=Cx1_Ersatz_Init_oder_Fehlerwert (CM_TG_QBit_Geber_3_Cx1_Ersatz_Init_oder_Fehlerwert), 0=Cx0_gueltiger_Wert (CM_TG_QBit_Geber_3_Cx0_gueltiger_Wert)}, range raw 0..1, transfer-property=PENDING, to HCP3_IONode(timeout 5 s)  # QBit des Tankgebers. Gesetzt bei niedriger Messwertguete, Init oder Fehler.
    signal TG_QBit_Geber_4_XIX_Tankgeber_02_XIX_VLAN_Cockpit: start 15, 1 bit, little-endian, data-type-policy=OVERRIDE, i-signal-type=PRIMITIVE, init-value=1, base-type=BT_TG_QBit_Geber_4, compu {1=Cx1_Ersatz_Init_oder_Fehlerwert (CM_TG_QBit_Geber_4_Cx1_Ersatz_Init_oder_Fehlerwert), 0=Cx0_gueltiger_Wert (CM_TG_QBit_Geber_4_Cx0_gueltiger_Wert)}, range raw 0..1, transfer-property=PENDING, to HCP3_IONode(timeout 5 s)  # QBit des Tankgebers. Gesetzt bei niedriger Messwertguete, Init oder Fehler.
    signal TG_Geber_1_Mittelwert_XIX_Tankgeber_02_XIX_VLAN_Cockpit: start 16, 12 bit, little-endian, data-type-policy=OVERRIDE, i-signal-type=PRIMITIVE, init-value=4094, base-type=BT_TG_Geber_1_Mittelwert, invalid-value=Invalid_TG_Geber_1_Mittelwert_XIX_Tankgeber_02_XIX_VLAN_Cockpit:4095, compu {phys=raw for raw 0..4092, 4095=Cxfff_Fehler (CM_TG_Geber_1_Mittelwert_Cxfff_Fehler), 4094=Cxffe_Init (CM_TG_Geber_1_Mittelwert_Cxffe_Init), 4093=Cxffd_nicht_verbaut (CM_TG_Geber_1_Mittelwert_Cxffd_nicht_verbaut); unit Unit_Ohm}, range phys 0..4092 Unit_Ohm, raw 0..4095, unit=Unit_Ohm, transfer-property=PENDING, to HCP3_IONode(timeout 5 s)  # Rohwert der Tankgeber
    signal TG_Geber_2_Mittelwert_XIX_Tankgeber_02_XIX_VLAN_Cockpit: start 28, 12 bit, little-endian, data-type-policy=OVERRIDE, i-signal-type=PRIMITIVE, init-value=4094, base-type=BT_TG_Geber_2_Mittelwert, invalid-value=Invalid_TG_Geber_2_Mittelwert_XIX_Tankgeber_02_XIX_VLAN_Cockpit:4095, compu {phys=raw for raw 0..4092, 4095=Cxfff_Fehler (CM_TG_Geber_2_Mittelwert_Cxfff_Fehler), 4093=Cxffd_nicht_verbaut (CM_TG_Geber_2_Mittelwert_Cxffd_nicht_verbaut), 4094=Cxffe_Init (CM_TG_Geber_2_Mittelwert_Cxffe_Init); unit Unit_Ohm}, range phys 0..4092 Unit_Ohm, raw 0..4095, unit=Unit_Ohm, transfer-property=PENDING, to HCP3_IONode(timeout 5 s)  # Rohwert der Tankgeber
    signal TG_Geber_3_Mittelwert_XIX_Tankgeber_02_XIX_VLAN_Cockpit: start 40, 12 bit, little-endian, data-type-policy=OVERRIDE, i-signal-type=PRIMITIVE, init-value=4094, base-type=BT_TG_Geber_3_Mittelwert, invalid-value=Invalid_TG_Geber_3_Mittelwert_XIX_Tankgeber_02_XIX_VLAN_Cockpit:4095, compu {phys=raw for raw 0..4092, 4095=Cxfff_Fehler (CM_TG_Geber_3_Mittelwert_Cxfff_Fehler), 4093=Cxffd_nicht_verbaut (CM_TG_Geber_3_Mittelwert_Cxffd_nicht_verbaut), 4094=Cxffe_Init (CM_TG_Geber_3_Mittelwert_Cxffe_Init); unit Unit_Ohm}, range phys 0..4092 Unit_Ohm, raw 0..4095, unit=Unit_Ohm, transfer-property=PENDING, to HCP3_IONode(timeout 5 s)  # Rohwert der Tankgeber
    signal TG_Geber_4_Mittelwert_XIX_Tankgeber_02_XIX_VLAN_Cockpit: start 52, 12 bit, little-endian, data-type-policy=OVERRIDE, i-signal-type=PRIMITIVE, init-value=4094, base-type=BT_TG_Geber_4_Mittelwert, invalid-value=Invalid_TG_Geber_4_Mittelwert_XIX_Tankgeber_02_XIX_VLAN_Cockpit:4095, compu {phys=raw for raw 0..4092, 4095=Cxfff_Fehler (CM_TG_Geber_4_Mittelwert_Cxfff_Fehler), 4093=Cxffd_nicht_verbaut (CM_TG_Geber_4_Mittelwert_Cxffd_nicht_verbaut), 4094=Cxffe_Init (CM_TG_Geber_4_Mittelwert_Cxffe_Init); unit Unit_Ohm}, range phys 0..4092 Unit_Ohm, raw 0..4095, unit=Unit_Ohm, transfer-property=PENDING, to HCP3_IONode(timeout 5 s)  # Rohwert der Tankgeber
    signal TG_Geber_1_Stand_XIX_Tankgeber_02_XIX_VLAN_Cockpit: start 64, 12 bit, little-endian, data-type-policy=OVERRIDE, i-signal-type=PRIMITIVE, init-value=4094, base-type=BT_TG_Geber_1_Stand, invalid-value=Invalid_TG_Geber_1_Stand_XIX_Tankgeber_02_XIX_VLAN_Cockpit:4095, compu {phys=raw for raw 0..4092, 4095=Cxfff_Fehler (CM_TG_Geber_1_Stand_Cxfff_Fehler), 4093=Cxffd_nicht_verbaut (CM_TG_Geber_1_Stand_Cxffd_nicht_verbaut), 4094=Cxffe_Init (CM_TG_Geber_1_Stand_Cxffe_Init); unit Unit_Ohm}, range phys 0..4092 Unit_Ohm, raw 0..4095, unit=Unit_Ohm, transfer-property=PENDING, to HCP3_IONode(timeout 5 s)  # Rohwert der Tankgeber im Stand
    signal TG_Geber_2_Stand_XIX_Tankgeber_02_XIX_VLAN_Cockpit: start 76, 12 bit, little-endian, data-type-policy=OVERRIDE, i-signal-type=PRIMITIVE, init-value=4094, base-type=BT_TG_Geber_2_Stand, invalid-value=Invalid_TG_Geber_2_Stand_XIX_Tankgeber_02_XIX_VLAN_Cockpit:4095, compu {phys=raw for raw 0..4092, 4095=Cxfff_Fehler (CM_TG_Geber_2_Stand_Cxfff_Fehler), 4093=Cxffd_nicht_verbaut (CM_TG_Geber_2_Stand_Cxffd_nicht_verbaut), 4094=Cxffe_Init (CM_TG_Geber_2_Stand_Cxffe_Init); unit Unit_Ohm}, range phys 0..4092 Unit_Ohm, raw 0..4095, unit=Unit_Ohm, transfer-property=PENDING, to HCP3_IONode(timeout 5 s)  # Rohwert der Tankgeber im Stand
    signal TG_Geber_3_Stand_XIX_Tankgeber_02_XIX_VLAN_Cockpit: start 88, 12 bit, little-endian, data-type-policy=OVERRIDE, i-signal-type=PRIMITIVE, init-value=4094, base-type=BT_TG_Geber_3_Stand, invalid-value=Invalid_TG_Geber_3_Stand_XIX_Tankgeber_02_XIX_VLAN_Cockpit:4095, compu {phys=raw for raw 0..4092, 4095=Cxfff_Fehler (CM_TG_Geber_3_Stand_Cxfff_Fehler), 4093=Cxffd_nicht_verbaut (CM_TG_Geber_3_Stand_Cxffd_nicht_verbaut), 4094=Cxffe_Init (CM_TG_Geber_3_Stand_Cxffe_Init); unit Unit_Ohm}, range phys 0..4092 Unit_Ohm, raw 0..4095, unit=Unit_Ohm, transfer-property=PENDING, to HCP3_IONode(timeout 5 s)  # Rohwert der Tankgeber im Stand
    signal TG_Geber_4_Stand_XIX_Tankgeber_02_XIX_VLAN_Cockpit: start 100, 12 bit, little-endian, data-type-policy=OVERRIDE, i-signal-type=PRIMITIVE, init-value=4094, base-type=BT_TG_Geber_4_Stand, invalid-value=Invalid_TG_Geber_4_Stand_XIX_Tankgeber_02_XIX_VLAN_Cockpit:4095, compu {phys=raw for raw 0..4092, 4095=Cxfff_Fehler (CM_TG_Geber_4_Stand_Cxfff_Fehler), 4093=Cxffd_nicht_verbaut (CM_TG_Geber_4_Stand_Cxffd_nicht_verbaut), 4094=Cxffe_Init (CM_TG_Geber_4_Stand_Cxffe_Init); unit Unit_Ohm}, range phys 0..4092 Unit_Ohm, raw 0..4095, unit=Unit_Ohm, transfer-property=PENDING, to HCP3_IONode(timeout 5 s)  # Rohwert der Tankgeber im Stand
  pdu TCPServer_IP_TS_Info_El_DTO_01_XIX_VLAN_Cockpit: length=1440, unused-bit-pattern=0
    signal TCPServer_IP_TS_DTO_01_Data_XIX_TCPServer_IP_TS_Info_El_DTO_01_XIX_VLAN_Cockpit: start 0, 11520 bit, opaque, data-type-policy=OVERRIDE, i-signal-type=ARRAY, base-type=BT_TCPServer_IP_TS_DTO_01_Data, implementation-data-type=TCPServer_IP_TS_DTO_01_Data, transfer-property=TRIGGERED
  pdu TCPServer_IP_TS_Info_El_DTO_02_XIX_VLAN_Cockpit: length=1440, unused-bit-pattern=0
    signal TCPServer_IP_TS_DTO_02_Data_XIX_TCPServer_IP_TS_Info_El_DTO_02_XIX_VLAN_Cockpit: start 0, 11520 bit, opaque, data-type-policy=OVERRIDE, i-signal-type=ARRAY, base-type=BT_TCPServer_IP_TS_DTO_02_Data, implementation-data-type=TCPServer_IP_TS_DTO_02_Data, transfer-property=TRIGGERED
  pdu TCPServer_IP_TS_Info_El_DTO_03_XIX_VLAN_Cockpit: length=1440, unused-bit-pattern=0
    signal TCPServer_IP_TS_DTO_03_Data_XIX_TCPServer_IP_TS_Info_El_DTO_03_XIX_VLAN_Cockpit: start 0, 11520 bit, opaque, data-type-policy=OVERRIDE, i-signal-type=ARRAY, base-type=BT_TCPServer_IP_TS_DTO_03_Data, implementation-data-type=TCPServer_IP_TS_DTO_03_Data, transfer-property=TRIGGERED
  pdu TCPServer_IP_TS_Info_El_DTO_04_XIX_VLAN_Cockpit: length=1440, unused-bit-pattern=0
    signal TCPServer_IP_TS_DTO_04_Data_XIX_TCPServer_IP_TS_Info_El_DTO_04_XIX_VLAN_Cockpit: start 0, 11520 bit, opaque, data-type-policy=OVERRIDE, i-signal-type=ARRAY, base-type=BT_TCPServer_IP_TS_DTO_04_Data, implementation-data-type=TCPServer_IP_TS_DTO_04_Data, transfer-property=TRIGGERED
  pdu VDSO_05_XIX_VLAN_Cockpit_E2E: length=8, transmission-mode-true-timing=event-controlled-timing={number-of-repetitions=0, repetition-period=0.0}, unused-bit-pattern=0  # Fuer die Botschaft ist das Cyclic-Timing 0.005 zu verwenden.
    signal VDSO_05_CRC_XIX_VDSO_05_XIX_VLAN_Cockpit: start 0, 8 bit, little-endian, data-type-policy=OVERRIDE, i-signal-type=PRIMITIVE, init-value=0, base-type=BT_VDSO_05_CRC, compu {phys=raw for raw 0..255}, range phys 0..255, raw 0..255, to HCP3_IONode(timeout 0.5 s)  # Für MLB: Berechnung siehe Lastenheft "Kommunikationsabsicherung für FlexRay und CAN" Ab MQB und MLBevo: Berechnung siehe Lastenheft "End-to-End Kommunikationsabsicherung" Endwerte siehe Begleitdokument "S-PDU Kennungsfolgen"
    signal VDSO_05_BZ_XIX_VDSO_05_XIX_VLAN_Cockpit: start 8, 4 bit, little-endian, data-type-policy=OVERRIDE, i-signal-type=PRIMITIVE, init-value=0, base-type=BT_VDSO_05_BZ, compu {phys=raw for raw 0..15}, range phys 0..15, raw 0..15, to HCP3_IONode(timeout 0.5 s)  # 4bit Botschaftszähler, wird mit jeder Sendebotschaft inkrementiert
    signal VDSO_Vx3d_XIX_VDSO_05_XIX_VLAN_Cockpit: start 12, 16 bit, little-endian, data-type-policy=OVERRIDE, i-signal-type=PRIMITIVE, init-value=65534, base-type=BT_VDSO_Vx3d, invalid-value=Invalid_VDSO_Vx3d_XIX_VDSO_05_XIX_VLAN_Cockpit:65535, compu {phys=raw*0.0039-127.7874 for raw 0..65533, 65535=Cxffff_Fehler (CM_VDSO_Vx3d_Cxffff_Fehler), 65534=Cxfffe_Init (CM_VDSO_Vx3d_Cxfffe_Init); unit Unit_MeterPerSecon}, range phys -127.7874..127.7913 Unit_MeterPerSecon, raw 0..65535, unit=Unit_MeterPerSecon, to HCP3_IONode(timeout 0.5 s)  # Geschwindigkeitssignal vom ABS/ASR oder ESP. Mittelwert der angetriebenen Räder. Bei MSR oder ABS Eingriffen wird die ABS-Referenzgeschwindigkeit für >= 200ms eingespiegelt (Zeit wird mit Aktiv-Flanke der Funktionsbits getriggert) MQB: Bei Frontantrieb und gesteuertem Allrad (Haldex) Mittelwert der Vorderräder.
    signal VDSO_Vx3dKmph_XIX_VDSO_05_XIX_VLAN_Cockpit: start 28, 16 bit, little-endian, data-type-policy=OVERRIDE, i-signal-type=PRIMITIVE, init-value=65534, base-type=BT_VDSO_Vx3dKmph, invalid-value=Invalid_VDSO_Vx3dKmph_XIX_VDSO_05_XIX_VLAN_Cockpit:65535, compu {phys=raw*0.014-458.724 for raw 0..65533, 65535=Cxffff_Fehler (CM_VDSO_Vx3dKmph_Cxffff_Fehler), 65534=Cxfffe_Init (CM_VDSO_Vx3dKmph_Cxfffe_Init); unit Unit_KiloMeterPerHour}, range phys -458.724..458.738 Unit_KiloMeterPerHour, raw 0..65535, unit=Unit_KiloMeterPerHour  # Longitudinal velocity estimated at the centre of rear axle. Estimation requires 3D IMU.
    signal VDSO_Vx3dDisp_XIX_VDSO_05_XIX_VLAN_Cockpit: start 44, 16 bit, little-endian, data-type-policy=OVERRIDE, i-signal-type=PRIMITIVE, init-value=65534, base-type=BT_VDSO_Vx3dDisp, invalid-value=Invalid_VDSO_Vx3dDisp_XIX_VDSO_05_XIX_VLAN_Cockpit:65535, compu {phys=raw*0.0039-127.7874 for raw 0..65533, 65535=Cxffff_Fehler (CM_VDSO_Vx3dDisp_Cxffff_Fehler), 65534=Cxfffe_Init (CM_VDSO_Vx3dDisp_Cxfffe_Init); unit Unit_MeterPerSecon}, range phys -127.7874..127.7913 Unit_MeterPerSecon, raw 0..65535, unit=Unit_MeterPerSecon, to HCP3_IONode(timeout 0.5 s)  # VDSO_Vx3d incl. additional scaling to meet official regulations (Typ approval. NCAP eg)
    signal VDSO_BasTi200_NumClc_05_XIX_VDSO_05_XIX_VLAN_Cockpit: start 60, 4 bit, little-endian, data-type-policy=OVERRIDE, i-signal-type=PRIMITIVE, base-type=BT_VDSO_BasTi200_NumClc_05, compu {phys=raw for raw 0..15; unit Unit_None}, range phys 0..15 Unit_None, raw 0..15, unit=Unit_None  # CalculationNumber of the VDSO 200 Runnable to enable PDU-TLT merge in receiver ECU
    mapping SG_VDSO_05_XIX_VLAN_Cockpit: i-signal-group=SG_VDSO_05_XIX_VLAN_Cockpit, transfer-property=TRIGGERED-WITHOUT-REPETITION
  pdu VDSO_09_XIX_VLAN_Cockpit: length=32, transmission-mode-true-timing=cyclic-timing={time-offset=0.0, time-period=0.005}, unused-bit-pattern=0
    signal VDSO_09_CRC_XIX_VDSO_09_XIX_VLAN_Cockpit: start 0, 8 bit, little-endian, data-type-policy=OVERRIDE, i-signal-type=PRIMITIVE, init-value=0, base-type=BT_VDSO_09_CRC, compu {phys=raw for raw 0..255}, range phys 0..255, raw 0..255, transfer-property=TRIGGERED-WITHOUT-REPETITION  # Für MLB: Berechnung siehe Lastenheft "Kommunikationsabsicherung für FlexRay und CAN" Ab MQB und MLBevo: Berechnung siehe Lastenheft "End-to-End Kommunikationsabsicherung" Endwerte siehe Begleitdokument "S-PDU Kennungsfolgen"
    signal VDSO_09_BZ_XIX_VDSO_09_XIX_VLAN_Cockpit: start 8, 4 bit, little-endian, data-type-policy=OVERRIDE, i-signal-type=PRIMITIVE, init-value=0, base-type=BT_VDSO_09_BZ, compu {phys=raw for raw 0..15}, range phys 0..15, raw 0..15, transfer-property=TRIGGERED-WITHOUT-REPETITION  # 4bit Botschaftszähler, wird mit jeder Sendebotschaft inkrementiert
    signal VDSO_AgFrWhlStgAxlOfsCmp_XIX_VDSO_09_XIX_VLAN_Cockpit: start 12, 16 bit, little-endian, data-type-policy=OVERRIDE, i-signal-type=PRIMITIVE, init-value=65534, base-type=BT_VDSO_AgFrWhlStgAxlOfsCmp, invalid-value=Invalid_VDSO_AgFrWhlStgAxlOfsCmp_XIX_VDSO_09_XIX_VLAN_Cockpit:65535, compu {phys=raw*3.195890839e-05-1.047197551 for raw 0..65533, 65535=Cxffff_Fehler (CM_VDSO_AgFrWhlStgAxlOfsCmp_Cxffff_Fehler), 65534=Cxfffe_Init (CM_VDSO_AgFrWhlStgAxlOfsCmp_Cxfffe_Init); unit Unit_Radia}, range phys -1.0471975511966..1.0471655922882046 Unit_Radia, raw 0..65535, unit=Unit_Radia, transfer-property=TRIGGERED-WITHOUT-REPETITION  # Steering angle of front axle including EPS-Straight-Forward-Correction. Calculation based on EPS-Signals. For ASIL requirements VDSO_StAgFrWhlStgAxl has to be monitored.
    signal VDSO_ALatOfs_XIX_VDSO_09_XIX_VLAN_Cockpit: start 28, 10 bit, little-endian, data-type-policy=OVERRIDE, i-signal-type=PRIMITIVE, init-value=1022, base-type=BT_VDSO_ALatOfs, invalid-value=Invalid_VDSO_ALatOfs_XIX_VDSO_09_XIX_VLAN_Cockpit:1023, compu {phys=raw*0.005-2.5 for raw 0..1021, 1023=Cx3ff_Fehler (CM_VDSO_ALatOfs_Cx3ff_Fehler), 1022=Cx3fe_Init (CM_VDSO_ALatOfs_Cx3fe_Init); unit Unit_MeterPerSeconSquar}, range phys -2.5..2.605 Unit_MeterPerSeconSquar, raw 0..1023, unit=Unit_MeterPerSeconSquar, transfer-property=TRIGGERED-WITHOUT-REPETITION  # Static offset of lateral acceleration sensor. Formula: Sensor Value - Offset = True Value
    signal VDSO_ALgtOfs_XIX_VDSO_09_XIX_VLAN_Cockpit: start 38, 10 bit, little-endian, data-type-policy=OVERRIDE, i-signal-type=PRIMITIVE, init-value=1022, base-type=BT_VDSO_ALgtOfs, invalid-value=Invalid_VDSO_ALgtOfs_XIX_VDSO_09_XIX_VLAN_Cockpit:1023, compu {phys=raw*0.005-2.5 for raw 0..1021, 1023=Cx3ff_Fehler (CM_VDSO_ALgtOfs_Cx3ff_Fehler), 1022=Cx3fe_Init (CM_VDSO_ALgtOfs_Cx3fe_Init); unit Unit_MeterPerSeconSquar}, range phys -2.5..2.605 Unit_MeterPerSeconSquar, raw 0..1023, unit=Unit_MeterPerSeconSquar, transfer-property=TRIGGERED-WITHOUT-REPETITION  # Static offset of longitudinal acceleration sensor. Formula: Sensor Value - Offset = True Value
    signal VDSO_StVx3d_XIX_VDSO_09_XIX_VLAN_Cockpit: start 48, 4 bit, little-endian, data-type-policy=OVERRIDE, i-signal-type=PRIMITIVE, init-value=0, base-type=BT_VDSO_StVx3d, compu {7=Cx7_degradation_7 (CM_VDSO_StVx3d_Cx7_degradation_7), 2=Cx2_degradation_2 (CM_VDSO_StVx3d_Cx2_degradation_2), 8=Cx8_degradation_8 (CM_VDSO_StVx3d_Cx8_degradation_8), 3=Cx3_degradation_3 (CM_VDSO_StVx3d_Cx3_degradation_3), 0=Cx0_no_degradation (CM_VDSO_StVx3d_Cx0_no_degradation), 1=Cx1_degradation_1 (CM_VDSO_StVx3d_Cx1_degradation_1), 5=Cx5_degradation_5 (CM_VDSO_StVx3d_Cx5_degradation_5), 4=Cx4_degradation_4 (CM_VDSO_StVx3d_Cx4_degradation_4), 6=Cx6_degradation_6 (CM_VDSO_StVx3d_Cx6_degradation_6)}, range raw 0..8, transfer-property=TRIGGERED-WITHOUT-REPETITION  # Signal describes the estimation mode of Vx3d state estimation. If sensors which are required for normal Vx3d estimation are not recieved valid (e.g. broken sensor / bus) or can't be provided (e.g. GPS during tunnel) Vx3d will switch to the next best estimation algorithm. Reduced accuracy is to be expected with increased degradation.
    signal VDSO_AgReWhlStgAxl_XIX_VDSO_09_XIX_VLAN_Cockpit: start 52, 14 bit, little-endian, data-type-policy=OVERRIDE, i-signal-type=PRIMITIVE, init-value=16382, base-type=BT_VDSO_AgReWhlStgAxl, invalid-value=Invalid_VDSO_AgReWhlStgAxl_XIX_VDSO_09_XIX_VLAN_Cockpit:16383, compu {phys=raw*3.195890839e-05-0.2617993878 for raw 0..16381, 16383=Cx3fff_Fehler (CM_VDSO_AgReWhlStgAxl_Cx3fff_Fehler), 16382=Cx3ffe_Init (CM_VDSO_AgReWhlStgAxl_Cx3ffe_Init); unit Unit_Radia}, range phys -0.261799387799149..0.2617194905281762 Unit_Radia, raw 0..16383, unit=Unit_Radia, transfer-property=TRIGGERED-WITHOUT-REPETITION  # Steering angle of rear axle.
    signal VDSO_WhlSlipFrLe3d_XIX_VDSO_09_XIX_VLAN_Cockpit: start 66, 8 bit, little-endian, data-type-policy=OVERRIDE, i-signal-type=PRIMITIVE, init-value=254, base-type=BT_VDSO_WhlSlipFrLe3d, invalid-value=Invalid_VDSO_WhlSlipFrLe3d_XIX_VDSO_09_XIX_VLAN_Cockpit:255, compu {phys=raw/126-1 for raw 0..252, 255=Cxff_Fehler (CM_VDSO_WhlSlipFrLe3d_Cxff_Fehler), 254=Cxfe_Init (CM_VDSO_WhlSlipFrLe3d_Cxfe_Init); unit Unit_None}, range phys -1..1.0000000000000009 Unit_None, raw 0..255, unit=Unit_None, transfer-property=TRIGGERED-WITHOUT-REPETITION  # Estimated wheel slip front left. Estimation requires 3D IMU
    signal VDSO_WhlSlipFrRi3d_XIX_VDSO_09_XIX_VLAN_Cockpit: start 74, 8 bit, little-endian, data-type-policy=OVERRIDE, i-signal-type=PRIMITIVE, init-value=254, base-type=BT_VDSO_WhlSlipFrRi3d, invalid-value=Invalid_VDSO_WhlSlipFrRi3d_XIX_VDSO_09_XIX_VLAN_Cockpit:255, compu {phys=raw/126-1 for raw 0..252, 255=Cxff_Fehler (CM_VDSO_WhlSlipFrRi3d_Cxff_Fehler), 254=Cxfe_Init (CM_VDSO_WhlSlipFrRi3d_Cxfe_Init); unit Unit_None}, range phys -1..1.0000000000000009 Unit_None, raw 0..255, unit=Unit_None, transfer-property=TRIGGERED-WITHOUT-REPETITION  # Estimated wheel slip front right. Estimation requires 3D IMU
    signal VDSO_WhlSlipReLe3d_XIX_VDSO_09_XIX_VLAN_Cockpit: start 82, 8 bit, little-endian, data-type-policy=OVERRIDE, i-signal-type=PRIMITIVE, init-value=254, base-type=BT_VDSO_WhlSlipReLe3d, invalid-value=Invalid_VDSO_WhlSlipReLe3d_XIX_VDSO_09_XIX_VLAN_Cockpit:255, compu {phys=raw/126-1 for raw 0..252, 255=Cxff_Fehler (CM_VDSO_WhlSlipReLe3d_Cxff_Fehler), 254=Cxfe_Init (CM_VDSO_WhlSlipReLe3d_Cxfe_Init); unit Unit_None}, range phys -1..1.0000000000000009 Unit_None, raw 0..255, unit=Unit_None, transfer-property=TRIGGERED-WITHOUT-REPETITION  # Estimated wheel slip rear left. Estimation requires 3D IMU
    signal VDSO_WhlSlipReRi3d_XIX_VDSO_09_XIX_VLAN_Cockpit: start 90, 8 bit, little-endian, data-type-policy=OVERRIDE, i-signal-type=PRIMITIVE, init-value=254, base-type=BT_VDSO_WhlSlipReRi3d, invalid-value=Invalid_VDSO_WhlSlipReRi3d_XIX_VDSO_09_XIX_VLAN_Cockpit:255, compu {phys=raw/126-1 for raw 0..252, 255=Cxff_Fehler (CM_VDSO_WhlSlipReRi3d_Cxff_Fehler), 254=Cxfe_Init (CM_VDSO_WhlSlipReRi3d_Cxfe_Init); unit Unit_None}, range phys -1..1.0000000000000009 Unit_None, raw 0..255, unit=Unit_None, transfer-property=TRIGGERED-WITHOUT-REPETITION  # Estimated wheel slip rear right. Estimation requires 3D IMU
    signal VDSO_BasTi200_NumClc_09_XIX_VDSO_09_XIX_VLAN_Cockpit: start 98, 4 bit, little-endian, data-type-policy=OVERRIDE, i-signal-type=PRIMITIVE, base-type=BT_VDSO_BasTi200_NumClc_09, compu {phys=raw for raw 0..15; unit Unit_None}, range phys 0..15 Unit_None, raw 0..15, unit=Unit_None, transfer-property=TRIGGERED-WITHOUT-REPETITION  # CalculationNumber of the VDSO 200 Runnable to enable PDU-TLT merge in receiver ECU
    signal VDSO_AgFrWhlStgAxlLWIOfsCmp_XIX_VDSO_09_XIX_VLAN_Cockpit: start 102, 16 bit, little-endian, data-type-policy=OVERRIDE, i-signal-type=PRIMITIVE, init-value=65534, base-type=BT_VDSO_AgFrWhlStgAxlLWIOfsCmp, invalid-value=Invalid_VDSO_AgFrWhlStgAxlLWIOfsCmp_XIX_VDSO_09_XIX_VLAN_Cockpit:65535, compu {phys=raw*3.195988376e-05-1.047197551 for raw 0..65532, 65535=Cxffff_Fehler (CM_VDSO_AgFrWhlStgAxlLWIOfsCmp_Cxffff_Fehler), 65534=Cxfffe_Init (CM_VDSO_AgFrWhlStgAxlLWIOfsCmp_Cxfffe_Init); unit Unit_Radia}, range phys -1.0471975511966..1.0471975511965936 Unit_Radia, raw 0..65535, unit=Unit_Radia, transfer-property=TRIGGERED-WITHOUT-REPETITION  # Steering angle of front axle including offset estimation. Calculation based on LWI-Signals
    signal VDSO_DKmtg_XIX_VDSO_09_XIX_VLAN_Cockpit: start 118, 32 bit, little-endian, data-type-policy=OVERRIDE, i-signal-type=PRIMITIVE, init-value=4294967294, base-type=BT_VDSO_DKmtg, invalid-value=Invalid_VDSO_DKmtg_XIX_VDSO_09_XIX_VLAN_Cockpit:4294967295, compu {phys=raw for raw 0..4294967293, 4294967295=Cxffffffff_Fehler (CM_VDSO_DKmtg_Cxffffffff_Fehler), 4294967294=Cxfffffffe_Init (CM_VDSO_DKmtg_Cxfffffffe_Init); unit Unit_Meter}, range phys 0..4294967293 Unit_Meter, raw 0..4294967295, unit=Unit_Meter, transfer-property=TRIGGERED-WITHOUT-REPETITION, to HCP3_IONode(timeout 0.5 s)  # Vehicle lifetime traveled distance
    signal VDSO_DKmtg2Ord_XIX_VDSO_09_XIX_VLAN_Cockpit: start 150, 8 bit, little-endian, data-type-policy=OVERRIDE, i-signal-type=PRIMITIVE, init-value=254, base-type=BT_VDSO_DKmtg2Ord, invalid-value=Invalid_VDSO_DKmtg2Ord_XIX_VDSO_09_XIX_VLAN_Cockpit:255, compu {phys=raw for raw 0..253, 255=Cxff_Fehler (CM_VDSO_DKmtg2Ord_Cxff_Fehler), 254=Cxfe_Init (CM_VDSO_DKmtg2Ord_Cxfe_Init); unit Unit_Centimeter}, range phys 0..253 Unit_Centimeter, raw 0..255, unit=Unit_Centimeter, transfer-property=TRIGGERED-WITHOUT-REPETITION  # Distance traveled since the last full meter of VDSO_DKmtg.
  pdu VKM_04_XIX_VLAN_Cockpit: length=8, transmission-mode-true-timing=cyclic-timing={time-offset=0.0, time-period=0.02}, unused-bit-pattern=0
    signal CE_VolCns_XIX_VKM_04_XIX_VLAN_Cockpit: start 12, 15 bit, little-endian, data-type-policy=OVERRIDE, i-signal-type=PRIMITIVE, init-value=0, base-type=BT_CE_VolCns, compu {phys=raw for raw 0..32767; unit Unit_MicroLiter}, range phys 0..32767 Unit_MicroLiter, raw 0..32767, unit=Unit_MicroLiter, transfer-property=PENDING, to HCP3_IONode(timeout 0.5 s)  # Motorsteuergerätinterner Verbrauchszähler, der vom Kombi zyklisch ausgelesen wird, um die Einspritzmenge zur Verbrauchsmessung für die Verbrauchsanzeige aufzusummieren; das Überlauf-Bit ist zu berücksichtigen.
    signal CE_VfCns_XIX_VKM_04_XIX_VLAN_Cockpit: start 27, 16 bit, little-endian, data-type-policy=OVERRIDE, i-signal-type=PRIMITIVE, init-value=0, base-type=BT_CE_VfCns, compu {phys=raw*0.01 for raw 0..65535; unit Unit_LiterPerHour}, range phys 0..655.35 Unit_LiterPerHour, raw 0..65535, unit=Unit_LiterPerHour, transfer-property=PENDING  # Momentaner Kraftstoffverbrauch der VKM zur Berechnung eines optimierten Anzeige-Momentanverbrauchs.
    signal CE_FlgOvf_VolCns_XIX_VKM_04_XIX_VLAN_Cockpit: start 43, 1 bit, little-endian, data-type-policy=OVERRIDE, i-signal-type=PRIMITIVE, init-value=0, base-type=BT_CE_FlgOvf_VolCns, compu {1=Cx1_Ueberlauf (CM_CE_FlgOvf_VolCns_Cx1_Ueberlauf), 0=Cx0_kein_Ueberlauf (CM_CE_FlgOvf_VolCns_Cx0_kein_Ueberlauf)}, range raw 0..1, transfer-property=PENDING, to HCP3_IONode(timeout 0.5 s)  # Der motorsteuergeräteinterne Verbrauchszähler ist mindestens einmal übergelaufen. Dieses Bit wird genutzt, um erkennen zu können, daß das Motorsteuergerät aus dem Reset-Zustand hochläuft.
    signal PTankCtl_StFuFlapCtl_XIX_VKM_04_XIX_VLAN_Cockpit: start 44, 2 bit, little-endian, data-type-policy=OVERRIDE, i-signal-type=PRIMITIVE, init-value=0, base-type=BT_PTankCtl_StFuFlapCtl, compu {2=Cx2_Tankklappe_soll_verriegeln (CM_PTankCtl_StFuFlapCtl_Cx2_Tankklappe_soll_verriegeln), 1=Cx1_Tankklappe_soll_entriegeln (CM_PTankCtl_StFuFlapCtl_Cx1_Tankklappe_soll_entriegeln), 3=Cx3_keine_Aktion (CM_PTankCtl_StFuFlapCtl_Cx3_keine_Aktion), 0=Cx0_Init_nicht_verbaut (CM_PTankCtl_StFuFlapCtl_Cx0_Init_nicht_verbaut)}, range raw 0..3, transfer-property=PENDING  # Signal dient zur Steuerung der Tankklappenentriegelung (ehemals MO_Tankklappensteuerung)
    signal CE_StTrbcPMaxDisp_XIX_VKM_04_XIX_VLAN_Cockpit: start 46, 1 bit, little-endian, data-type-policy=OVERRIDE, i-signal-type=PRIMITIVE, init-value=0, base-type=BT_CE_StTrbcPMaxDisp, compu {1=Cx1_active (CM_CE_StTrbcPMaxDisp_Cx1_active), 0=Cx0_inactive (CM_CE_StTrbcPMaxDisp_Cx0_inactive)}, range raw 0..1, transfer-property=PENDING  # Anzeige des Overboostzustandes der Ladedruckregelung durch rote Einfärbung der Ladedruckanzeige im Kombi.
    signal CE_TCooPT_XIX_VKM_04_XIX_VLAN_Cockpit: start 47, 8 bit, little-endian, data-type-policy=OVERRIDE, i-signal-type=PRIMITIVE, base-type=BT_CE_TCooPT, invalid-value=Invalid_CE_TCooPT_XIX_VKM_04_XIX_VLAN_Cockpit:255, compu {phys=raw-40 for raw 0..254, 255=Cxff_Fehler (CM_CE_TCooPT_Cxff_Fehler); unit Unit_DegreCelsi}, range phys -40..214 Unit_DegreCelsi, raw 0..255, unit=Unit_DegreCelsi, transfer-property=PENDING  # Motorkühlmitteltemperatur am Zylinderkopfaustritt
    signal CE_StCpb_XIX_VKM_04_XIX_VLAN_Cockpit: start 55, 2 bit, little-endian, data-type-policy=OVERRIDE, i-signal-type=PRIMITIVE, init-value=0, base-type=BT_CE_StCpb, invalid-value=Invalid_CE_StCpb_XIX_VKM_04_XIX_VLAN_Cockpit:3, compu {3=Cx3_Fehler (CM_CE_StCpb_Cx3_Fehler), 2=Cx2_nominal_performance_available (CM_CE_StCpb_Cx2_nominal_performance_available), 0=Cx0_InitWert (CM_CE_StCpb_Cx0_InitWert), 1=Cx1_enhanced_performance_available (CM_CE_StCpb_Cx1_enhanced_performance_available)}, range raw 0..3, transfer-property=PENDING  # Leistungsverfügbarkeit VKM
  pdu WakeupclusterConfiguration_Events_configurationsEvent: length=196, transmission-mode-true-timing=event-controlled-timing={number-of-repetitions=0, repetition-period=0.0}, unused-bit-pattern=0
    signal WakeupclusterConfiguration_Events_configurationsEvent: start 0, 1568 bit, opaque, data-transformations=SOMEIPOnlyTransformerChain, data-type-policy=TRANSFORMING-I-SIGNAL, i-signal-type=ARRAY, someip-transformation-i-signal-props{transformer=TransformationTechnologySOMEIP, interface-version=3, message-type=NOTIFICATION, size-of-array-length-fields=2, size-of-struct-length-fields=2, size-of-union-length-fields=2}, dynamic-length=true, transfer-property=TRIGGERED, to HCP3_IONode  # ServiceInterface for Service_ReconfigureWakeupclusterLocation
  pdu WakeupclusterConfiguration_Methods_createConfigurationsElement_Request_XIX_SomeIP_ServiceProvid_7737BB873B01B3A00B3C2023AB27203D: length=163, transmission-mode-true-timing=event-controlled-timing={number-of-repetitions=0, repetition-period=0.0}, unused-bit-pattern=0  # WakeupclusterConfiguration_Methods_createConfigurationsElement_Request_XIX_SomeIP_ServiceProvider_01_Gateway_Info_El_01_UC_XIX_VLAN_Cockpit
    signal WakeupclusterConfiguration_Methods_createConfigurationsElement_Request_XIX_SomeIP_ServiceProvid_7737BB873B01B3A00B3C2023AB27203D: start 0, 1304 bit, opaque, data-transformations=SOMEIPOnlyTransformerChain, data-type-policy=TRANSFORMING-I-SIGNAL, i-signal-type=ARRAY, someip-transformation-i-signal-props{cs-error-reaction=AUTONOMOUS, transformer=TransformationTechnologySOMEIP, interface-version=3, message-type=REQUEST, size-of-array-length-fields=2, size-of-struct-length-fields=2, size-of-union-length-fields=2}, dynamic-length=true, transfer-property=TRIGGERED  # WakeupclusterConfiguration_Methods_createConfigurationsElement_Request_XIX_SomeIP_ServiceProvider_01_Gateway_Info_El_01_UC_XIX_VLAN_Cockpit  # ServiceInterface for Service_ReconfigureWakeupclusterLocation
  pdu WakeupclusterConfiguration_Methods_createConfigurationsElement_Response_XIX_SomeIP_ServiceProvi_231B67EBCBF09FBC4FA70DC1F8EBF924: length=19, transmission-mode-true-timing=event-controlled-timing={number-of-repetitions=0, repetition-period=0.0}, unused-bit-pattern=0  # WakeupclusterConfiguration_Methods_createConfigurationsElement_Response_XIX_SomeIP_ServiceProvider_01_Gateway_Info_El_01_UC_XIX_VLAN_Cockpit
    signal WakeupclusterConfiguration_Methods_createConfigurationsElement_Response_XIX_SomeIP_ServiceProvi_231B67EBCBF09FBC4FA70DC1F8EBF924: start 0, 152 bit, opaque, data-transformations=SOMEIPOnlyTransformerChain, data-type-policy=TRANSFORMING-I-SIGNAL, i-signal-type=ARRAY, someip-transformation-i-signal-props{cs-error-reaction=AUTONOMOUS, transformer=TransformationTechnologySOMEIP, interface-version=3, message-type=RESPONSE, size-of-array-length-fields=2, size-of-struct-length-fields=2, size-of-union-length-fields=2}, dynamic-length=true, transfer-property=TRIGGERED, to HCP3_IONode  # WakeupclusterConfiguration_Methods_createConfigurationsElement_Response_XIX_SomeIP_ServiceProvider_01_Gateway_Info_El_01_UC_XIX_VLAN_Cockpit  # ServiceInterface for Service_ReconfigureWakeupclusterLocation
  pdu WakeupclusterConfiguration_Methods_getConfigurationsElementByKey_Request_XIX_SomeIP_ServiceProv_915C94CE0BB3781DF02EF7972CEC1C52: length=11, transmission-mode-true-timing=event-controlled-timing={number-of-repetitions=0, repetition-period=0.0}, unused-bit-pattern=0  # WakeupclusterConfiguration_Methods_getConfigurationsElementByKey_Request_XIX_SomeIP_ServiceProvider_01_Gateway_Info_El_01_UC_XIX_VLAN_Cockpit
    signal WakeupclusterConfiguration_Methods_getConfigurationsElementByKey_Request_XIX_SomeIP_ServiceProv_915C94CE0BB3781DF02EF7972CEC1C52: start 0, 88 bit, opaque, data-transformations=SOMEIPOnlyTransformerChain, data-type-policy=TRANSFORMING-I-SIGNAL, i-signal-type=ARRAY, someip-transformation-i-signal-props{cs-error-reaction=AUTONOMOUS, transformer=TransformationTechnologySOMEIP, interface-version=3, message-type=REQUEST, size-of-array-length-fields=2, size-of-struct-length-fields=2, size-of-union-length-fields=2}, dynamic-length=true, transfer-property=TRIGGERED  # WakeupclusterConfiguration_Methods_getConfigurationsElementByKey_Request_XIX_SomeIP_ServiceProvider_01_Gateway_Info_El_01_UC_XIX_VLAN_Cockpit  # ServiceInterface for Service_ReconfigureWakeupclusterLocation
  pdu WakeupclusterConfiguration_Methods_getConfigurationsElementByKey_Response_XIX_SomeIP_ServicePro_5F40FB5A1866E25D2F44ACF3DA9DBB90: length=171, transmission-mode-true-timing=event-controlled-timing={number-of-repetitions=0, repetition-period=0.0}, unused-bit-pattern=0  # WakeupclusterConfiguration_Methods_getConfigurationsElementByKey_Response_XIX_SomeIP_ServiceProvider_01_Gateway_Info_El_01_UC_XIX_VLAN_Cockpit
    signal WakeupclusterConfiguration_Methods_getConfigurationsElementByKey_Response_XIX_SomeIP_ServicePro_5F40FB5A1866E25D2F44ACF3DA9DBB90: start 0, 1368 bit, opaque, data-transformations=SOMEIPOnlyTransformerChain, data-type-policy=TRANSFORMING-I-SIGNAL, i-signal-type=ARRAY, someip-transformation-i-signal-props{cs-error-reaction=AUTONOMOUS, transformer=TransformationTechnologySOMEIP, interface-version=3, message-type=RESPONSE, size-of-array-length-fields=2, size-of-struct-length-fields=2, size-of-union-length-fields=2}, dynamic-length=true, transfer-property=TRIGGERED, to HCP3_IONode  # WakeupclusterConfiguration_Methods_getConfigurationsElementByKey_Response_XIX_SomeIP_ServiceProvider_01_Gateway_Info_El_01_UC_XIX_VLAN_Cockpit  # ServiceInterface for Service_ReconfigureWakeupclusterLocation
  pdu WakeupclusterConfiguration_Methods_getConfigurationsElements_Request_XIX_SomeIP_ServiceProvider_83EA04CC8AD03D4FFDA545878D6C3966: length=8, transmission-mode-true-timing=event-controlled-timing={number-of-repetitions=0, repetition-period=0.0}, unused-bit-pattern=0  # WakeupclusterConfiguration_Methods_getConfigurationsElements_Request_XIX_SomeIP_ServiceProvider_01_Gateway_Info_El_01_UC_XIX_VLAN_Cockpit
    signal WakeupclusterConfiguration_Methods_getConfigurationsElements_Request_XIX_SomeIP_ServiceProvider_83EA04CC8AD03D4FFDA545878D6C3966: start 0, 64 bit, opaque, data-transformations=SOMEIPOnlyTransformerChain, data-type-policy=TRANSFORMING-I-SIGNAL, i-signal-type=ARRAY, someip-transformation-i-signal-props{cs-error-reaction=AUTONOMOUS, transformer=TransformationTechnologySOMEIP, interface-version=3, message-type=REQUEST, size-of-array-length-fields=2, size-of-struct-length-fields=2, size-of-union-length-fields=2}, dynamic-length=true, transfer-property=TRIGGERED  # WakeupclusterConfiguration_Methods_getConfigurationsElements_Request_XIX_SomeIP_ServiceProvider_01_Gateway_Info_El_01_UC_XIX_VLAN_Cockpit  # ServiceInterface for Service_ReconfigureWakeupclusterLocation
  pdu WakeupclusterConfiguration_Methods_getConfigurationsElements_Response_XIX_SomeIP_ServiceProvide_2E5FD60B99F81F557A6910B338C49833: length=938, transmission-mode-true-timing=event-controlled-timing={number-of-repetitions=0, repetition-period=0.0}, unused-bit-pattern=0  # WakeupclusterConfiguration_Methods_getConfigurationsElements_Response_XIX_SomeIP_ServiceProvider_01_Gateway_Info_El_01_UC_XIX_VLAN_Cockpit
    signal WakeupclusterConfiguration_Methods_getConfigurationsElements_Response_XIX_SomeIP_ServiceProvide_2E5FD60B99F81F557A6910B338C49833: start 0, 7504 bit, opaque, data-transformations=SOMEIPOnlyTransformerChain, data-type-policy=TRANSFORMING-I-SIGNAL, i-signal-type=ARRAY, someip-transformation-i-signal-props{cs-error-reaction=AUTONOMOUS, transformer=TransformationTechnologySOMEIP, interface-version=3, message-type=RESPONSE, size-of-array-length-fields=2, size-of-struct-length-fields=2, size-of-union-length-fields=2}, dynamic-length=true, transfer-property=TRIGGERED, to HCP3_IONode  # WakeupclusterConfiguration_Methods_getConfigurationsElements_Response_XIX_SomeIP_ServiceProvider_01_Gateway_Info_El_01_UC_XIX_VLAN_Cockpit  # ServiceInterface for Service_ReconfigureWakeupclusterLocation
  pdu WakeupclusterConfiguration_Methods_setConfigurationsElement_Request_XIX_SomeIP_ServiceProvider_D8F002AA1F2AB500774DEA13942C0264: length=163, transmission-mode-true-timing=event-controlled-timing={number-of-repetitions=0, repetition-period=0.0}, unused-bit-pattern=0  # WakeupclusterConfiguration_Methods_setConfigurationsElement_Request_XIX_SomeIP_ServiceProvider_01_Gateway_Info_El_01_UC_XIX_VLAN_Cockpit
    signal WakeupclusterConfiguration_Methods_setConfigurationsElement_Request_XIX_SomeIP_ServiceProvider_D8F002AA1F2AB500774DEA13942C0264: start 0, 1304 bit, opaque, data-transformations=SOMEIPOnlyTransformerChain, data-type-policy=TRANSFORMING-I-SIGNAL, i-signal-type=ARRAY, someip-transformation-i-signal-props{cs-error-reaction=AUTONOMOUS, transformer=TransformationTechnologySOMEIP, interface-version=3, message-type=REQUEST, size-of-array-length-fields=2, size-of-struct-length-fields=2, size-of-union-length-fields=2}, dynamic-length=true, transfer-property=TRIGGERED  # WakeupclusterConfiguration_Methods_setConfigurationsElement_Request_XIX_SomeIP_ServiceProvider_01_Gateway_Info_El_01_UC_XIX_VLAN_Cockpit  # ServiceInterface for Service_ReconfigureWakeupclusterLocation
  pdu WakeupclusterConfiguration_Methods_setConfigurationsElement_Response_XIX_SomeIP_ServiceProvider_B3CA95585AEFD5969CCFE8B81AEAD959: length=12, transmission-mode-true-timing=event-controlled-timing={number-of-repetitions=0, repetition-period=0.0}, unused-bit-pattern=0  # WakeupclusterConfiguration_Methods_setConfigurationsElement_Response_XIX_SomeIP_ServiceProvider_01_Gateway_Info_El_01_UC_XIX_VLAN_Cockpit
    signal WakeupclusterConfiguration_Methods_setConfigurationsElement_Response_XIX_SomeIP_ServiceProvider_B3CA95585AEFD5969CCFE8B81AEAD959: start 0, 96 bit, opaque, data-transformations=SOMEIPOnlyTransformerChain, data-type-policy=TRANSFORMING-I-SIGNAL, i-signal-type=ARRAY, someip-transformation-i-signal-props{cs-error-reaction=AUTONOMOUS, transformer=TransformationTechnologySOMEIP, interface-version=3, message-type=RESPONSE, size-of-array-length-fields=2, size-of-struct-length-fields=2, size-of-union-length-fields=2}, dynamic-length=true, transfer-property=TRIGGERED, to HCP3_IONode  # WakeupclusterConfiguration_Methods_setConfigurationsElement_Response_XIX_SomeIP_ServiceProvider_01_Gateway_Info_El_01_UC_XIX_VLAN_Cockpit  # ServiceInterface for Service_ReconfigureWakeupclusterLocation
  pdu WakeupclusterConfiguration_Methods_subscribeConfigurations_Request_XIX_SomeIP_ServiceProvider_0_DBABD344C00D07A361B29B6A5CB24FD3: length=11, transmission-mode-true-timing=event-controlled-timing={number-of-repetitions=0, repetition-period=0.0}, unused-bit-pattern=0  # WakeupclusterConfiguration_Methods_subscribeConfigurations_Request_XIX_SomeIP_ServiceProvider_01_Gateway_Info_El_01_UC_XIX_VLAN_Cockpit
    signal WakeupclusterConfiguration_Methods_subscribeConfigurations_Request_XIX_SomeIP_ServiceProvider_0_DBABD344C00D07A361B29B6A5CB24FD3: start 0, 88 bit, opaque, data-transformations=SOMEIPOnlyTransformerChain, data-type-policy=TRANSFORMING-I-SIGNAL, i-signal-type=ARRAY, someip-transformation-i-signal-props{cs-error-reaction=AUTONOMOUS, transformer=TransformationTechnologySOMEIP, interface-version=3, message-type=REQUEST, size-of-array-length-fields=2, size-of-struct-length-fields=2, size-of-union-length-fields=2}, dynamic-length=true, transfer-property=TRIGGERED  # WakeupclusterConfiguration_Methods_subscribeConfigurations_Request_XIX_SomeIP_ServiceProvider_01_Gateway_Info_El_01_UC_XIX_VLAN_Cockpit  # ServiceInterface for Service_ReconfigureWakeupclusterLocation
  pdu WakeupclusterConfiguration_Methods_subscribeConfigurations_Response_XIX_SomeIP_ServiceProvider_F85D5CE3466F3F22466CF9911D2EA7E8: length=22, transmission-mode-true-timing=event-controlled-timing={number-of-repetitions=0, repetition-period=0.0}, unused-bit-pattern=0  # WakeupclusterConfiguration_Methods_subscribeConfigurations_Response_XIX_SomeIP_ServiceProvider_01_Gateway_Info_El_01_UC_XIX_VLAN_Cockpit
    signal WakeupclusterConfiguration_Methods_subscribeConfigurations_Response_XIX_SomeIP_ServiceProvider_F85D5CE3466F3F22466CF9911D2EA7E8: start 0, 176 bit, opaque, data-transformations=SOMEIPOnlyTransformerChain, data-type-policy=TRANSFORMING-I-SIGNAL, i-signal-type=ARRAY, someip-transformation-i-signal-props{cs-error-reaction=AUTONOMOUS, transformer=TransformationTechnologySOMEIP, interface-version=3, message-type=RESPONSE, size-of-array-length-fields=2, size-of-struct-length-fields=2, size-of-union-length-fields=2}, dynamic-length=true, transfer-property=TRIGGERED, to HCP3_IONode  # WakeupclusterConfiguration_Methods_subscribeConfigurations_Response_XIX_SomeIP_ServiceProvider_01_Gateway_Info_El_01_UC_XIX_VLAN_Cockpit  # ServiceInterface for Service_ReconfigureWakeupclusterLocation
  pdu WakeupclusterConfiguration_Methods_subscribeConfigurationsByKey_Request_XIX_SomeIP_ServiceProvi_7E6CBA6D90EFBC1C0C8259184F31093C: length=14, transmission-mode-true-timing=event-controlled-timing={number-of-repetitions=0, repetition-period=0.0}, unused-bit-pattern=0  # WakeupclusterConfiguration_Methods_subscribeConfigurationsByKey_Request_XIX_SomeIP_ServiceProvider_01_Gateway_Info_El_01_UC_XIX_VLAN_Cockpit
    signal WakeupclusterConfiguration_Methods_subscribeConfigurationsByKey_Request_XIX_SomeIP_ServiceProvi_7E6CBA6D90EFBC1C0C8259184F31093C: start 0, 112 bit, opaque, data-transformations=SOMEIPOnlyTransformerChain, data-type-policy=TRANSFORMING-I-SIGNAL, i-signal-type=ARRAY, someip-transformation-i-signal-props{cs-error-reaction=AUTONOMOUS, transformer=TransformationTechnologySOMEIP, interface-version=3, message-type=REQUEST, size-of-array-length-fields=2, size-of-struct-length-fields=2, size-of-union-length-fields=2}, dynamic-length=true, transfer-property=TRIGGERED  # WakeupclusterConfiguration_Methods_subscribeConfigurationsByKey_Request_XIX_SomeIP_ServiceProvider_01_Gateway_Info_El_01_UC_XIX_VLAN_Cockpit  # ServiceInterface for Service_ReconfigureWakeupclusterLocation
  pdu WakeupclusterConfiguration_Methods_subscribeConfigurationsByKey_Response_XIX_SomeIP_ServiceProv_DAB357DD5E2932C31761DB84F3B5D9E6: length=22, transmission-mode-true-timing=event-controlled-timing={number-of-repetitions=0, repetition-period=0.0}, unused-bit-pattern=0  # WakeupclusterConfiguration_Methods_subscribeConfigurationsByKey_Response_XIX_SomeIP_ServiceProvider_01_Gateway_Info_El_01_UC_XIX_VLAN_Cockpit
    signal WakeupclusterConfiguration_Methods_subscribeConfigurationsByKey_Response_XIX_SomeIP_ServiceProv_DAB357DD5E2932C31761DB84F3B5D9E6: start 0, 176 bit, opaque, data-transformations=SOMEIPOnlyTransformerChain, data-type-policy=TRANSFORMING-I-SIGNAL, i-signal-type=ARRAY, someip-transformation-i-signal-props{cs-error-reaction=AUTONOMOUS, transformer=TransformationTechnologySOMEIP, interface-version=3, message-type=RESPONSE, size-of-array-length-fields=2, size-of-struct-length-fields=2, size-of-union-length-fields=2}, dynamic-length=true, transfer-property=TRIGGERED, to HCP3_IONode  # WakeupclusterConfiguration_Methods_subscribeConfigurationsByKey_Response_XIX_SomeIP_ServiceProvider_01_Gateway_Info_El_01_UC_XIX_VLAN_Cockpit  # ServiceInterface for Service_ReconfigureWakeupclusterLocation
  pdu WakeupclusterConfiguration_Methods_unsubscribeConfigurations_Request_XIX_SomeIP_ServiceProvider_A92E979D506F6973EF947DF57A11513F: length=14, transmission-mode-true-timing=event-controlled-timing={number-of-repetitions=0, repetition-period=0.0}, unused-bit-pattern=0  # WakeupclusterConfiguration_Methods_unsubscribeConfigurations_Request_XIX_SomeIP_ServiceProvider_01_Gateway_Info_El_01_UC_XIX_VLAN_Cockpit
    signal WakeupclusterConfiguration_Methods_unsubscribeConfigurations_Request_XIX_SomeIP_ServiceProvider_A92E979D506F6973EF947DF57A11513F: start 0, 112 bit, opaque, data-transformations=SOMEIPOnlyTransformerChain, data-type-policy=TRANSFORMING-I-SIGNAL, i-signal-type=ARRAY, someip-transformation-i-signal-props{cs-error-reaction=AUTONOMOUS, transformer=TransformationTechnologySOMEIP, interface-version=3, message-type=REQUEST, size-of-array-length-fields=2, size-of-struct-length-fields=2, size-of-union-length-fields=2}, dynamic-length=true, transfer-property=TRIGGERED  # WakeupclusterConfiguration_Methods_unsubscribeConfigurations_Request_XIX_SomeIP_ServiceProvider_01_Gateway_Info_El_01_UC_XIX_VLAN_Cockpit  # ServiceInterface for Service_ReconfigureWakeupclusterLocation
  pdu WakeupclusterConfiguration_Methods_unsubscribeConfigurations_Response_XIX_SomeIP_ServiceProvide_A5BA5F80A437E042A3A50D941887F96B: length=12, transmission-mode-true-timing=event-controlled-timing={number-of-repetitions=0, repetition-period=0.0}, unused-bit-pattern=0  # WakeupclusterConfiguration_Methods_unsubscribeConfigurations_Response_XIX_SomeIP_ServiceProvider_01_Gateway_Info_El_01_UC_XIX_VLAN_Cockpit
    signal WakeupclusterConfiguration_Methods_unsubscribeConfigurations_Response_XIX_SomeIP_ServiceProvide_A5BA5F80A437E042A3A50D941887F96B: start 0, 96 bit, opaque, data-transformations=SOMEIPOnlyTransformerChain, data-type-policy=TRANSFORMING-I-SIGNAL, i-signal-type=ARRAY, someip-transformation-i-signal-props{cs-error-reaction=AUTONOMOUS, transformer=TransformationTechnologySOMEIP, interface-version=3, message-type=RESPONSE, size-of-array-length-fields=2, size-of-struct-length-fields=2, size-of-union-length-fields=2}, dynamic-length=true, transfer-property=TRIGGERED, to HCP3_IONode  # WakeupclusterConfiguration_Methods_unsubscribeConfigurations_Response_XIX_SomeIP_ServiceProvider_01_Gateway_Info_El_01_UC_XIX_VLAN_Cockpit  # ServiceInterface for Service_ReconfigureWakeupclusterLocation
  pdu WakeUpMonitorData_Methods_getTable_Request_XIX_TCPServer_SomeIP_01_Info_El_SGW03_XIX_VLAN_Cockpit: length=14, transmission-mode-true-timing=event-controlled-timing={number-of-repetitions=0, repetition-period=0.0}, unused-bit-pattern=0
    signal WakeUpMonitorData_Methods_getTable_Request_XIX_TCPServer_SomeIP_01_Info_El_SGW03_XIX_VLAN_Cockpit: start 0, 112 bit, opaque, data-transformations=SOMEIPOnlyTransformerChain, data-type-policy=TRANSFORMING-I-SIGNAL, i-signal-type=ARRAY, someip-transformation-i-signal-props{cs-error-reaction=AUTONOMOUS, transformer=TransformationTechnologySOMEIP, interface-version=2, message-type=REQUEST, size-of-array-length-fields=1, size-of-struct-length-fields=1, size-of-union-length-fields=1}, dynamic-length=true, transfer-property=TRIGGERED, to HCP3_IONode  # ServiceInterface for Service_WakeUpMonitorData
  pdu WakeUpMonitorData_Methods_getTable_Response_XIX_TCPServer_SomeIP_01_Info_El_SGW03_XIX_VLAN_Cockpit: length=344, transmission-mode-true-timing=event-controlled-timing={number-of-repetitions=0, repetition-period=0.0}, unused-bit-pattern=0
    signal WakeUpMonitorData_Methods_getTable_Response_XIX_TCPServer_SomeIP_01_Info_El_SGW03_XIX_VLAN_Cockpit: start 0, 2752 bit, opaque, data-transformations=SOMEIPOnlyTransformerChain, data-type-policy=TRANSFORMING-I-SIGNAL, i-signal-type=ARRAY, someip-transformation-i-signal-props{cs-error-reaction=AUTONOMOUS, transformer=TransformationTechnologySOMEIP, interface-version=2, message-type=RESPONSE, size-of-array-length-fields=1, size-of-struct-length-fields=1, size-of-union-length-fields=1}, dynamic-length=true, transfer-property=TRIGGERED  # ServiceInterface for Service_WakeUpMonitorData
  pdu WakeUpMonitorData_Methods_startCycle_Request_XIX_TCPServer_SomeIP_01_Info_El_SGW03_XIX_VLAN_Cockpit: length=14, transmission-mode-true-timing=event-controlled-timing={number-of-repetitions=0, repetition-period=0.0}, unused-bit-pattern=0
    signal WakeUpMonitorData_Methods_startCycle_Request_XIX_TCPServer_SomeIP_01_Info_El_SGW03_XIX_VLAN_Cockpit: start 0, 112 bit, opaque, data-transformations=SOMEIPOnlyTransformerChain, data-type-policy=TRANSFORMING-I-SIGNAL, i-signal-type=ARRAY, someip-transformation-i-signal-props{cs-error-reaction=AUTONOMOUS, transformer=TransformationTechnologySOMEIP, interface-version=2, message-type=REQUEST, size-of-array-length-fields=1, size-of-struct-length-fields=1, size-of-union-length-fields=1}, dynamic-length=true, transfer-property=TRIGGERED, to HCP3_IONode  # ServiceInterface for Service_WakeUpMonitorData
  pdu WakeUpMonitorData_Methods_startCycle_Response_XIX_TCPServer_SomeIP_01_Info_El_SGW03_XIX_VLAN_Cockpit: length=14, transmission-mode-true-timing=event-controlled-timing={number-of-repetitions=0, repetition-period=0.0}, unused-bit-pattern=0
    signal WakeUpMonitorData_Methods_startCycle_Response_XIX_TCPServer_SomeIP_01_Info_El_SGW03_XIX_VLAN_Cockpit: start 0, 112 bit, opaque, data-transformations=SOMEIPOnlyTransformerChain, data-type-policy=TRANSFORMING-I-SIGNAL, i-signal-type=ARRAY, someip-transformation-i-signal-props{cs-error-reaction=AUTONOMOUS, transformer=TransformationTechnologySOMEIP, interface-version=2, message-type=RESPONSE, size-of-array-length-fields=1, size-of-struct-length-fields=1, size-of-union-length-fields=1}, dynamic-length=true, transfer-property=TRIGGERED  # ServiceInterface for Service_WakeUpMonitorData
  pdu WakeUpMonitorData_RnRMethods_configuration_XIX_TCPServer_SomeIP_01_Info_El_SGW03_XIX_VLAN_Cockpit: length=42, transmission-mode-true-timing=event-controlled-timing={number-of-repetitions=0, repetition-period=0.0}, unused-bit-pattern=0
    signal WakeUpMonitorData_RnRMethods_configuration_XIX_TCPServer_SomeIP_01_Info_El_SGW03_XIX_VLAN_Cockpit: start 0, 336 bit, opaque, data-transformations=SOMEIPOnlyTransformerChain, data-type-policy=TRANSFORMING-I-SIGNAL, i-signal-type=ARRAY, someip-transformation-i-signal-props{transformer=TransformationTechnologySOMEIP, interface-version=2, message-type=REQUEST-NO-RETURN, size-of-array-length-fields=1, size-of-struct-length-fields=1, size-of-union-length-fields=1}, dynamic-length=true, transfer-property=TRIGGERED, to HCP3_IONode  # ServiceInterface for Service_WakeUpMonitorData
  pdu WFS_02_XIX_HCP3_CANFD01: length=28, minimum-delay=0.05, transmission-mode-true-timing={cyclic-timing={time-offset=0.0, time-period=0.4}, event-controlled-timing={number-of-repetitions=0, repetition-period=0.0}}, unused-bit-pattern=0
    signal WFS_02_CRC_XIX_WFS_02_XIX_HCP3_CANFD01: start 0, 8 bit, little-endian, data-type-policy=OVERRIDE, i-signal-type=PRIMITIVE, init-value=0, base-type=BT_WFS_02_CRC, compu {phys=raw for raw 0..255}, range phys 0..255, raw 0..255  # Für MLB: Berechnung siehe Lastenheft "Kommunikationsabsicherung für FlexRay und CAN" Ab MQB und MLBevo: Berechnung siehe Lastenheft "End-to-End Kommunikationsabsicherung" Endwerte siehe Begleitdokument "S-PDU Kennungsfolgen"
    signal WFS_02_BZ_XIX_WFS_02_XIX_HCP3_CANFD01: start 8, 4 bit, little-endian, data-type-policy=OVERRIDE, i-signal-type=PRIMITIVE, init-value=0, base-type=BT_WFS_02_BZ, compu {phys=raw for raw 0..15}, range phys 0..15, raw 0..15
    signal WFS_ID_Geb_autorisiert_in_Kl15_XIX_WFS_02_XIX_HCP3_CANFD01: start 12, 1 bit, little-endian, data-type-policy=OVERRIDE, i-signal-type=PRIMITIVE, init-value=0, base-type=BT_WFS_ID_Geb_autorisiert_in_Kl15, compu {0=Cx0_nicht_authorisiert_in_Kl15 (CM_WFS_ID_Geb_autorisiert_in_Kl15_Cx0_nicht_authorisiert_in_Kl15), 1=Cx1_authorisiert_in_Kl15 (CM_WFS_ID_Geb_autorisiert_in_Kl15_Cx1_authorisiert_in_Kl15)}, range raw 0..1  # Authorisierung des Schlüssels im aktiven Klemme-15-Zyklus
    signal WFS_ID_Geb_steckt_XIX_WFS_02_XIX_HCP3_CANFD01: start 13, 1 bit, little-endian, data-type-policy=OVERRIDE, i-signal-type=PRIMITIVE, init-value=0, base-type=BT_WFS_ID_Geb_steckt, compu {0=Cx0_kein_Schluessel_im_Zuendschloss (CM_WFS_ID_Geb_steckt_Cx0_kein_Schluessel_im_Zuendschloss), 1=Cx1_Schluessel_steckt_im_Zuendschloss (CM_WFS_ID_Geb_steckt_Cx1_Schluessel_steckt_im_Zuendschloss) (Schluessel steckt im Zuendschloss)}, range raw 0..1  # Schluessel (ID-Geber) im Zuendschloss
    signal WFS_ID_Geb_autorisiert_XIX_WFS_02_XIX_HCP3_CANFD01: start 14, 1 bit, little-endian, data-type-policy=OVERRIDE, i-signal-type=PRIMITIVE, init-value=0, base-type=BT_WFS_ID_Geb_autorisiert, compu {1=Cx1_Schluessel_authorisiert (CM_WFS_ID_Geb_autorisiert_Cx1_Schluessel_authorisiert), 0=Cx0_Schluessel_nicht_authorisiert (CM_WFS_ID_Geb_autorisiert_Cx0_Schluessel_nicht_authorisiert)}, range raw 0..1  # Authorisierung Schluessel (ID-Geber)
    signal WFS_Safe_XIX_WFS_02_XIX_HCP3_CANFD01: start 15, 1 bit, little-endian, data-type-policy=OVERRIDE, i-signal-type=PRIMITIVE, init-value=0, base-type=BT_WFS_Safe, compu {1=Cx1_WFS_nicht_deaktiviert (CM_WFS_Safe_Cx1_WFS_nicht_deaktiviert) (WFS nicht deaktiviert), 0=Cx0_Init (CM_WFS_Safe_Cx0_Init)}, range raw 0..1  # Status WFS
    signal VIN_1_XIX_WFS_02_XIX_HCP3_CANFD01: start 16, 8 bit, little-endian, data-type-policy=OVERRIDE, i-signal-type=PRIMITIVE, init-value=45, base-type=BT_VIN_1, compu {phys=raw for raw 0..255}, range phys 0..255, raw 0..255  # Initwert: 0x2D bei Fahrzeugen mit Wegfahrsperrengeneration >= 5 0x58 bei Fahrzeugen mit Wegfahrsperrengeneration < 5 (z.B. WFS-4)
    signal VIN_2_XIX_WFS_02_XIX_HCP3_CANFD01: start 24, 8 bit, little-endian, data-type-policy=OVERRIDE, i-signal-type=PRIMITIVE, init-value=45, base-type=BT_VIN_2, compu {phys=raw for raw 0..255}, range phys 0..255, raw 0..255  # Initwert: 0x2D bei Fahrzeugen mit Wegfahrsperrengeneration >= 5 0x58 bei Fahrzeugen mit Wegfahrsperrengeneration < 5 (z.B. WFS-4)
    signal VIN_3_XIX_WFS_02_XIX_HCP3_CANFD01: start 32, 8 bit, little-endian, data-type-policy=OVERRIDE, i-signal-type=PRIMITIVE, init-value=45, base-type=BT_VIN_3, compu {phys=raw for raw 0..255}, range phys 0..255, raw 0..255  # Initwert: 0x2D bei Fahrzeugen mit Wegfahrsperrengeneration >= 5 0x58 bei Fahrzeugen mit Wegfahrsperrengeneration < 5 (z.B. WFS-4)
    signal VIN_4_XIX_WFS_02_XIX_HCP3_CANFD01: start 40, 8 bit, little-endian, data-type-policy=OVERRIDE, i-signal-type=PRIMITIVE, init-value=45, base-type=BT_VIN_4, compu {phys=raw for raw 0..255}, range phys 0..255, raw 0..255  # Initwert: 0x2D bei Fahrzeugen mit Wegfahrsperrengeneration >= 5 0x58 bei Fahrzeugen mit Wegfahrsperrengeneration < 5 (z.B. WFS-4)
    signal VIN_5_XIX_WFS_02_XIX_HCP3_CANFD01: start 48, 8 bit, little-endian, data-type-policy=OVERRIDE, i-signal-type=PRIMITIVE, init-value=45, base-type=BT_VIN_5, compu {phys=raw for raw 0..255}, range phys 0..255, raw 0..255  # Initwert: 0x2D bei Fahrzeugen mit Wegfahrsperrengeneration >= 5 0x58 bei Fahrzeugen mit Wegfahrsperrengeneration < 5 (z.B. WFS-4)
    signal VIN_6_XIX_WFS_02_XIX_HCP3_CANFD01: start 56, 8 bit, little-endian, data-type-policy=OVERRIDE, i-signal-type=PRIMITIVE, init-value=45, base-type=BT_VIN_6, compu {phys=raw for raw 0..255}, range phys 0..255, raw 0..255  # Initwert: 0x2D bei Fahrzeugen mit Wegfahrsperrengeneration >= 5 0x58 bei Fahrzeugen mit Wegfahrsperrengeneration < 5 (z.B. WFS-4)
    signal VIN_7_XIX_WFS_02_XIX_HCP3_CANFD01: start 64, 8 bit, little-endian, data-type-policy=OVERRIDE, i-signal-type=PRIMITIVE, init-value=45, base-type=BT_VIN_7, compu {phys=raw for raw 0..255}, range phys 0..255, raw 0..255  # Initwert: 0x2D bei Fahrzeugen mit Wegfahrsperrengeneration >= 5 0x58 bei Fahrzeugen mit Wegfahrsperrengeneration < 5 (z.B. WFS-4)
    signal VIN_8_XIX_WFS_02_XIX_HCP3_CANFD01: start 72, 8 bit, little-endian, data-type-policy=OVERRIDE, i-signal-type=PRIMITIVE, init-value=45, base-type=BT_VIN_8, compu {phys=raw for raw 0..255}, range phys 0..255, raw 0..255  # Initwert: 0x2D bei Fahrzeugen mit Wegfahrsperrengeneration >= 5 0x58 bei Fahrzeugen mit Wegfahrsperrengeneration < 5 (z.B. WFS-4)
    signal VIN_9_XIX_WFS_02_XIX_HCP3_CANFD01: start 80, 8 bit, little-endian, data-type-policy=OVERRIDE, i-signal-type=PRIMITIVE, init-value=45, base-type=BT_VIN_9, compu {phys=raw for raw 0..255}, range phys 0..255, raw 0..255  # Initwert: 0x2D bei Fahrzeugen mit Wegfahrsperrengeneration >= 5 0x58 bei Fahrzeugen mit Wegfahrsperrengeneration < 5 (z.B. WFS-4)
    signal VIN_10_XIX_WFS_02_XIX_HCP3_CANFD01: start 88, 8 bit, little-endian, data-type-policy=OVERRIDE, i-signal-type=PRIMITIVE, init-value=45, base-type=BT_VIN_10, compu {phys=raw for raw 0..255}, range phys 0..255, raw 0..255  # Initwert: 0x2D bei Fahrzeugen mit Wegfahrsperrengeneration >= 5 0x58 bei Fahrzeugen mit Wegfahrsperrengeneration < 5 (z.B. WFS-4)
    signal VIN_11_XIX_WFS_02_XIX_HCP3_CANFD01: start 96, 8 bit, little-endian, data-type-policy=OVERRIDE, i-signal-type=PRIMITIVE, init-value=45, base-type=BT_VIN_11, compu {phys=raw for raw 0..255}, range phys 0..255, raw 0..255  # Initwert: 0x2D bei Fahrzeugen mit Wegfahrsperrengeneration >= 5 0x58 bei Fahrzeugen mit Wegfahrsperrengeneration < 5 (z.B. WFS-4)
    signal VIN_12_XIX_WFS_02_XIX_HCP3_CANFD01: start 104, 8 bit, little-endian, data-type-policy=OVERRIDE, i-signal-type=PRIMITIVE, init-value=45, base-type=BT_VIN_12, compu {phys=raw for raw 0..255}, range phys 0..255, raw 0..255  # Initwert: 0x2D bei Fahrzeugen mit Wegfahrsperrengeneration >= 5 0x58 bei Fahrzeugen mit Wegfahrsperrengeneration < 5 (z.B. WFS-4)
    signal VIN_13_XIX_WFS_02_XIX_HCP3_CANFD01: start 112, 8 bit, little-endian, data-type-policy=OVERRIDE, i-signal-type=PRIMITIVE, init-value=45, base-type=BT_VIN_13, compu {phys=raw for raw 0..255}, range phys 0..255, raw 0..255  # Initwert: 0x2D bei Fahrzeugen mit Wegfahrsperrengeneration >= 5 0x58 bei Fahrzeugen mit Wegfahrsperrengeneration < 5 (z.B. WFS-4)
    signal VIN_14_XIX_WFS_02_XIX_HCP3_CANFD01: start 120, 8 bit, little-endian, data-type-policy=OVERRIDE, i-signal-type=PRIMITIVE, init-value=45, base-type=BT_VIN_14, compu {phys=raw for raw 0..255}, range phys 0..255, raw 0..255  # Initwert: 0x2D bei Fahrzeugen mit Wegfahrsperrengeneration >= 5 0x58 bei Fahrzeugen mit Wegfahrsperrengeneration < 5 (z.B. WFS-4)
    signal VIN_15_XIX_WFS_02_XIX_HCP3_CANFD01: start 128, 8 bit, little-endian, data-type-policy=OVERRIDE, i-signal-type=PRIMITIVE, init-value=45, base-type=BT_VIN_15, compu {phys=raw for raw 0..255}, range phys 0..255, raw 0..255  # Initwert: 0x2D bei Fahrzeugen mit Wegfahrsperrengeneration >= 5 0x58 bei Fahrzeugen mit Wegfahrsperrengeneration < 5 (z.B. WFS-4)
    signal VIN_16_XIX_WFS_02_XIX_HCP3_CANFD01: start 136, 8 bit, little-endian, data-type-policy=OVERRIDE, i-signal-type=PRIMITIVE, init-value=45, base-type=BT_VIN_16, compu {phys=raw for raw 0..255}, range phys 0..255, raw 0..255  # Initwert: 0x2D bei Fahrzeugen mit Wegfahrsperrengeneration >= 5 0x58 bei Fahrzeugen mit Wegfahrsperrengeneration < 5 (z.B. WFS-4)
    signal VIN_17_XIX_WFS_02_XIX_HCP3_CANFD01: start 144, 8 bit, little-endian, data-type-policy=OVERRIDE, i-signal-type=PRIMITIVE, init-value=45, base-type=BT_VIN_17, compu {phys=raw for raw 0..255}, range phys 0..255, raw 0..255  # Initwert: 0x2D bei Fahrzeugen mit Wegfahrsperrengeneration >= 5 0x58 bei Fahrzeugen mit Wegfahrsperrengeneration < 5 (z.B. WFS-4)
    signal WFS_Schluessel_Soll_XIX_WFS_02_XIX_HCP3_CANFD01: start 152, 4 bit, little-endian, data-type-policy=OVERRIDE, i-signal-type=PRIMITIVE, init-value=0, base-type=BT_WFS_Schluessel_Soll, compu {phys=raw for raw 0..8; unit Unit_None}, range phys 0..8 Unit_None, raw 0..8, unit=Unit_None  # Sollwert der zu lernenden Schluessel
    signal WFS_Schluessel_Ist_XIX_WFS_02_XIX_HCP3_CANFD01: start 156, 4 bit, little-endian, data-type-policy=OVERRIDE, i-signal-type=PRIMITIVE, init-value=0, base-type=BT_WFS_Schluessel_Ist, compu {phys=raw for raw 0..8; unit Unit_None}, range phys 0..8 Unit_None, raw 0..8, unit=Unit_None  # Istwert der gelernten Schluessel
    signal WFS_Schluessel_Fahrberecht_XIX_WFS_02_XIX_HCP3_CANFD01: start 160, 4 bit, little-endian, data-type-policy=OVERRIDE, i-signal-type=PRIMITIVE, init-value=0, base-type=BT_WFS_Schluessel_Fahrberecht, compu {10=Cxa_ungueltig_10 (CM_WFS_Schluessel_Fahrberecht_Cxa_ungueltig_10), 5=Cx5_aktive_Funkschluessel_Nr_05 (CM_WFS_Schluessel_Fahrberecht_Cx5_aktive_Funkschluessel_Nr_05), 14=Cxe_ungueltig_14 (CM_WFS_Schluessel_Fahrberecht_Cxe_ungueltig_14), 12=Cxc_ungueltig_12 (CM_WFS_Schluessel_Fahrberecht_Cxc_ungueltig_12), 3=Cx3_aktive_Funkschluessel_Nr_03 (CM_WFS_Schluessel_Fahrberecht_Cx3_aktive_Funkschluessel_Nr_03), 0=Cx0_kein_authorisierter_Schluessel_erkannt (CM_WFS_Schluessel_Fahrberecht_Cx0_kein_authorisierter_Schluessel_erkannt) (kein authorisierter Schluessel erkannt), 11=Cxb_ungueltig_11 (CM_WFS_Schluessel_Fahrberecht_Cxb_ungueltig_11), 2=Cx2_aktive_Funkschluessel_Nr_02 (CM_WFS_Schluessel_Fahrberecht_Cx2_aktive_Funkschluessel_Nr_02), 13=Cxd_ungueltig_13 (CM_WFS_Schluessel_Fahrberecht_Cxd_ungueltig_13), 4=Cx4_aktive_Funkschluessel_Nr_04 (CM_WFS_Schluessel_Fahrberecht_Cx4_aktive_Funkschluessel_Nr_04), 15=Cxf_digitaler_Schluessel_aktiv (CM_WFS_Schluessel_Fahrberecht_Cxf_digitaler_Schluessel_aktiv), 6=Cx6_aktive_Funkschluessel_Nr_06 (CM_WFS_Schluessel_Fahrberecht_Cx6_aktive_Funkschluessel_Nr_06), 8=Cx8_aktive_Funkschluessel_Nr_08 (CM_WFS_Schluessel_Fahrberecht_Cx8_aktive_Funkschluessel_Nr_08), 1=Cx1_aktive_Funkschluessel_Nr_01 (CM_WFS_Schluessel_Fahrberecht_Cx1_aktive_Funkschluessel_Nr_01), 7=Cx7_aktive_Funkschluessel_Nr_07 (CM_WFS_Schluessel_Fahrberecht_Cx7_aktive_Funkschluessel_Nr_07), 9=Cx9_ungueltig_09 (CM_WFS_Schluessel_Fahrberecht_Cx9_ungueltig_09)}, range raw 0..15  # Schlüsselnummer Fahrberechtigung 0 = ungueltig, xxxx = Schluessel-Nr.
    signal WFS_Fahrerhinweise_XIX_WFS_02_XIX_HCP3_CANFD01: start 164, 2 bit, little-endian, data-type-policy=OVERRIDE, i-signal-type=PRIMITIVE, init-value=0, base-type=BT_WFS_Fahrerhinweise, compu {3=Cx3_Schluessel_Kessy_nicht_gefunden (CM_WFS_Fahrerhinweise_Cx3_Schluessel_Kessy_nicht_gefunden), 0=Cx0_Keine_Anzeigeanforderung (CM_WFS_Fahrerhinweise_Cx0_Keine_Anzeigeanforderung), 2=Cx2_Notlauf_aktiv (CM_WFS_Fahrerhinweise_Cx2_Notlauf_aktiv), 1=Cx1_Schuessel_Auth_niO (CM_WFS_Fahrerhinweise_Cx1_Schuessel_Auth_niO)}, range raw 0..3  # Meldungen, Fahrer- und Warnhinweise der Wegfahrsperre
    signal WFS_Parken_Status_XIX_WFS_02_XIX_HCP3_CANFD01: start 166, 2 bit, little-endian, data-type-policy=OVERRIDE, i-signal-type=PRIMITIVE, init-value=0, base-type=BT_WFS_Parken_Status, compu {0=Cx0_Limitierung_inaktiv (CM_WFS_Parken_Status_Cx0_Limitierung_inaktiv), 2=Cx2_Abbruch (CM_WFS_Parken_Status_Cx2_Abbruch), 1=Cx1_Limitierung_aktiv (CM_WFS_Parken_Status_Cx1_Limitierung_aktiv)}, range raw 0..2  # Schnittstelle zwischen WFS und ZFAS für das Pilotierte Parken um in Richtung ZFAS den Status der WFS im BCM2 zu kommunizieren
    signal WFS_Klemmenfreigabe_XIX_WFS_02_XIX_HCP3_CANFD01: start 169, 1 bit, little-endian, data-type-policy=OVERRIDE, i-signal-type=PRIMITIVE, init-value=0, base-type=BT_WFS_Klemmenfreigabe, compu {1=Cx1_Freigabe (CM_WFS_Klemmenfreigabe_Cx1_Freigabe), 0=Cx0_keine_Freigabe (CM_WFS_Klemmenfreigabe_Cx0_keine_Freigabe)}, range raw 0..1  # Freigabe von der WFS zum Einschalten der Klemme 15 und Klemme S
    signal WFS_ELV_authorisiert_XIX_WFS_02_XIX_HCP3_CANFD01: start 170, 1 bit, little-endian, data-type-policy=OVERRIDE, i-signal-type=PRIMITIVE, init-value=0, base-type=BT_WFS_ELV_authorisiert, compu {0=Cx0_ELV_nicht_authorisiert (CM_WFS_ELV_authorisiert_Cx0_ELV_nicht_authorisiert), 1=Cx1_ELV_authorisiert (CM_WFS_ELV_authorisiert_Cx1_ELV_authorisiert)}, range raw 0..1  # Authorisierung der elektrischen Lenkungsverriegelung an der WFS
    signal WFS_Betrieb_Lesespule_XIX_WFS_02_XIX_HCP3_CANFD01: start 171, 1 bit, little-endian, data-type-policy=OVERRIDE, i-signal-type=PRIMITIVE, init-value=0, base-type=BT_WFS_Betrieb_Lesespule, compu {1=Cx1_Schluesselkomm_Lesespule (CM_WFS_Betrieb_Lesespule_Cx1_Schluesselkomm_Lesespule), 0=Cx0_keine_Schluesselkomm_Lesespule (CM_WFS_Betrieb_Lesespule_Cx0_keine_Schluesselkomm_Lesespule)}, range raw 0..1  # Schlüsselkommunikation über die Lesespule
    signal WFS_LF_Aktiv_XIX_WFS_02_XIX_HCP3_CANFD01: start 172, 1 bit, little-endian, data-type-policy=OVERRIDE, i-signal-type=PRIMITIVE, init-value=0, base-type=BT_WFS_LF_Aktiv, compu {1=Cx1_LF_Funkempfang_aktiv (CM_WFS_LF_Aktiv_Cx1_LF_Funkempfang_aktiv), 0=Cx0_Funktempfang_nicht_aktiv (CM_WFS_LF_Aktiv_Cx0_Funktempfang_nicht_aktiv)}, range raw 0..1  # LF Schluesselkommunikation
    signal WFS_LZ_02_XIX_WFS_02_XIX_HCP3_CANFD01: start 173, 4 bit, little-endian, data-type-policy=OVERRIDE, i-signal-type=PRIMITIVE, init-value=0, base-type=BT_WFS_LZ_02, invalid-value=Invalid_WFS_LZ_02_XIX_WFS_02_XIX_HCP3_CANFD01:9, compu {9=Cx9_Fehler (CM_WFS_LZ_02_Cx9_Fehler), 2=Cx2_angelernt (CM_WFS_LZ_02_Cx2_angelernt), 8=Cx8_WFS_temporaer_nicht_verfuegbar (CM_WFS_LZ_02_Cx8_WFS_temporaer_nicht_verfuegbar), 3=Cx3_Schluessel_lernen_Kundendienst (CM_WFS_LZ_02_Cx3_Schluessel_lernen_Kundendienst), 0=Cx0_Lieferant_Init (CM_WFS_LZ_02_Cx0_Lieferant_Init) (Lieferant/Init), 4=Cx4_Schluessel_lernen_Produktion (CM_WFS_LZ_02_Cx4_Schluessel_lernen_Produktion), 1=Cx1_fabrikneu (CM_WFS_LZ_02_Cx1_fabrikneu)}, range raw 0..9  # Inbetriebnahme/Anlernzustand der Wegfahrsperre
    signal IMMO_Display_XIX_WFS_02_XIX_HCP3_CANFD01: start 177, 2 bit, little-endian, data-type-policy=OVERRIDE, i-signal-type=PRIMITIVE, init-value=0, base-type=BT_IMMO_Display, invalid-value=Invalid_IMMO_Display_XIX_WFS_02_XIX_HCP3_CANFD01:2, compu {2=Cx2_Fehler (CM_IMMO_Display_Cx2_Fehler), 0=Cx0_keine_Anzeige (CM_IMMO_Display_Cx0_keine_Anzeige) (keine Anzeige), 1=Cx1_Anzeige (CM_IMMO_Display_Cx1_Anzeige)}, range raw 0..2  # Signal zur Steuerung der WFS-Anzeige im Kombi (Service)
    signal IMMO_ClampPermStatus_XIX_WFS_02_XIX_HCP3_CANFD01: start 179, 4 bit, little-endian, data-type-policy=OVERRIDE, i-signal-type=PRIMITIVE, init-value=15, base-type=BT_IMMO_ClampPermStatus, compu {9=Cx9_RemoteStart_Freigabe_Leistungsbereitstellung (CM_IMMO_ClampPermStatus_Cx9_RemoteStart_Freigabe_Leistungsbereitstellung), 1=Cx1_Normale_Freigabe (CM_IMMO_ClampPermStatus_Cx1_Normale_Freigabe), 5=Cx5_RemoteDrive_Freigabe_Leistungsbereitstellung_mit_Vortrieb (CM_IMMO_ClampPermStatus_Cx5_RemoteDrive_Freigabe_Leistungsbereitstellung_mit_Vortrieb), 3=Cx3_Diagnose_Freigabe (CM_IMMO_ClampPermStatus_Cx3_Diagnose_Freigabe), 14=Cxe_Busy (CM_IMMO_ClampPermStatus_Cxe_Busy), 15=Cxf_Init (CM_IMMO_ClampPermStatus_Cxf_Init), 0=Cx0_keine_Freigabe (CM_IMMO_ClampPermStatus_Cx0_keine_Freigabe)}, range raw 0..15  # Antwortsignal der WFS an die Klemmensteuerung zur Klemmenfreigabe
    mapping SG_WFS_02_XIX_HCP3_CANFD01: i-signal-group=SG_WFS_02_XIX_HCP3_CANFD01, transfer-property=TRIGGERED-WITHOUT-REPETITION
