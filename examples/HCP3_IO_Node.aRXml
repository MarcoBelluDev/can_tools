[part 12 of 15: packages /PDU to /Semantics]
AUTOSAR XML (schema 4-3-0)
package /PDU  (continued)
  pdu WFS_02_XIX_VLAN_Cockpit: length=28, minimum-delay=0.05, transmission-mode-true-timing={cyclic-timing={time-offset=0.0, time-period=0.4}, event-controlled-timing={number-of-repetitions=0, repetition-period=0.0}}, unused-bit-pattern=0
    signal WFS_02_CRC_XIX_WFS_02_XIX_VLAN_Cockpit: start 0, 8 bit, little-endian, data-type-policy=OVERRIDE, i-signal-type=PRIMITIVE, init-value=0, base-type=BT_WFS_02_CRC, compu {phys=raw for raw 0..255}, range phys 0..255, raw 0..255  # Für MLB: Berechnung siehe Lastenheft "Kommunikationsabsicherung für FlexRay und CAN" Ab MQB und MLBevo: Berechnung siehe Lastenheft "End-to-End Kommunikationsabsicherung" Endwerte siehe Begleitdokument "S-PDU Kennungsfolgen"
    signal WFS_02_BZ_XIX_WFS_02_XIX_VLAN_Cockpit: start 8, 4 bit, little-endian, data-type-policy=OVERRIDE, i-signal-type=PRIMITIVE, init-value=0, base-type=BT_WFS_02_BZ, compu {phys=raw for raw 0..15}, range phys 0..15, raw 0..15
    signal WFS_ID_Geb_autorisiert_in_Kl15_XIX_WFS_02_XIX_VLAN_Cockpit: start 12, 1 bit, little-endian, data-type-policy=OVERRIDE, i-signal-type=PRIMITIVE, init-value=0, base-type=BT_WFS_ID_Geb_autorisiert_in_Kl15, compu {0=Cx0_nicht_authorisiert_in_Kl15 (CM_WFS_ID_Geb_autorisiert_in_Kl15_Cx0_nicht_authorisiert_in_Kl15), 1=Cx1_authorisiert_in_Kl15 (CM_WFS_ID_Geb_autorisiert_in_Kl15_Cx1_authorisiert_in_Kl15)}, range raw 0..1  # Authorisierung des Schlüssels im aktiven Klemme-15-Zyklus
    signal WFS_ID_Geb_steckt_XIX_WFS_02_XIX_VLAN_Cockpit: start 13, 1 bit, little-endian, data-type-policy=OVERRIDE, i-signal-type=PRIMITIVE, init-value=0, base-type=BT_WFS_ID_Geb_steckt, compu {0=Cx0_kein_Schluessel_im_Zuendschloss (CM_WFS_ID_Geb_steckt_Cx0_kein_Schluessel_im_Zuendschloss), 1=Cx1_Schluessel_steckt_im_Zuendschloss (CM_WFS_ID_Geb_steckt_Cx1_Schluessel_steckt_im_Zuendschloss) (Schluessel steckt im Zuendschloss)}, range raw 0..1  # Schluessel (ID-Geber) im Zuendschloss
    signal WFS_ID_Geb_autorisiert_XIX_WFS_02_XIX_VLAN_Cockpit: start 14, 1 bit, little-endian, data-type-policy=OVERRIDE, i-signal-type=PRIMITIVE, init-value=0, base-type=BT_WFS_ID_Geb_autorisiert, compu {1=Cx1_Schluessel_authorisiert (CM_WFS_ID_Geb_autorisiert_Cx1_Schluessel_authorisiert), 0=Cx0_Schluessel_nicht_authorisiert (CM_WFS_ID_Geb_autorisiert_Cx0_Schluessel_nicht_authorisiert)}, range raw 0..1  # Authorisierung Schluessel (ID-Geber)
    signal WFS_Safe_XIX_WFS_02_XIX_VLAN_Cockpit: start 15, 1 bit, little-endian, data-type-policy=OVERRIDE, i-signal-type=PRIMITIVE, init-value=0, base-type=BT_WFS_Safe, compu {1=Cx1_WFS_nicht_deaktiviert (CM_WFS_Safe_Cx1_WFS_nicht_deaktiviert) (WFS nicht deaktiviert), 0=Cx0_Init (CM_WFS_Safe_Cx0_Init)}, range raw 0..1  # Status WFS
    signal VIN_1_XIX_WFS_02_XIX_VLAN_Cockpit: start 16, 8 bit, little-endian, data-type-policy=OVERRIDE, i-signal-type=PRIMITIVE, init-value=45, base-type=BT_VIN_1, compu {phys=raw for raw 0..255}, range phys 0..255, raw 0..255, to HCP3_IONode(timeout 4 s)  # Initwert: 0x2D bei Fahrzeugen mit Wegfahrsperrengeneration >= 5 0x58 bei Fahrzeugen mit Wegfahrsperrengeneration < 5 (z.B. WFS-4)
    signal VIN_2_XIX_WFS_02_XIX_VLAN_Cockpit: start 24, 8 bit, little-endian, data-type-policy=OVERRIDE, i-signal-type=PRIMITIVE, init-value=45, base-type=BT_VIN_2, compu {phys=raw for raw 0..255}, range phys 0..255, raw 0..255, to HCP3_IONode(timeout 4 s)  # Initwert: 0x2D bei Fahrzeugen mit Wegfahrsperrengeneration >= 5 0x58 bei Fahrzeugen mit Wegfahrsperrengeneration < 5 (z.B. WFS-4)
    signal VIN_3_XIX_WFS_02_XIX_VLAN_Cockpit: start 32, 8 bit, little-endian, data-type-policy=OVERRIDE, i-signal-type=PRIMITIVE, init-value=45, base-type=BT_VIN_3, compu {phys=raw for raw 0..255}, range phys 0..255, raw 0..255, to HCP3_IONode(timeout 4 s)  # Initwert: 0x2D bei Fahrzeugen mit Wegfahrsperrengeneration >= 5 0x58 bei Fahrzeugen mit Wegfahrsperrengeneration < 5 (z.B. WFS-4)
    signal VIN_4_XIX_WFS_02_XIX_VLAN_Cockpit: start 40, 8 bit, little-endian, data-type-policy=OVERRIDE, i-signal-type=PRIMITIVE, init-value=45, base-type=BT_VIN_4, compu {phys=raw for raw 0..255}, range phys 0..255, raw 0..255, to HCP3_IONode(timeout 4 s)  # Initwert: 0x2D bei Fahrzeugen mit Wegfahrsperrengeneration >= 5 0x58 bei Fahrzeugen mit Wegfahrsperrengeneration < 5 (z.B. WFS-4)
    signal VIN_5_XIX_WFS_02_XIX_VLAN_Cockpit: start 48, 8 bit, little-endian, data-type-policy=OVERRIDE, i-signal-type=PRIMITIVE, init-value=45, base-type=BT_VIN_5, compu {phys=raw for raw 0..255}, range phys 0..255, raw 0..255, to HCP3_IONode(timeout 4 s)  # Initwert: 0x2D bei Fahrzeugen mit Wegfahrsperrengeneration >= 5 0x58 bei Fahrzeugen mit Wegfahrsperrengeneration < 5 (z.B. WFS-4)
    signal VIN_6_XIX_WFS_02_XIX_VLAN_Cockpit: start 56, 8 bit, little-endian, data-type-policy=OVERRIDE, i-signal-type=PRIMITIVE, init-value=45, base-type=BT_VIN_6, compu {phys=raw for raw 0..255}, range phys 0..255, raw 0..255, to HCP3_IONode(timeout 4 s)  # Initwert: 0x2D bei Fahrzeugen mit Wegfahrsperrengeneration >= 5 0x58 bei Fahrzeugen mit Wegfahrsperrengeneration < 5 (z.B. WFS-4)
    signal VIN_7_XIX_WFS_02_XIX_VLAN_Cockpit: start 64, 8 bit, little-endian, data-type-policy=OVERRIDE, i-signal-type=PRIMITIVE, init-value=45, base-type=BT_VIN_7, compu {phys=raw for raw 0..255}, range phys 0..255, raw 0..255, to HCP3_IONode(timeout 4 s)  # Initwert: 0x2D bei Fahrzeugen mit Wegfahrsperrengeneration >= 5 0x58 bei Fahrzeugen mit Wegfahrsperrengeneration < 5 (z.B. WFS-4)
    signal VIN_8_XIX_WFS_02_XIX_VLAN_Cockpit: start 72, 8 bit, little-endian, data-type-policy=OVERRIDE, i-signal-type=PRIMITIVE, init-value=45, base-type=BT_VIN_8, compu {phys=raw for raw 0..255}, range phys 0..255, raw 0..255, to HCP3_IONode(timeout 4 s)  # Initwert: 0x2D bei Fahrzeugen mit Wegfahrsperrengeneration >= 5 0x58 bei Fahrzeugen mit Wegfahrsperrengeneration < 5 (z.B. WFS-4)
    signal VIN_9_XIX_WFS_02_XIX_VLAN_Cockpit: start 80, 8 bit, little-endian, data-type-policy=OVERRIDE, i-signal-type=PRIMITIVE, init-value=45, base-type=BT_VIN_9, compu {phys=raw for raw 0..255}, range phys 0..255, raw 0..255, to HCP3_IONode(timeout 4 s)  # Initwert: 0x2D bei Fahrzeugen mit Wegfahrsperrengeneration >= 5 0x58 bei Fahrzeugen mit Wegfahrsperrengeneration < 5 (z.B. WFS-4)
    signal VIN_10_XIX_WFS_02_XIX_VLAN_Cockpit: start 88, 8 bit, little-endian, data-type-policy=OVERRIDE, i-signal-type=PRIMITIVE, init-value=45, base-type=BT_VIN_10, compu {phys=raw for raw 0..255}, range phys 0..255, raw 0..255, to HCP3_IONode(timeout 4 s)  # Initwert: 0x2D bei Fahrzeugen mit Wegfahrsperrengeneration >= 5 0x58 bei Fahrzeugen mit Wegfahrsperrengeneration < 5 (z.B. WFS-4)
    signal VIN_11_XIX_WFS_02_XIX_VLAN_Cockpit: start 96, 8 bit, little-endian, data-type-policy=OVERRIDE, i-signal-type=PRIMITIVE, init-value=45, base-type=BT_VIN_11, compu {phys=raw for raw 0..255}, range phys 0..255, raw 0..255, to HCP3_IONode(timeout 4 s)  # Initwert: 0x2D bei Fahrzeugen mit Wegfahrsperrengeneration >= 5 0x58 bei Fahrzeugen mit Wegfahrsperrengeneration < 5 (z.B. WFS-4)
    signal VIN_12_XIX_WFS_02_XIX_VLAN_Cockpit: start 104, 8 bit, little-endian, data-type-policy=OVERRIDE, i-signal-type=PRIMITIVE, init-value=45, base-type=BT_VIN_12, compu {phys=raw for raw 0..255}, range phys 0..255, raw 0..255, to HCP3_IONode(timeout 4 s)  # Initwert: 0x2D bei Fahrzeugen mit Wegfahrsperrengeneration >= 5 0x58 bei Fahrzeugen mit Wegfahrsperrengeneration < 5 (z.B. WFS-4)
    signal VIN_13_XIX_WFS_02_XIX_VLAN_Cockpit: start 112, 8 bit, little-endian, data-type-policy=OVERRIDE, i-signal-type=PRIMITIVE, init-value=45, base-type=BT_VIN_13, compu {phys=raw for raw 0..255}, range phys 0..255, raw 0..255, to HCP3_IONode(timeout 4 s)  # Initwert: 0x2D bei Fahrzeugen mit Wegfahrsperrengeneration >= 5 0x58 bei Fahrzeugen mit Wegfahrsperrengeneration < 5 (z.B. WFS-4)
    signal VIN_14_XIX_WFS_02_XIX_VLAN_Cockpit: start 120, 8 bit, little-endian, data-type-policy=OVERRIDE, i-signal-type=PRIMITIVE, init-value=45, base-type=BT_VIN_14, compu {phys=raw for raw 0..255}, range phys 0..255, raw 0..255, to HCP3_IONode(timeout 4 s)  # Initwert: 0x2D bei Fahrzeugen mit Wegfahrsperrengeneration >= 5 0x58 bei Fahrzeugen mit Wegfahrsperrengeneration < 5 (z.B. WFS-4)
    signal VIN_15_XIX_WFS_02_XIX_VLAN_Cockpit: start 128, 8 bit, little-endian, data-type-policy=OVERRIDE, i-signal-type=PRIMITIVE, init-value=45, base-type=BT_VIN_15, compu {phys=raw for raw 0..255}, range phys 0..255, raw 0..255, to HCP3_IONode(timeout 4 s)  # Initwert: 0x2D bei Fahrzeugen mit Wegfahrsperrengeneration >= 5 0x58 bei Fahrzeugen mit Wegfahrsperrengeneration < 5 (z.B. WFS-4)
    signal VIN_16_XIX_WFS_02_XIX_VLAN_Cockpit: start 136, 8 bit, little-endian, data-type-policy=OVERRIDE, i-signal-type=PRIMITIVE, init-value=45, base-type=BT_VIN_16, compu {phys=raw for raw 0..255}, range phys 0..255, raw 0..255, to HCP3_IONode(timeout 4 s)  # Initwert: 0x2D bei Fahrzeugen mit Wegfahrsperrengeneration >= 5 0x58 bei Fahrzeugen mit Wegfahrsperrengeneration < 5 (z.B. WFS-4)
    signal VIN_17_XIX_WFS_02_XIX_VLAN_Cockpit: start 144, 8 bit, little-endian, data-type-policy=OVERRIDE, i-signal-type=PRIMITIVE, init-value=45, base-type=BT_VIN_17, compu {phys=raw for raw 0..255}, range phys 0..255, raw 0..255, to HCP3_IONode(timeout 4 s)  # Initwert: 0x2D bei Fahrzeugen mit Wegfahrsperrengeneration >= 5 0x58 bei Fahrzeugen mit Wegfahrsperrengeneration < 5 (z.B. WFS-4)
    signal WFS_Schluessel_Soll_XIX_WFS_02_XIX_VLAN_Cockpit: start 152, 4 bit, little-endian, data-type-policy=OVERRIDE, i-signal-type=PRIMITIVE, init-value=0, base-type=BT_WFS_Schluessel_Soll, compu {phys=raw for raw 0..8; unit Unit_None}, range phys 0..8 Unit_None, raw 0..8, unit=Unit_None  # Sollwert der zu lernenden Schluessel
    signal WFS_Schluessel_Ist_XIX_WFS_02_XIX_VLAN_Cockpit: start 156, 4 bit, little-endian, data-type-policy=OVERRIDE, i-signal-type=PRIMITIVE, init-value=0, base-type=BT_WFS_Schluessel_Ist, compu {phys=raw for raw 0..8; unit Unit_None}, range phys 0..8 Unit_None, raw 0..8, unit=Unit_None  # Istwert der gelernten Schluessel
    signal WFS_Schluessel_Fahrberecht_XIX_WFS_02_XIX_VLAN_Cockpit: start 160, 4 bit, little-endian, data-type-policy=OVERRIDE, i-signal-type=PRIMITIVE, init-value=0, base-type=BT_WFS_Schluessel_Fahrberecht, compu {10=Cxa_ungueltig_10 (CM_WFS_Schluessel_Fahrberecht_Cxa_ungueltig_10), 5=Cx5_aktive_Funkschluessel_Nr_05 (CM_WFS_Schluessel_Fahrberecht_Cx5_aktive_Funkschluessel_Nr_05), 14=Cxe_ungueltig_14 (CM_WFS_Schluessel_Fahrberecht_Cxe_ungueltig_14), 12=Cxc_ungueltig_12 (CM_WFS_Schluessel_Fahrberecht_Cxc_ungueltig_12), 3=Cx3_aktive_Funkschluessel_Nr_03 (CM_WFS_Schluessel_Fahrberecht_Cx3_aktive_Funkschluessel_Nr_03), 0=Cx0_kein_authorisierter_Schluessel_erkannt (CM_WFS_Schluessel_Fahrberecht_Cx0_kein_authorisierter_Schluessel_erkannt) (kein authorisierter Schluessel erkannt), 11=Cxb_ungueltig_11 (CM_WFS_Schluessel_Fahrberecht_Cxb_ungueltig_11), 2=Cx2_aktive_Funkschluessel_Nr_02 (CM_WFS_Schluessel_Fahrberecht_Cx2_aktive_Funkschluessel_Nr_02), 13=Cxd_ungueltig_13 (CM_WFS_Schluessel_Fahrberecht_Cxd_ungueltig_13), 4=Cx4_aktive_Funkschluessel_Nr_04 (CM_WFS_Schluessel_Fahrberecht_Cx4_aktive_Funkschluessel_Nr_04), 15=Cxf_digitaler_Schluessel_aktiv (CM_WFS_Schluessel_Fahrberecht_Cxf_digitaler_Schluessel_aktiv), 6=Cx6_aktive_Funkschluessel_Nr_06 (CM_WFS_Schluessel_Fahrberecht_Cx6_aktive_Funkschluessel_Nr_06), 8=Cx8_aktive_Funkschluessel_Nr_08 (CM_WFS_Schluessel_Fahrberecht_Cx8_aktive_Funkschluessel_Nr_08), 1=Cx1_aktive_Funkschluessel_Nr_01 (CM_WFS_Schluessel_Fahrberecht_Cx1_aktive_Funkschluessel_Nr_01), 7=Cx7_aktive_Funkschluessel_Nr_07 (CM_WFS_Schluessel_Fahrberecht_Cx7_aktive_Funkschluessel_Nr_07), 9=Cx9_ungueltig_09 (CM_WFS_Schluessel_Fahrberecht_Cx9_ungueltig_09)}, range raw 0..15  # Schlüsselnummer Fahrberechtigung 0 = ungueltig, xxxx = Schluessel-Nr.
    signal WFS_Fahrerhinweise_XIX_WFS_02_XIX_VLAN_Cockpit: start 164, 2 bit, little-endian, data-type-policy=OVERRIDE, i-signal-type=PRIMITIVE, init-value=0, base-type=BT_WFS_Fahrerhinweise, compu {3=Cx3_Schluessel_Kessy_nicht_gefunden (CM_WFS_Fahrerhinweise_Cx3_Schluessel_Kessy_nicht_gefunden), 0=Cx0_Keine_Anzeigeanforderung (CM_WFS_Fahrerhinweise_Cx0_Keine_Anzeigeanforderung), 2=Cx2_Notlauf_aktiv (CM_WFS_Fahrerhinweise_Cx2_Notlauf_aktiv), 1=Cx1_Schuessel_Auth_niO (CM_WFS_Fahrerhinweise_Cx1_Schuessel_Auth_niO)}, range raw 0..3  # Meldungen, Fahrer- und Warnhinweise der Wegfahrsperre
    signal WFS_Parken_Status_XIX_WFS_02_XIX_VLAN_Cockpit: start 166, 2 bit, little-endian, data-type-policy=OVERRIDE, i-signal-type=PRIMITIVE, init-value=0, base-type=BT_WFS_Parken_Status, compu {0=Cx0_Limitierung_inaktiv (CM_WFS_Parken_Status_Cx0_Limitierung_inaktiv), 2=Cx2_Abbruch (CM_WFS_Parken_Status_Cx2_Abbruch), 1=Cx1_Limitierung_aktiv (CM_WFS_Parken_Status_Cx1_Limitierung_aktiv)}, range raw 0..2  # Schnittstelle zwischen WFS und ZFAS für das Pilotierte Parken um in Richtung ZFAS den Status der WFS im BCM2 zu kommunizieren
    signal WFS_Klemmenfreigabe_XIX_WFS_02_XIX_VLAN_Cockpit: start 169, 1 bit, little-endian, data-type-policy=OVERRIDE, i-signal-type=PRIMITIVE, init-value=0, base-type=BT_WFS_Klemmenfreigabe, compu {1=Cx1_Freigabe (CM_WFS_Klemmenfreigabe_Cx1_Freigabe), 0=Cx0_keine_Freigabe (CM_WFS_Klemmenfreigabe_Cx0_keine_Freigabe)}, range raw 0..1  # Freigabe von der WFS zum Einschalten der Klemme 15 und Klemme S
    signal WFS_ELV_authorisiert_XIX_WFS_02_XIX_VLAN_Cockpit: start 170, 1 bit, little-endian, data-type-policy=OVERRIDE, i-signal-type=PRIMITIVE, init-value=0, base-type=BT_WFS_ELV_authorisiert, compu {0=Cx0_ELV_nicht_authorisiert (CM_WFS_ELV_authorisiert_Cx0_ELV_nicht_authorisiert), 1=Cx1_ELV_authorisiert (CM_WFS_ELV_authorisiert_Cx1_ELV_authorisiert)}, range raw 0..1  # Authorisierung der elektrischen Lenkungsverriegelung an der WFS
    signal WFS_Betrieb_Lesespule_XIX_WFS_02_XIX_VLAN_Cockpit: start 171, 1 bit, little-endian, data-type-policy=OVERRIDE, i-signal-type=PRIMITIVE, init-value=0, base-type=BT_WFS_Betrieb_Lesespule, compu {1=Cx1_Schluesselkomm_Lesespule (CM_WFS_Betrieb_Lesespule_Cx1_Schluesselkomm_Lesespule), 0=Cx0_keine_Schluesselkomm_Lesespule (CM_WFS_Betrieb_Lesespule_Cx0_keine_Schluesselkomm_Lesespule)}, range raw 0..1  # Schlüsselkommunikation über die Lesespule
    signal WFS_LF_Aktiv_XIX_WFS_02_XIX_VLAN_Cockpit: start 172, 1 bit, little-endian, data-type-policy=OVERRIDE, i-signal-type=PRIMITIVE, init-value=0, base-type=BT_WFS_LF_Aktiv, compu {1=Cx1_LF_Funkempfang_aktiv (CM_WFS_LF_Aktiv_Cx1_LF_Funkempfang_aktiv), 0=Cx0_Funktempfang_nicht_aktiv (CM_WFS_LF_Aktiv_Cx0_Funktempfang_nicht_aktiv)}, range raw 0..1  # LF Schluesselkommunikation
    signal WFS_LZ_02_XIX_WFS_02_XIX_VLAN_Cockpit: start 173, 4 bit, little-endian, data-type-policy=OVERRIDE, i-signal-type=PRIMITIVE, init-value=0, base-type=BT_WFS_LZ_02, invalid-value=Invalid_WFS_LZ_02_XIX_WFS_02_XIX_VLAN_Cockpit:9, compu {9=Cx9_Fehler (CM_WFS_LZ_02_Cx9_Fehler), 2=Cx2_angelernt (CM_WFS_LZ_02_Cx2_angelernt), 8=Cx8_WFS_temporaer_nicht_verfuegbar (CM_WFS_LZ_02_Cx8_WFS_temporaer_nicht_verfuegbar), 3=Cx3_Schluessel_lernen_Kundendienst (CM_WFS_LZ_02_Cx3_Schluessel_lernen_Kundendienst), 0=Cx0_Lieferant_Init (CM_WFS_LZ_02_Cx0_Lieferant_Init) (Lieferant/Init), 4=Cx4_Schluessel_lernen_Produktion (CM_WFS_LZ_02_Cx4_Schluessel_lernen_Produktion), 1=Cx1_fabrikneu (CM_WFS_LZ_02_Cx1_fabrikneu)}, range raw 0..9  # Inbetriebnahme/Anlernzustand der Wegfahrsperre
    signal IMMO_Display_XIX_WFS_02_XIX_VLAN_Cockpit: start 177, 2 bit, little-endian, data-type-policy=OVERRIDE, i-signal-type=PRIMITIVE, init-value=0, base-type=BT_IMMO_Display, invalid-value=Invalid_IMMO_Display_XIX_WFS_02_XIX_VLAN_Cockpit:2, compu {2=Cx2_Fehler (CM_IMMO_Display_Cx2_Fehler), 0=Cx0_keine_Anzeige (CM_IMMO_Display_Cx0_keine_Anzeige) (keine Anzeige), 1=Cx1_Anzeige (CM_IMMO_Display_Cx1_Anzeige)}, range raw 0..2  # Signal zur Steuerung der WFS-Anzeige im Kombi (Service)
    signal IMMO_ClampPermStatus_XIX_WFS_02_XIX_VLAN_Cockpit: start 179, 4 bit, little-endian, data-type-policy=OVERRIDE, i-signal-type=PRIMITIVE, init-value=15, base-type=BT_IMMO_ClampPermStatus, compu {9=Cx9_RemoteStart_Freigabe_Leistungsbereitstellung (CM_IMMO_ClampPermStatus_Cx9_RemoteStart_Freigabe_Leistungsbereitstellung), 1=Cx1_Normale_Freigabe (CM_IMMO_ClampPermStatus_Cx1_Normale_Freigabe), 5=Cx5_RemoteDrive_Freigabe_Leistungsbereitstellung_mit_Vortrieb (CM_IMMO_ClampPermStatus_Cx5_RemoteDrive_Freigabe_Leistungsbereitstellung_mit_Vortrieb), 3=Cx3_Diagnose_Freigabe (CM_IMMO_ClampPermStatus_Cx3_Diagnose_Freigabe), 14=Cxe_Busy (CM_IMMO_ClampPermStatus_Cxe_Busy), 15=Cxf_Init (CM_IMMO_ClampPermStatus_Cxf_Init), 0=Cx0_keine_Freigabe (CM_IMMO_ClampPermStatus_Cx0_keine_Freigabe)}, range raw 0..15  # Antwortsignal der WFS an die Klemmensteuerung zur Klemmenfreigabe
    mapping SG_WFS_02_XIX_VLAN_Cockpit: i-signal-group=SG_WFS_02_XIX_VLAN_Cockpit, transfer-property=TRIGGERED-WITHOUT-REPETITION
  pdu ZR_VA_Challenge_FID_XIX_VLAN_Cockpit: length=64, minimum-delay=0.1, transmission-mode-true-timing={cyclic-timing={time-offset=0.0, time-period=1.0}, event-controlled-timing={number-of-repetitions=0, repetition-period=0.0}}, unused-bit-pattern=0
    signal ZR_VA_Challenge_FID_XIX_ZR_VA_Challenge_FID_XIX_VLAN_Cockpit: start 0, 512 bit, opaque, data-type-policy=OVERRIDE, i-signal-type=ARRAY, init-value=64 x 0, base-type=BT_ZR_VA_Challenge_FID, implementation-data-type=ZR_VA_Challenge_FID, transfer-property=TRIGGERED-ON-CHANGE-WITHOUT-REPETITION  # Video-authentication challenge
  pdu ZR_VA_Communication_Init_Ack_FID_XIX_VLAN_Cockpit: length=20, minimum-delay=0.1, transmission-mode-true-timing={cyclic-timing={time-offset=0.0, time-period=1.0}, event-controlled-timing={number-of-repetitions=0, repetition-period=0.0}}, unused-bit-pattern=0
    signal ZR_VA_Communication_Init_Ack_FID_XIX_ZR_VA_Communication_Init_Ack_FID_XIX_VLAN_Cockpit: start 0, 136 bit, opaque, data-type-policy=OVERRIDE, i-signal-type=ARRAY, init-value=17 x 0, base-type=BT_ZR_VA_Communication_Init_Ack_FID, implementation-data-type=ZR_VA_Communication_Init_Ack_FID, transfer-property=TRIGGERED-ON-CHANGE-WITHOUT-REPETITION  # This data channel is used for display video authentication of FID.
  pdu ZR_VA_Communication_Init_FID_XIX_VLAN_Cockpit: length=20, minimum-delay=0.1, transmission-mode-true-timing={cyclic-timing={time-offset=0.0, time-period=1.0}, event-controlled-timing={number-of-repetitions=0, repetition-period=0.0}}, unused-bit-pattern=0
    signal ZR_VA_Communication_Init_FID_XIX_ZR_VA_Communication_Init_FID_XIX_VLAN_Cockpit: start 0, 136 bit, opaque, data-type-policy=OVERRIDE, i-signal-type=ARRAY, init-value=17 x 0, base-type=BT_ZR_VA_Communication_Init_FID, implementation-data-type=ZR_VA_Communication_Init_FID, transfer-property=TRIGGERED-ON-CHANGE-WITHOUT-REPETITION  # Init communication of video-authentication
  secured i pdu FoD_Info_El_Req_SOK_XIX_VLAN_Cockpit:
    length=410
    authentication-props=SecureCommunicationAuthenticationProps_XIX_64
    freshness-props=SecureCommunicationFreshnessProps
    payload=PT_FoD_Info_El_Req
    secure-communication-props={auth-data-freshness-length=0, auth-data-freshness-start-position=0, auth-info-tx-length=64, authentication-build-attempts=1, authentication-retries=1, data-id=633, freshness-value-id=0, freshness-value-length=64, freshness-value-tx-length=0}
    use-as-cryptographic-i-pdu=false
  secured i pdu FoD_Info_El_Resp_SOK_XIX_VLAN_Cockpit:
    length=510
    authentication-props=SecureCommunicationAuthenticationProps_XIX_64
    freshness-props=SecureCommunicationFreshnessProps
    payload=PT_FoD_Info_El_Resp
    secure-communication-props={auth-data-freshness-length=0, auth-data-freshness-start-position=0, auth-info-tx-length=64, authentication-build-attempts=1, authentication-retries=1, data-id=634, freshness-value-id=0, freshness-value-length=64, freshness-value-tx-length=0}
    use-as-cryptographic-i-pdu=false
  secured i pdu SOK_Zeit_Info_El_Resp_01_SOK_XIX_VLAN_Cockpit:
    length=16
    authentication-props=SecureCommunicationAuthenticationProps_XIX_64
    freshness-props=SecureCommunicationFreshnessProps
    payload=PT_SOK_Zeit_Info_El_Resp_01
    secure-communication-props={auth-data-freshness-length=0, auth-data-freshness-start-position=0, auth-info-tx-length=64, authentication-build-attempts=1, authentication-retries=1, data-id=5, freshness-value-id=1, freshness-value-length=64, freshness-value-tx-length=0}
    use-as-cryptographic-i-pdu=false
  secured i pdu WFS_02_SOK_XIX_VLAN_Cockpit:
    length=32
    authentication-props=SecureCommunicationAuthenticationProps_XIX_32
    freshness-props=SecureCommunicationFreshnessProps
    payload=VLAN_Cockpit/PT_WFS_02
    secure-communication-props={auth-data-freshness-length=0, auth-data-freshness-start-position=0, auth-info-tx-length=32, authentication-build-attempts=1, authentication-retries=4, data-id=607, freshness-value-id=2, freshness-value-length=64, freshness-value-tx-length=0}
    use-as-cryptographic-i-pdu=false
  user defined i pdu CDD_HCP3_CANFD01_XIX_TPCHType_CANFD_ARC_Master_XIX_0x1C403B1B_XIX_0x1C423B1B_XIX_Physical: length=512, cdd-type=TPCHType_CANFD_ARC_Master
  user defined i pdu CDD_HCP3_CANFD01_XIX_TPCHType_CANFD_ARC_Master_XIX_0x1C423B1B_XIX_0x1C403B1B_XIX_Physical: length=512, cdd-type=TPCHType_CANFD_ARC_Master
  user defined i pdu CDD_HCP3_CANFD01_XIX_TPCHType_CANFD_ARC_Slave_XIX_0x1CC01B3B_XIX_0x1CC21B3B_XIX_Physical: length=512, cdd-type=TPCHType_CANFD_ARC_Slave
  user defined i pdu CDD_HCP3_CANFD01_XIX_TPCHType_CANFD_ARC_Slave_XIX_0x1CC21B3B_XIX_0x1CC01B3B_XIX_Physical: length=512, cdd-type=TPCHType_CANFD_ARC_Slave
  user defined i pdu CDD_HCP3_CANFD01_XIX_TPCHType_CANFD_HID_Master_XIX_0x1C446723_XIX_0x1C466723_XIX_Physical: length=512, cdd-type=TPCHType_CANFD_HID_Master
  user defined i pdu CDD_HCP3_CANFD01_XIX_TPCHType_CANFD_HID_Master_XIX_0x1C446822_XIX_0x1C466822_XIX_Physical: length=512, cdd-type=TPCHType_CANFD_HID_Master
  user defined i pdu CDD_HCP3_CANFD01_XIX_TPCHType_CANFD_HID_Master_XIX_0x1C446A23_XIX_0x1C466A23_XIX_Physical: length=512, cdd-type=TPCHType_CANFD_HID_Master
  user defined i pdu CDD_HCP3_CANFD01_XIX_TPCHType_CANFD_HID_Master_XIX_0x1C446B22_XIX_0x1C466B22_XIX_Physical: length=512, cdd-type=TPCHType_CANFD_HID_Master
  user defined i pdu CDD_HCP3_CANFD01_XIX_TPCHType_CANFD_HID_Master_XIX_0x1C446C24_XIX_0x1C466C24_XIX_Physical: length=512, cdd-type=TPCHType_CANFD_HID_Master
  user defined i pdu CDD_HCP3_CANFD01_XIX_TPCHType_CANFD_HID_Master_XIX_0x1C446D23_XIX_0x1C466D23_XIX_Physical: length=512, cdd-type=TPCHType_CANFD_HID_Master
  user defined i pdu CDD_HCP3_CANFD01_XIX_TPCHType_CANFD_HID_Master_XIX_0x1C446E22_XIX_0x1C466E22_XIX_Physical: length=512, cdd-type=TPCHType_CANFD_HID_Master
  user defined i pdu CDD_HCP3_CANFD01_XIX_TPCHType_CANFD_HID_Master_XIX_0x1C466723_XIX_0x1C446723_XIX_Physical: length=512, cdd-type=TPCHType_CANFD_HID_Master
  user defined i pdu CDD_HCP3_CANFD01_XIX_TPCHType_CANFD_HID_Master_XIX_0x1C466822_XIX_0x1C446822_XIX_Physical: length=512, cdd-type=TPCHType_CANFD_HID_Master
  user defined i pdu CDD_HCP3_CANFD01_XIX_TPCHType_CANFD_HID_Master_XIX_0x1C466A23_XIX_0x1C446A23_XIX_Physical: length=512, cdd-type=TPCHType_CANFD_HID_Master
  user defined i pdu CDD_HCP3_CANFD01_XIX_TPCHType_CANFD_HID_Master_XIX_0x1C466B22_XIX_0x1C446B22_XIX_Physical: length=512, cdd-type=TPCHType_CANFD_HID_Master
  user defined i pdu CDD_HCP3_CANFD01_XIX_TPCHType_CANFD_HID_Master_XIX_0x1C466C24_XIX_0x1C446C24_XIX_Physical: length=512, cdd-type=TPCHType_CANFD_HID_Master
  user defined i pdu CDD_HCP3_CANFD01_XIX_TPCHType_CANFD_HID_Master_XIX_0x1C466D23_XIX_0x1C446D23_XIX_Physical: length=512, cdd-type=TPCHType_CANFD_HID_Master
  user defined i pdu CDD_HCP3_CANFD01_XIX_TPCHType_CANFD_HID_Master_XIX_0x1C466E22_XIX_0x1C446E22_XIX_Physical: length=512, cdd-type=TPCHType_CANFD_HID_Master
  user defined i pdu CDD_HCP3_CANFD01_XIX_TPCHType_CANFD_HID_Master_XIX_0x1D00731B_XIX_0x1D02731B_XIX_Physical: length=512, cdd-type=TPCHType_CANFD_HID_Master
  user defined i pdu CDD_HCP3_CANFD01_XIX_TPCHType_CANFD_HID_Master_XIX_0x1D02731B_XIX_0x1D00731B_XIX_Physical: length=512, cdd-type=TPCHType_CANFD_HID_Master
  user defined i pdu CDD_HCP3_CANFD01_XIX_TPCHType_CANFD_HID_Slave_XIX_0x1CD02268_XIX_0x1CD22268_XIX_Physical: length=512, cdd-type=TPCHType_CANFD_HID_Slave
  user defined i pdu CDD_HCP3_CANFD01_XIX_TPCHType_CANFD_HID_Slave_XIX_0x1CD0226B_XIX_0x1CD2226B_XIX_Physical: length=512, cdd-type=TPCHType_CANFD_HID_Slave
  user defined i pdu CDD_HCP3_CANFD01_XIX_TPCHType_CANFD_HID_Slave_XIX_0x1CD0226E_XIX_0x1CD2226E_XIX_Physical: length=512, cdd-type=TPCHType_CANFD_HID_Slave
  user defined i pdu CDD_HCP3_CANFD01_XIX_TPCHType_CANFD_HID_Slave_XIX_0x1CD02367_XIX_0x1CD22367_XIX_Physical: length=512, cdd-type=TPCHType_CANFD_HID_Slave
  user defined i pdu CDD_HCP3_CANFD01_XIX_TPCHType_CANFD_HID_Slave_XIX_0x1CD0236A_XIX_0x1CD2236A_XIX_Physical: length=512, cdd-type=TPCHType_CANFD_HID_Slave
  user defined i pdu CDD_HCP3_CANFD01_XIX_TPCHType_CANFD_HID_Slave_XIX_0x1CD0236D_XIX_0x1CD2236D_XIX_Physical: length=512, cdd-type=TPCHType_CANFD_HID_Slave
  user defined i pdu CDD_HCP3_CANFD01_XIX_TPCHType_CANFD_HID_Slave_XIX_0x1CD0246C_XIX_0x1CD2246C_XIX_Physical: length=512, cdd-type=TPCHType_CANFD_HID_Slave
  user defined i pdu CDD_HCP3_CANFD01_XIX_TPCHType_CANFD_HID_Slave_XIX_0x1CD22268_XIX_0x1CD02268_XIX_Physical: length=512, cdd-type=TPCHType_CANFD_HID_Slave
  user defined i pdu CDD_HCP3_CANFD01_XIX_TPCHType_CANFD_HID_Slave_XIX_0x1CD2226B_XIX_0x1CD0226B_XIX_Physical: length=512, cdd-type=TPCHType_CANFD_HID_Slave
  user defined i pdu CDD_HCP3_CANFD01_XIX_TPCHType_CANFD_HID_Slave_XIX_0x1CD2226E_XIX_0x1CD0226E_XIX_Physical: length=512, cdd-type=TPCHType_CANFD_HID_Slave
  user defined i pdu CDD_HCP3_CANFD01_XIX_TPCHType_CANFD_HID_Slave_XIX_0x1CD22367_XIX_0x1CD02367_XIX_Physical: length=512, cdd-type=TPCHType_CANFD_HID_Slave
  user defined i pdu CDD_HCP3_CANFD01_XIX_TPCHType_CANFD_HID_Slave_XIX_0x1CD2236A_XIX_0x1CD0236A_XIX_Physical: length=512, cdd-type=TPCHType_CANFD_HID_Slave
  user defined i pdu CDD_HCP3_CANFD01_XIX_TPCHType_CANFD_HID_Slave_XIX_0x1CD2236D_XIX_0x1CD0236D_XIX_Physical: length=512, cdd-type=TPCHType_CANFD_HID_Slave
  user defined i pdu CDD_HCP3_CANFD01_XIX_TPCHType_CANFD_HID_Slave_XIX_0x1CD2246C_XIX_0x1CD0246C_XIX_Physical: length=512, cdd-type=TPCHType_CANFD_HID_Slave
  user defined i pdu CDD_HCP3_CANFD01_XIX_TPCHType_CANFD_HID_Slave_XIX_0x1D001B73_XIX_0x1D021B73_XIX_Physical: length=512, cdd-type=TPCHType_CANFD_HID_Slave
  user defined i pdu CDD_HCP3_CANFD01_XIX_TPCHType_CANFD_HID_Slave_XIX_0x1D021B73_XIX_0x1D001B73_XIX_Physical: length=512, cdd-type=TPCHType_CANFD_HID_Slave
  general purpose pdu ServiceDiscoveryRxMulticast_XIX_HCP3_IONode: category=SD, length=1444
  general purpose pdu ServiceDiscoveryTx_XIX_HCP3_IONode: category=SD, length=1444
  general purpose pdu ServiceDiscoveryRxUnicast_XIX_HCP3_IONode: category=SD, length=1444
  pdu TCPClient_SSOA_Gateway_Info_El: length=48, transmission-mode-true-timing=event-controlled-timing={number-of-repetitions=0, repetition-period=0.0}, unused-bit-pattern=0
    signal TCPClient_SSOA_Gateway_Info_El_data: start 0, 384 bit, opaque, data-type-policy=OVERRIDE, i-signal-type=ARRAY, init-value=48 x 0, base-type=BT_SSOA_Signals, dynamic-length=true, transfer-property=TRIGGERED-WITHOUT-REPETITION, to HCP3_IONode  # Payload-Data for SSOA
  pdu TCPServer_SSOA_Info_El_Gateway: length=1424, transmission-mode-true-timing=event-controlled-timing={number-of-repetitions=0, repetition-period=0.0}, unused-bit-pattern=0
    signal TCPServer_SSOA_Info_El_Gateway_data: start 0, 11392 bit, opaque, data-type-policy=OVERRIDE, i-signal-type=ARRAY, init-value=1424 x 0, base-type=BT_SSOA_Signals, dynamic-length=true, transfer-property=TRIGGERED-WITHOUT-REPETITION  # Payload-Data for SSOA
  pdu TCPClient_SSOA_SGW03_Info_El: length=48, transmission-mode-true-timing=event-controlled-timing={number-of-repetitions=0, repetition-period=0.0}, unused-bit-pattern=0
    signal TCPClient_SSOA_SGW03_Info_El_data: start 0, 384 bit, opaque, data-type-policy=OVERRIDE, i-signal-type=ARRAY, init-value=48 x 0, base-type=BT_SSOA_Signals, dynamic-length=true, transfer-property=TRIGGERED-WITHOUT-REPETITION, to HCP3_IONode  # Payload-Data for SSOA
  pdu TCPServer_SSOA_Info_El_SGW03: length=1424, transmission-mode-true-timing=event-controlled-timing={number-of-repetitions=0, repetition-period=0.0}, unused-bit-pattern=0
    signal TCPServer_SSOA_Info_El_SGW03_data: start 0, 11392 bit, opaque, data-type-policy=OVERRIDE, i-signal-type=ARRAY, init-value=1424 x 0, base-type=BT_SSOA_Signals, dynamic-length=true, transfer-property=TRIGGERED-WITHOUT-REPETITION  # Payload-Data for SSOA
  pdu SSOA_Info_El_Multicast: length=48, transmission-mode-true-timing=event-controlled-timing={number-of-repetitions=0, repetition-period=0.0}, unused-bit-pattern=0
    signal SSOA_Info_El_Multicast_data: start 0, 384 bit, opaque, data-type-policy=OVERRIDE, i-signal-type=ARRAY, init-value=48 x 0, base-type=BT_SSOA_Signals, dynamic-length=true, transfer-property=TRIGGERED-WITHOUT-REPETITION  # Payload-Data for SSOA
  general purpose pdu DoIP_Gateway_MC_XIX_VLAN_Cockpit: category=DoIP, length=1452
package /IPDUGroup
  26 x i signal i pdu group:
    HCP3_IONode_XIX_HCP3_CANFD01_Rx: communication-direction=IN, communication-mode=CAN_Receive_All
      i-signal-i-pdus:
        NFC_MiKo_01_XIX_HCP3_CANFD01
        KN_HUD_XIX_HCP3_CANFD01
        KN_DispKBI_FS_XIX_HCP3_CANFD01
        CID_01_XIX_HCP3_CANFD01
        KN_CCF_XIX_HCP3_CANFD01
        KN_CID_XIX_HCP3_CANFD01
        LSR_1_02_XIX_HCP3_CANFD01
        DS_PID_XIX_HCP3_CANFD01
        DS_HUD_XIX_HCP3_CANFD01
        DS_CID_XIX_HCP3_CANFD01
        DS_CCF_XIX_HCP3_CANFD01
        DS_WLC1_XIX_HCP3_CANFD01
        DS_WLC2_XIX_HCP3_CANFD01
        KN_WLC2_XIX_HCP3_CANFD01
        KN_WLC1_XIX_HCP3_CANFD01
        KN_PID_XIX_HCP3_CANFD01
        PID_01_XIX_HCP3_CANFD01
        MKGO_FBS_01_XIX_HCP3_CANFD01
        MKGO_FBS_04_XIX_HCP3_CANFD01
        MKGO_FBS_03_XIX_HCP3_CANFD01
        MKGO_FBS_05_XIX_HCP3_CANFD01
        MKGO_FBS_02_XIX_HCP3_CANFD01
        KN_AMP_XIX_HCP3_CANFD01
        LSR_Common_01_XIX_HCP3_CANFD01
        CID_VA_Communication_Init_Ack_XIX_HCP3_CANFD01
        PID_VA_Response_XIX_HCP3_CANFD01
        CID_VA_Response_XIX_HCP3_CANFD01
        PID_VA_Communication_Init_Ack_XIX_HCP3_CANFD01
        WLC1_03_XIX_HCP3_CANFD01
        WLC2_03_XIX_HCP3_CANFD01
        CID_VA_Communication_Init_XIX_HCP3_CANFD01
        PID_VA_Communication_Init_XIX_HCP3_CANFD01
    HCP3_IONode_XIX_HCP3_CANFD01_Tx: communication-direction=OUT, communication-mode=CAN_Transmit_All
      i-signal-i-pdus:
        VDSO_09_XIX_HCP3_CANFD01
        VDSO_05_XIX_HCP3_CANFD01
        OTAMC_D_01_XIX_HCP3_CANFD01
        ORU_Control_D_01_XIX_HCP3_CANFD01
        ORU_Control_A_01_XIX_HCP3_CANFD01
        Diagnose_01_XIX_HCP3_CANFD01
        Dimmung_01_XIX_HCP3_CANFD01
        Systeminfo_01_XIX_HCP3_CANFD01
        RLS_01_XIX_HCP3_CANFD01
        ORU_01_XIX_HCP3_CANFD01
        Systeminfo_02_XIX_HCP3_CANFD01
        WFS_02_XIX_HCP3_CANFD01
        ClimateControl_01_XIX_HCP3_CANFD01
        KN_Info_El_XIX_HCP3_CANFD01
        KeylessAccess_01_XIX_HCP3_CANFD01
        NVEM_12_XIX_HCP3_CANFD01
        ClampControl_01_XIX_HCP3_CANFD01
        Info_El_01_XIX_HCP3_CANFD01
        RLSs_01_XIX_HCP3_CANFD01
        OBD_03_XIX_HCP3_CANFD01
        ZR_Modes_01_XIX_HCP3_CANFD01
        RadioFunc_01_XIX_HCP3_CANFD01
        FBS_MKGO_03_XIX_HCP3_CANFD01
        FBS_MKGO_04_XIX_HCP3_CANFD01
        FBS_MKGO_02_XIX_HCP3_CANFD01
        FBS_MKGO_05_XIX_HCP3_CANFD01
        FBS_MKGO_01_XIX_HCP3_CANFD01
        OBD_04_XIX_HCP3_CANFD01
        ZR_VA_Challenge_CID_XIX_HCP3_CANFD01
        ZR_VA_Communication_Init_CID_XIX_HCP3_CANFD01
        ZR_VA_Communication_Init_PID_XIX_HCP3_CANFD01
        ZR_VA_Challenge_PID_XIX_HCP3_CANFD01
        MDK_02_XIX_HCP3_CANFD01
        ZR_VA_Communication_Init_Ack_CID_XIX_HCP3_CANFD01
        ZR_VA_Communication_Init_Ack_PID_XIX_HCP3_CANFD01
    HCP3_IONode_XIX_PNC_01_CarWakeUp_Rx: communication-direction=IN, communication-mode=Receive_01_CarWakeUp
      i-signal-i-pdus:
        KN_AMP_XIX_HCP3_CANFD01
        KN_CID_XIX_HCP3_CANFD01
        KN_HUD_XIX_HCP3_CANFD01
        KN_PID_XIX_HCP3_CANFD01
        KN_WLC1_XIX_HCP3_CANFD01
        KN_WLC2_XIX_HCP3_CANFD01
    HCP3_IONode_XIX_PNC_01_CarWakeUp_Tx: communication-direction=OUT, communication-mode=Transmit_01_CarWakeUp
    HCP3_IONode_XIX_PNC_02_Basefunction_Powertrain_Rx: communication-direction=IN, communication-mode=Receive_02_Basefunction_Powertrain
    HCP3_IONode_XIX_PNC_04_Basefunction_DrivingAssistance_Rx: communication-direction=IN, communication-mode=Receive_04_Basefunction_DrivingAssistance
    HCP3_IONode_XIX_PNC_05_Basefunction_Infotainment_Rx: communication-direction=IN, communication-mode=Receive_05_Basefunction_Infotainment
    HCP3_IONode_XIX_PNC_05_Basefunction_Infotainment_Tx: communication-direction=OUT, communication-mode=Transmit_05_Basefunction_Infotainment
    HCP3_IONode_XIX_PNC_06_Basefunction_ComfortLight_Rx: communication-direction=IN, communication-mode=Receive_06_Basefunction_ComfortLight
    HCP3_IONode_XIX_PNC_07_Basefunction_CrossSection_Rx: communication-direction=IN, communication-mode=Receive_07_Basefunction_CrossSection
    HCP3_IONode_XIX_PNC_08_Basefunction_Connectivity_Rx: communication-direction=IN, communication-mode=Receive_08_Basefunction_Connectivity
    HCP3_IONode_XIX_PNC_10_Powertrain_Rx: communication-direction=IN, communication-mode=Receive_10_Powertrain
    HCP3_IONode_XIX_PNC_11_Chassis_Rx: communication-direction=IN, communication-mode=Receive_11_Chassis
    HCP3_IONode_XIX_PNC_15_InstrumentclusterDisplay_Rx: communication-direction=IN, communication-mode=Receive_15_InstrumentclusterDisplay
    HCP3_IONode_XIX_PNC_16_InfotainmentDisplay_Rx: communication-direction=IN, communication-mode=Receive_16_InfotainmentDisplay
      i-signal-i-pdus:
        CID_01_XIX_HCP3_CANFD01
        CID_VA_Communication_Init_Ack_XIX_HCP3_CANFD01
        CID_VA_Communication_Init_XIX_HCP3_CANFD01
        CID_VA_Response_XIX_HCP3_CANFD01
        LSR_1_02_XIX_HCP3_CANFD01
        LSR_Common_01_XIX_HCP3_CANFD01
        PID_01_XIX_HCP3_CANFD01
        PID_VA_Communication_Init_Ack_XIX_HCP3_CANFD01
        PID_VA_Communication_Init_XIX_HCP3_CANFD01
        PID_VA_Response_XIX_HCP3_CANFD01
        WLC1_03_XIX_HCP3_CANFD01
        WLC2_03_XIX_HCP3_CANFD01
    HCP3_IONode_XIX_PNC_19_Doors_Hatches_Rx: communication-direction=IN, communication-mode=Receive_19_Doors_Hatches
    HCP3_IONode_XIX_PNC_23_Climate_Rx: communication-direction=IN, communication-mode=Receive_23_Climate
    HCP3_IONode_XIX_PNC_27_Timemaster_Timer_Rx: communication-direction=IN, communication-mode=Receive_27_Timemaster_Timer
    HCP3_IONode_XIX_PNC_30_EnergyManagement_Rx: communication-direction=IN, communication-mode=Receive_30_EnergyManagement
    HCP3_IONode_XIX_PNC_31_MultifunctionalSteeringWheel_Rx: communication-direction=IN, communication-mode=Receive_31_MultifunctionalSteeringWheel, i-signal-i-pdus=KN_Gateway_XIX_WU_HCP3_CANFD
    HCP3_IONode_XIX_PNC_36_Preheater_Rx: communication-direction=IN, communication-mode=Receive_36_Preheater
    HCP3_IONode_XIX_PNC_44_Diagnosis_Infotainment_Rx: communication-direction=IN, communication-mode=Receive_44_Diagnosis_Infotainment
      i-signal-i-pdus:
        KN_AMP_XIX_HCP3_CANFD01
        KN_CCF_XIX_HCP3_CANFD01
        KN_CID_XIX_HCP3_CANFD01
        KN_HUD_XIX_HCP3_CANFD01
        KN_PID_XIX_HCP3_CANFD01
        KN_WLC1_XIX_HCP3_CANFD01
        KN_WLC2_XIX_HCP3_CANFD01
    HCP3_IONode_XIX_VLAN_Cockpit_Rx: communication-direction=IN, communication-mode=CAN_Receive_All
      i-signal-i-pdus:
        VKM_04_XIX_VLAN_Cockpit
        KN_AMP_XIX_VLAN_Cockpit
        KN_ICAS3Sys01_XIX_VLAN_Cockpit
        HCP1_07_XIX_VLAN_Cockpit
        OBD_03_XIX_VLAN_Cockpit
        OBD_04_XIX_VLAN_Cockpit
        ClimateControl_01_XIX_VLAN_Cockpit
        FBS_MKGO_{03..05}_XIX_VLAN_Cockpit
        FBS_MKGO_02_XIX_VLAN_Cockpit
        FBS_MKGO_01_XIX_VLAN_Cockpit
        RLS_01_XIX_VLAN_Cockpit
        DoorFunctions_FS_01_XIX_VLAN_Cockpit
        Dimmung_01_XIX_VLAN_Cockpit
        KeylessAccess_01_XIX_VLAN_Cockpit
        DoorFunctions_HBFS_01_XIX_VLAN_Cockpit
        DoorFunctions_BFS_01_XIX_VLAN_Cockpit
        DoorFunctions_HFS_01_XIX_VLAN_Cockpit
        CentralLocking_01_XIX_VLAN_Cockpit
        STH_01_XIX_VLAN_Cockpit
        FID_01_XIX_VLAN_Cockpit
        MDK_02_XIX_VLAN_Cockpit
        WFS_02_XIX_VLAN_Cockpit
        ACA_02_XIX_VLAN_Cockpit
        IP_TS_Info_El_CTO_01_XIX_VLAN_Cockpit
        IP_TS_Info_El_DTO_{01..04}_XIX_VLAN_Cockpit
        RLSs_01_XIX_VLAN_Cockpit
        Tankgeber_02_XIX_VLAN_Cockpit
        FID_VA_Communication_Init_Ack_XIX_VLAN_Cockpit
        FID_VA_Response_XIX_VLAN_Cockpit
        FID_VA_Communication_Init_XIX_VLAN_Cockpit
        HWP_02_XIX_VLAN_Cockpit
        SOK_FoD_Info_El_Req_Challenge_XIX_VLAN_Cockpit
        NVEM_12_XIX_VLAN_Cockpit
        Diagnose_01_XIX_VLAN_Cockpit
        MFL_Tasten_Konzern_XIX_VLAN_Cockpit
        MFL_01_XIX_VLAN_Cockpit
        SOK_Zeit_Info_El_Resp_01_XIX_VLAN_Cockpit
        SOK_NoAuthenticTime_01_XIX_VLAN_Cockpit
        ORU_01_XIX_VLAN_Cockpit
        HCP1_02_XIX_VLAN_Cockpit
        VDSO_09_XIX_VLAN_Cockpit
        DTSO_01_XIX_VLAN_Cockpit
        KN_HCP3Sys03_XIX_VLAN_Cockpit
        ORU_Control_A_01_XIX_VLAN_Cockpit_E2E
        ClampControl_01_XIX_VLAN_Cockpit_E2E
        ORU_Control_D_01_XIX_VLAN_Cockpit_E2E
        OTAMC_D_01_XIX_VLAN_Cockpit_E2E
        HWP_01_XIX_VLAN_Cockpit_E2E
        VDSO_05_XIX_VLAN_Cockpit_E2E
    HCP3_IONode_XIX_VLAN_Cockpit_Tx: communication-direction=OUT, communication-mode=CAN_Transmit_All
      i-signal-i-pdus:
        KN_Info_El_XIX_VLAN_Cockpit
        DS_WLC1_XIX_VLAN_Cockpit
        DS_Info_El_XIX_VLAN_Cockpit
        DS_WLC2_XIX_VLAN_Cockpit
        DS_CID_XIX_VLAN_Cockpit
        DS_HUD_XIX_VLAN_Cockpit
        DS_PID_XIX_VLAN_Cockpit
        DS_CCF_XIX_VLAN_Cockpit
        Tank_01_XIX_VLAN_Cockpit
        Info_FID_01_XIX_VLAN_Cockpit
        RadioFunc_01_XIX_VLAN_Cockpit
        NFC_MiKo_01_XIX_VLAN_Cockpit
        ZR_VA_Challenge_FID_XIX_VLAN_Cockpit
        ZR_VA_Communication_Init_FID_XIX_VLAN_Cockpit
        ZR_VA_Communication_Init_Ack_FID_XIX_VLAN_Cockpit
        CID_01_XIX_VLAN_Cockpit
        MKGO_FBS_{01..05}_XIX_VLAN_Cockpit
        SOK_FoD_Info_El_Resp_Challenge_XIX_VLAN_Cockpit
        SOK_Zeit_Info_E_Chal_01_XIX_VLAN_Cockpit
        TCPServer_IP_TS_Info_El_DTO_01_XIX_VLAN_Cockpit
        TCPServer_IP_TS_Info_El_DTO_04_XIX_VLAN_Cockpit
        TCPServer_IP_TS_Info_El_DTO_03_XIX_VLAN_Cockpit
        TCPServer_IP_TS_Info_El_DTO_02_XIX_VLAN_Cockpit
    HCP3_IONode_XIX_WU_HCP3_CANFD_Rx: communication-direction=IN, communication-mode=CAN_Receive_All, i-signal-i-pdus=[Systeminfo_01_XIX_WU_HCP3_CANFD, KN_Gateway_XIX_WU_HCP3_CANFD]
    HCP3_IONode_XIX_WU_HCP3_CANFD_Tx: communication-direction=OUT, communication-mode=CAN_Transmit_All, i-signal-i-pdus=KN_Info_El_XIX_WU_HCP3_CANFD
package /Gateway
  gateway HCP3_IONode: ecu=HCP3_IONode
    i-pdu-mappings:
      source-i-pdu=CHNL/PT_CID_01, target-i-pdu=VLAN_Cockpit/PT_CID_01
      source-i-pdu=CHNL/PT_DS_CCF, target-i-pdu=VLAN_Cockpit/PT_DS_CCF
      source-i-pdu=CHNL/PT_DS_CID, target-i-pdu=VLAN_Cockpit/PT_DS_CID
      source-i-pdu=CHNL/PT_DS_HUD, target-i-pdu=VLAN_Cockpit/PT_DS_HUD
      source-i-pdu=CHNL/PT_DS_PID, target-i-pdu=VLAN_Cockpit/PT_DS_PID
      source-i-pdu=CHNL/PT_DS_WLC1, target-i-pdu=VLAN_Cockpit/PT_DS_WLC1
      source-i-pdu=CHNL/PT_DS_WLC2, target-i-pdu=VLAN_Cockpit/PT_DS_WLC2
      source-i-pdu=CHNL/PT_MKGO_FBS_{01..05}, target-i-pdu=VLAN_Cockpit/PT_MKGO_FBS_{01..05}
      source-i-pdu=CHNL/PT_NFC_MiKo_01, target-i-pdu=VLAN_Cockpit/PT_NFC_MiKo_01
      source-i-pdu=PT_ClampControl_01_E2E, target-i-pdu=PT_ClampControl_01
      source-i-pdu=VLAN_Cockpit/PT_ClimateControl_01, target-i-pdu=CHNL/PT_ClimateControl_01
      source-i-pdu=VLAN_Cockpit/PT_Diagnose_01, target-i-pdu=CHNL/PT_Diagnose_01
      source-i-pdu=VLAN_Cockpit/PT_Dimmung_01, target-i-pdu=CHNL/PT_Dimmung_01
      source-i-pdu=VLAN_Cockpit/PT_FBS_MKGO_{01..05}, target-i-pdu=CHNL/PT_FBS_MKGO_{01..05}
      source-i-pdu=VLAN_Cockpit/PT_KeylessAccess_01, target-i-pdu=CHNL/PT_KeylessAccess_01
      source-i-pdu=VLAN_Cockpit/PT_MDK_02, target-i-pdu=CHNL/PT_MDK_02
      source-i-pdu=VLAN_Cockpit/PT_NVEM_12, target-i-pdu=CHNL/PT_NVEM_12
      source-i-pdu=VLAN_Cockpit/PT_OBD_03, target-i-pdu=CHNL/PT_OBD_03
      source-i-pdu=VLAN_Cockpit/PT_OBD_04, target-i-pdu=CHNL/PT_OBD_04
      source-i-pdu=VLAN_Cockpit/PT_ORU_01, target-i-pdu=CHNL/PT_ORU_01
      source-i-pdu=PT_ORU_Control_A_01_E2E, target-i-pdu=PT_ORU_Control_A_01
      source-i-pdu=PT_ORU_Control_D_01_E2E, target-i-pdu=PT_ORU_Control_D_01
      source-i-pdu=PT_OTAMC_D_01_E2E, target-i-pdu=PT_OTAMC_D_01
      source-i-pdu=VLAN_Cockpit/PT_RLS_01, target-i-pdu=CHNL/PT_RLS_01
      source-i-pdu=VLAN_Cockpit/PT_RLSs_01, target-i-pdu=CHNL/PT_RLSs_01
      source-i-pdu=PT_VDSO_05_E2E, target-i-pdu=PT_VDSO_05
      source-i-pdu=VLAN_Cockpit/PT_VDSO_09, target-i-pdu=CHNL/PT_VDSO_09
      source-i-pdu=VLAN_Cockpit/PT_WFS_02_SOK, target-i-pdu=CHNL/PT_WFS_02_SOK
      source-i-pdu=CHNL/PT_Systeminfo_01, target-i-pdu=CHNL/PT_Systeminfo_01
      source-i-pdu=PT_VLAN_Cockpit_XIX_TPCHType_DoIP_Cockpit_OBDC_XIX_0xF02_XIX_0x30A6_XIX_Physical, target-i-pdu=PT_HCP3_CANFD01_XIX_TPCHType_CANFD_OBDC_Diagnose_XIX_0x1C4002A6_XIX_0x1C4202A6_XIX_Physical
      source-i-pdu=PT_HCP3_CANFD01_XIX_TPCHType_CANFD_OBDC_Diagnose_XIX_0x1C4202A6_XIX_0x1C4002A6_XIX_Physical, target-i-pdu=PT_VLAN_Cockpit_XIX_TPCHType_DoIP_Cockpit_OBDC_XIX_0x30A6_XIX_0xF02_XIX_Physical
      source-i-pdu=PT_VLAN_Cockpit_XIX_TPCHType_DoIP_Cockpit_XIX_0xE80_XIX_0x3124_XIX_Physical, target-i-pdu=PT_HCP3_CANFD01_XIX_TPCHType_CANFD_ISO_Diagnose_XIX_0x1C440024_XIX_0x1C460024_XIX_Physical
      source-i-pdu=PT_HCP3_CANFD01_XIX_TPCHType_CANFD_ISO_Diagnose_XIX_0x1C460024_XIX_0x1C440024_XIX_Physical, target-i-pdu=PT_VLAN_Cockpit_XIX_TPCHType_DoIP_Cockpit_XIX_0x3124_XIX_0xE80_XIX_Physical
      source-i-pdu=PT_VLAN_Cockpit_XIX_TPCHType_DoIP_Cockpit_OBDC_XIX_0xF02_XIX_0x3123_XIX_Physical, target-i-pdu=PT_HCP3_CANFD01_XIX_TPCHType_CANFD_OBDC_Diagnose_XIX_0x1C440223_XIX_0x1C460223_XIX_Physical
      source-i-pdu=PT_HCP3_CANFD01_XIX_TPCHType_CANFD_OBDC_Diagnose_XIX_0x1C460223_XIX_0x1C440223_XIX_Physical, target-i-pdu=PT_VLAN_Cockpit_XIX_TPCHType_DoIP_Cockpit_OBDC_XIX_0x3123_XIX_0xF02_XIX_Physical
      source-i-pdu=PT_VLAN_Cockpit_XIX_TPCHType_DoIP_Cockpit_XIX_0xE80_XIX_0x30A6_XIX_Physical, target-i-pdu=PT_HCP3_CANFD01_XIX_TPCHType_CANFD_ISO_Diagnose_XIX_0x1C4000A6_XIX_0x1C4200A6_XIX_Physical
      source-i-pdu=PT_HCP3_CANFD01_XIX_TPCHType_CANFD_ISO_Diagnose_XIX_0x1C4200A6_XIX_0x1C4000A6_XIX_Physical, target-i-pdu=PT_VLAN_Cockpit_XIX_TPCHType_DoIP_Cockpit_XIX_0x30A6_XIX_0xE80_XIX_Physical
      source-i-pdu=PT_VLAN_Cockpit_XIX_TPCHType_DoIP_Cockpit_OBDC_XIX_0xF02_XIX_0x101B_XIX_Physical, target-i-pdu=PT_HCP3_CANFD01_XIX_TPCHType_CANFD_OBDC_Diagnose_XIX_0x1C40021B_XIX_0x1C42021B_XIX_Physical
      source-i-pdu=PT_HCP3_CANFD01_XIX_TPCHType_CANFD_OBDC_Diagnose_XIX_0x1C42021B_XIX_0x1C40021B_XIX_Physical, target-i-pdu=PT_VLAN_Cockpit_XIX_TPCHType_DoIP_Cockpit_OBDC_XIX_0x101B_XIX_0xF02_XIX_Physical
      source-i-pdu=PT_VLAN_Cockpit_XIX_TPCHType_DoIP_Cockpit_XIX_0xE80_XIX_0x101B_XIX_Physical, target-i-pdu=PT_HCP3_CANFD01_XIX_TPCHType_CANFD_ISO_Diagnose_XIX_0x1C40001B_XIX_0x1C42001B_XIX_Physical
      source-i-pdu=PT_HCP3_CANFD01_XIX_TPCHType_CANFD_ISO_Diagnose_XIX_0x1C42001B_XIX_0x1C40001B_XIX_Physical, target-i-pdu=PT_VLAN_Cockpit_XIX_TPCHType_DoIP_Cockpit_XIX_0x101B_XIX_0xE80_XIX_Physical
      source-i-pdu=PT_VLAN_Cockpit_XIX_TPCHType_DoIP_Cockpit_XIX_0xE80_XIX_0x3123_XIX_Physical, target-i-pdu=PT_HCP3_CANFD01_XIX_TPCHType_CANFD_ISO_Diagnose_XIX_0x1C440023_XIX_0x1C460023_XIX_Physical
      source-i-pdu=PT_HCP3_CANFD01_XIX_TPCHType_CANFD_ISO_Diagnose_XIX_0x1C460023_XIX_0x1C440023_XIX_Physical, target-i-pdu=PT_VLAN_Cockpit_XIX_TPCHType_DoIP_Cockpit_XIX_0x3123_XIX_0xE80_XIX_Physical
      source-i-pdu=PT_VLAN_Cockpit_XIX_TPCHType_DoIP_Cockpit_OBDC_XIX_0xF02_XIX_0x3124_XIX_Physical, target-i-pdu=PT_HCP3_CANFD01_XIX_TPCHType_CANFD_OBDC_Diagnose_XIX_0x1C440224_XIX_0x1C460224_XIX_Physical
      source-i-pdu=PT_HCP3_CANFD01_XIX_TPCHType_CANFD_OBDC_Diagnose_XIX_0x1C460224_XIX_0x1C440224_XIX_Physical, target-i-pdu=PT_VLAN_Cockpit_XIX_TPCHType_DoIP_Cockpit_OBDC_XIX_0x3124_XIX_0xF02_XIX_Physical
      source-i-pdu=PT_VLAN_Cockpit_XIX_TPCHType_DoIP_Cockpit_XIX_0xE80_XIX_0x3493_XIX_Physical, target-i-pdu=PT_HCP3_CANFD01_XIX_TPCHType_CANFD_Flash_DIA_XIX_0x1C401693_XIX_0x1C421693_XIX_Physical
      source-i-pdu=PT_HCP3_CANFD01_XIX_TPCHType_CANFD_Flash_DIA_XIX_0x1C421693_XIX_0x1C401693_XIX_Physical, target-i-pdu=PT_VLAN_Cockpit_XIX_TPCHType_DoIP_Cockpit_XIX_0x3493_XIX_0xE80_XIX_Physical
      source-i-pdu=PT_VLAN_Cockpit_XIX_TPCHType_DoIP_Cockpit_XIX_0xE80_XIX_0x30A5_XIX_Physical, target-i-pdu=PT_HCP3_CANFD01_XIX_TPCHType_CANFD_ISO_Diagnose_XIX_0x1C4000A5_XIX_0x1C4200A5_XIX_Physical
      source-i-pdu=PT_HCP3_CANFD01_XIX_TPCHType_CANFD_ISO_Diagnose_XIX_0x1C4200A5_XIX_0x1C4000A5_XIX_Physical, target-i-pdu=PT_VLAN_Cockpit_XIX_TPCHType_DoIP_Cockpit_XIX_0x30A5_XIX_0xE80_XIX_Physical
      source-i-pdu=PT_VLAN_Cockpit_XIX_TPCHType_DoIP_Cockpit_OBDC_XIX_0xF02_XIX_0x30A5_XIX_Physical, target-i-pdu=PT_HCP3_CANFD01_XIX_TPCHType_CANFD_OBDC_Diagnose_XIX_0x1C4002A5_XIX_0x1C4202A5_XIX_Physical
      source-i-pdu=PT_HCP3_CANFD01_XIX_TPCHType_CANFD_OBDC_Diagnose_XIX_0x1C4202A5_XIX_0x1C4002A5_XIX_Physical, target-i-pdu=PT_VLAN_Cockpit_XIX_TPCHType_DoIP_Cockpit_OBDC_XIX_0x30A5_XIX_0xF02_XIX_Physical
      source-i-pdu=PT_VLAN_Cockpit_XIX_TPCHType_DoIP_Cockpit_XIX_0xE80_XIX_0x3122_XIX_Physical, target-i-pdu=PT_HCP3_CANFD01_XIX_TPCHType_CANFD_ISO_Diagnose_XIX_0x1C440022_XIX_0x1C460022_XIX_Physical
      source-i-pdu=PT_HCP3_CANFD01_XIX_TPCHType_CANFD_ISO_Diagnose_XIX_0x1C460022_XIX_0x1C440022_XIX_Physical, target-i-pdu=PT_VLAN_Cockpit_XIX_TPCHType_DoIP_Cockpit_XIX_0x3122_XIX_0xE80_XIX_Physical
      source-i-pdu=PT_VLAN_Cockpit_XIX_TPCHType_DoIP_Cockpit_OBDC_XIX_0xF02_XIX_0x3122_XIX_Physical, target-i-pdu=PT_HCP3_CANFD01_XIX_TPCHType_CANFD_OBDC_Diagnose_XIX_0x1C440222_XIX_0x1C460222_XIX_Physical
      source-i-pdu=PT_HCP3_CANFD01_XIX_TPCHType_CANFD_OBDC_Diagnose_XIX_0x1C460222_XIX_0x1C440222_XIX_Physical, target-i-pdu=PT_VLAN_Cockpit_XIX_TPCHType_DoIP_Cockpit_OBDC_XIX_0x3122_XIX_0xF02_XIX_Physical
      source-i-pdu=PT_VLAN_Cockpit_XIX_TPCHType_DoIP_Cockpit_OBDC_XIX_0xF02_XIX_0x3493_XIX_Physical, target-i-pdu=PT_HCP3_CANFD01_XIX_TPCHType_CANFD_OBDC_SSN_Diagnose_XIX_0x1C407093_XIX_0x1C427093_XIX_Physical
      source-i-pdu=PT_HCP3_CANFD01_XIX_TPCHType_CANFD_OBDC_SSN_Diagnose_XIX_0x1C427093_XIX_0x1C407093_XIX_Physical, target-i-pdu=PT_VLAN_Cockpit_XIX_TPCHType_DoIP_Cockpit_OBDC_XIX_0x3493_XIX_0xF02_XIX_Physical
      source-i-pdu=PT_VLAN_Cockpit_XIX_TPCHType_DoIP_Cockpit_XIX_0xE80_XIX_Functional, target-i-pdu=PT_HCP3_CANFD01_XIX_TPCHType_CANFD_ISO_Diagnose_XIX_0x1C410000_XIX_Functional
      source-i-pdu=PT_VLAN_Cockpit_XIX_TPCHType_DoIP_Cockpit_OBDC_XIX_0xF02_XIX_Functional, target-i-pdu=PT_HCP3_CANFD01_XIX_TPCHType_CANFD_OBDC_Diagnose_XIX_0x1C410200_XIX_Functional
package /E2E
  end to end protection set E2E_ProtectionSet
    6 x end to end protection:
      E2E_Protection_ClampControl_01_XIX_VLAN_Cockpit: end-to-end-profile={category=PROFILE_02, data-ids=[0x63, 0xb6, 0x16, 0x88, 0xac, 0x40, 0xcc, 0x19, 0xf6, 0x7b, 0x29, 0xd2, 0x9d, 0x27, 0xd5, 0xdf], data-length=64, crc-offset=0, counter-offset=8}, end-to-end-protection-i-signal-i-pdu{data-offset=0, i-signal-group=SG_ClampControl_01_XIX_VLAN_Cockpit, i-signal-i-pdu=ClampControl_01_XIX_VLAN_Cockpit_E2E}
      E2E_Protection_HWP_01_XIX_VLAN_Cockpit: end-to-end-profile={category=PROFILE_02, data-ids=[0x38, 0x6b, 0x99, 0xe3, 0xb3, 0xec, 0x8a, 0x71, 0xa8, 0x5d, 0x79, 0x13, 0xb4, 0xc0, 0xd6, 0x54], data-length=64, crc-offset=0, counter-offset=8}, end-to-end-protection-i-signal-i-pdu{data-offset=0, i-signal-group=SG_HWP_01_XIX_VLAN_Cockpit, i-signal-i-pdu=HWP_01_XIX_VLAN_Cockpit_E2E}
      E2E_Protection_ORU_Control_A_01_XIX_VLAN_Cockpit: end-to-end-profile={category=PROFILE_02, data-ids=[0x97, 0x70, 0x84, 0xb4, 0xb8, 0xe7, 0x20, 0x7c, 0x0e, 0x40, 0x93, 0x0d, 0x4e, 0x05, 0x5b, 0x95], data-length=64, crc-offset=0, counter-offset=8}, end-to-end-protection-i-signal-i-pdu{data-offset=0, i-signal-group=SG_ORU_Control_A_01_XIX_VLAN_Cockpit, i-signal-i-pdu=ORU_Control_A_01_XIX_VLAN_Cockpit_E2E}
      E2E_Protection_ORU_Control_D_01_XIX_VLAN_Cockpit: end-to-end-profile={category=PROFILE_02, data-ids=[0x92, 0x1b, 0xc6, 0x91, 0x29, 0x5a, 0x4e, 0xf0, 0x6e, 0x43, 0x80, 0x28, 0xee, 0xa3, 0xc8, 0x3e], data-length=64, crc-offset=0, counter-offset=8}, end-to-end-protection-i-signal-i-pdu{data-offset=0, i-signal-group=SG_ORU_Control_D_01_XIX_VLAN_Cockpit, i-signal-i-pdu=ORU_Control_D_01_XIX_VLAN_Cockpit_E2E}
      E2E_Protection_OTAMC_D_01_XIX_VLAN_Cockpit: end-to-end-profile={category=PROFILE_02, data-ids=[0x5f, 0x18, 0xf5, 0x71, 0x82, 0x10, 0x93, 0x8d, 0x4c, 0xd7, 0x6e, 0xaa, 0xd6, 0xb0, 0xb7, 0x78], data-length=32, crc-offset=0, counter-offset=8}, end-to-end-protection-i-signal-i-pdu{data-offset=0, i-signal-group=SG_OTAMC_D_01_XIX_VLAN_Cockpit, i-signal-i-pdu=OTAMC_D_01_XIX_VLAN_Cockpit_E2E}
      E2E_Protection_VDSO_05_XIX_VLAN_Cockpit: end-to-end-profile={category=PROFILE_02, data-ids=[0x9d, 0x8f, 0x47, 0x05, 0xbd, 0xb0, 0x22, 0x76, 0x34, 0xa4, 0x93, 0x32, 0x57, 0x6d, 0xbc, 0xf4], data-length=64, crc-offset=0, counter-offset=8}, end-to-end-protection-i-signal-i-pdu{data-offset=0, i-signal-group=SG_VDSO_05_XIX_VLAN_Cockpit, i-signal-i-pdu=VDSO_05_XIX_VLAN_Cockpit_E2E}
package /SOMEIP
  data transformation set DataTransformationSet
    data transformation SOMEIPOnlyTransformerChain: data-transformation-kind=SYMMETRIC, execute-despite-data-unavailability=false, transformer-chain=TransformationTechnologySOMEIP
    transformation technology TransformationTechnologySOMEIP: buffer-properties={buffer-computation=compu-rational-coeffs={compu-numerator=[8, 1], compu-denominator=1}, header-length=64, in-place=false}, needs-original-data=false, protocol=SOMEIP, someip-transformation-description{alignment=8, byte-order=big-endian, interface-version=1}, transformer-class=SERIALIZER, version=1
    transformation technology E2E_Profile4_SOMEIP_Transformer: buffer-properties={buffer-computation=compu-rational-coeffs={compu-numerator=[12, 1], compu-denominator=1}, header-length=96, in-place=true}, has-internal-state=true, needs-original-data=false, protocol=E2E, end-to-end-transformation-description{max-delta-counter=1, offset=64, profile-name=PROFILE_04, upper-header-bits-to-shift=64}, transformer-class=SAFETY, version=1.0.0
package /ISignal
  13 x i signal group:
    SG_ClampControl_01_XIX_VLAN_Cockpit: i-signal=[ClampControl_01_CRC_XIX_ClampControl_01_XIX_VLAN_Cockpit, ClampControl_01_BZ_XIX_ClampControl_01_XIX_VLAN_Cockpit, KST_Warn_P1_ZAT_def_XIX_ClampControl_01_XIX_VLAN_Cockpit, KST_Warn_P2_ZAT_def_XIX_ClampControl_01_XIX_VLAN_Cockpit, KST_Deaktivierungs_Trigger_XIX_ClampControl_01_XIX_VLAN_Cockpit, KST_Kl_S_XIX_ClampControl_01_XIX_VLAN_Cockpit, KST_KL_15_XIX_ClampControl_01_XIX_VLAN_Cockpit, KST_Kl_50_Startanforderung_XIX_ClampControl_01_XIX_VLAN_Cockpit, KST_Sonderzustand_Status_XIX_ClampControl_01_XIX_VLAN_Cockpit, KST_Ausstiegswunsch_Status_XIX_ClampControl_01_XIX_VLAN_Cockpit, ISignalVoid_ClampControl_01_XIX_VLAN_Cockpit_0, KST_BulbCheckReq_XIX_ClampControl_01_XIX_VLAN_Cockpit, KST_Kl_X_XIX_ClampControl_01_XIX_VLAN_Cockpit, KST_Ausparken_Betrieb_XIX_ClampControl_01_XIX_VLAN_Cockpit, KST_Fahrerhinweis_1_XIX_ClampControl_01_XIX_VLAN_Cockpit, KST_Fahrerhinweis_2_XIX_ClampControl_01_XIX_VLAN_Cockpit, KST_Fahrerhinweis_3_XIX_ClampControl_01_XIX_VLAN_Cockpit, KST_Fahrerhinweis_4_XIX_ClampControl_01_XIX_VLAN_Cockpit, KST_Fahrerhinweis_5_XIX_ClampControl_01_XIX_VLAN_Cockpit, KST_Fahrerhinweis_6_XIX_ClampControl_01_XIX_VLAN_Cockpit, ISignalVoid_ClampControl_01_XIX_VLAN_Cockpit_1, KST_Txt_Panikabschaltung_XIX_ClampControl_01_XIX_VLAN_Cockpit, ISignalVoid_ClampControl_01_XIX_VLAN_Cockpit_2, ISignalVoid_ClampControl_01_XIX_VLAN_Cockpit_3, KST_Anf_Klemmenfreigabe_ELV_XIX_ClampControl_01_XIX_VLAN_Cockpit, KST_aut_Abschaltung_Zuendung_XIX_ClampControl_01_XIX_VLAN_Cockpit, KST_StPtAcvReq_XIX_ClampControl_01_XIX_VLAN_Cockpit, KST_StPtDeacReq_XIX_ClampControl_01_XIX_VLAN_Cockpit, KST_ZAT_betaetigt_XIX_ClampControl_01_XIX_VLAN_Cockpit, KST_ComfortReadyStatus_XIX_ClampControl_01_XIX_VLAN_Cockpit, KST_Sonderzustand_Anforderung_XIX_ClampControl_01_XIX_VLAN_Cockpit, KST_WFS_Fahrfreigabe_Anforderung_XIX_ClampControl_01_XIX_VLAN_Cockpit, ISignalVoid_ClampControl_01_XIX_VLAN_Cockpit_4, ISignalVoid_ClampControl_01_XIX_VLAN_Cockpit_5], system-signal-group=SG_ClampControl_01  # Kennungsfolge: K_1634-0x63,0xb6,0x16,0x88,0xac,0x40,0xcc,0x19,0xf6,0x7b,0x29,0xd2,0x9d,0x27,0xd5,0xdf
    SG_ClampControl_01_XIX_HCP3_CANFD01: i-signal=[ClampControl_01_CRC_XIX_ClampControl_01_XIX_HCP3_CANFD01, ClampControl_01_BZ_XIX_ClampControl_01_XIX_HCP3_CANFD01, KST_Warn_P1_ZAT_def_XIX_ClampControl_01_XIX_HCP3_CANFD01, KST_Warn_P2_ZAT_def_XIX_ClampControl_01_XIX_HCP3_CANFD01, KST_Deaktivierungs_Trigger_XIX_ClampControl_01_XIX_HCP3_CANFD01, KST_Kl_S_XIX_ClampControl_01_XIX_HCP3_CANFD01, KST_KL_15_XIX_ClampControl_01_XIX_HCP3_CANFD01, KST_Kl_50_Startanforderung_XIX_ClampControl_01_XIX_HCP3_CANFD01, KST_Sonderzustand_Status_XIX_ClampControl_01_XIX_HCP3_CANFD01, KST_Ausstiegswunsch_Status_XIX_ClampControl_01_XIX_HCP3_CANFD01, ISignalVoid_ClampControl_01_XIX_HCP3_CANFD01_0, KST_BulbCheckReq_XIX_ClampControl_01_XIX_HCP3_CANFD01, KST_Kl_X_XIX_ClampControl_01_XIX_HCP3_CANFD01, KST_Ausparken_Betrieb_XIX_ClampControl_01_XIX_HCP3_CANFD01, KST_Fahrerhinweis_1_XIX_ClampControl_01_XIX_HCP3_CANFD01, KST_Fahrerhinweis_2_XIX_ClampControl_01_XIX_HCP3_CANFD01, KST_Fahrerhinweis_3_XIX_ClampControl_01_XIX_HCP3_CANFD01, KST_Fahrerhinweis_4_XIX_ClampControl_01_XIX_HCP3_CANFD01, KST_Fahrerhinweis_5_XIX_ClampControl_01_XIX_HCP3_CANFD01, KST_Fahrerhinweis_6_XIX_ClampControl_01_XIX_HCP3_CANFD01, ISignalVoid_ClampControl_01_XIX_HCP3_CANFD01_1, KST_Txt_Panikabschaltung_XIX_ClampControl_01_XIX_HCP3_CANFD01, ISignalVoid_ClampControl_01_XIX_HCP3_CANFD01_2, ISignalVoid_ClampControl_01_XIX_HCP3_CANFD01_3, KST_Anf_Klemmenfreigabe_ELV_XIX_ClampControl_01_XIX_HCP3_CANFD01, KST_aut_Abschaltung_Zuendung_XIX_ClampControl_01_XIX_HCP3_CANFD01, KST_StPtAcvReq_XIX_ClampControl_01_XIX_HCP3_CANFD01, KST_StPtDeacReq_XIX_ClampControl_01_XIX_HCP3_CANFD01, KST_ZAT_betaetigt_XIX_ClampControl_01_XIX_HCP3_CANFD01, KST_ComfortReadyStatus_XIX_ClampControl_01_XIX_HCP3_CANFD01, KST_Sonderzustand_Anforderung_XIX_ClampControl_01_XIX_HCP3_CANFD01, KST_WFS_Fahrfreigabe_Anforderung_XIX_ClampControl_01_XIX_HCP3_CANFD01, ISignalVoid_ClampControl_01_XIX_HCP3_CANFD01_4, ISignalVoid_ClampControl_01_XIX_HCP3_CANFD01_5], system-signal-group=SG_ClampControl_01  # Kennungsfolge: K_1634-0x63,0xb6,0x16,0x88,0xac,0x40,0xcc,0x19,0xf6,0x7b,0x29,0xd2,0x9d,0x27,0xd5,0xdf
    SG_HWP_01_XIX_VLAN_Cockpit: i-signal=[HWP_01_CRC_XIX_HWP_01_XIX_VLAN_Cockpit, HWP_01_BZ_XIX_HWP_01_XIX_VLAN_Cockpit, HWP_HMI_ASIL_Color_XIX_HWP_01_XIX_VLAN_Cockpit, ISignalVoid_HWP_01_XIX_VLAN_Cockpit_0, ISignalVoid_HWP_01_XIX_VLAN_Cockpit_1, ISignalVoid_HWP_01_XIX_VLAN_Cockpit_2, ISignalVoid_HWP_01_XIX_VLAN_Cockpit_3, ISignalVoid_HWP_01_XIX_VLAN_Cockpit_4, ISignalVoid_HWP_01_XIX_VLAN_Cockpit_5], system-signal-group=SG_HWP_01  # Kennungsfolge: K_1550-0x38,0x6b,0x99,0xe3,0xb3,0xec,0x8a,0x71,0xa8,0x5d,0x79,0x13,0xb4,0xc0,0xd6,0x54
    SG_ORU_Control_A_01_XIX_VLAN_Cockpit: i-signal=[ORU_Control_A_01_CRC_XIX_ORU_Control_A_01_XIX_VLAN_Cockpit, ORU_Control_A_01_BZ_XIX_ORU_Control_A_01_XIX_VLAN_Cockpit, OnlineRemoteUpdateControlA_XIX_ORU_Control_A_01_XIX_VLAN_Cockpit, OnlineRemoteUpdateControlOldA_XIX_ORU_Control_A_01_XIX_VLAN_Cockpit, OruVehicleLockRequestA_XIX_ORU_Control_A_01_XIX_VLAN_Cockpit, OruIntegrityCheckActiveA_XIX_ORU_Control_A_01_XIX_VLAN_Cockpit, OruControlReleaseA_XIX_ORU_Control_A_01_XIX_VLAN_Cockpit, OruControlStateA_XIX_ORU_Control_A_01_XIX_VLAN_Cockpit, OruReleasePartitionSwitchA_XIX_ORU_Control_A_01_XIX_VLAN_Cockpit, OruHostUpdateA_XIX_ORU_Control_A_01_XIX_VLAN_Cockpit, OTA_FlgPTAcvPhdA_XIX_ORU_Control_A_01_XIX_VLAN_Cockpit, ISignalVoid_ORU_Control_A_01_XIX_VLAN_Cockpit_0, ISignalVoid_ORU_Control_A_01_XIX_VLAN_Cockpit_1], system-signal-group=SG_ORU_Control_A_01  # Kennungsfolge: K_1449-0x97,0x70,0x84,0xb4,0xb8,0xe7,0x20,0x7c,0x0e,0x40,0x93,0x0d,0x4e,0x05,0x5b,0x95
    SG_ORU_Control_A_01_XIX_HCP3_CANFD01: i-signal=[ORU_Control_A_01_CRC_XIX_ORU_Control_A_01_XIX_HCP3_CANFD01, ORU_Control_A_01_BZ_XIX_ORU_Control_A_01_XIX_HCP3_CANFD01, OnlineRemoteUpdateControlA_XIX_ORU_Control_A_01_XIX_HCP3_CANFD01, OnlineRemoteUpdateControlOldA_XIX_ORU_Control_A_01_XIX_HCP3_CANFD01, OruVehicleLockRequestA_XIX_ORU_Control_A_01_XIX_HCP3_CANFD01, OruIntegrityCheckActiveA_XIX_ORU_Control_A_01_XIX_HCP3_CANFD01, OruControlReleaseA_XIX_ORU_Control_A_01_XIX_HCP3_CANFD01, OruControlStateA_XIX_ORU_Control_A_01_XIX_HCP3_CANFD01, OruReleasePartitionSwitchA_XIX_ORU_Control_A_01_XIX_HCP3_CANFD01, OruHostUpdateA_XIX_ORU_Control_A_01_XIX_HCP3_CANFD01, OTA_FlgPTAcvPhdA_XIX_ORU_Control_A_01_XIX_HCP3_CANFD01, ISignalVoid_ORU_Control_A_01_XIX_HCP3_CANFD01_0, ISignalVoid_ORU_Control_A_01_XIX_HCP3_CANFD01_1], system-signal-group=SG_ORU_Control_A_01  # Kennungsfolge: K_1449-0x97,0x70,0x84,0xb4,0xb8,0xe7,0x20,0x7c,0x0e,0x40,0x93,0x0d,0x4e,0x05,0x5b,0x95
    SG_ORU_Control_D_01_XIX_VLAN_Cockpit: i-signal=[ORU_Control_D_01_CRC_XIX_ORU_Control_D_01_XIX_VLAN_Cockpit, ORU_Control_D_01_BZ_XIX_ORU_Control_D_01_XIX_VLAN_Cockpit, OnlineRemoteUpdateControlD_XIX_ORU_Control_D_01_XIX_VLAN_Cockpit, OnlineRemoteUpdateControlOldD_XIX_ORU_Control_D_01_XIX_VLAN_Cockpit, OruVehicleLockRequestD_XIX_ORU_Control_D_01_XIX_VLAN_Cockpit, OruIntegrityCheckActiveD_XIX_ORU_Control_D_01_XIX_VLAN_Cockpit, OruControlReleaseD_XIX_ORU_Control_D_01_XIX_VLAN_Cockpit, OruControlStateD_XIX_ORU_Control_D_01_XIX_VLAN_Cockpit, OruReleasePartitionSwitchD_XIX_ORU_Control_D_01_XIX_VLAN_Cockpit, OruHostUpdateD_XIX_ORU_Control_D_01_XIX_VLAN_Cockpit, ISignalVoid_ORU_Control_D_01_XIX_VLAN_Cockpit_0, ISignalVoid_ORU_Control_D_01_XIX_VLAN_Cockpit_1], system-signal-group=SG_ORU_Control_D_01  # Kennungsfolge: K_1646-0x92,0x1b,0xc6,0x91,0x29,0x5a,0x4e,0xf0,0x6e,0x43,0x80,0x28,0xee,0xa3,0xc8,0x3e
    SG_ORU_Control_D_01_XIX_HCP3_CANFD01: i-signal=[ORU_Control_D_01_CRC_XIX_ORU_Control_D_01_XIX_HCP3_CANFD01, ORU_Control_D_01_BZ_XIX_ORU_Control_D_01_XIX_HCP3_CANFD01, OnlineRemoteUpdateControlD_XIX_ORU_Control_D_01_XIX_HCP3_CANFD01, OnlineRemoteUpdateControlOldD_XIX_ORU_Control_D_01_XIX_HCP3_CANFD01, OruVehicleLockRequestD_XIX_ORU_Control_D_01_XIX_HCP3_CANFD01, OruIntegrityCheckActiveD_XIX_ORU_Control_D_01_XIX_HCP3_CANFD01, OruControlReleaseD_XIX_ORU_Control_D_01_XIX_HCP3_CANFD01, OruControlStateD_XIX_ORU_Control_D_01_XIX_HCP3_CANFD01, OruReleasePartitionSwitchD_XIX_ORU_Control_D_01_XIX_HCP3_CANFD01, OruHostUpdateD_XIX_ORU_Control_D_01_XIX_HCP3_CANFD01, ISignalVoid_ORU_Control_D_01_XIX_HCP3_CANFD01_0, ISignalVoid_ORU_Control_D_01_XIX_HCP3_CANFD01_1], system-signal-group=SG_ORU_Control_D_01  # Kennungsfolge: K_1646-0x92,0x1b,0xc6,0x91,0x29,0x5a,0x4e,0xf0,0x6e,0x43,0x80,0x28,0xee,0xa3,0xc8,0x3e
    SG_OTAMC_D_01_XIX_VLAN_Cockpit: i-signal=[OTAMC_D_01_CRC_XIX_OTAMC_D_01_XIX_VLAN_Cockpit, OTAMC_D_01_BZ_XIX_OTAMC_D_01_XIX_VLAN_Cockpit, VehicleProtectedEnvironment_D_XIX_OTAMC_D_01_XIX_VLAN_Cockpit, ISignalVoid_OTAMC_D_01_XIX_VLAN_Cockpit_0, ISignalVoid_OTAMC_D_01_XIX_VLAN_Cockpit_1, ISignalVoid_OTAMC_D_01_XIX_VLAN_Cockpit_2], system-signal-group=SG_OTAMC_D_01  # Kennungsfolge: K_309-0x5f,0x18,0xf5,0x71,0x82,0x10,0x93,0x8d,0x4c,0xd7,0x6e,0xaa,0xd6,0xb0,0xb7,0x78
    SG_OTAMC_D_01_XIX_HCP3_CANFD01: i-signal=[OTAMC_D_01_CRC_XIX_OTAMC_D_01_XIX_HCP3_CANFD01, OTAMC_D_01_BZ_XIX_OTAMC_D_01_XIX_HCP3_CANFD01, VehicleProtectedEnvironment_D_XIX_OTAMC_D_01_XIX_HCP3_CANFD01, ISignalVoid_OTAMC_D_01_XIX_HCP3_CANFD01_0, ISignalVoid_OTAMC_D_01_XIX_HCP3_CANFD01_1, ISignalVoid_OTAMC_D_01_XIX_HCP3_CANFD01_2], system-signal-group=SG_OTAMC_D_01  # Kennungsfolge: K_309-0x5f,0x18,0xf5,0x71,0x82,0x10,0x93,0x8d,0x4c,0xd7,0x6e,0xaa,0xd6,0xb0,0xb7,0x78
    SG_VDSO_05_XIX_VLAN_Cockpit: i-signal=[VDSO_05_CRC_XIX_VDSO_05_XIX_VLAN_Cockpit, VDSO_05_BZ_XIX_VDSO_05_XIX_VLAN_Cockpit, VDSO_Vx3d_XIX_VDSO_05_XIX_VLAN_Cockpit, VDSO_Vx3dKmph_XIX_VDSO_05_XIX_VLAN_Cockpit, VDSO_Vx3dDisp_XIX_VDSO_05_XIX_VLAN_Cockpit, VDSO_BasTi200_NumClc_05_XIX_VDSO_05_XIX_VLAN_Cockpit], system-signal-group=SG_VDSO_05  # Kennungsfolge: K_1552-0x9d,0x8f,0x47,0x05,0xbd,0xb0,0x22,0x76,0x34,0xa4,0x93,0x32,0x57,0x6d,0xbc,0xf4
    SG_VDSO_05_XIX_HCP3_CANFD01: i-signal=[VDSO_05_CRC_XIX_VDSO_05_XIX_HCP3_CANFD01, VDSO_05_BZ_XIX_VDSO_05_XIX_HCP3_CANFD01, VDSO_Vx3d_XIX_VDSO_05_XIX_HCP3_CANFD01, VDSO_Vx3dKmph_XIX_VDSO_05_XIX_HCP3_CANFD01, VDSO_Vx3dDisp_XIX_VDSO_05_XIX_HCP3_CANFD01, VDSO_BasTi200_NumClc_05_XIX_VDSO_05_XIX_HCP3_CANFD01], system-signal-group=SG_VDSO_05  # Kennungsfolge: K_1552-0x9d,0x8f,0x47,0x05,0xbd,0xb0,0x22,0x76,0x34,0xa4,0x93,0x32,0x57,0x6d,0xbc,0xf4
    SG_WFS_02_XIX_HCP3_CANFD01: i-signal=[WFS_02_CRC_XIX_WFS_02_XIX_HCP3_CANFD01, WFS_02_BZ_XIX_WFS_02_XIX_HCP3_CANFD01, WFS_ID_Geb_autorisiert_in_Kl15_XIX_WFS_02_XIX_HCP3_CANFD01, WFS_ID_Geb_steckt_XIX_WFS_02_XIX_HCP3_CANFD01, WFS_ID_Geb_autorisiert_XIX_WFS_02_XIX_HCP3_CANFD01, WFS_Safe_XIX_WFS_02_XIX_HCP3_CANFD01, VIN_1_XIX_WFS_02_XIX_HCP3_CANFD01, VIN_2_XIX_WFS_02_XIX_HCP3_CANFD01, VIN_3_XIX_WFS_02_XIX_HCP3_CANFD01, VIN_4_XIX_WFS_02_XIX_HCP3_CANFD01, VIN_5_XIX_WFS_02_XIX_HCP3_CANFD01, VIN_6_XIX_WFS_02_XIX_HCP3_CANFD01, VIN_7_XIX_WFS_02_XIX_HCP3_CANFD01, VIN_8_XIX_WFS_02_XIX_HCP3_CANFD01, VIN_9_XIX_WFS_02_XIX_HCP3_CANFD01, VIN_10_XIX_WFS_02_XIX_HCP3_CANFD01, VIN_11_XIX_WFS_02_XIX_HCP3_CANFD01, VIN_12_XIX_WFS_02_XIX_HCP3_CANFD01, VIN_13_XIX_WFS_02_XIX_HCP3_CANFD01, VIN_14_XIX_WFS_02_XIX_HCP3_CANFD01, VIN_15_XIX_WFS_02_XIX_HCP3_CANFD01, VIN_16_XIX_WFS_02_XIX_HCP3_CANFD01, VIN_17_XIX_WFS_02_XIX_HCP3_CANFD01, WFS_Schluessel_Soll_XIX_WFS_02_XIX_HCP3_CANFD01, WFS_Schluessel_Ist_XIX_WFS_02_XIX_HCP3_CANFD01, WFS_Schluessel_Fahrberecht_XIX_WFS_02_XIX_HCP3_CANFD01, WFS_Fahrerhinweise_XIX_WFS_02_XIX_HCP3_CANFD01, WFS_Parken_Status_XIX_WFS_02_XIX_HCP3_CANFD01, WFS_Klemmenfreigabe_XIX_WFS_02_XIX_HCP3_CANFD01, WFS_ELV_authorisiert_XIX_WFS_02_XIX_HCP3_CANFD01, WFS_Betrieb_Lesespule_XIX_WFS_02_XIX_HCP3_CANFD01, WFS_LF_Aktiv_XIX_WFS_02_XIX_HCP3_CANFD01, WFS_LZ_02_XIX_WFS_02_XIX_HCP3_CANFD01, IMMO_Display_XIX_WFS_02_XIX_HCP3_CANFD01, IMMO_ClampPermStatus_XIX_WFS_02_XIX_HCP3_CANFD01], system-signal-group=SG_WFS_02  # custom ECU specified i-signal group
    SG_WFS_02_XIX_VLAN_Cockpit: i-signal=[WFS_02_CRC_XIX_WFS_02_XIX_VLAN_Cockpit, WFS_02_BZ_XIX_WFS_02_XIX_VLAN_Cockpit, WFS_ID_Geb_autorisiert_in_Kl15_XIX_WFS_02_XIX_VLAN_Cockpit, WFS_ID_Geb_steckt_XIX_WFS_02_XIX_VLAN_Cockpit, WFS_ID_Geb_autorisiert_XIX_WFS_02_XIX_VLAN_Cockpit, WFS_Safe_XIX_WFS_02_XIX_VLAN_Cockpit, VIN_1_XIX_WFS_02_XIX_VLAN_Cockpit, VIN_2_XIX_WFS_02_XIX_VLAN_Cockpit, VIN_3_XIX_WFS_02_XIX_VLAN_Cockpit, VIN_4_XIX_WFS_02_XIX_VLAN_Cockpit, VIN_5_XIX_WFS_02_XIX_VLAN_Cockpit, VIN_6_XIX_WFS_02_XIX_VLAN_Cockpit, VIN_7_XIX_WFS_02_XIX_VLAN_Cockpit, VIN_8_XIX_WFS_02_XIX_VLAN_Cockpit, VIN_9_XIX_WFS_02_XIX_VLAN_Cockpit, VIN_10_XIX_WFS_02_XIX_VLAN_Cockpit, VIN_11_XIX_WFS_02_XIX_VLAN_Cockpit, VIN_12_XIX_WFS_02_XIX_VLAN_Cockpit, VIN_13_XIX_WFS_02_XIX_VLAN_Cockpit, VIN_14_XIX_WFS_02_XIX_VLAN_Cockpit, VIN_15_XIX_WFS_02_XIX_VLAN_Cockpit, VIN_16_XIX_WFS_02_XIX_VLAN_Cockpit, VIN_17_XIX_WFS_02_XIX_VLAN_Cockpit, WFS_Schluessel_Soll_XIX_WFS_02_XIX_VLAN_Cockpit, WFS_Schluessel_Ist_XIX_WFS_02_XIX_VLAN_Cockpit, WFS_Schluessel_Fahrberecht_XIX_WFS_02_XIX_VLAN_Cockpit, WFS_Fahrerhinweise_XIX_WFS_02_XIX_VLAN_Cockpit, WFS_Parken_Status_XIX_WFS_02_XIX_VLAN_Cockpit, WFS_Klemmenfreigabe_XIX_WFS_02_XIX_VLAN_Cockpit, WFS_ELV_authorisiert_XIX_WFS_02_XIX_VLAN_Cockpit, WFS_Betrieb_Lesespule_XIX_WFS_02_XIX_VLAN_Cockpit, WFS_LF_Aktiv_XIX_WFS_02_XIX_VLAN_Cockpit, WFS_LZ_02_XIX_WFS_02_XIX_VLAN_Cockpit, IMMO_Display_XIX_WFS_02_XIX_VLAN_Cockpit, IMMO_ClampPermStatus_XIX_WFS_02_XIX_VLAN_Cockpit], system-signal-group=SG_WFS_02  # custom ECU specified i-signal group
package /BaseType
  1465 x base type, all with category=FIXED_LENGTH:
    BT_ACA_02_BZ: base-type-encoding=NONE
    BT_ACA_02_CRC: base-type-encoding=NONE
    BT_ACA_Akustik: base-type-encoding=NONE
    BT_ACA_CrvtCtl_CrvtDmd: base-type-encoding=NONE
    BT_ACA_CrvtCtl_CrvtGrdDmd: base-type-encoding=NONE
    BT_ACA_CrvtCtl_FacSsty: base-type-encoding=NONE
    BT_ACA_CrvtCtl_StLimCtlFReq: base-type-encoding=NONE
    BT_ACA_EA_Fahrerinaktivitaet: base-type-encoding=NONE
    BT_ACA_Hands_off_LED: base-type-encoding=NONE
    BT_ACA_HMI_Color: base-type-encoding=NONE
    BT_ACA_HndFre_StDiReq: base-type-encoding=NONE
    BT_ACA_HndFre_StHndDet1: base-type-encoding=NONE
    BT_ACA_HndFre_StHndDet2: base-type-encoding=NONE
    BT_ACA_IntruMon_CamObj_ID: base-type-encoding=NONE
    BT_ACA_Laengsregelmodus: base-type-encoding=NONE
    BT_ACA_LatCtl_stAcv: base-type-encoding=NONE
    BT_ACA_PaCo_VideoRequest: base-type-encoding=NONE
    BT_ACA_PreCrash_Anf: base-type-encoding=NONE
    BT_ACA_RDR_Status: base-type-encoding=NONE
    BT_ACA_Status_Color: base-type-encoding=NONE
    BT_ACA_Status_Laengs: base-type-encoding=NONE
    BT_ACA_Status_LDW: base-type-encoding=NONE
    BT_ACA_Status_Quer: base-type-encoding=NONE
    BT_ACA_Status_TriggeredLaneChange: base-type-encoding=NONE
    BT_ACA_StgWhlVib_IdxProfReq: base-type-encoding=NONE
    BT_AIAD_PwrCns: base-type-encoding=NONE
    BT_AIAD_PwrCnsOvf: base-type-encoding=NONE
    BT_AICluT_TqWhlDesAllWd: base-type-encoding=NONE
    BT_AID_StsSysDgrd: base-type-encoding=NONE
    BT_AMP_KD_Fehler: base-type-encoding=NONE
    BT_AMP_KompSchutz: base-type-encoding=NONE
    BT_AMP_Nachlauftyp: base-type-encoding=NONE
    BT_AMP_SNI_10: base-type-encoding=NONE
    BT_API_PrctDrvPed: base-type-encoding=NONE
    BT_API_PrctGrdDrvPed: base-type-encoding=NONE
    BT_API_StDrvPed: base-type-encoding=NONE
    BT_API_StDrvPedCnfd: base-type-encoding=NONE
    BT_APP_Kundenwarnung_Panik: base-type-encoding=NONE
    BT_ASW_HMI_defekt: base-type-encoding=NONE
    BT_ASW_wakeup: base-type-encoding=NONE
    BT_ASW_Warnung_aktiv_BFS: base-type-encoding=NONE
    BT_ASW_Warnung_aktiv_FS: base-type-encoding=NONE
    BT_ASW_Warnung_aktiv_HBFS: base-type-encoding=NONE
    BT_ASW_Warnung_aktiv_HFS: base-type-encoding=NONE
    BT_ASW_Warnung_Aussenlicht_BFS_Li: base-type-encoding=NONE
    BT_ASW_Warnung_Aussenlicht_BFS_Re: base-type-encoding=NONE
    BT_ASW_Warnung_Aussenlicht_FS_Li: base-type-encoding=NONE
    BT_ASW_Warnung_Aussenlicht_FS_Re: base-type-encoding=NONE
    BT_BCM1_Stellgroesse_Kl_58s: base-type-encoding=NONE
    BT_BEM_Batt_Ab: base-type-encoding=NONE
    BT_BEM_Generatordiagnose: base-type-encoding=NONE
    BT_BEM_HL_Regelung_Status: base-type-encoding=NONE
    BT_BEM_Red_Innengeblaese: base-type-encoding=NONE
    BT_BEM_STH_Einschaltverbot: base-type-encoding=NONE
    BT_BEM_STH_Zielzeit: base-type-encoding=NONE
    BT_BFS_Status_eTAG: base-type-encoding=NONE
    BT_BFT_HSK_Taste: base-type-encoding=NONE
    BT_BT_ASW_HMI_defekt: base-type-encoding=NONE
    BT_BT_ASW_Warnton: base-type-encoding=NONE
    BT_BT_ASW_Warnung_Aussenlicht: base-type-encoding=NONE
    BT_BT_ASW_Warnung_VAS: base-type-encoding=NONE
    BT_BT_EC_Spiegel_Helligkeit: base-type-encoding=NONE
    BT_BT_FH_Bew_hoch: base-type-encoding=NONE
    BT_BT_FH_Bew_tief: base-type-encoding=NONE
    BT_BT_FH_Block: base-type-encoding=NONE
    BT_BT_FH_Fang: base-type-encoding=NONE
    BT_BT_FH_normiert: base-type-encoding=NONE
    BT_BT_FH_Oeffnung: base-type-encoding=NONE
    BT_BT_FH_Pos_oben: base-type-encoding=NONE
    BT_BT_FH_S_AutoHoch: base-type-encoding=NONE
    BT_BT_FH_S_AutoTief: base-type-encoding=NONE
    BT_BT_FH_S_ManHoch: base-type-encoding=NONE
    BT_BT_FH_S_ManTief: base-type-encoding=NONE
    BT_BT_FH_Thermo: base-type-encoding=NONE
    BT_BT_gesafet: base-type-encoding=NONE
    BT_BT_Kisi_Fehler: base-type-encoding=NONE
    BT_BT_Lock_Taster: base-type-encoding=NONE
    BT_BT_Oben_Block_erw: base-type-encoding=NONE
    BT_BT_Schluesselschalter_auf: base-type-encoding=NONE
    BT_BT_Schluesselschalter_zu: base-type-encoding=NONE
    BT_BT_SP_ausgerastet: base-type-encoding=NONE
    BT_BT_Sp_Blk_def: base-type-encoding=NONE
    BT_BT_Sp_Heizung_Anf: base-type-encoding=NONE
    BT_BT_SP_Heizung_Status: base-type-encoding=NONE
    BT_BT_SP_ht_aktiv: base-type-encoding=NONE
    BT_BT_SP_lr_aktiv: base-type-encoding=NONE
    BT_BT_Sperrklinke: base-type-encoding=NONE
    BT_BT_SWA_HMI_defekt: base-type-encoding=NONE
    BT_BT_TAG_betaetigt: base-type-encoding=NONE
    BT_BT_TCR_Mode_aktiv: base-type-encoding=NONE
    BT_BT_TIG_betaetigt: base-type-encoding=NONE
    BT_BT_Tuer_geoeffnet: base-type-encoding=NONE
    BT_BT_Tuer_Status: base-type-encoding=NONE
    BT_BT_Tuer_Status_QBit: base-type-encoding=NONE
    BT_BT_Tueroeffnen_Warnung: base-type-encoding=NONE
    BT_BT_Tuerschloss_defekt: base-type-encoding=NONE
    BT_BT_UEKB_aktiviert: base-type-encoding=NONE
    BT_BT_Unlock_Taster: base-type-encoding=NONE
    BT_BT_Unten_Block_erw: base-type-encoding=NONE
    BT_BT_verriegelt: base-type-encoding=NONE
    BT_BT_Zuziehhilfe_aktiv: base-type-encoding=NONE
    BT_CCF_KD_Fehler: base-type-encoding=NONE
    BT_CCF_SNI_10: base-type-encoding=NONE
    BT_CE_FlgOvf_VolCns: base-type-encoding=NONE
    BT_CE_StCpb: base-type-encoding=NONE
    BT_CE_StTrbcPMaxDisp: base-type-encoding=NONE
    BT_CE_TCooPT: base-type-encoding=NONE
    BT_CE_VfCns: base-type-encoding=NONE
    BT_CE_VolCns: base-type-encoding=NONE
    BT_CentralLocking_01_BZ: base-type-encoding=NONE
    BT_CentralLocking_01_CRC: base-type-encoding=NONE
    BT_CID_Backlight_OpenCircuit: base-type-encoding=NONE
    BT_CID_Backlight_ShortCircuit: base-type-encoding=NONE
    BT_CID_CL_30F: base-type-encoding=NONE
    BT_CID_CL30_Overvolt_Error: base-type-encoding=NONE
    BT_CID_CL30_Undervolt_Error: base-type-encoding=NONE
    BT_CID_DispDerating: base-type-encoding=NONE
    BT_CID_EEPROM_Error: base-type-encoding=NONE
    BT_CID_FanSpeed: base-type-encoding=NONE
    BT_CID_Haptik_Errorstate: base-type-encoding=NONE
    BT_CID_HDCP_Status: base-type-encoding=NONE
    BT_CID_HID_FetchAll: base-type-encoding=NONE
    BT_CID_Image_Errorstate: base-type-encoding=NONE
    BT_CID_Input_Errorstate: base-type-encoding=NONE
    BT_CID_Input_ErrorState_TNCTOC: base-type-encoding=NONE
    BT_CID_KD_Fehler: base-type-encoding=NONE
    BT_CID_LVDS_Errorstate: base-type-encoding=NONE
    BT_CID_LVDS_Splitter_Errorstate: base-type-encoding=NONE
    BT_CID_LVDS_Status: base-type-encoding=NONE
    BT_CID_Nachlauftyp: base-type-encoding=NONE
    BT_CID_OperatingTime_hr: base-type-encoding=NONE
    BT_CID_OperatingTime_min: base-type-encoding=NONE
    BT_CID_PCB_Temp_Error: base-type-encoding=NONE
    BT_CID_PCB_TempSensor: base-type-encoding=NONE
    BT_CID_PCB_TempSensorMax: base-type-encoding=NONE
    BT_CID_Photosensor: base-type-encoding=NONE
    BT_CID_Proximity_Errorstate: base-type-encoding=NONE
    BT_CID_ShutterFoil_Errorstate: base-type-encoding=NONE
    BT_CID_Slider_Errorstate: base-type-encoding=NONE
    BT_CID_SNI_10: base-type-encoding=NONE
    BT_CID_State: base-type-encoding=NONE
    BT_CID_SW_inconsistent: base-type-encoding=NONE
    BT_CID_SystemMode: base-type-encoding=NONE
    BT_CID_Temp_Error: base-type-encoding=NONE
    BT_CID_TempSensor: base-type-encoding=NONE
    BT_CID_TempSensorMax: base-type-encoding=NONE
    BT_CID_Touch_Errorstate: base-type-encoding=NONE
    BT_CID_Touchstate: base-type-encoding=NONE
    BT_CID_VA_Communication_Init: base-type-size=8, base-type-encoding=ISO-8859-1
    BT_CID_VA_Communication_Init_Ack: base-type-size=8, base-type-encoding=ISO-8859-1
    BT_CID_VA_Response: base-type-size=8, base-type-encoding=ISO-8859-1
    BT_CID_VW_SL_App_SW_Version_Nr: base-type-encoding=NONE
    BT_CID_VW_SL_HW_Version_Nr: base-type-encoding=NONE
    BT_CID_VW_SL_Spare_Part_Nr_EndNr: base-type-encoding=NONE
    BT_CID_VW_SL_Spare_Part_Nr_Index: base-type-encoding=NONE
    BT_CID_VW_SL_Spare_Part_Nr_MittelNr: base-type-encoding=NONE
    BT_CID_VW_SL_Spare_Part_Nr_TMA: base-type-encoding=NONE
    BT_ClampControl_01_BZ: base-type-encoding=NONE
    BT_ClampControl_01_CRC: base-type-encoding=NONE
    BT_ClimateControl_01_BZ: base-type-encoding=NONE
    BT_ClimateControl_01_CRC: base-type-encoding=NONE
    BT_CMM_ReqAcvHdc: base-type-encoding=NONE
    BT_DGN_Verlernzaehler: base-type-encoding=NONE
    BT_DI_Display_Nachtdesign: base-type-encoding=NONE
    BT_DI_Fotosensor: base-type-encoding=NONE
    BT_DI_KL_58xd: base-type-encoding=NONE
    BT_DI_KL_58xs: base-type-encoding=NONE
    BT_DI_KL_58xt: base-type-encoding=NONE
    BT_DispKBI_FS_Abschaltstufe: base-type-encoding=NONE
    BT_DispKBI_FS_KD_Fehler: base-type-encoding=NONE
    BT_DispKBI_FS_KompSchutz: base-type-encoding=NONE
    BT_DispKBI_FS_Nachlauftyp: base-type-encoding=NONE
    BT_DispKBI_FS_SNI_10: base-type-encoding=NONE
    BT_DispKBI_FS_Transport_Mode: base-type-encoding=NONE
    BT_DLO_StAllWd: base-type-encoding=NONE
    BT_DLO_StAllWdCluDes: base-type-encoding=NONE
    BT_DLO_TqReqAllWdClu: base-type-encoding=NONE
    BT_DoorFunctions_BFS_01_BZ: base-type-encoding=NONE
    BT_DoorFunctions_BFS_01_CRC: base-type-encoding=NONE
    BT_DoorFunctions_FS_01_BZ: base-type-encoding=NONE
    BT_DoorFunctions_FS_01_CRC: base-type-encoding=NONE
    BT_DoorFunctions_HBFS_01_BZ: base-type-encoding=NONE
    BT_DoorFunctions_HBFS_01_CRC: base-type-encoding=NONE
    BT_DoorFunctions_HFS_01_BZ: base-type-encoding=NONE
    BT_DoorFunctions_HFS_01_CRC: base-type-encoding=NONE
    BT_DS_CCF_ConfDTCChanged: base-type-encoding=NONE
    BT_DS_CCF_DiagAdr: base-type-encoding=NONE
    BT_DS_CCF_IdentValid: base-type-encoding=NONE
    BT_DS_CCF_Lokalaktiv: base-type-encoding=NONE
    BT_DS_CCF_MemSel10Changed: base-type-encoding=NONE
    BT_DS_CCF_MemSelChanged: base-type-encoding=NONE
    BT_DS_CCF_StMemChanged: base-type-encoding=NONE
    BT_DS_CCF_TestFailedChanged: base-type-encoding=NONE
    BT_DS_CCF_WIRChanged: base-type-encoding=NONE
    BT_DS_CID_ConfDTCChanged: base-type-encoding=NONE
    BT_DS_CID_DiagAdr: base-type-encoding=NONE
    BT_DS_CID_IdentValid: base-type-encoding=NONE
    BT_DS_CID_Lokalaktiv: base-type-encoding=NONE
    BT_DS_CID_MemSel10Changed: base-type-encoding=NONE
    BT_DS_CID_MemSelChanged: base-type-encoding=NONE
    BT_DS_CID_StMemChanged: base-type-encoding=NONE
    BT_DS_CID_Subsystemaktiv: base-type-encoding=NONE
    BT_DS_CID_TestFailedChanged: base-type-encoding=NONE
    BT_DS_CID_WIRChanged: base-type-encoding=NONE
    BT_DS_HUD_ConfDTCChanged: base-type-encoding=NONE
    BT_DS_HUD_DiagAdr: base-type-encoding=NONE
    BT_DS_HUD_IdentValid: base-type-encoding=NONE
    BT_DS_HUD_Lokalaktiv: base-type-encoding=NONE
    BT_DS_HUD_MemSel10Changed: base-type-encoding=NONE
    BT_DS_HUD_MemSelChanged: base-type-encoding=NONE
    BT_DS_HUD_StMemChanged: base-type-encoding=NONE
    BT_DS_HUD_Subsystemaktiv: base-type-encoding=NONE
    BT_DS_HUD_TestFailedChanged: base-type-encoding=NONE
    BT_DS_HUD_WIRChanged: base-type-encoding=NONE
    BT_DS_Info_El_ConfDTCChanged: base-type-encoding=NONE
    BT_DS_Info_El_DiagAdr: base-type-encoding=NONE
    BT_DS_Info_El_IdentValid: base-type-encoding=NONE
    BT_DS_Info_El_Lokalaktiv: base-type-encoding=NONE
    BT_DS_Info_El_MemSel10Changed: base-type-encoding=NONE
    BT_DS_Info_El_MemSelChanged: base-type-encoding=NONE
    BT_DS_Info_El_StMemChanged: base-type-encoding=NONE
    BT_DS_Info_El_TestFailedChanged: base-type-encoding=NONE
    BT_DS_Info_El_WIRChanged: base-type-encoding=NONE
    BT_DS_PID_ConfDTCChanged: base-type-encoding=NONE
    BT_DS_PID_DiagAdr: base-type-encoding=NONE
    BT_DS_PID_IdentValid: base-type-encoding=NONE
    BT_DS_PID_Lokalaktiv: base-type-encoding=NONE
    BT_DS_PID_MemSel10Changed: base-type-encoding=NONE
    BT_DS_PID_MemSelChanged: base-type-encoding=NONE
    BT_DS_PID_StMemChanged: base-type-encoding=NONE
    BT_DS_PID_Subsystemaktiv: base-type-encoding=NONE
    BT_DS_PID_TestFailedChanged: base-type-encoding=NONE
    BT_DS_PID_WIRChanged: base-type-encoding=NONE
    BT_DS_WLC1_ConfDTCChanged: base-type-encoding=NONE
    BT_DS_WLC1_DiagAdr: base-type-encoding=NONE
    BT_DS_WLC1_IdentValid: base-type-encoding=NONE
    BT_DS_WLC1_Lokalaktiv: base-type-encoding=NONE
    BT_DS_WLC1_MemSel10Changed: base-type-encoding=NONE
    BT_DS_WLC1_MemSelChanged: base-type-encoding=NONE
    BT_DS_WLC1_StMemChanged: base-type-encoding=NONE
    BT_DS_WLC1_TestFailedChanged: base-type-encoding=NONE
    BT_DS_WLC1_WIRChanged: base-type-encoding=NONE
    BT_DS_WLC2_ConfDTCChanged: base-type-encoding=NONE
    BT_DS_WLC2_DiagAdr: base-type-encoding=NONE
    BT_DS_WLC2_IdentValid: base-type-encoding=NONE
    BT_DS_WLC2_Lokalaktiv: base-type-encoding=NONE
    BT_DS_WLC2_MemSel10Changed: base-type-encoding=NONE
    BT_DS_WLC2_MemSelChanged: base-type-encoding=NONE
    BT_DS_WLC2_StMemChanged: base-type-encoding=NONE
    BT_DS_WLC2_TestFailedChanged: base-type-encoding=NONE
    BT_DS_WLC2_WIRChanged: base-type-encoding=NONE
    BT_DSI_OvrstrIdx: base-type-encoding=NONE
    BT_DSI_SlipAgOvrstr: base-type-encoding=NONE
    BT_DSI_UndstrIdx: base-type-encoding=NONE
    BT_DSI_YawRateAyDyn: base-type-encoding=NONE
    BT_DTC_StAllWdCluCal: base-type-encoding=NONE
    BT_DTSO_StCELvStrtInfo: base-type-encoding=NONE
    BT_DTSO_StCEStrtStop: base-type-encoding=NONE
    BT_DTSO_StElmAxp: base-type-encoding=NONE
    BT_DTSO_StElmAxs: base-type-encoding=NONE
    BT_DTSO_StElmHyb: base-type-encoding=NONE
    BT_DTSO_StPrpUnitAcvWhl: base-type-encoding=NONE
    BT_DTSO_StPsa: base-type-encoding=NONE
    BT_DTSO_StPTEgySrc: base-type-encoding=NONE
    BT_DW_Kilometerstand: base-type-encoding=NONE
    BT_DWA_aktiv: base-type-encoding=NONE
    BT_DWA_Alarmquelle_02: base-type-encoding=NONE
    BT_eTAB_BFS_Oeffnen_Annaeh: base-type-encoding=NONE
    BT_eTAB_BFS_Oeffnen_Betaet: base-type-encoding=NONE
    BT_eTAB_BFS_Schliessen_Annaeh: base-type-encoding=NONE
    BT_eTAB_BFS_Schliessen_Betaet: base-type-encoding=NONE
    BT_eTAB_FS_Bowdenzug_Auswerfen: base-type-encoding=NONE
    BT_eTAB_FS_Oeffnen_Annaeh: base-type-encoding=NONE
    BT_eTAB_FS_Oeffnen_Betaet: base-type-encoding=NONE
    BT_eTAB_FS_Schliessen_Annaeh: base-type-encoding=NONE
    BT_eTAB_FS_Schliessen_Betaet: base-type-encoding=NONE
    BT_eTAB_HBFS_Oeffnen_Annaeh: base-type-encoding=NONE
    BT_eTAB_HBFS_Oeffnen_Betaet: base-type-encoding=NONE
    BT_eTAB_HBFS_Schliessen_Annaeh: base-type-encoding=NONE
    BT_eTAB_HBFS_Schliessen_Betaet: base-type-encoding=NONE
    BT_eTAB_HFS_Oeffnen_Annaeh: base-type-encoding=NONE
    BT_eTAB_HFS_Oeffnen_Betaet: base-type-encoding=NONE
    BT_eTAB_HFS_Schliessen_Annaeh: base-type-encoding=NONE
    BT_eTAB_HFS_Schliessen_Betaet: base-type-encoding=NONE
    BT_FBS_Anf_Access_Auth: base-type-encoding=NONE
    BT_FBS_Anf_Start_Auth: base-type-encoding=NONE
    BT_FBS_KSY_adv_position: base-type-encoding=NONE
    BT_FBS_KSY_adv_zone: base-type-encoding=NONE
    BT_FBS_KSY_driver_warning: base-type-encoding=NONE
    BT_FBS_KSY_easy_close1: base-type-encoding=NONE
    BT_FBS_KSY_easy_close2: base-type-encoding=NONE
    BT_FBS_KSY_enable_park: base-type-encoding=NONE
    BT_FBS_KSY_HF: base-type-encoding=NONE
    BT_FBS_KSY_HF_telegram: base-type-encoding=NONE
    BT_FBS_KSY_ID_active: base-type-encoding=NONE
    BT_FBS_KSY_ID_battery: base-type-encoding=NONE
    BT_FBS_KSY_jobnumber: base-type-encoding=NONE
    BT_FBS_KSY_LF: base-type-encoding=NONE
    BT_FBS_KSY_lock_sensor_auth: base-type-encoding=NONE
    BT_FBS_KSY_lock_sensor_prox: base-type-encoding=NONE
    BT_FBS_KSY_unlock_sensor_auth: base-type-encoding=NONE
    BT_FBS_KSY_unlock_sensor_prox: base-type-encoding=NONE
    BT_FBS_KSY_UWB_range: base-type-encoding=NONE
    BT_FBS_KSY_VIP: base-type-encoding=NONE
    BT_FBS_MDK_BLE_lock_sensor_auth: base-type-encoding=NONE
    BT_FBS_MDK_BLE_unlock_sensor_auth: base-type-encoding=NONE
    BT_FBS_MDK_button: base-type-encoding=NONE
    BT_FBS_MDK_in_Reichweite: base-type-encoding=NONE
    BT_FBS_MDK_NFC_lock_sensor_auth: base-type-encoding=NONE
    BT_FBS_MDK_NFC_unlock_sensor_auth: base-type-encoding=NONE
    BT_FBS_MKGO_{01..05}: base-type-size=8, base-type-encoding=ISO-8859-1
    BT_FBS_RKE_button: base-type-encoding=NONE
    BT_FID_01_BZ: base-type-encoding=NONE
    BT_FID_01_CRC: base-type-encoding=NONE
    BT_FID_Acoustics_State: base-type-encoding=NONE
    BT_FID_Backlight_OpenCircuit: base-type-encoding=NONE
    BT_FID_Backlight_ShortCircuit: base-type-encoding=NONE
    BT_FID_CL_30F: base-type-encoding=NONE
    BT_FID_CL30_Overvolt_Error: base-type-encoding=NONE
    BT_FID_CL30_Undervolt_Error: base-type-encoding=NONE
    BT_FID_DispDerating: base-type-encoding=NONE
    BT_FID_Display_Ready: base-type-encoding=NONE
    BT_FID_E2E_SF: base-type-encoding=NONE
    BT_FID_EEPROM_Error: base-type-encoding=NONE
    BT_FID_LVDS_Errorstate: base-type-encoding=NONE
    BT_FID_LVDS_State: base-type-encoding=NONE
    BT_FID_OperatingTime_hr: base-type-encoding=NONE
    BT_FID_OperatingTime_min: base-type-encoding=NONE
    BT_FID_PCB_Temp_Error: base-type-encoding=NONE
    BT_FID_PCB_TempSensor: base-type-encoding=NONE
    BT_FID_PCB_TempSensorMax: base-type-encoding=NONE
    BT_FID_Photosensor: base-type-encoding=NONE
    BT_FID_State: base-type-encoding=NONE
    BT_FID_SW_inconsistent: base-type-encoding=NONE
    BT_FID_SystemMode: base-type-encoding=NONE
    BT_FID_Telltale_Check: base-type-encoding=NONE
    BT_FID_Telltale_State: base-type-encoding=NONE
    BT_FID_Temp_Error: base-type-encoding=NONE
    BT_FID_TempSensor: base-type-encoding=NONE
    BT_FID_TempSensorMax: base-type-encoding=NONE
    BT_FID_VA_Communication_Init: base-type-size=8, base-type-encoding=ISO-8859-1
    BT_FID_VA_Communication_Init_Ack: base-type-size=8, base-type-encoding=ISO-8859-1
    BT_FID_VA_Response: base-type-size=8, base-type-encoding=ISO-8859-1
    BT_FID_Video_State: base-type-encoding=NONE
    BT_FoD_Info_El_Req_Eth_Data: base-type-size=8, base-type-encoding=ISO-8859-1
    BT_FoD_Info_El_Resp_Eth_Data: base-type-size=8, base-type-encoding=ISO-8859-1
    BT_FS_Status_eTAG: base-type-encoding=NONE
    BT_FT_ASW_Warnton: base-type-encoding=NONE
    BT_FT_ASW_Warnung_Aussenlicht: base-type-encoding=NONE
    BT_FT_ASW_Warnung_VAS: base-type-encoding=NONE
    BT_FT_BFS_Fond_Freigabe: base-type-encoding=NONE
    BT_FT_BFS_Tuer_Status: base-type-encoding=NONE
    BT_FT_Daemmglas: base-type-encoding=NONE
    BT_FT_FD_Taste: base-type-encoding=NONE
    BT_FT_FH_Bew_hoch: base-type-encoding=NONE
    BT_FT_FH_Bew_tief: base-type-encoding=NONE
    BT_FT_FH_Block: base-type-encoding=NONE
    BT_FT_FH_Fang: base-type-encoding=NONE
    BT_FT_FH_normiert: base-type-encoding=NONE
    BT_FT_FH_Oeffnung: base-type-encoding=NONE
    BT_FT_FH_Pos_oben: base-type-encoding=NONE
    BT_FT_FH_S_AutoHoch: base-type-encoding=NONE
    BT_FT_FH_S_AutoTief: base-type-encoding=NONE
    BT_FT_FH_S_ManHoch: base-type-encoding=NONE
    BT_FT_FH_S_ManTief: base-type-encoding=NONE
    BT_FT_FH_Thermo: base-type-encoding=NONE
    BT_FT_gesafet: base-type-encoding=NONE
    BT_FT_HBFS_Tuer_Status: base-type-encoding=NONE
    BT_FT_HD_Taste: base-type-encoding=NONE
    BT_FT_HD_Taste_auf: base-type-encoding=NONE
    BT_FT_HD_Taste_zu: base-type-encoding=NONE
    BT_FT_HFS_Tuer_Status: base-type-encoding=NONE
    BT_FT_IRUE_Taste: base-type-encoding=NONE
    BT_FT_Kisi_Fehler: base-type-encoding=NONE
    BT_FT_Kisi_li_aktiv: base-type-encoding=NONE
    BT_FT_Kisi_re_aktiv: base-type-encoding=NONE
    BT_FT_Kisi_Taster_li_02: base-type-encoding=NONE
    BT_FT_Kisi_Taster_re_02: base-type-encoding=NONE
    BT_FT_Lock_Taster: base-type-encoding=NONE
    BT_FT_Oben_Block_erw: base-type-encoding=NONE
    BT_FT_Schliesstaster: base-type-encoding=NONE
    BT_FT_Schluesselschalter_auf: base-type-encoding=NONE
    BT_FT_Schluesselschalter_zu: base-type-encoding=NONE
    BT_FT_SP_ausgerastet: base-type-encoding=NONE
    BT_FT_Sp_Blk_def: base-type-encoding=NONE
    BT_FT_Sp_Heizung_Anf: base-type-encoding=NONE
    BT_FT_SP_Heizung_ein: base-type-encoding=NONE
    BT_FT_SP_Heizung_Status: base-type-encoding=NONE
    BT_FT_SP_ht_aktiv: base-type-encoding=NONE
    BT_FT_SP_lr_aktiv: base-type-encoding=NONE
    BT_FT_Sperrklinke: base-type-encoding=NONE
    BT_FT_SWA_Taster: base-type-encoding=NONE
    BT_FT_TAG_betaetigt: base-type-encoding=NONE
    BT_FT_TCR_Mode_aktiv: base-type-encoding=NONE
    BT_FT_TD_Taste: base-type-encoding=NONE
    BT_FT_TD_Taste_Fehler: base-type-encoding=NONE
    BT_FT_TD_Taste_Status: base-type-encoding=NONE
    BT_FT_TIG_betaetigt: base-type-encoding=NONE
    BT_FT_Tuer_geoeffnet: base-type-encoding=NONE
    BT_FT_Tuer_nwakeup_geoeffnet: base-type-encoding=NONE
    BT_FT_Tuer_Status: base-type-encoding=NONE
    BT_FT_Tuer_Status_QBit: base-type-encoding=NONE
    BT_FT_Tueroeffnen_Warnung: base-type-encoding=NONE
    BT_FT_Tuerschloss_defekt: base-type-encoding=NONE
    BT_FT_UEKB_aktiviert: base-type-encoding=NONE
    BT_FT_Unlock_Taster: base-type-encoding=NONE
    BT_FT_Unten_Block_erw: base-type-encoding=NONE
    BT_FT_verriegelt: base-type-encoding=NONE
    BT_FT_Zuziehhilfe_aktiv: base-type-encoding=NONE
    BT_Gateway_Matrix_Generation: base-type-encoding=NONE
    BT_Gateway_Matrix_Version: base-type-encoding=NONE
    BT_Gateway_Nachlauftyp: base-type-encoding=NONE
    BT_Gateway_SNI_10: base-type-encoding=NONE
    BT_GW_KD_Fehler: base-type-encoding=NONE
    BT_HBFS_ASW_HMI_defekt: base-type-encoding=NONE
    BT_HBFS_ASW_Warnton: base-type-encoding=NONE
    BT_HBFS_ASW_Warnung_Aussenlicht: base-type-encoding=NONE
    BT_HBFS_ASW_Warnung_VAS: base-type-encoding=NONE
    BT_HBFS_FH_Bew_hoch: base-type-encoding=NONE
    BT_HBFS_FH_Bew_tief: base-type-encoding=NONE
    BT_HBFS_FH_Block: base-type-encoding=NONE
    BT_HBFS_FH_Fang: base-type-encoding=NONE
    BT_HBFS_FH_normiert: base-type-encoding=NONE
    BT_HBFS_FH_Oeffnung: base-type-encoding=NONE
    BT_HBFS_FH_S_AutoHoch: base-type-encoding=NONE
    BT_HBFS_FH_S_AutoTief: base-type-encoding=NONE
    BT_HBFS_FH_S_HFS_AutoHoch: base-type-encoding=NONE
    BT_HBFS_FH_S_HFS_AutoTief: base-type-encoding=NONE
    BT_HBFS_FH_S_HFS_ManHoch: base-type-encoding=NONE
    BT_HBFS_FH_S_HFS_ManTief: base-type-encoding=NONE
    BT_HBFS_FH_S_ManHoch: base-type-encoding=NONE
    BT_HBFS_FH_S_ManTief: base-type-encoding=NONE
    BT_HBFS_FH_Thermo: base-type-encoding=NONE
    BT_HBFS_gesafet: base-type-encoding=NONE
    BT_HBFS_Heckrollotaster_betaetigt: base-type-encoding=NONE
    BT_HBFS_Lock_Taster: base-type-encoding=NONE
    BT_HBFS_MRollo_Schalter: base-type-encoding=NONE
    BT_HBFS_Oben_Block_erw: base-type-encoding=NONE
    BT_HBFS_SAD_Schalter: base-type-encoding=NONE
    BT_HBFS_Seitenrollo_hoch: base-type-encoding=NONE
    BT_HBFS_Seitenrollo_tief: base-type-encoding=NONE
    BT_HBFS_Sperrklinke: base-type-encoding=NONE
    BT_HBFS_Status_eTAG: base-type-encoding=NONE
    BT_HBFS_Status_KiSi: base-type-encoding=NONE
    BT_HBFS_Status_KiSi_inv: base-type-encoding=NONE
    BT_HBFS_TAG_betaetigt: base-type-encoding=NONE
    BT_HBFS_TCR_Mode_aktiv: base-type-encoding=NONE
    BT_HBFS_TIG_betaetigt: base-type-encoding=NONE
    BT_HBFS_Tuer_geoeffnet: base-type-encoding=NONE
    BT_HBFS_Tuer_Status: base-type-encoding=NONE
    BT_HBFS_Tuer_Status_QBit: base-type-encoding=NONE
    BT_HBFS_Tueroeffnen_Warnung: base-type-encoding=NONE
    BT_HBFS_Tuerschloss_defekt: base-type-encoding=NONE
    BT_HBFS_UEKB_aktiviert: base-type-encoding=NONE
    BT_HBFS_Unlock_Taster: base-type-encoding=NONE
    BT_HBFS_Unten_Block_erw: base-type-encoding=NONE
    BT_HBFS_verriegelt: base-type-encoding=NONE
    BT_HBFS_Zuziehhilfe_aktiv: base-type-encoding=NONE
    BT_HBFT_Kisi_Fehler: base-type-encoding=NONE
    BT_HCP1_02_BZ: base-type-encoding=NONE
    BT_HCP1_02_CRC: base-type-encoding=NONE
    BT_HCP3Sys03_KD_Fehler: base-type-encoding=NONE
    BT_HCP3Sys03_SNI_10: base-type-encoding=NONE
    BT_HFS_ASW_HMI_defekt: base-type-encoding=NONE
    BT_HFS_ASW_Warnton: base-type-encoding=NONE
    BT_HFS_ASW_Warnung_Aussenlicht: base-type-encoding=NONE
    BT_HFS_ASW_Warnung_VAS: base-type-encoding=NONE
    BT_HFS_FH_Bew_hoch: base-type-encoding=NONE
    BT_HFS_FH_Bew_tief: base-type-encoding=NONE
    BT_HFS_FH_Block: base-type-encoding=NONE
    BT_HFS_FH_Fang: base-type-encoding=NONE
    BT_HFS_FH_normiert: base-type-encoding=NONE
    BT_HFS_FH_Oeffnung: base-type-encoding=NONE
    BT_HFS_FH_S_AutoHoch: base-type-encoding=NONE
    BT_HFS_FH_S_AutoTief: base-type-encoding=NONE
    BT_HFS_FH_S_HBFS_AutoHoch: base-type-encoding=NONE
    BT_HFS_FH_S_HBFS_AutoTief: base-type-encoding=NONE
    BT_HFS_FH_S_HBFS_ManHoch: base-type-encoding=NONE
    BT_HFS_FH_S_HBFS_ManTief: base-type-encoding=NONE
    BT_HFS_FH_S_ManHoch: base-type-encoding=NONE
    BT_HFS_FH_S_ManTief: base-type-encoding=NONE
    BT_HFS_FH_Thermo: base-type-encoding=NONE
    BT_HFS_gesafet: base-type-encoding=NONE
    BT_HFS_Heckrollotaster_betaetigt: base-type-encoding=NONE
    BT_HFS_Lock_Taster: base-type-encoding=NONE
    BT_HFS_MRollo_Schalter: base-type-encoding=NONE
    BT_HFS_Oben_Block_erw: base-type-encoding=NONE
    BT_HFS_SAD_Schalter: base-type-encoding=NONE
    BT_HFS_Seitenrollo_hoch: base-type-encoding=NONE
    BT_HFS_Seitenrollo_tief: base-type-encoding=NONE
    BT_HFS_Sperrklinke: base-type-encoding=NONE
    BT_HFS_Status_eTAG: base-type-encoding=NONE
    BT_HFS_Status_KiSi: base-type-encoding=NONE
    BT_HFS_TAG_betaetigt: base-type-encoding=NONE
    BT_HFS_TCR_Mode_aktiv: base-type-encoding=NONE
    BT_HFS_TIG_betaetigt: base-type-encoding=NONE
    BT_HFS_Tuer_geoeffnet: base-type-encoding=NONE
    BT_HFS_Tuer_Status: base-type-encoding=NONE
    BT_HFS_Tuer_Status_QBit: base-type-encoding=NONE
    BT_HFS_Tueroeffnen_Warnung: base-type-encoding=NONE
    BT_HFS_Tuerschloss_defekt: base-type-encoding=NONE
    BT_HFS_UEKB_aktiviert: base-type-encoding=NONE
    BT_HFS_Unlock_Taster: base-type-encoding=NONE
    BT_HFS_Unten_Block_erw: base-type-encoding=NONE
    BT_HFS_verriegelt: base-type-encoding=NONE
    BT_HFS_Zuziehhilfe_aktiv: base-type-encoding=NONE
    BT_HFT_Kisi_Fehler: base-type-encoding=NONE
    BT_HSH_Taster: base-type-encoding=NONE
    BT_HUD_Abschaltstufe: base-type-encoding=NONE
    BT_HUD_KD_Fehler: base-type-encoding=NONE
    BT_HUD_KompSchutz: base-type-encoding=NONE
    BT_HUD_Nachlauftyp: base-type-encoding=NONE
    BT_HUD_SNI_10: base-type-encoding=NONE
    BT_HUD_Transport_Mode: base-type-encoding=NONE
    BT_HWP_01_BZ: base-type-encoding=NONE
    BT_HWP_01_CRC: base-type-encoding=NONE
    BT_HWP_HMI_ASIL_Color: base-type-encoding=NONE
    BT_HWP_HMI_State: base-type-encoding=NONE
    BT_ICAS3Sys01_KD_Fehler: base-type-encoding=NONE
    BT_ICAS3Sys01_SNI_10: base-type-encoding=NONE
    BT_IMMO_ClampPermStatus: base-type-encoding=NONE
    BT_IMMO_Display: base-type-encoding=NONE
    BT_Info_El_KD_Fehler: base-type-encoding=NONE
    BT_Info_El_Nachlauftyp: base-type-encoding=NONE
    BT_Info_El_SNI_10: base-type-encoding=NONE
    BT_IP_TS_CTO_01_Data: base-type-size=8, base-type-encoding=ISO-8859-1
    BT_IP_TS_DTO_{01..04}_Data: base-type-size=8, base-type-encoding=ISO-8859-1
    BT_IRUE_Taster_Fkts_LED: base-type-encoding=NONE
    BT_Kessy_KeylessAccess_01_BZ: base-type-encoding=NONE
    BT_Kessy_KeylessAccess_01_CRC: base-type-encoding=NONE
    BT_KL_AC_Aktiv: base-type-encoding=NONE
    BT_KL_AC_Schalter: base-type-encoding=NONE
    BT_KL_Anf_AussenspiegelHzg: base-type-encoding=NONE
    BT_KL_Beschlagsgefahr: base-type-encoding=NONE
    BT_KL_ECO_Aktiv: base-type-encoding=NONE
    BT_KL_ECO_PRO_Aktiv: base-type-encoding=NONE
    BT_KL_Eps_Innen: base-type-encoding=NONE
    BT_KL_ErwVK_Anf: base-type-encoding=NONE
    BT_KL_FSA_Luftfeuchte_rel: base-type-encoding=NONE
    BT_KL_FSA_Taupunkt: base-type-encoding=NONE
    BT_KL_FSH_Anf: base-type-encoding=NONE
    BT_KL_FSH_ansteuern: base-type-encoding=NONE
    BT_KL_FSH_Soll_P: base-type-encoding=NONE
    BT_KL_Geblaese_Fond_Status: base-type-encoding=NONE
    BT_KL_Geblaese_Status: base-type-encoding=NONE
    BT_KL_Heizbedarf: base-type-encoding=NONE
    BT_KL_Heizbedarf_Z{1..4}: base-type-encoding=NONE
    BT_KL_Heizlstg_Delta_Eingriff: base-type-encoding=NONE
    BT_KL_HSH_Soll: base-type-encoding=NONE
    BT_KL_I_Geblaese: base-type-encoding=NONE
    BT_KL_Innen_Temp: base-type-encoding=NONE
    BT_KL_Kuehlbedarf: base-type-encoding=NONE
    BT_KL_Kuehllstg_Delta_Eingriff: base-type-encoding=NONE
    BT_KL_Kundeneingriff_Geblaese: base-type-encoding=NONE
    BT_KL_Kundeneingriff_Geblaese_Z{1..4}: base-type-encoding=NONE
    BT_KL_Leistungspriorisierung: base-type-encoding=NONE
    BT_KL_Luftfeuchte_vVerd_Front: base-type-encoding=NONE
    BT_KL_Luftmasse_Gesamt_Z{1..4}: base-type-encoding=NONE
    BT_KL_NV_Energie_Anf: base-type-encoding=NONE
    BT_KL_QBit_Sonnenintensitaet: base-type-encoding=NONE
    BT_KL_Restwaerme_aktiv: base-type-encoding=NONE
    BT_KL_SIH_Soll_li: base-type-encoding=NONE
    BT_KL_SIH_Soll_re: base-type-encoding=NONE
    BT_KL_SIL_Soll_li: base-type-encoding=NONE
    BT_KL_SIL_Soll_re: base-type-encoding=NONE
    BT_KL_Solarluefter_aktiv: base-type-encoding=NONE
    BT_KL_Sonnenintensitaet: base-type-encoding=NONE
    BT_KL_Status_Klimastil: base-type-encoding=NONE
    BT_KL_STH_aktiv: base-type-encoding=NONE
    BT_KL_STL_aktiv: base-type-encoding=NONE
    BT_KL_Temp_vor_Verdampfer: base-type-encoding=NONE
    BT_KL_Tempklappe_Fond: base-type-encoding=NONE
    BT_KL_Tempklappe_li: base-type-encoding=NONE
    BT_KL_Tempklappe_re: base-type-encoding=NONE
    BT_KL_Thermischer_Bedarf: base-type-encoding=NONE
    BT_KL_Thermomanagement: base-type-encoding=NONE
    BT_KL_Umluftklappe_Status: base-type-encoding=NONE
    BT_KL_VK_Anf: base-type-encoding=NONE
    BT_KL_Vorkond_Strategie: base-type-encoding=NONE
    BT_KL_ZR_Anforderung: base-type-encoding=NONE
    BT_KL_Zuheizer_Freigabe: base-type-encoding=NONE
    BT_KL_Zustand: base-type-encoding=NONE
    BT_KN_AMP_BusKnockOut: base-type-encoding=NONE
    BT_KN_AMP_BusKnockOutTimer: base-type-encoding=NONE
    BT_KN_AMP_DiagPfad_V12: base-type-encoding=NONE
    BT_KN_AMP_ECUKnockOut: base-type-encoding=NONE
    BT_KN_AMP_ECUKnockOutTimer: base-type-encoding=NONE
    BT_KN_CCF_BusKnockOut: base-type-encoding=NONE
    BT_KN_CCF_BusKnockOutTimer: base-type-encoding=NONE
    BT_KN_CCF_DiagPfad_V12: base-type-encoding=NONE
    BT_KN_CCF_ECUKnockOut: base-type-encoding=NONE
    BT_KN_CCF_ECUKnockOutTimer: base-type-encoding=NONE
    BT_KN_CID_BusKnockOut: base-type-encoding=NONE
    BT_KN_CID_BusKnockOutTimer: base-type-encoding=NONE
    BT_KN_CID_DiagPfad_V12: base-type-encoding=NONE
    BT_KN_CID_ECUKnockOut: base-type-encoding=NONE
    BT_KN_CID_ECUKnockOutTimer: base-type-encoding=NONE
    BT_KN_DispKBI_FS_BusKnockOut: base-type-encoding=NONE
    BT_KN_DispKBI_FS_BusKnockOutTimer: base-type-encoding=NONE
    BT_KN_DispKBI_FS_DiagPfad_V12: base-type-encoding=NONE
    BT_KN_DispKBI_FS_ECUKnockOut: base-type-encoding=NONE
    BT_KN_DispKBI_FS_ECUKnockOutTimer: base-type-encoding=NONE
    BT_KN_Gateway_BusKnockOut: base-type-encoding=NONE
    BT_KN_Gateway_BusKnockOutTimer: base-type-encoding=NONE
    BT_KN_Gateway_DiagPfad_V12: base-type-encoding=NONE
    BT_KN_Gateway_ECUKnockOut: base-type-encoding=NONE
    BT_KN_Gateway_ECUKnockOutTimer: base-type-encoding=NONE
    BT_KN_HCP3Sys03_DiagPfad_V12: base-type-encoding=NONE
    BT_KN_HUD_BusKnockOut: base-type-encoding=NONE
    BT_KN_HUD_BusKnockOutTimer: base-type-encoding=NONE
    BT_KN_HUD_DiagPfad_V12: base-type-encoding=NONE
    BT_KN_HUD_ECUKnockOut: base-type-encoding=NONE
    BT_KN_HUD_ECUKnockOutTimer: base-type-encoding=NONE
    BT_KN_ICAS3Sys01_DiagPfad_V12: base-type-encoding=NONE
    BT_KN_Info_El_BusKnockOut: base-type-encoding=NONE
    BT_KN_Info_El_BusKnockOutTimer: base-type-encoding=NONE
    BT_KN_Info_El_DiagPfad_V12: base-type-encoding=NONE
    BT_KN_Info_El_ECUKnockOut: base-type-encoding=NONE
    BT_KN_Info_El_ECUKnockOutTimer: base-type-encoding=NONE
    BT_KN_PID_BusKnockOut: base-type-encoding=NONE
    BT_KN_PID_BusKnockOutTimer: base-type-encoding=NONE
    BT_KN_PID_DiagPfad_V12: base-type-encoding=NONE
    BT_KN_PID_ECUKnockOut: base-type-encoding=NONE
    BT_KN_PID_ECUKnockOutTimer: base-type-encoding=NONE
    BT_KN_WLC1_BusKnockOut: base-type-encoding=NONE
    BT_KN_WLC1_BusKnockOutTimer: base-type-encoding=NONE
    BT_KN_WLC1_DiagPfad_V12: base-type-encoding=NONE
    BT_KN_WLC1_ECUKnockOut: base-type-encoding=NONE
    BT_KN_WLC1_ECUKnockOutTimer: base-type-encoding=NONE
    BT_KN_WLC2_BusKnockOut: base-type-encoding=NONE
    BT_KN_WLC2_BusKnockOutTimer: base-type-encoding=NONE
    BT_KN_WLC2_DiagPfad_V12: base-type-encoding=NONE
    BT_KN_WLC2_ECUKnockOut: base-type-encoding=NONE
    BT_KN_WLC2_ECUKnockOutTimer: base-type-encoding=NONE
    BT_KRH_Soll_li: base-type-encoding=NONE
    BT_KRH_Soll_re: base-type-encoding=NONE
    BT_KST_Anf_Klemmenfreigabe_ELV: base-type-encoding=NONE
    BT_KST_Ausparken_Betrieb: base-type-encoding=NONE
    BT_KST_Ausstiegswunsch_Status: base-type-encoding=NONE
    BT_KST_aut_Abschaltung_Zuendung: base-type-encoding=NONE
    BT_KST_BulbCheckReq: base-type-encoding=NONE
    BT_KST_ComfortReadyStatus: base-type-encoding=NONE
    BT_KST_Deaktivierungs_Trigger: base-type-encoding=NONE
    BT_KST_Fahrerhinweis_{1..6}: base-type-encoding=NONE
    BT_KST_KL_15: base-type-encoding=NONE
    BT_KST_Kl_50_Startanforderung: base-type-encoding=NONE
    BT_KST_Kl_S: base-type-encoding=NONE
    BT_KST_Kl_X: base-type-encoding=NONE
    BT_KST_Sonderzustand_Anforderung: base-type-encoding=NONE
    BT_KST_Sonderzustand_Status: base-type-encoding=NONE
    BT_KST_StPtAcvReq: base-type-encoding=NONE
    BT_KST_StPtDeacReq: base-type-encoding=NONE
    BT_KST_Txt_Panikabschaltung: base-type-encoding=NONE
    BT_KST_Warn_P1_ZAT_def: base-type-encoding=NONE
    BT_KST_Warn_P2_ZAT_def: base-type-encoding=NONE
    BT_KST_Wegstrecke_Challenge: base-type-encoding=NONE
    BT_KST_WFS_Fahrfreigabe_Anforderung: base-type-encoding=NONE
    BT_KST_ZAT_betaetigt: base-type-encoding=NONE
    BT_KY_Bereich: base-type-encoding=NONE
    BT_KY_EasyClose_Abbruch: base-type-encoding=NONE
    BT_KY_EasyClose_Status: base-type-encoding=NONE
    BT_KY_FDF_Taste: base-type-encoding=NONE
    BT_KY_Front_Entr_Autorisiert_02: base-type-encoding=NONE
    BT_KY_Front_Verr_Autorisiert_02: base-type-encoding=NONE
    BT_KY_Fzg_Verlassen_erkannt: base-type-encoding=NONE
    BT_KY_Fzg_Zugang_erkannt: base-type-encoding=NONE
    BT_KY_HD_Auffahrt: base-type-encoding=NONE
    BT_KY_HD_Entr_Autorisiert_02: base-type-encoding=NONE
    BT_KY_HD_Verr_Autorisiert_02: base-type-encoding=NONE
    BT_KY_HD_Zufahrt: base-type-encoding=NONE
    BT_KY_IDG_in_Reichweite: base-type-encoding=NONE
    BT_KY_Indikator_Mehrere_Schluessel: base-type-encoding=NONE
    BT_KY_Mehrere_Schluessel_aussen: base-type-encoding=NONE
    BT_KY_Position: base-type-encoding=NONE
    BT_KY_Schluessel_im_Fzg: base-type-encoding=NONE
    BT_KY_ZV_Signatur: base-type-encoding=NONE
    BT_LS_Autobahnfahrlicht: base-type-encoding=NONE
    BT_LS_defekt: base-type-encoding=NONE
    BT_LS_Dunkel: base-type-encoding=NONE
    BT_LS_Error: base-type-encoding=NONE
    BT_LS_Helligkeit_FW: base-type-encoding=NONE
    BT_LS_Helligkeit_global: base-type-encoding=NONE
    BT_LS_Licht_ein: base-type-encoding=NONE
    BT_LS_Licht_ein_invers: base-type-encoding=NONE
    BT_LS_Verbau: base-type-encoding=NONE
    BT_LSR_CL30_Overvolt_Error: base-type-encoding=NONE
    BT_LSR_CL30_Undervoltage_Error: base-type-encoding=NONE
    BT_LSR_dimming_post_carriage: base-type-encoding=NONE
    BT_LSR_dimming_PWM: base-type-encoding=NONE
    BT_LSR_EEPROM_Error_TF: base-type-encoding=NONE
    BT_LSR_EEPROM_Error_TNCTOC: base-type-encoding=NONE
    BT_LSR_SW_inconsistent_TF: base-type-encoding=NONE
    BT_LSR_SW_inconsistent_TNCTOC: base-type-encoding=NONE
    BT_LSR_SystemMode: base-type-encoding=NONE
    BT_LSR_VW_SL_App_SW_Version_Nr: base-type-encoding=NONE
    BT_LSR_VW_SL_HW_Version_Nr: base-type-encoding=NONE
    BT_LSR_VW_SL_Spare_Part_Nr_EndNr: base-type-encoding=NONE
    BT_LSR_VW_SL_Spare_Part_Nr_Index: base-type-encoding=NONE
    BT_LSR_VW_SL_Spare_Part_Nr_MittelNr: base-type-encoding=NONE
    BT_LSR_VW_SL_Spare_Part_Nr_TMA: base-type-encoding=NONE
    BT_MDK_Change_Polling_Mode: base-type-encoding=NONE
    BT_MDK_Function_State: base-type-encoding=NONE
    BT_MemFT_Pos1_EE: base-type-encoding=NONE
    BT_MemFT_Pos{2..4}: base-type-encoding=NONE
    BT_MFL_Eventcode_1: base-type-encoding=NONE
    BT_MFL_Eventcode_2: base-type-encoding=NONE
    BT_MFL_Marke: base-type-encoding=NONE
    BT_MFL_Paddle_Verbau: base-type-encoding=NONE
    BT_MFL_Signalhorn: base-type-encoding=NONE
    BT_MFL_Tastencode_1: base-type-encoding=NONE
    BT_MFL_Tastencode_2: base-type-encoding=NONE
    BT_MFL_Tip_Down: base-type-encoding=NONE
    BT_MFL_Tip_links_Err: base-type-encoding=NONE
    BT_MFL_Tip_rechts_Err: base-type-encoding=NONE
    BT_MFL_Tip_Up: base-type-encoding=NONE
    BT_MFL_Variante: base-type-encoding=NONE
    BT_MKGO_FBS_{01..05}: base-type-size=8, base-type-encoding=ISO-8859-1
    BT_MM_PropulsionSystemActive: base-type-encoding=NONE
    BT_MTBT_M_Taste: base-type-encoding=NONE
    BT_MTBT_On_Off: base-type-encoding=NONE
    BT_MTBT_Pos{1..4}: base-type-encoding=NONE
    BT_MTFT_M_Taste: base-type-encoding=NONE
    BT_MTFT_On_Off: base-type-encoding=NONE
    BT_MTFT_Pos1_EE: base-type-encoding=NONE
    BT_MTFT_Pos{2..4}: base-type-encoding=NONE
    BT_MTFT_Verst_akt: base-type-encoding=NONE
    BT_MTHBFS_M_Taste: base-type-encoding=NONE
    BT_MTHBFS_Pos{1..3}: base-type-encoding=NONE
    BT_MTHFS_M_Taste: base-type-encoding=NONE
    BT_MTHFS_Pos{1..3}: base-type-encoding=NONE
    BT_NFC_MiKo_NFC_Device_gekoppelt: base-type-encoding=NONE
    BT_NFC_MiKo_NFC_Device_Status: base-type-encoding=NONE
    BT_NFC_TGS_Kapa_deaktivieren: base-type-encoding=NONE
    BT_NM_aktiv_AutomotiveEdge_{1..5}: base-type-encoding=NONE
    BT_NM_aktiv_Backend_KomGW: base-type-encoding=NONE
    BT_NM_aktiv_BAP_Kommunikation_SYS: base-type-encoding=NONE
    BT_NM_aktiv_Batteriekonditionierung: base-type-encoding=NONE
    BT_NM_aktiv_Call: base-type-encoding=NONE
    BT_NM_aktiv_ConnectVerbund_UseCase{1..6}: base-type-encoding=NONE
    BT_NM_aktiv_E3_SW_Plattform_{1..5}: base-type-encoding=NONE
    BT_NM_aktiv_Erw_HV_Ladefunktion: base-type-encoding=NONE
    BT_NM_aktiv_Gefahreninfo: base-type-encoding=NONE
    BT_NM_aktiv_GoodbyeScreen: base-type-encoding=NONE
    BT_NM_aktiv_HV_Laden: base-type-encoding=NONE
    BT_NM_aktiv_HVEM: base-type-encoding=NONE
    BT_NM_aktiv_HVK: base-type-encoding=NONE
    BT_NM_aktiv_HVLM: base-type-encoding=NONE
    BT_NM_aktiv_Innenraumerlebnis: base-type-encoding=NONE
    BT_NM_aktiv_Internetverbindung: base-type-encoding=NONE
    BT_NM_aktiv_IVIPartition_{1..3}: base-type-encoding=NONE
    BT_NM_aktiv_Key_Authentifiz_SMS: base-type-encoding=NONE
    BT_NM_aktiv_KL30_Reset_Kombi: base-type-encoding=NONE
    BT_NM_aktiv_Ladezustand: base-type-encoding=NONE
    BT_NM_aktiv_MVEM_Fremdladung: base-type-encoding=NONE
    BT_NM_aktiv_MVEM_Pos_RSG: base-type-encoding=NONE
    BT_NM_aktiv_NVEM: base-type-encoding=NONE
    BT_NM_aktiv_NVEM2: base-type-encoding=NONE
    BT_NM_aktiv_OnlineRemoteUpdate: base-type-encoding=NONE
    BT_NM_aktiv_OnOff_Lautstaerkeregler: base-type-encoding=NONE
    BT_NM_aktiv_Remote_Unlock_Lock: base-type-encoding=NONE
    BT_NM_aktiv_RemoteDiensteGW: base-type-encoding=NONE
    BT_NM_aktiv_RemoteStart: base-type-encoding=NONE
    BT_NM_aktiv_RemoteVehicleTracking: base-type-encoding=NONE
    BT_NM_aktiv_SOK_Master_Anf_Info_El: base-type-encoding=NONE
    BT_NM_aktiv_SubbusSteuerung_HCP5: base-type-encoding=NONE
    BT_NM_aktiv_SysPartition_{1..3}: base-type-encoding=NONE
    BT_NM_aktiv_Tankinhalt_ermitteln: base-type-encoding=NONE
    BT_NM_aktiv_Timer_abgelaufen: base-type-encoding=NONE
    BT_NM_aktiv_User_Anmeldung: base-type-encoding=NONE
    BT_NM_aktiv_VehicleStatReport_Main: base-type-encoding=NONE
    BT_NM_aktiv_WarnblinkerInfo: base-type-encoding=NONE
    BT_NM_AMP_FCIB: base-type-encoding=ISO-8859-1
    BT_NM_CCF_CBV_AWB: base-type-encoding=NONE
    BT_NM_CCF_CBV_CRI: base-type-encoding=NONE
    BT_NM_CCF_FCAB: base-type-encoding=ISO-8859-1
    BT_NM_CCF_FCIB: base-type-encoding=ISO-8859-1
    BT_NM_CCF_NM_aktiv_Diag: base-type-encoding=NONE
    BT_NM_CCF_NM_aktiv_KL15: base-type-encoding=NONE
    BT_NM_CCF_NM_aktiv_Tmin: base-type-encoding=NONE
    BT_NM_CCF_NM_State: base-type-encoding=NONE
    BT_NM_CCF_SNI_10: base-type-encoding=NONE
    BT_NM_CCF_UDS_CC: base-type-encoding=NONE
    BT_NM_CCF_Wakeup_V12: base-type-encoding=NONE
    BT_NM_CID_CBV_AWB: base-type-encoding=NONE
    BT_NM_CID_CBV_CRI: base-type-encoding=NONE
    BT_NM_CID_FCAB: base-type-encoding=ISO-8859-1
    BT_NM_CID_FCIB: base-type-encoding=ISO-8859-1
    BT_NM_CID_Lokalaktiv: base-type-encoding=NONE
    BT_NM_CID_NM_aktiv_Diag: base-type-encoding=NONE
    BT_NM_CID_NM_aktiv_KL15: base-type-encoding=NONE
    BT_NM_CID_NM_aktiv_Tmin: base-type-encoding=NONE
    BT_NM_CID_NM_State: base-type-encoding=NONE
    BT_NM_CID_SNI_10: base-type-encoding=NONE
    BT_NM_CID_Subsystemaktiv: base-type-encoding=NONE
    BT_NM_CID_UDS_CC: base-type-encoding=NONE
    BT_NM_CID_Wakeup_V12: base-type-encoding=NONE
    BT_NM_DispKBI_FS_CBV_AWB: base-type-encoding=NONE
    BT_NM_DispKBI_FS_CBV_CRI: base-type-encoding=NONE
    BT_NM_DispKBI_FS_FCAB: base-type-encoding=ISO-8859-1
    BT_NM_DispKBI_FS_FCIB: base-type-encoding=ISO-8859-1
    BT_NM_DispKBI_FS_NM_aktiv_Diag: base-type-encoding=NONE
    BT_NM_DispKBI_FS_NM_aktiv_KL15: base-type-encoding=NONE
    BT_NM_DispKBI_FS_NM_aktiv_Tmin: base-type-encoding=NONE
    BT_NM_DispKBI_FS_NM_State: base-type-encoding=NONE
    BT_NM_DispKBI_FS_SNI_10: base-type-encoding=NONE
    BT_NM_DispKBI_FS_UDS_CC: base-type-encoding=NONE
    BT_NM_DispKBI_FS_Wakeup_V12: base-type-encoding=NONE
    BT_NM_Gateway_CBV_AWB: base-type-encoding=NONE
    BT_NM_Gateway_CBV_CRI: base-type-encoding=NONE
    BT_NM_Gateway_FCAB: base-type-encoding=ISO-8859-1
    BT_NM_Gateway_FCIB: base-type-encoding=ISO-8859-1
    BT_NM_Gateway_Lokalaktiv: base-type-encoding=NONE
    BT_NM_Gateway_NM_aktiv_CABaktiv: base-type-encoding=NONE
    BT_NM_Gateway_NM_aktiv_Diag: base-type-encoding=NONE
    BT_NM_Gateway_NM_aktiv_KL15: base-type-encoding=NONE
    BT_NM_Gateway_NM_aktiv_Tmin: base-type-encoding=NONE
    BT_NM_Gateway_NM_State: base-type-encoding=NONE
    BT_NM_Gateway_SNI_10: base-type-encoding=NONE
    BT_NM_Gateway_Subsystemaktiv: base-type-encoding=NONE
    BT_NM_Gateway_UDS_CC: base-type-encoding=NONE
    BT_NM_Gateway_Wakeup_V12: base-type-encoding=NONE
    BT_NM_GW_Abschaltstufe_aktiv: base-type-encoding=NONE
    BT_NM_GW_KompSchutz: base-type-encoding=NONE
    BT_NM_GW_Transport_Mode: base-type-encoding=NONE
    BT_NM_HUD_CBV_AWB: base-type-encoding=NONE
    BT_NM_HUD_CBV_CRI: base-type-encoding=NONE
    BT_NM_HUD_FCAB: base-type-encoding=ISO-8859-1
    BT_NM_HUD_FCIB: base-type-encoding=ISO-8859-1
    BT_NM_HUD_Lokalaktiv: base-type-encoding=NONE
    BT_NM_HUD_NM_aktiv_Diag: base-type-encoding=NONE
    BT_NM_HUD_NM_aktiv_KL15: base-type-encoding=NONE
    BT_NM_HUD_NM_aktiv_Tmin: base-type-encoding=NONE
    BT_NM_HUD_NM_State: base-type-encoding=NONE
    BT_NM_HUD_SNI_10: base-type-encoding=NONE
    BT_NM_HUD_Subsystemaktiv: base-type-encoding=NONE
    BT_NM_HUD_UDS_CC: base-type-encoding=NONE
    BT_NM_HUD_Wakeup_V12: base-type-encoding=NONE
    BT_NM_Info_El_CBV_AWB: base-type-encoding=NONE
    BT_NM_Info_El_CBV_CRI: base-type-encoding=NONE
    BT_NM_Info_El_FCAB: base-type-encoding=ISO-8859-1
    BT_NM_Info_El_FCIB: base-type-encoding=ISO-8859-1
    BT_NM_Info_El_NM_aktiv_CABaktiv: base-type-encoding=NONE
    BT_NM_Info_El_NM_aktiv_Diag: base-type-encoding=NONE
    BT_NM_Info_El_NM_aktiv_KL15: base-type-encoding=NONE
    BT_NM_Info_El_NM_aktiv_Tmin: base-type-encoding=NONE
    BT_NM_Info_El_NM_State: base-type-encoding=NONE
    BT_NM_Info_El_SNI_10: base-type-encoding=NONE
    BT_NM_Info_El_UDS_CC: base-type-encoding=NONE
    BT_NM_Info_El_Wakeup_V12: base-type-encoding=NONE
    BT_NM_LSR_1_CBV_AWB: base-type-encoding=NONE
    BT_NM_LSR_1_CBV_CRI: base-type-encoding=NONE
    BT_NM_LSR_1_FCAB: base-type-encoding=ISO-8859-1
    BT_NM_LSR_1_NM_aktiv_Diag: base-type-encoding=NONE
    BT_NM_LSR_1_NM_aktiv_KL15: base-type-encoding=NONE
    BT_NM_LSR_1_NM_aktiv_Tmin: base-type-encoding=NONE
    BT_NM_LSR_1_NM_State: base-type-encoding=NONE
    BT_NM_LSR_1_SNI_10: base-type-encoding=NONE
    BT_NM_LSR_1_UDS_CC: base-type-encoding=NONE
    BT_NM_LSR_1_Wakeup_V12: base-type-encoding=NONE
    BT_NM_PID_CBV_AWB: base-type-encoding=NONE
    BT_NM_PID_CBV_CRI: base-type-encoding=NONE
    BT_NM_PID_FCAB: base-type-encoding=ISO-8859-1
    BT_NM_PID_FCIB: base-type-encoding=ISO-8859-1
    BT_NM_PID_Lokalaktiv: base-type-encoding=NONE
    BT_NM_PID_NM_aktiv_Diag: base-type-encoding=NONE
    BT_NM_PID_NM_aktiv_KL15: base-type-encoding=NONE
    BT_NM_PID_NM_aktiv_Tmin: base-type-encoding=NONE
    BT_NM_PID_NM_State: base-type-encoding=NONE
    BT_NM_PID_SNI_10: base-type-encoding=NONE
    BT_NM_PID_Subsystemaktiv: base-type-encoding=NONE
    BT_NM_PID_UDS_CC: base-type-encoding=NONE
    BT_NM_PID_Wakeup_V12: base-type-encoding=NONE
    BT_NM_WLC1_CBV_AWB: base-type-encoding=NONE
    BT_NM_WLC1_CBV_CRI: base-type-encoding=NONE
    BT_NM_WLC1_FCAB: base-type-encoding=ISO-8859-1
    BT_NM_WLC1_FCIB: base-type-encoding=ISO-8859-1
    BT_NM_WLC1_NM_aktiv_Diag: base-type-encoding=NONE
    BT_NM_WLC1_NM_aktiv_KL15: base-type-encoding=NONE
    BT_NM_WLC1_NM_aktiv_Tmin: base-type-encoding=NONE
    BT_NM_WLC1_NM_State: base-type-encoding=NONE
    BT_NM_WLC1_SNI_10: base-type-encoding=NONE
    BT_NM_WLC1_UDS_CC: base-type-encoding=NONE
    BT_NM_WLC1_Wakeup_V12: base-type-encoding=NONE
    BT_NM_WLC2_CBV_AWB: base-type-encoding=NONE
    BT_NM_WLC2_CBV_CRI: base-type-encoding=NONE
    BT_NM_WLC2_FCAB: base-type-encoding=ISO-8859-1
    BT_NM_WLC2_FCIB: base-type-encoding=ISO-8859-1
    BT_NM_WLC2_NM_aktiv_Diag: base-type-encoding=NONE
    BT_NM_WLC2_NM_aktiv_KL15: base-type-encoding=NONE
    BT_NM_WLC2_NM_aktiv_Tmin: base-type-encoding=NONE
    BT_NM_WLC2_NM_State: base-type-encoding=NONE
    BT_NM_WLC2_SNI_10: base-type-encoding=NONE
    BT_NM_WLC2_UDS_CC: base-type-encoding=NONE
    BT_NM_WLC2_Wakeup_V12: base-type-encoding=NONE
    BT_NVEM_12_BZ: base-type-encoding=NONE
    BT_NVEM_12_CRC: base-type-encoding=NONE
    BT_NVEM_Abschaltstufe: base-type-encoding=NONE
    BT_NVEM_Bordnetz_Information: base-type-encoding=NONE
    BT_NVEM_Bordnetzdiagnose: base-type-encoding=NONE
    BT_NVEM_DC_iSoll_NV: base-type-encoding=NONE
    BT_NVEM_DC_uMin_NV: base-type-encoding=NONE
    BT_NVEM_DC_uSoll_NV: base-type-encoding=NONE
    BT_NVEM_Freigabe_OTA: base-type-encoding=NONE
    BT_NVEM_Last_Anf: base-type-encoding=NONE
    BT_NVEM_MV_DC_iSoll_NV: base-type-encoding=NONE
    BT_NVEM_MV_DC_uMinLV: base-type-encoding=NONE
    BT_NVEM_MV_DC_uSollLV: base-type-encoding=NONE
    BT_NVEM_NV_BAT_ZellStatus_Index_Anf: base-type-encoding=NONE
    BT_NVEM_NV_BAT_ZellStatus_Typ_Anf: base-type-encoding=NONE
    BT_NVEM_Verbraucher_Information: base-type-encoding=NONE
    BT_NVEM3_Absch_SCR: base-type-encoding=NONE
    BT_OBD_Abs_Load_Val: base-type-encoding=NONE
    BT_OBD_Abs_Pedal_Pos: base-type-encoding=NONE
    BT_OBD_Abs_Throttle_Pos: base-type-encoding=NONE
    BT_OBD_Aussen_Temp_gef: base-type-encoding=NONE
    BT_OBD_Barometric_Pressure: base-type-encoding=NONE
    BT_OBD_Calc_Load_Val: base-type-encoding=NONE
    BT_OBD_ClearMem_Inhibit: base-type-encoding=NONE
    BT_OBD_Driving_Cycle: base-type-encoding=NONE
    BT_OBD_Eng_Cool_Temp: base-type-encoding=NONE
    BT_OBD_Engine_RPM: base-type-encoding=NONE
    BT_OBD_Kaltstart_Denominator: base-type-encoding=NONE
    BT_OBD_MIL: base-type-encoding=NONE
    BT_OBD_Minimum_Trip: base-type-encoding=NONE
    BT_OBD_Normed_Trip: base-type-encoding=NONE
    BT_OBD_Normed_Trip_Wout_Fu_Cdn: base-type-encoding=NONE
    BT_OBD_NumDcyMilOnReq: base-type-encoding=NONE
    BT_OBD_QBit_Aussen_Temp: base-type-encoding=NONE
    BT_OBD_Sperrung_IUMPR: base-type-encoding=NONE
    BT_OBD_Sperrung_Kaltstart_Denom: base-type-encoding=NONE
    BT_OBD_Typ: base-type-encoding=NONE
    BT_OBD_Warm_Up_Cycle: base-type-encoding=NONE
    BT_OnlineRemoteUpdateControlA: base-type-encoding=NONE
    BT_OnlineRemoteUpdateControlD: base-type-encoding=NONE
    BT_OnlineRemoteUpdateControlOldA: base-type-encoding=NONE
    BT_OnlineRemoteUpdateControlOldD: base-type-encoding=NONE
    BT_ORU_AgLgtSdsl: base-type-encoding=NONE
    BT_ORU_Control_A_01_BZ: base-type-encoding=NONE
    BT_ORU_Control_A_01_CRC: base-type-encoding=NONE
    BT_ORU_Control_D_01_BZ: base-type-encoding=NONE
    BT_ORU_Control_D_01_CRC: base-type-encoding=NONE
    BT_ORU_Status: base-type-encoding=NONE
    BT_OruControlReleaseA: base-type-encoding=NONE
    BT_OruControlReleaseD: base-type-encoding=NONE
    BT_OruControlStateA: base-type-encoding=NONE
    BT_OruControlStateD: base-type-encoding=NONE
    BT_OruHostUpdateA: base-type-encoding=NONE
    BT_OruHostUpdateD: base-type-encoding=NONE
    BT_OruIntegrityCheckActiveA: base-type-encoding=NONE
    BT_OruIntegrityCheckActiveD: base-type-encoding=NONE
    BT_OruReleasePartitionSwitchA: base-type-encoding=NONE
    BT_OruReleasePartitionSwitchD: base-type-encoding=NONE
    BT_OruVehicleLockRequestA: base-type-encoding=NONE
    BT_OruVehicleLockRequestD: base-type-encoding=NONE
    BT_OTA_FlgPTAcvPhdA: base-type-encoding=NONE
    BT_OTAMC_D_01_BZ: base-type-encoding=NONE
    BT_OTAMC_D_01_CRC: base-type-encoding=NONE
    BT_PID_Backlight_OpenCircuit: base-type-encoding=NONE
    BT_PID_Backlight_ShortCircuit: base-type-encoding=NONE
    BT_PID_CL_30F: base-type-encoding=NONE
    BT_PID_CL30_Overvoltage_Error: base-type-encoding=NONE
    BT_PID_CL30_Undervoltage_Error: base-type-encoding=NONE
    BT_PID_DispDerating: base-type-encoding=NONE
    BT_PID_EEPROM_Error: base-type-encoding=NONE
    BT_PID_FanSpeed: base-type-encoding=NONE
    BT_PID_Haptik_Errorstate: base-type-encoding=NONE
    BT_PID_HDCP_Status: base-type-encoding=NONE
    BT_PID_KD_Fehler: base-type-encoding=NONE
    BT_PID_LVDS_Errorstate: base-type-encoding=NONE
    BT_PID_LVDS_Splitter_Errorstate: base-type-encoding=NONE
    BT_PID_LVDS_State: base-type-encoding=NONE
    BT_PID_Nachlauftyp: base-type-encoding=NONE
    BT_PID_OperatingTime_hr: base-type-encoding=NONE
    BT_PID_OperatingTime_min: base-type-encoding=NONE
    BT_PID_PCB_Temp_Error: base-type-encoding=NONE
    BT_PID_PCB_TempSensor: base-type-encoding=NONE
    BT_PID_PCB_TempSensorMax: base-type-encoding=NONE
    BT_PID_Photosensor: base-type-encoding=NONE
    BT_PID_Proximity_Errorstate: base-type-encoding=NONE
    BT_PID_ShutterFoil_Errorstate: base-type-encoding=NONE
    BT_PID_Slider_Errorstate: base-type-encoding=NONE
    BT_PID_SNI_10: base-type-encoding=NONE
    BT_PID_State: base-type-encoding=NONE
    BT_PID_SW_inconsistent: base-type-encoding=NONE
    BT_PID_SystemMode: base-type-encoding=NONE
    BT_PID_Temp_Error: base-type-encoding=NONE
    BT_PID_TempSensor: base-type-encoding=NONE
    BT_PID_TempSensorMax: base-type-encoding=NONE
    BT_PID_Touch_Errorstate: base-type-encoding=NONE
    BT_PID_Touchstate: base-type-encoding=NONE
    BT_PID_VA_Communication_Init: base-type-size=8, base-type-encoding=ISO-8859-1
    BT_PID_VA_Communication_Init_Ack: base-type-size=8, base-type-encoding=ISO-8859-1
    BT_PID_VA_Response: base-type-size=8, base-type-encoding=ISO-8859-1
    BT_PID_VW_SL_App_SW_Version_Nr: base-type-encoding=NONE
    BT_PID_VW_SL_HW_Version_Nr: base-type-encoding=NONE
    BT_PID_VW_SL_Spare_Part_Nr_EndNr: base-type-encoding=NONE
    BT_PID_VW_SL_Spare_Part_Nr_Index: base-type-encoding=NONE
    BT_PID_VW_SL_Spare_Part_Nr_MittelNr: base-type-encoding=NONE
    BT_PID_VW_SL_Spare_Part_Nr_TMA: base-type-encoding=NONE
    BT_PTAcvSrv_StDrvMd: base-type-encoding=NONE
    BT_PTAcvSrv_StDrvPTAcvReqPmd: base-type-encoding=NONE
    BT_PTAcvSrv_StPTAcvReq: base-type-encoding=NONE
    BT_PTAcvSrv_StPwrMd: base-type-encoding=NONE
    BT_PTankCtl_StFuFlapCtl: base-type-encoding=NONE
    BT_PTERM_StCEStopDesHisSto: base-type-encoding=NONE
    BT_PTERO_StStrtStopDeacUsr: base-type-encoding=NONE
    BT_PTERO_WThDeacEv: base-type-encoding=NONE
    BT_RA_AM_Tuning: base-type-encoding=NONE
    BT_RA_Frequency: base-type-encoding=NONE
    BT_RA_Frequency_unit: base-type-encoding=NONE
    BT_RLS_BZ: base-type-encoding=NONE
    BT_RLS_HUD_Plausibilisierung: base-type-encoding=NONE
    BT_RLS_Qualifizierungsbit: base-type-encoding=NONE
    BT_RLS_ResponseError: base-type-encoding=NONE
    BT_RLS_Vorfeldhelligkeit_Boost: base-type-encoding=NONE
    BT_RLSs_01_Checksum: base-type-encoding=NONE
    BT_RS_AdaptierungError: base-type-encoding=NONE
    BT_RS_defekt: base-type-encoding=NONE
    BT_RS_Error: base-type-encoding=NONE
    BT_RS_Regenfahrlicht: base-type-encoding=NONE
    BT_RS_Regenmenge: base-type-encoding=NONE
    BT_RS_Schwall: base-type-encoding=NONE
    BT_RS_Verbau: base-type-encoding=NONE
    BT_RS_Verglasung_schliessen: base-type-encoding=NONE
    BT_RS_versParklage_Wischer: base-type-encoding=NONE
    BT_RS_Wischergeschwindigkeit: base-type-encoding=NONE
    BT_SI_Bus_Identifikation: base-type-encoding=NONE
    BT_SI_Diagnose_Aktiv: base-type-encoding=NONE
    BT_SI_FCAB: base-type-encoding=ISO-8859-1
    BT_SI_NWDF: base-type-encoding=NONE
    BT_SI_NWDF_30: base-type-encoding=NONE
    BT_SI_NWDF_gueltig: base-type-encoding=NONE
    BT_SI_P_Mode: base-type-encoding=NONE
    BT_SI_P_Mode_gueltig: base-type-encoding=NONE
    BT_SI_QRS_Mode: base-type-encoding=NONE
    BT_SI_T_Mode: base-type-encoding=NONE
    BT_SI_T_Schutz: base-type-encoding=NONE
    BT_SOK_FoD_Info_El_Req_Eth_Challeng: base-type-size=8, base-type-encoding=ISO-8859-1
    BT_SOK_FoD_Info_El_Resp_Eth_Challen: base-type-size=8, base-type-encoding=ISO-8859-1
    BT_SOK_ungeschuetzte_Zeit: base-type-size=8, base-type-encoding=ISO-8859-1
    BT_SOK_Zeit_Info_El_Challenge: base-type-size=8, base-type-encoding=ISO-8859-1
    BT_SOK_Zeit_Info_El_Zeit: base-type-size=8, base-type-encoding=ISO-8859-1
    BT_SP_abklappen: base-type-encoding=NONE
    BT_SP_anklappen: base-type-encoding=NONE
    BT_SP_ARA_Status: base-type-encoding=NONE
    BT_SP_Auswahl_li: base-type-encoding=NONE
    BT_SP_Auswahl_re: base-type-encoding=NONE
    BT_SP_Bordsteinfunktion: base-type-encoding=NONE
    BT_SP_BT_links: base-type-encoding=NONE
    BT_SP_BT_oben: base-type-encoding=NONE
    BT_SP_BT_rechts: base-type-encoding=NONE
    BT_SP_BT_unten: base-type-encoding=NONE
    BT_SP_FT_links: base-type-encoding=NONE
    BT_SP_FT_oben: base-type-encoding=NONE
    BT_SP_FT_rechts: base-type-encoding=NONE
    BT_SP_FT_unten: base-type-encoding=NONE
    BT_SP_Hzg_Taster: base-type-encoding=NONE
    BT_SP_normieren: base-type-encoding=NONE
    BT_SP_S_Klappen: base-type-encoding=NONE
    BT_SP_S_links: base-type-encoding=NONE
    BT_SP_S_oben: base-type-encoding=NONE
    BT_SP_S_rechts: base-type-encoding=NONE
    BT_SP_S_unten: base-type-encoding=NONE
    BT_SP_Spg_Verstellschalter_Fehler: base-type-encoding=NONE
    BT_SP_Status_Bordsteinfunktion: base-type-encoding=NONE
    BT_SP_Verstellschalter_Fehler: base-type-encoding=NONE
    BT_SSA_BFT_Amb_Bel_Fehler: base-type-encoding=NONE
    BT_SSA_BFT_Amb_Bel_Status: base-type-encoding=NONE
    BT_SSA_BFT_ASP_Heizung_Fehler: base-type-encoding=NONE
    BT_SSA_BFT_ASP_Heizung_Status: base-type-encoding=NONE
    BT_SSA_BFT_ASP_Klappung_Fehler: base-type-encoding=NONE
    BT_SSA_BFT_ASP_Klappung_Status: base-type-encoding=NONE
    BT_SSA_BFT_ASP_Spiegelglas_Fehler: base-type-encoding=NONE
    BT_SSA_BFT_ASP_Spiegelglas_Pos_X: base-type-encoding=NONE
    BT_SSA_BFT_ASP_Spiegelglas_Pos_Y: base-type-encoding=NONE
    BT_SSA_BFT_ASW_Fehler: base-type-encoding=NONE
    BT_SSA_BFT_ASW_Status: base-type-encoding=NONE
    BT_SSA_BFT_el_Tuerantrieb_Fehler: base-type-encoding=NONE
    BT_SSA_BFT_el_Tuerantrieb_Status: base-type-encoding=NONE
    BT_SSA_BFT_FH_Bewegungsrichutng: base-type-encoding=NONE
    BT_SSA_BFT_FH_Fehler: base-type-encoding=NONE
    BT_SSA_BFT_FH_Normierung: base-type-encoding=NONE
    BT_SSA_BFT_FH_Oeffnungsweite: base-type-encoding=NONE
    BT_SSA_BFT_FH_Thermoschutz: base-type-encoding=NONE
    BT_SSA_BFT_Tuerverschluss_Fehler: base-type-encoding=NONE
    BT_SSA_BFT_Tuerverschluss_Status: base-type-encoding=NONE
    BT_SSA_BFT_ZV_Ansteuern: base-type-encoding=NONE
    BT_SSA_BFT_ZV_Fehler: base-type-encoding=NONE
    BT_SSA_BFT_ZV_Status: base-type-encoding=NONE
    BT_SSA_BFT_ZZH_Fehler: base-type-encoding=NONE
    BT_SSA_BFT_ZZH_Status: base-type-encoding=NONE
    BT_SSA_FT_Amb_Bel_Fehler: base-type-encoding=NONE
    BT_SSA_FT_Amb_Bel_Status: base-type-encoding=NONE
    BT_SSA_FT_ASP_Heizung_Fehler: base-type-encoding=NONE
    BT_SSA_FT_ASP_Heizung_Status: base-type-encoding=NONE
    BT_SSA_FT_ASP_Klappung_Fehler: base-type-encoding=NONE
    BT_SSA_FT_ASP_Klappung_Status: base-type-encoding=NONE
    BT_SSA_FT_ASP_Spiegelglas_Fehler: base-type-encoding=NONE
    BT_SSA_FT_ASP_Spiegelglas_Pos_X: base-type-encoding=NONE
    BT_SSA_FT_ASP_Spiegelglas_Pos_Y: base-type-encoding=NONE
    BT_SSA_FT_ASW_Fehler: base-type-encoding=NONE
    BT_SSA_FT_ASW_Status: base-type-encoding=NONE
    BT_SSA_FT_el_Tuerantrieb_Fehler: base-type-encoding=NONE
    BT_SSA_FT_el_Tuerantrieb_Status: base-type-encoding=NONE
    BT_SSA_FT_FH_Bewegungsrichutng: base-type-encoding=NONE
    BT_SSA_FT_FH_Fehler: base-type-encoding=NONE
    BT_SSA_FT_FH_Normierung: base-type-encoding=NONE
    BT_SSA_FT_FH_Oeffnungsweite: base-type-encoding=NONE
    BT_SSA_FT_FH_Thermoschutz: base-type-encoding=NONE
    BT_SSA_FT_Tuerverschluss_Fehler: base-type-encoding=NONE
    BT_SSA_FT_Tuerverschluss_Status: base-type-encoding=NONE
    BT_SSA_FT_ZV_Fehler: base-type-encoding=NONE
    BT_SSA_FT_ZV_Status: base-type-encoding=NONE
    BT_SSA_FT_ZZH_Fehler: base-type-encoding=NONE
    BT_SSA_FT_ZZH_Status: base-type-encoding=NONE
    BT_SSA_HBFS_eKisi_Fehler: base-type-encoding=NONE
    BT_SSA_HBFS_eKisi_Status: base-type-encoding=NONE
    BT_SSA_HBFT_Amb_Bel_Fehler: base-type-encoding=NONE
    BT_SSA_HBFT_Amb_Bel_Status: base-type-encoding=NONE
    BT_SSA_HBFT_ASW_Fehler: base-type-encoding=NONE
    BT_SSA_HBFT_ASW_Status: base-type-encoding=NONE
    BT_SSA_HBFT_el_Tuerantrieb_Fehler: base-type-encoding=NONE
    BT_SSA_HBFT_el_Tuerantrieb_Status: base-type-encoding=NONE
    BT_SSA_HBFT_FH_Bewegungsrichutng: base-type-encoding=NONE
    BT_SSA_HBFT_FH_Fehler: base-type-encoding=NONE
    BT_SSA_HBFT_FH_Normierung: base-type-encoding=NONE
    BT_SSA_HBFT_FH_Oeffnungsweite: base-type-encoding=NONE
    BT_SSA_HBFT_FH_Thermoschutz: base-type-encoding=NONE
    BT_SSA_HBFT_SSR_Fehler: base-type-encoding=NONE
    BT_SSA_HBFT_SSR_Status: base-type-encoding=NONE
    BT_SSA_HBFT_Tuerverschluss_Fehler: base-type-encoding=NONE
    BT_SSA_HBFT_Tuerverschluss_Status: base-type-encoding=NONE
    BT_SSA_HBFT_ZV_Ansteuern: base-type-encoding=NONE
    BT_SSA_HBFT_ZV_Fehler: base-type-encoding=NONE
    BT_SSA_HBFT_ZV_Status: base-type-encoding=NONE
    BT_SSA_HBFT_ZZH_Fehler: base-type-encoding=NONE
    BT_SSA_HBFT_ZZH_Status: base-type-encoding=NONE
    BT_SSA_Heckschloss_ansteuern: base-type-encoding=NONE
    BT_SSA_HFS_eKisi_Fehler: base-type-encoding=NONE
    BT_SSA_HFS_eKisi_Status: base-type-encoding=NONE
    BT_SSA_HFT_Amb_Bel_Fehler: base-type-encoding=NONE
    BT_SSA_HFT_Amb_Bel_Status: base-type-encoding=NONE
    BT_SSA_HFT_ASW_Fehler: base-type-encoding=NONE
    BT_SSA_HFT_ASW_Status: base-type-encoding=NONE
    BT_SSA_HFT_el_Tuerantrieb_Fehler: base-type-encoding=NONE
    BT_SSA_HFT_el_Tuerantrieb_Status: base-type-encoding=NONE
    BT_SSA_HFT_FH_Bewegungsrichutng: base-type-encoding=NONE
    BT_SSA_HFT_FH_Fehler: base-type-encoding=NONE
    BT_SSA_HFT_FH_Normierung: base-type-encoding=NONE
    BT_SSA_HFT_FH_Oeffnungsweite: base-type-encoding=NONE
    BT_SSA_HFT_FH_Thermoschutz: base-type-encoding=NONE
    BT_SSA_HFT_SSR_Fehler: base-type-encoding=NONE
    BT_SSA_HFT_SSR_Status: base-type-encoding=NONE
    BT_SSA_HFT_Tuerverschluss_Fehler: base-type-encoding=NONE
    BT_SSA_HFT_Tuerverschluss_Status: base-type-encoding=NONE
    BT_SSA_HFT_ZV_Ansteuern: base-type-encoding=NONE
    BT_SSA_HFT_ZV_Fehler: base-type-encoding=NONE
    BT_SSA_HFT_ZV_Status: base-type-encoding=NONE
    BT_SSA_HFT_ZZH_Fehler: base-type-encoding=NONE
    BT_SSA_HFT_ZZH_Status: base-type-encoding=NONE
    BT_SSA_Tankklappe_ansteuern: base-type-encoding=NONE
    BT_SSR_HBFS_Pos_Unten: base-type-encoding=NONE
    BT_SSR_HFS_Pos_Unten: base-type-encoding=NONE
    BT_SSR_Temp_Freigabe: base-type-encoding=NONE
    BT_STH_Fehler_ElWaPu: base-type-encoding=NONE
    BT_STH_Fehlerstatus: base-type-encoding=NONE
    BT_STH_FlgFuPmp: base-type-encoding=NONE
    BT_STH_Funk_aus: base-type-encoding=NONE
    BT_STH_Funk_ein: base-type-encoding=NONE
    BT_STH_Geblaese: base-type-encoding=NONE
    BT_STH_Heizleistung: base-type-encoding=NONE
    BT_STH_KVS: base-type-encoding=NONE
    BT_STH_KVS_Ueberlauf: base-type-encoding=NONE
    BT_STH_LED: base-type-encoding=NONE
    BT_STH_Motorvorwaermung: base-type-encoding=NONE
    BT_STH_Pumpe_ein: base-type-encoding=NONE
    BT_STH_Pumpen_Anf_extern: base-type-encoding=NONE
    BT_STH_Servicemode: base-type-encoding=NONE
    BT_STH_Start_folgt: base-type-encoding=NONE
    BT_STH_Texte: base-type-encoding=NONE
    BT_STH_Ventil_Status: base-type-encoding=NONE
    BT_STH_Ventiloeffnungszeit: base-type-encoding=NONE
    BT_STH_Waermeeintrag: base-type-encoding=NONE
    BT_STH_war_aktiv: base-type-encoding=NONE
    BT_STH_Wassertemp: base-type-encoding=NONE
    BT_STH_Zusatzheizung: base-type-encoding=NONE
    BT_SWA_HMI_Diagnose: base-type-encoding=NONE
    BT_TCPServer_IP_TS_DTO_{01..04}_Data: base-type-size=8, base-type-encoding=ISO-8859-1
    BT_TG_Geber_1_Mittelwert: base-type-encoding=NONE
    BT_TG_Geber_1_Stand: base-type-encoding=NONE
    BT_TG_Geber_2_Mittelwert: base-type-encoding=NONE
    BT_TG_Geber_2_Stand: base-type-encoding=NONE
    BT_TG_Geber_3_Mittelwert: base-type-encoding=NONE
    BT_TG_Geber_3_Stand: base-type-encoding=NONE
    BT_TG_Geber_4_Mittelwert: base-type-encoding=NONE
    BT_TG_Geber_4_Stand: base-type-encoding=NONE
    BT_TG_QBit_Geber_{1..4}: base-type-encoding=NONE
    BT_TNK_FStatus_Tank: base-type-encoding=NONE
    BT_TNK_Kraftstoffvorrat: base-type-encoding=NONE
    BT_TNK_Max_Tankinhalt: base-type-encoding=NONE
    BT_TNK_Min_Tankinhalt: base-type-encoding=NONE
    BT_TNK_Nachtanken_erkannt: base-type-encoding=NONE
    BT_TNK_Tankanzeigefreigabe: base-type-encoding=NONE
    BT_TNK_Tankinhalt_hochaufl: base-type-encoding=NONE
    BT_TNK_Tankinhalt_roh: base-type-encoding=NONE
    BT_TNK_Tankwarnung: base-type-encoding=NONE
    BT_TNK_Tankwarnung_ungueltig: base-type-encoding=NONE
    BT_TNK_Wegstrecke_Hinweis: base-type-encoding=NONE
    BT_TSG_FlHz_BFS_FnAbbruchHzKreis_A: base-type-encoding=NONE
    BT_TSG_FlHz_BFS_FnAbbruchHzKreis_B: base-type-encoding=NONE
    BT_TSG_FlHz_BFS_NTC_A: base-type-encoding=NONE
    BT_TSG_FlHz_BFS_NTC_B: base-type-encoding=NONE
    BT_TSG_FlHz_BFS_Unterbrech_HzK_A: base-type-encoding=NONE
    BT_TSG_FlHz_BFS_Unterbrech_HzK_B: base-type-encoding=NONE
    BT_TSG_FlHz_FS_FnAbbruchHzKreis_A: base-type-encoding=NONE
    BT_TSG_FlHz_FS_FnAbbruchHzKreis_B: base-type-encoding=NONE
    BT_TSG_FlHz_FS_NTC_A: base-type-encoding=NONE
    BT_TSG_FlHz_FS_NTC_B: base-type-encoding=NONE
    BT_TSG_FlHz_FS_Unterbrech_HzK_A: base-type-encoding=NONE
    BT_TSG_FlHz_FS_Unterbrech_HzK_B: base-type-encoding=NONE
    BT_TSG_FlHz_HBFS_FnAbbruchHzKreis_A: base-type-encoding=NONE
    BT_TSG_FlHz_HBFS_FnAbbruchHzKreis_B: base-type-encoding=NONE
    BT_TSG_FlHz_HBFS_NTC_A: base-type-encoding=NONE
    BT_TSG_FlHz_HBFS_NTC_B: base-type-encoding=NONE
    BT_TSG_FlHz_HBFS_Unterbrech_HzK_A: base-type-encoding=NONE
    BT_TSG_FlHz_HBFS_Unterbrech_HzK_B: base-type-encoding=NONE
    BT_TSG_FlHz_HFS_FnAbbruchHzKreis_A: base-type-encoding=NONE
    BT_TSG_FlHz_HFS_FnAbbruchHzKreis_B: base-type-encoding=NONE
    BT_TSG_FlHz_HFS_NTC_A: base-type-encoding=NONE
    BT_TSG_FlHz_HFS_NTC_B: base-type-encoding=NONE
    BT_TSG_FlHz_HFS_Unterbrech_HzK_A: base-type-encoding=NONE
    BT_TSG_FlHz_HFS_Unterbrech_HzK_B: base-type-encoding=NONE
    BT_TSG_FS_Spiegel_angeklappt: base-type-encoding=NONE
    BT_UH_Jahr: base-type-encoding=NONE
    BT_UH_Minute: base-type-encoding=NONE
    BT_UH_Monat: base-type-encoding=NONE
    BT_UH_Sekunde: base-type-encoding=NONE
    BT_UH_Stunde: base-type-encoding=NONE
    BT_UH_Tag: base-type-encoding=NONE
    BT_VDSO_05_BZ: base-type-encoding=NONE
    BT_VDSO_05_CRC: base-type-encoding=NONE
    BT_VDSO_09_BZ: base-type-encoding=NONE
    BT_VDSO_09_CRC: base-type-encoding=NONE
    BT_VDSO_AgFrWhlStgAxlLWIOfsCmp: base-type-encoding=NONE
    BT_VDSO_AgFrWhlStgAxlOfsCmp: base-type-encoding=NONE
    BT_VDSO_AgReWhlStgAxl: base-type-encoding=NONE
    BT_VDSO_ALatOfs: base-type-encoding=NONE
    BT_VDSO_ALgtOfs: base-type-encoding=NONE
    BT_VDSO_BasTi200_NumClc_05: base-type-encoding=NONE
    BT_VDSO_BasTi200_NumClc_09: base-type-encoding=NONE
    BT_VDSO_DKmtg: base-type-encoding=NONE
    BT_VDSO_DKmtg_Auth: base-type-encoding=NONE
    BT_VDSO_DKmtg2Ord: base-type-encoding=NONE
    BT_VDSO_StDKmtg_Auth: base-type-encoding=NONE
    BT_VDSO_StVx3d: base-type-encoding=NONE
    BT_VDSO_Vx3d: base-type-encoding=NONE
    BT_VDSO_Vx3dDisp: base-type-encoding=NONE
    BT_VDSO_Vx3dKmph: base-type-encoding=NONE
    BT_VDSO_WhlSlipFrLe3d: base-type-encoding=NONE
    BT_VDSO_WhlSlipFrRi3d: base-type-encoding=NONE
    BT_VDSO_WhlSlipReLe3d: base-type-encoding=NONE
    BT_VDSO_WhlSlipReRi3d: base-type-encoding=NONE
    BT_VehicleProtectedEnvironment_D: base-type-encoding=NONE
    BT_VIN_1: base-type-encoding=NONE
    BT_VIN_{10..17}: base-type-encoding=NONE
    BT_VIN_{2..9}: base-type-encoding=NONE
    BT_VIP_Sensor_betaetigt: base-type-encoding=NONE
    BT_WFS_02_BZ: base-type-encoding=NONE
    BT_WFS_02_CRC: base-type-encoding=NONE
    BT_WFS_Betrieb_Lesespule: base-type-encoding=NONE
    BT_WFS_ELV_authorisiert: base-type-encoding=NONE
    BT_WFS_Fahrerhinweise: base-type-encoding=NONE
    BT_WFS_ID_Geb_autorisiert: base-type-encoding=NONE
    BT_WFS_ID_Geb_autorisiert_in_Kl15: base-type-encoding=NONE
    BT_WFS_ID_Geb_steckt: base-type-encoding=NONE
    BT_WFS_Klemmenfreigabe: base-type-encoding=NONE
    BT_WFS_LF_Aktiv: base-type-encoding=NONE
    BT_WFS_LZ_02: base-type-encoding=NONE
    BT_WFS_Parken_Status: base-type-encoding=NONE
    BT_WFS_Safe: base-type-encoding=NONE
    BT_WFS_Schluessel_Fahrberecht: base-type-encoding=NONE
    BT_WFS_Schluessel_Ist: base-type-encoding=NONE
    BT_WFS_Schluessel_Soll: base-type-encoding=NONE
    BT_WLC_laden_unterbrechen: base-type-encoding=NONE
    BT_WLC1_Abschaltstufe: base-type-encoding=NONE
    BT_WLC1_ChargingEfficiency: base-type-encoding=NONE
    BT_WLC1_ChargingStatus: base-type-encoding=NONE
    BT_WLC1_KD_Fehler: base-type-encoding=NONE
    BT_WLC1_KompSchutz: base-type-encoding=NONE
    BT_WLC1_Nachlauftyp: base-type-encoding=NONE
    BT_WLC1_SNI_10: base-type-encoding=NONE
    BT_WLC1_Systemzustand: base-type-encoding=NONE
    BT_WLC1_Transport_Mode: base-type-encoding=NONE
    BT_WLC1_UsedChargingStandard: base-type-encoding=NONE
    BT_WLC2_Abschaltstufe: base-type-encoding=NONE
    BT_WLC2_ChargingEfficiency: base-type-encoding=NONE
    BT_WLC2_ChargingStatus: base-type-encoding=NONE
    BT_WLC2_KD_Fehler: base-type-encoding=NONE
    BT_WLC2_KompSchutz: base-type-encoding=NONE
    BT_WLC2_Nachlauftyp: base-type-encoding=NONE
    BT_WLC2_SNI_10: base-type-encoding=NONE
    BT_WLC2_Systemzustand: base-type-encoding=NONE
    BT_WLC2_Transport_Mode: base-type-encoding=NONE
    BT_WLC2_UsedChargingStandard: base-type-encoding=NONE
    BT_ZR_CL_Mode: base-type-encoding=NONE
    BT_ZR_HUD_Mode: base-type-encoding=NONE
    BT_ZR_IOC_Mode: base-type-encoding=NONE
    BT_ZR_IVI1_Mode: base-type-encoding=NONE
    BT_ZR_State_CID: base-type-encoding=NONE
    BT_ZR_State_FID: base-type-encoding=NONE
    BT_ZR_State_PID: base-type-encoding=NONE
    BT_ZR_SYS1_Mode: base-type-encoding=NONE
    BT_ZR_VA_Challenge_CID: base-type-size=8, base-type-encoding=ISO-8859-1
    BT_ZR_VA_Challenge_FID: base-type-size=8, base-type-encoding=ISO-8859-1
    BT_ZR_VA_Challenge_PID: base-type-size=8, base-type-encoding=ISO-8859-1
    BT_ZR_VA_Communication_Init_Ack_CID: base-type-size=8, base-type-encoding=ISO-8859-1
    BT_ZR_VA_Communication_Init_Ack_FID: base-type-size=8, base-type-encoding=ISO-8859-1
    BT_ZR_VA_Communication_Init_Ack_PID: base-type-size=8, base-type-encoding=ISO-8859-1
    BT_ZR_VA_Communication_Init_CID: base-type-size=8, base-type-encoding=ISO-8859-1
    BT_ZR_VA_Communication_Init_FID: base-type-size=8, base-type-encoding=ISO-8859-1
    BT_ZR_VA_Communication_Init_PID: base-type-size=8, base-type-encoding=ISO-8859-1
    BT_ZV_Anf_Auffindbel_TE_hinten: base-type-encoding=NONE
    BT_ZV_Anf_Auffindbel_TE_vorne: base-type-encoding=NONE
    BT_ZV_Anf_Fanghaken_Frontschloss: base-type-encoding=NONE
    BT_ZV_Anf_Heckschloss_ansteuern: base-type-encoding=NONE
    BT_ZV_Anf_HSK: base-type-encoding=NONE
    BT_ZV_APP_Kundenwarnung_Funk: base-type-encoding=NONE
    BT_ZV_APP_Kundenwarnung_Notein: base-type-encoding=NONE
    BT_ZV_auf_Funk: base-type-encoding=NONE
    BT_ZV_auto_Ansteuerung: base-type-encoding=NONE
    BT_ZV_Bedienstelle_auf: base-type-encoding=NONE
    BT_ZV_Bedienstelle_zu: base-type-encoding=NONE
    BT_ZV_BT_entriegeln: base-type-encoding=NONE
    BT_ZV_BT_offen: base-type-encoding=NONE
    BT_ZV_BT_verriegeln: base-type-encoding=NONE
    BT_ZV_Crashfall_erkannt: base-type-encoding=NONE
    BT_ZV_FD_Taste_auf: base-type-encoding=NONE
    BT_ZV_Freigabe_Heckschloss: base-type-encoding=NONE
    BT_ZV_Frontdeckel_offen: base-type-encoding=NONE
    BT_ZV_Frontdeckelzustand: base-type-encoding=NONE
    BT_ZV_Frontschloss_Hauptraste: base-type-encoding=NONE
    BT_ZV_Frontschloss_Sperrklinke: base-type-encoding=NONE
    BT_ZV_Frontschloss_Taste: base-type-encoding=NONE
    BT_ZV_Frontschloss_Vorraste: base-type-encoding=NONE
    BT_ZV_Frontschlossstatus: base-type-encoding=NONE
    BT_ZV_FT_entriegeln: base-type-encoding=NONE
    BT_ZV_FT_offen: base-type-encoding=NONE
    BT_ZV_FT_verriegeln: base-type-encoding=NONE
    BT_ZV_gesafet_extern_ist_02: base-type-encoding=NONE
    BT_ZV_gesafet_extern_soll_02: base-type-encoding=NONE
    BT_ZV_HBFS_entriegeln: base-type-encoding=NONE
    BT_ZV_HBFS_offen: base-type-encoding=NONE
    BT_ZV_HBFS_verriegeln: base-type-encoding=NONE
    BT_ZV_HD_Taste_zu: base-type-encoding=NONE
    BT_ZV_Heck_offen: base-type-encoding=NONE
    BT_ZV_Heckentriegelunsanforderung: base-type-encoding=NONE
    BT_ZV_Heckoeffnungsfreigabe: base-type-encoding=NONE
    BT_ZV_Heckschloss_Taste_auf: base-type-encoding=NONE
    BT_ZV_Heckschlossstatus: base-type-encoding=NONE
    BT_ZV_Heckschlosszustand: base-type-encoding=NONE
    BT_ZV_HFS_entriegeln: base-type-encoding=NONE
    BT_ZV_HFS_verriegeln: base-type-encoding=NONE
    BT_ZV_HSK_Freigabe: base-type-encoding=NONE
    BT_ZV_LED_Steuerung: base-type-encoding=NONE
    BT_ZV_LED_Uebernahme: base-type-encoding=NONE
    BT_ZV_Noteinspeisung_erkannt: base-type-encoding=NONE
    BT_ZV_SafeFunktion_aktiv: base-type-encoding=NONE
    BT_ZV_Signatur: base-type-encoding=NONE
    BT_ZV_Spg_Anklappen: base-type-encoding=NONE
    BT_ZV_Status_eTAG_ist: base-type-encoding=NONE
    BT_ZV_Status_eTAG_soll: base-type-encoding=NONE
    BT_ZV_TAG_BT_verfahren: base-type-encoding=NONE
    BT_ZV_TAG_FT_verfahren: base-type-encoding=NONE
    BT_ZV_TAG_HBFS_verfahren: base-type-encoding=NONE
    BT_ZV_TAG_HFS_verfahren: base-type-encoding=NONE
    BT_ZV_Tasten_HMI_Anf: base-type-encoding=NONE
    BT_ZV_TxT_Frontschloss_Warnung: base-type-encoding=NONE
    BT_ZV_Txt_Handbremse_Hinweis: base-type-encoding=NONE
    BT_ZV_TxT_Heckschloss_Warnung: base-type-encoding=NONE
    BT_ZV_TxT_TE_Warnung_hinten: base-type-encoding=NONE
    BT_ZV_TxT_TE_Warnung_vorne: base-type-encoding=NONE
    BT_ZV_Txt_Waehlhebel_P_Hinweis: base-type-encoding=NONE
    BT_ZV_ValetTaster_Fkts_LED: base-type-encoding=NONE
    BT_ZV_verriegelt_extern_ist_02: base-type-encoding=NONE
    BT_ZV_verriegelt_extern_soll_03: base-type-encoding=NONE
    BT_ZV_verriegelt_intern_ist_02: base-type-encoding=NONE
    BT_ZV_verriegelt_intern_soll_02: base-type-encoding=NONE
    BT_ZV_zentral_entsafen: base-type-encoding=NONE
    BT_ZV_zentral_safen: base-type-encoding=NONE
    BT_ZV_zu_Zeitl_Nachverr: base-type-encoding=NONE
    BT_SignalVoid: base-type-encoding=NONE
    BT_SSOA_Signals: base-type-size=8, base-type-encoding=ISO-8859-1
package /Constraints
  range DC_SOK_CentralLocking_01_Signatur: phys 0..4294967295, raw 0..4294967295
  range DC_SOK_DTSO_01_Signatur: phys 0..4294967295, raw 0..4294967295
  range DC_SOK_HCP1_02_Signatur: phys 0..4294967295, raw 0..4294967295
  range DC_SOK_HCP1_07_Signatur: phys 0..4294967295, raw 0..4294967295
  range DC_SOK_Zeit_Info_El_Signatur: phys 0..18446744073709551615, raw 0..18446744073709551615
package /Signal
  134 x system signal:
    SignalVoid_CentralLocking_01_{0..4}
    SignalVoid_DoorFunctions_BFS_01_0
    SignalVoid_DoorFunctions_BFS_01_1
    SignalVoid_DoorFunctions_BFS_01_{10..19}
    SignalVoid_DoorFunctions_BFS_01_2
    SignalVoid_DoorFunctions_BFS_01_{20..28}
    SignalVoid_DoorFunctions_BFS_01_{3..9}
    SignalVoid_DoorFunctions_FS_01_0
    SignalVoid_DoorFunctions_FS_01_1
    SignalVoid_DoorFunctions_FS_01_{10..19}
    SignalVoid_DoorFunctions_FS_01_2
    SignalVoid_DoorFunctions_FS_01_{20..29}
    SignalVoid_DoorFunctions_FS_01_3
    SignalVoid_DoorFunctions_FS_01_{30..39}
    SignalVoid_DoorFunctions_FS_01_{4..9}
    SignalVoid_DoorFunctions_HBFS_01_0
    SignalVoid_DoorFunctions_HBFS_01_1
    SignalVoid_DoorFunctions_HBFS_01_10
    SignalVoid_DoorFunctions_HBFS_01_{2..9}
    SignalVoid_DoorFunctions_HFS_01_0
    SignalVoid_DoorFunctions_HFS_01_1
    SignalVoid_DoorFunctions_HFS_01_10
    SignalVoid_DoorFunctions_HFS_01_{2..9}
    SignalVoid_FID_01_0
    SignalVoid_FID_01_1
    SignalVoid_FID_01_{10..19}
    SignalVoid_FID_01_2
    SignalVoid_FID_01_{20..29}
    SignalVoid_FID_01_{3..9}
    SignalVoid_HCP1_02_0
    SignalVoid_WFS_02_{0..6}
  7 x system signal group:
    SG_ClampControl_01: system-signal=[KST_Fahrerhinweis_3, KST_Fahrerhinweis_1, KST_Fahrerhinweis_2, KST_Fahrerhinweis_4, KST_Fahrerhinweis_5, KST_Fahrerhinweis_6, KST_ZAT_betaetigt, KST_Anf_Klemmenfreigabe_ELV, KST_aut_Abschaltung_Zuendung, KST_Txt_Panikabschaltung, KST_Sonderzustand_Status, KST_Sonderzustand_Anforderung, KST_WFS_Fahrfreigabe_Anforderung, KST_KL_15, KST_Kl_S, KST_Kl_50_Startanforderung, KST_StPtAcvReq, KST_StPtDeacReq, ClampControl_01_BZ, ClampControl_01_CRC, KST_Ausparken_Betrieb, KST_Kl_X, KST_Deaktivierungs_Trigger, KST_Ausstiegswunsch_Status, KST_ComfortReadyStatus, KST_BulbCheckReq, KST_Warn_P1_ZAT_def, KST_Warn_P2_ZAT_def, SignalVoid_ClampControl_01_0, SignalVoid_ClampControl_01_1, SignalVoid_ClampControl_01_2, SignalVoid_ClampControl_01_3, SignalVoid_ClampControl_01_4, SignalVoid_ClampControl_01_5]  # Signal Group
    SG_HWP_01: system-signal=[HWP_01_BZ, HWP_01_CRC, HWP_HMI_ASIL_Color, SignalVoid_HWP_01_0, SignalVoid_HWP_01_1, SignalVoid_HWP_01_2, SignalVoid_HWP_01_3, SignalVoid_HWP_01_4, SignalVoid_HWP_01_5]  # Signal Group
    SG_ORU_Control_A_01: system-signal=[OruVehicleLockRequestA, OruReleasePartitionSwitchA, OruIntegrityCheckActiveA, OruHostUpdateA, OruControlReleaseA, ORU_Control_A_01_CRC, ORU_Control_A_01_BZ, OnlineRemoteUpdateControlA, OnlineRemoteUpdateControlOldA, OTA_FlgPTAcvPhdA, OruControlStateA, SignalVoid_ORU_Control_A_01_0, SignalVoid_ORU_Control_A_01_1]  # Signal Group
    SG_ORU_Control_D_01: system-signal=[OruControlReleaseD, OruVehicleLockRequestD, OruReleasePartitionSwitchD, OruHostUpdateD, OruIntegrityCheckActiveD, OnlineRemoteUpdateControlOldD, OnlineRemoteUpdateControlD, ORU_Control_D_01_BZ, ORU_Control_D_01_CRC, OruControlStateD, SignalVoid_ORU_Control_D_01_0, SignalVoid_ORU_Control_D_01_1]  # Signal Group
    SG_OTAMC_D_01: system-signal=[VehicleProtectedEnvironment_D, OTAMC_D_01_CRC, OTAMC_D_01_BZ, SignalVoid_OTAMC_D_01_0, SignalVoid_OTAMC_D_01_1, SignalVoid_OTAMC_D_01_2]  # Signal Group
    SG_VDSO_05: system-signal=[VDSO_Vx3d, VDSO_Vx3dKmph, VDSO_Vx3dDisp, VDSO_05_BZ, VDSO_05_CRC, VDSO_BasTi200_NumClc_05]  # Signal Group
    SG_WFS_02: system-signal=[VIN_1, VIN_2, VIN_3, VIN_4, VIN_5, VIN_6, VIN_7, VIN_8, VIN_15, VIN_17, VIN_14, VIN_9, VIN_13, VIN_10, VIN_11, VIN_12, VIN_16, WFS_Schluessel_Fahrberecht, WFS_ELV_authorisiert, WFS_ID_Geb_autorisiert_in_Kl15, WFS_Betrieb_Lesespule, WFS_ID_Geb_autorisiert, WFS_ID_Geb_steckt, WFS_Schluessel_Soll, WFS_Schluessel_Ist, WFS_Safe, WFS_LF_Aktiv, WFS_Klemmenfreigabe, WFS_Fahrerhinweise, WFS_Parken_Status, WFS_02_BZ, WFS_LZ_02, IMMO_Display, WFS_02_CRC, IMMO_ClampPermStatus, SignalVoid_WFS_02_0, SignalVoid_WFS_02_1, SignalVoid_WFS_02_2, SignalVoid_WFS_02_3, SignalVoid_WFS_02_4, SignalVoid_WFS_02_5, SignalVoid_WFS_02_6]  # Signal Group
package /Unit
  34 x unit:
    Unit_Unit_Amper: display-name=Unit_Amper, factor-si-to-unit=1.0, physical-dimension=PD_siAmpere
    Unit_Unit_Centimeter: display-name=Unit_Centimeter, factor-si-to-unit=100.0, physical-dimension=PD_siMeter
    Unit_Unit_Day: display-name=Unit_Day, factor-si-to-unit=1.157E-5, physical-dimension=PD_siSecond
    Unit_Unit_DegreCelsi: display-name=Unit_DegreCelsi, factor-si-to-unit=1.0, offset-si-to-unit=-273.2, physical-dimension=PD_siKelvin
    Unit_Unit_Hours: display-name=Unit_Hours, factor-si-to-unit=2.778E-4, physical-dimension=PD_siSecond
    Unit_Unit_KiloMeter: display-name=Unit_KiloMeter, factor-si-to-unit=0.001, physical-dimension=PD_siMeter
    Unit_Unit_KiloMeterPerHour: display-name=Unit_KiloMeterPerHour, factor-si-to-unit=3.6, physical-dimension=PD_siMeterPerSecond
    Unit_Unit_KiloPascal: display-name=Unit_KiloPascal, factor-si-to-unit=0.001, physical-dimension=PD_siPascal
    Unit_Unit_Liter: display-name=Unit_Liter, factor-si-to-unit=1000.0, physical-dimension=PD_siCubicMeter
    Unit_Unit_LiterPerHour: display-name=Unit_LiterPerHour, factor-si-to-unit=3600000.0, physical-dimension=PD_siCubicMeterPerSecond
    Unit_Unit_Lux: display-name=Unit_Lux, factor-si-to-unit=1.0, physical-dimension=PD_siLux
    Unit_Unit_Meter: display-name=Unit_Meter, factor-si-to-unit=1.0, physical-dimension=PD_siMeter
    Unit_Unit_MeterInver: display-name=Unit_MeterInver, factor-si-to-unit=1.0, physical-dimension=PD_siPerMeter
    Unit_Unit_MeterPerSecon: display-name=Unit_MeterPerSecon, factor-si-to-unit=1.0, physical-dimension=PD_siMeterPerSecond
    Unit_Unit_MeterPerSeconSquar: display-name=Unit_MeterPerSeconSquar, factor-si-to-unit=1.0, physical-dimension=PD_siMeterPerSecondSquare
    Unit_Unit_MeterSeconInver: display-name=Unit_MeterSeconInver, factor-si-to-unit=1.0, physical-dimension=PD_siPerMeterSecond
    Unit_Unit_MicroLiter: display-name=Unit_MicroLiter, factor-si-to-unit=1.0E9, physical-dimension=PD_siCubicMeter
    Unit_Unit_MilliLiter: display-name=Unit_MilliLiter, factor-si-to-unit=1000000.0, physical-dimension=PD_siCubicMeter
    Unit_Unit_Minut: display-name=Unit_Minut, factor-si-to-unit=60.0, physical-dimension=PD_siSecond
    Unit_Unit_MinutInver: display-name=Unit_MinutInver, factor-si-to-unit=60.0, physical-dimension=PD_siPerSecond
    Unit_Unit_Month: display-name=Unit_Month, factor-si-to-unit=3.805E-7, physical-dimension=PD_siSecond
    Unit_Unit_NewtoMeter: display-name=Unit_NewtoMeter, factor-si-to-unit=1.0, physical-dimension=PD_siNewtonMeter
    Unit_Unit_None: display-name=Unit_None, factor-si-to-unit=1.0, physical-dimension=PD_siNone
    Unit_Unit_Ohm: display-name=Unit_Ohm, factor-si-to-unit=1.0, physical-dimension=PD_siOhm
    Unit_Unit_PerCent: display-name=Unit_PerCent, factor-si-to-unit=1.0, physical-dimension=PD_siNone
    Unit_Unit_PerCentPerSecon: display-name=Unit_PerCentPerSecon, factor-si-to-unit=1.0, physical-dimension=PD_siPerSecond
    Unit_Unit_Radia: display-name=Unit_Radia, factor-si-to-unit=1.0, physical-dimension=PD_siRadiant
    Unit_Unit_RadiaPerSecon: display-name=Unit_RadiaPerSecon, factor-si-to-unit=1.0, physical-dimension=PD_siRadiantPerSecond
    Unit_Unit_Secon: display-name=Unit_Secon, factor-si-to-unit=1.0, physical-dimension=PD_siSecond
    Unit_Unit_Volt: display-name=Unit_Volt, factor-si-to-unit=1.0, physical-dimension=PD_siVolt
    Unit_Unit_Watt: display-name=Unit_Watt, factor-si-to-unit=1.0, physical-dimension=PD_siWatt
    Unit_Unit_WattHour: display-name=Unit_WattHour, factor-si-to-unit=2.7778E-4, physical-dimension=PD_siWattSecond
    Unit_Unit_WattPerMeterSquar: display-name=Unit_WattPerMeterSquar, factor-si-to-unit=1.0, physical-dimension=PD_siWattPerMeterSquare
    Unit_Unit_Year: display-name=Unit_Year, factor-si-to-unit=3.16887646E-8, physical-dimension=PD_siSecond
package /PhysicalDimension
  22 x physical dimension:
    PD_siAmpere: current-exp=1
    PD_siCubicMeter: mass-exp=3
    PD_siCubicMeterPerSecond: length-exp=3, time-exp=-1
    PD_siKelvin: temperature-exp=1
    PD_siLux: length-exp=-2, luminous-intensity-exp=1
    PD_siMeter: length-exp=1
    PD_siMeterPerSecond: length-exp=1, time-exp=-1
    PD_siMeterPerSecondSquare: length-exp=1, time-exp=-2
    PD_siNewtonMeter: length-exp=2, mass-exp=1, time-exp=-2
    PD_siNone
    PD_siOhm: length-exp=2, mass-exp=1, time-exp=-3, current-exp=-2
    PD_siPascal: length-exp=-1, mass-exp=1, time-exp=-2
    PD_siPerMeter: length-exp=-1
    PD_siPerMeterSecond: length-exp=-1, time-exp=-1
    PD_siPerSecond: time-exp=-1
    PD_siRadiant: length-exp=0
    PD_siRadiantPerSecond: length-exp=0, time-exp=-1
    PD_siSecond: time-exp=1
    PD_siVolt: length-exp=2, mass-exp=1, time-exp=-1, current-exp=-1
    PD_siWatt: length-exp=2, mass-exp=1, time-exp=-3
    PD_siWattPerMeterSquare: mass-exp=1, time-exp=-3
    PD_siWattSecond: length-exp=2, mass-exp=1, time-exp=-2
package /Semantics
  compu method CM_SOK_CentralLocking_01_Signatur: phys=raw for raw 0..4294967295
  compu method CM_SOK_DTSO_01_Signatur: phys=raw for raw 0..4294967295
  compu method CM_SOK_HCP1_02_Signatur: phys=raw for raw 0..4294967295
  compu method CM_SOK_HCP1_07_Signatur: phys=raw for raw 0..4294967295
  compu method CM_SOK_Zeit_Info_El_Signatur: phys=raw for raw 0..18446744073709551615
