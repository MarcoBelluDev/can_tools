[part 8 of 15: package /PDU]
AUTOSAR XML (schema 4-3-0)
package /PDU  (continued)
  pdu DoorFunctions_BFS_01_XIX_VLAN_Cockpit: length=44, minimum-delay=0.02, transmission-mode-false-timing={cyclic-timing={time-offset=0.0, time-period=0.1}, event-controlled-timing={number-of-repetitions=10, repetition-period=0.02}}, transmission-mode-true-timing={cyclic-timing={time-offset=0.0, time-period=0.02}, event-controlled-timing={number-of-repetitions=10, repetition-period=0.02}}, unused-bit-pattern=0
    transmission-mode-conditions:
      {data-filter={data-filter-type=MASKED-NEW-DIFFERS-X, mask=1, x=0}, i-signal-in-i-pdu=BT_FH_S_ManHoch}
      {data-filter={data-filter-type=MASKED-NEW-DIFFERS-X, mask=1, x=0}, i-signal-in-i-pdu=BT_FH_S_AutoHoch}
      {data-filter={data-filter-type=MASKED-NEW-DIFFERS-X, mask=1, x=0}, i-signal-in-i-pdu=BT_FH_S_ManTief}
      {data-filter={data-filter-type=MASKED-NEW-DIFFERS-X, mask=1, x=0}, i-signal-in-i-pdu=BT_FH_S_AutoTief}
      {data-filter={data-filter-type=MASKED-NEW-DIFFERS-X, mask=255, x=0}, i-signal-in-i-pdu=BT_FH_Oeffnung}
      {data-filter={data-filter-type=MASKED-NEW-DIFFERS-X, mask=1, x=0}, i-signal-in-i-pdu=BT_FH_Bew_hoch}
      {data-filter={data-filter-type=MASKED-NEW-DIFFERS-X, mask=1, x=0}, i-signal-in-i-pdu=BT_FH_Bew_tief}
      {data-filter={data-filter-type=MASKED-NEW-DIFFERS-X, mask=1, x=0}, i-signal-in-i-pdu=BT_FH_Fang}
      {data-filter={data-filter-type=MASKED-NEW-DIFFERS-X, mask=1, x=0}, i-signal-in-i-pdu=BT_FH_Block}
      {data-filter={data-filter-type=MASKED-NEW-DIFFERS-X, mask=1, x=0}, i-signal-in-i-pdu=BT_FH_Thermo}
      {data-filter={data-filter-type=MASKED-NEW-DIFFERS-X, mask=1, x=0}, i-signal-in-i-pdu=BT_FH_normiert}
      {data-filter={data-filter-type=MASKED-NEW-DIFFERS-X, mask=1, x=0}, i-signal-in-i-pdu=BT_SP_ausgerastet}
      {data-filter={data-filter-type=MASKED-NEW-DIFFERS-X, mask=1, x=0}, i-signal-in-i-pdu=BT_SP_lr_aktiv}
      {data-filter={data-filter-type=MASKED-NEW-DIFFERS-X, mask=1, x=0}, i-signal-in-i-pdu=BT_SP_ht_aktiv}
      {data-filter={data-filter-type=MASKED-NEW-DIFFERS-X, mask=1, x=0}, i-signal-in-i-pdu=BT_SP_Heizung_Status}
      {data-filter={data-filter-type=MASKED-NEW-DIFFERS-X, mask=1, x=0}, i-signal-in-i-pdu=BT_FH_Pos_oben}
    signal DoorFunctions_BFS_01_CRC_XIX_DoorFunctions_BFS_01_XIX_VLAN_Cockpit: start 0, 8 bit, little-endian, data-type-policy=OVERRIDE, i-signal-type=PRIMITIVE, init-value=0, base-type=BT_DoorFunctions_BFS_01_CRC, compu {phys=raw for raw 0..255}, range phys 0..255, raw 0..255, transfer-property=TRIGGERED-WITHOUT-REPETITION
    signal DoorFunctions_BFS_01_BZ_XIX_DoorFunctions_BFS_01_XIX_VLAN_Cockpit: start 8, 4 bit, little-endian, data-type-policy=OVERRIDE, i-signal-type=PRIMITIVE, init-value=0, base-type=BT_DoorFunctions_BFS_01_BZ, compu {phys=raw for raw 0..15}, range phys 0..15, raw 0..15, transfer-property=TRIGGERED-WITHOUT-REPETITION
    signal eTAB_BFS_Oeffnen_Betaet_XIX_DoorFunctions_BFS_01_XIX_VLAN_Cockpit: start 12, 1 bit, little-endian, data-type-policy=OVERRIDE, i-signal-type=PRIMITIVE, init-value=0, base-type=BT_eTAB_BFS_Oeffnen_Betaet, compu {0=Cx0_Init_keine_Annaeherung (CM_eTAB_BFS_Oeffnen_Betaet_Cx0_Init_keine_Annaeherung), 1=Cx1_Betaetigung_Oeffnen_erkannt (CM_eTAB_BFS_Oeffnen_Betaet_Cx1_Betaetigung_Oeffnen_erkannt)}, range raw 0..1, transfer-property=TRIGGERED-WITHOUT-REPETITION  # Der Türgriffsensor hat eine Betaetigung zum Oeffnen erkannt.
    signal eTAB_BFS_Oeffnen_Annaeh_XIX_DoorFunctions_BFS_01_XIX_VLAN_Cockpit: start 13, 1 bit, little-endian, data-type-policy=OVERRIDE, i-signal-type=PRIMITIVE, init-value=0, base-type=BT_eTAB_BFS_Oeffnen_Annaeh, compu {1=Cx1_Annaeherung_Oeffnen_erkannt (CM_eTAB_BFS_Oeffnen_Annaeh_Cx1_Annaeherung_Oeffnen_erkannt), 0=Cx0_Init_keine_Annaeherung (CM_eTAB_BFS_Oeffnen_Annaeh_Cx0_Init_keine_Annaeherung)}, range raw 0..1, transfer-property=TRIGGERED-WITHOUT-REPETITION  # Der Türgriffsensor hat eine Annaeherung zum Oeffnen erkannt.
    signal eTAB_BFS_Schliessen_Betaet_XIX_DoorFunctions_BFS_01_XIX_VLAN_Cockpit: start 14, 1 bit, little-endian, data-type-policy=OVERRIDE, i-signal-type=PRIMITIVE, init-value=0, base-type=BT_eTAB_BFS_Schliessen_Betaet, compu {1=Cx1_Betaetigung_Schliessen_erkannt (CM_eTAB_BFS_Schliessen_Betaet_Cx1_Betaetigung_Schliessen_erkannt), 0=Cx0_Init_keine_Annaeherung (CM_eTAB_BFS_Schliessen_Betaet_Cx0_Init_keine_Annaeherung)}, range raw 0..1, transfer-property=TRIGGERED-WITHOUT-REPETITION  # Der Türgriffsensor hat eine Betaetigung zum Schliessen erkannt.
    signal eTAB_BFS_Schliessen_Annaeh_XIX_DoorFunctions_BFS_01_XIX_VLAN_Cockpit: start 15, 1 bit, little-endian, data-type-policy=OVERRIDE, i-signal-type=PRIMITIVE, init-value=0, base-type=BT_eTAB_BFS_Schliessen_Annaeh, compu {1=Cx1_Annaeherung_Schliessen_erkannt (CM_eTAB_BFS_Schliessen_Annaeh_Cx1_Annaeherung_Schliessen_erkannt), 0=Cx0_Init_keine_Annaeherung (CM_eTAB_BFS_Schliessen_Annaeh_Cx0_Init_keine_Annaeherung)}, range raw 0..1, transfer-property=TRIGGERED-WITHOUT-REPETITION  # Der Türgriffsensor hat eine Annaeherung zum Schliessen erkannt.
    signal BT_Tuer_geoeffnet_XIX_DoorFunctions_BFS_01_XIX_VLAN_Cockpit: start 16, 1 bit, little-endian, data-type-policy=OVERRIDE, i-signal-type=PRIMITIVE, init-value=0, base-type=BT_BT_Tuer_geoeffnet, compu {1=Cx1_offen (CM_BT_Tuer_geoeffnet_Cx1_offen), 0=Cx0_geschlossen (CM_BT_Tuer_geoeffnet_Cx0_geschlossen)}, range raw 0..1, transfer-property=TRIGGERED-WITHOUT-REPETITION  # Zeigt eine geöffnete Tür an
    signal BT_verriegelt_XIX_DoorFunctions_BFS_01_XIX_VLAN_Cockpit: start 17, 1 bit, little-endian, data-type-policy=OVERRIDE, i-signal-type=PRIMITIVE, init-value=0, base-type=BT_BT_verriegelt, compu {1=Cx1_verriegelt (CM_BT_verriegelt_Cx1_verriegelt), 0=Cx0_Init (CM_BT_verriegelt_Cx0_Init)}, range raw 0..1, transfer-property=TRIGGERED-WITHOUT-REPETITION  # Zeigt eine verriegelte Tür an ( Status wird erst nach vollständiger Schlossansteuerung ausgegeben (<=1,5sek))
    signal BT_gesafet_XIX_DoorFunctions_BFS_01_XIX_VLAN_Cockpit: start 18, 1 bit, little-endian, data-type-policy=OVERRIDE, i-signal-type=PRIMITIVE, init-value=0, base-type=BT_BT_gesafet, compu {0=Cx0_Init (CM_BT_gesafet_Cx0_Init), 1=Cx1_gesafet (CM_BT_gesafet_Cx1_gesafet)}, range raw 0..1, transfer-property=TRIGGERED-WITHOUT-REPETITION  # Im Zustand Safe wird auch das Signal BT_verriegelt = 1 gesendet
    signal BT_Schluesselschalter_auf_XIX_DoorFunctions_BFS_01_XIX_VLAN_Cockpit: start 19, 1 bit, little-endian, data-type-policy=OVERRIDE, i-signal-type=PRIMITIVE, init-value=0, base-type=BT_BT_Schluesselschalter_auf, compu {0=Cx0_Init (CM_BT_Schluesselschalter_auf_Cx0_Init), 1=Cx1_Schluesselschalter_auf_betaetigt (CM_BT_Schluesselschalter_auf_Cx1_Schluesselschalter_auf_betaetigt)}, range raw 0..1, transfer-property=TRIGGERED-WITHOUT-REPETITION  # Schlüsselschalter Richtung auf betätigt
    signal BT_Schluesselschalter_zu_XIX_DoorFunctions_BFS_01_XIX_VLAN_Cockpit: start 20, 1 bit, little-endian, data-type-policy=OVERRIDE, i-signal-type=PRIMITIVE, init-value=0, base-type=BT_BT_Schluesselschalter_zu, compu {1=Cx1_Schluesselschalter_zu_betaetigt (CM_BT_Schluesselschalter_zu_Cx1_Schluesselschalter_zu_betaetigt), 0=Cx0_Init (CM_BT_Schluesselschalter_zu_Cx0_Init)}, range raw 0..1, transfer-property=TRIGGERED-WITHOUT-REPETITION  # Schluesselschalter Richtung zu betaetigt
    signal BT_Unlock_Taster_XIX_DoorFunctions_BFS_01_XIX_VLAN_Cockpit: start 21, 1 bit, little-endian, data-type-policy=OVERRIDE, i-signal-type=PRIMITIVE, init-value=0, base-type=BT_BT_Unlock_Taster, compu {0=Cx0_Init (CM_BT_Unlock_Taster_Cx0_Init), 1=Cx1_Unlock_Taster_betaetigt (CM_BT_Unlock_Taster_Cx1_Unlock_Taster_betaetigt)}, range raw 0..1, transfer-property=TRIGGERED-WITHOUT-REPETITION  # Entriegelungstaster betätigt
    signal BT_Lock_Taster_XIX_DoorFunctions_BFS_01_XIX_VLAN_Cockpit: start 22, 1 bit, little-endian, data-type-policy=OVERRIDE, i-signal-type=PRIMITIVE, init-value=0, base-type=BT_BT_Lock_Taster, compu {1=Cx1_Lock_Taster_betaetigt (CM_BT_Lock_Taster_Cx1_Lock_Taster_betaetigt), 0=Cx0_Init (CM_BT_Lock_Taster_Cx0_Init)}, range raw 0..1, transfer-property=TRIGGERED-WITHOUT-REPETITION  # Verriegelungstaster
    signal BT_Sperrklinke_XIX_DoorFunctions_BFS_01_XIX_VLAN_Cockpit: start 23, 1 bit, little-endian, data-type-policy=OVERRIDE, i-signal-type=PRIMITIVE, init-value=0, base-type=BT_BT_Sperrklinke, compu {1=Cx1_Tuer_auf_oder_Tuer_Position_zwischen_Vor_und_Hauptraste (CM_BT_Sperrklinke_Cx1_Tuer_auf_oder_Tuer_Position_zwischen_Vor_und_Hauptraste), 0=Cx0_Schloss_in_Vorraste_und_Hauptraste (CM_BT_Sperrklinke_Cx0_Schloss_in_Vorraste_und_Hauptraste)}, range raw 0..1, transfer-property=TRIGGERED-WITHOUT-REPETITION  # Vorraste für Schloß zwischen Vor- und Hauptraste Signal kurz auf 1, danach wieder auf 0 wenn Tür in Hauptraste (Tür ist sicher zu wenn Sperrklinke und Türkontakt auf 0 sind)
    signal BT_TAG_betaetigt_XIX_DoorFunctions_BFS_01_XIX_VLAN_Cockpit: start 24, 1 bit, little-endian, data-type-policy=OVERRIDE, i-signal-type=PRIMITIVE, init-value=0, base-type=BT_BT_TAG_betaetigt, compu {1=Cx1_Tuerinnengriff_betaetigt (CM_BT_TAG_betaetigt_Cx1_Tuerinnengriff_betaetigt), 0=Cx0_Init (CM_BT_TAG_betaetigt_Cx0_Init)}, range raw 0..1, transfer-property=TRIGGERED-WITHOUT-REPETITION  # Türaussengriff
    signal BT_TIG_betaetigt_XIX_DoorFunctions_BFS_01_XIX_VLAN_Cockpit: start 25, 1 bit, little-endian, data-type-policy=OVERRIDE, i-signal-type=PRIMITIVE, init-value=0, base-type=BT_BT_TIG_betaetigt, compu {0=Cx0_Init (CM_BT_TIG_betaetigt_Cx0_Init), 1=Cx1_Tuerinnengriff_betaetigt (CM_BT_TIG_betaetigt_Cx1_Tuerinnengriff_betaetigt)}, range raw 0..1, transfer-property=TRIGGERED-WITHOUT-REPETITION  # Türinnengriff
    signal BT_EC_Spiegel_Helligkeit_XIX_DoorFunctions_BFS_01_XIX_VLAN_Cockpit: start 26, 5 bit, little-endian, data-type-policy=OVERRIDE, i-signal-type=PRIMITIVE, init-value=0, base-type=BT_BT_EC_Spiegel_Helligkeit, compu {phys=raw*3.125 for raw 0..31; unit Unit_PerCent}, range phys 0..96.875 Unit_PerCent, raw 0..31, unit=Unit_PerCent, transfer-property=TRIGGERED-WITHOUT-REPETITION  # Dimmung für den Aussenspiegel in %
    signal BT_Sp_Heizung_Anf_XIX_DoorFunctions_BFS_01_XIX_VLAN_Cockpit: start 31, 1 bit, little-endian, data-type-policy=OVERRIDE, i-signal-type=PRIMITIVE, init-value=0, base-type=BT_BT_Sp_Heizung_Anf, compu {phys=raw*100 for raw 0..1; unit Unit_PerCent}, range phys 0..100 Unit_PerCent, raw 0..1, unit=Unit_PerCent, transfer-property=TRIGGERED-WITHOUT-REPETITION  # Kundenanforderung der Außenspiegelheizung Beifahrertür
    signal BT_Tuer_Status_XIX_DoorFunctions_BFS_01_XIX_VLAN_Cockpit: start 32, 2 bit, little-endian, data-type-policy=OVERRIDE, i-signal-type=PRIMITIVE, init-value=0, base-type=BT_BT_Tuer_Status, invalid-value=Invalid_BT_Tuer_Status_XIX_DoorFunctions_BFS_01_XIX_VLAN_Cockpit:3, compu {3=Cx3_Fehler (CM_BT_Tuer_Status_Cx3_Fehler), 2=Cx2_Tuer_offen (CM_BT_Tuer_Status_Cx2_Tuer_offen), 1=Cx1_Tuer_geschlossen (CM_BT_Tuer_Status_Cx1_Tuer_geschlossen), 0=Cx0_Init (CM_BT_Tuer_Status_Cx0_Init)}, range raw 0..3, transfer-property=TRIGGERED-WITHOUT-REPETITION, to HCP3_IONode(timeout 1 s)  # Türstatus mit Fehler und Initwert
    signal BT_Sp_Blk_def_XIX_DoorFunctions_BFS_01_XIX_VLAN_Cockpit: start 35, 1 bit, little-endian, data-type-policy=OVERRIDE, i-signal-type=PRIMITIVE, init-value=0, base-type=BT_BT_Sp_Blk_def, compu {1=Cx1_Spiegel_Blinker_defekt (CM_BT_Sp_Blk_def_Cx1_Spiegel_Blinker_defekt), 0=Cx0_iO (CM_BT_Sp_Blk_def_Cx0_iO)}, range raw 0..1, transfer-property=TRIGGERED-WITHOUT-REPETITION  # Blinker am Spiegel defekt
    signal BT_FH_S_ManHoch_XIX_DoorFunctions_BFS_01_XIX_VLAN_Cockpit: start 36, 1 bit, little-endian, data-type-policy=OVERRIDE, i-signal-type=PRIMITIVE, init-value=0, base-type=BT_BT_FH_S_ManHoch, compu {0=Cx0_Init (CM_BT_FH_S_ManHoch_Cx0_Init), 1=Cx1_FH_Schalter_man_hoch_gedrueckt (CM_BT_FH_S_ManHoch_Cx1_FH_Schalter_man_hoch_gedrueckt)}, range raw 0..1, transfer-property=TRIGGERED-WITHOUT-REPETITION  # FH Schalter manuell hoch gedrückt
    signal BT_FH_S_AutoHoch_XIX_DoorFunctions_BFS_01_XIX_VLAN_Cockpit: start 37, 1 bit, little-endian, data-type-policy=OVERRIDE, i-signal-type=PRIMITIVE, init-value=0, base-type=BT_BT_FH_S_AutoHoch, compu {1=Cx1_FH_Schalter_auto_hoch_gedrueckt (CM_BT_FH_S_AutoHoch_Cx1_FH_Schalter_auto_hoch_gedrueckt), 0=Cx0_Init (CM_BT_FH_S_AutoHoch_Cx0_Init)}, range raw 0..1, transfer-property=TRIGGERED-WITHOUT-REPETITION  # FH Schalter automatisch hoch gedrückt
    signal BT_FH_S_ManTief_XIX_DoorFunctions_BFS_01_XIX_VLAN_Cockpit: start 38, 1 bit, little-endian, data-type-policy=OVERRIDE, i-signal-type=PRIMITIVE, init-value=0, base-type=BT_BT_FH_S_ManTief, compu {0=Cx0_Init (CM_BT_FH_S_ManTief_Cx0_Init), 1=Cx1_FH_Schalter_man_tief_gedrueckt (CM_BT_FH_S_ManTief_Cx1_FH_Schalter_man_tief_gedrueckt)}, range raw 0..1, transfer-property=TRIGGERED-WITHOUT-REPETITION  # FH Schalter manuell tief gedrückt
    signal BT_FH_S_AutoTief_XIX_DoorFunctions_BFS_01_XIX_VLAN_Cockpit: start 39, 1 bit, little-endian, data-type-policy=OVERRIDE, i-signal-type=PRIMITIVE, init-value=0, base-type=BT_BT_FH_S_AutoTief, compu {0=Cx0_Init (CM_BT_FH_S_AutoTief_Cx0_Init), 1=Cx1_FH_Schalter_auto_tief_gedrueckt (CM_BT_FH_S_AutoTief_Cx1_FH_Schalter_auto_tief_gedrueckt)}, range raw 0..1, transfer-property=TRIGGERED-WITHOUT-REPETITION  # FH Schalter automatisch tief gedrückt
    signal BT_FH_Oeffnung_XIX_DoorFunctions_BFS_01_XIX_VLAN_Cockpit: start 40, 8 bit, little-endian, data-type-policy=OVERRIDE, i-signal-type=PRIMITIVE, init-value=0, base-type=BT_BT_FH_Oeffnung, compu {phys=raw*0.5 for raw 0..200; unit Unit_PerCent}, range phys 0..100 Unit_PerCent, raw 0..200, unit=Unit_PerCent, transfer-property=TRIGGERED-WITHOUT-REPETITION  # Gibt den Fensteröffnungswert in % an.
    signal BT_FH_Bew_hoch_XIX_DoorFunctions_BFS_01_XIX_VLAN_Cockpit: start 48, 1 bit, little-endian, data-type-policy=OVERRIDE, i-signal-type=PRIMITIVE, init-value=0, base-type=BT_BT_FH_Bew_hoch, compu {1=Cx1_FH_ist_in_Bewegung_hoch (CM_BT_FH_Bew_hoch_Cx1_FH_ist_in_Bewegung_hoch), 0=Cx0_Init (CM_BT_FH_Bew_hoch_Cx0_Init)}, range raw 0..1, transfer-property=TRIGGERED-WITHOUT-REPETITION  # Fensterheber in Bewegung Richtung hoch
    signal BT_FH_Bew_tief_XIX_DoorFunctions_BFS_01_XIX_VLAN_Cockpit: start 49, 1 bit, little-endian, data-type-policy=OVERRIDE, i-signal-type=PRIMITIVE, init-value=0, base-type=BT_BT_FH_Bew_tief, compu {1=Cx1_FH_ist_in_Bewegung_tief (CM_BT_FH_Bew_tief_Cx1_FH_ist_in_Bewegung_tief), 0=Cx0_Init (CM_BT_FH_Bew_tief_Cx0_Init)}, range raw 0..1, transfer-property=TRIGGERED-WITHOUT-REPETITION  # Fensterheber in Bewegung Richtung tief
    signal BT_FH_Fang_XIX_DoorFunctions_BFS_01_XIX_VLAN_Cockpit: start 50, 1 bit, little-endian, data-type-policy=OVERRIDE, i-signal-type=PRIMITIVE, init-value=0, base-type=BT_BT_FH_Fang, compu {0=Cx0_ausserhalb_Fangbereich (CM_BT_FH_Fang_Cx0_ausserhalb_Fangbereich), 1=Cx1_innerhalb_Fangbereich (CM_BT_FH_Fang_Cx1_innerhalb_Fangbereich)}, range raw 0..1, transfer-property=TRIGGERED-WITHOUT-REPETITION  # Fangbereich ist 4mm von oberer Lippendichtung
    signal BT_FH_Block_XIX_DoorFunctions_BFS_01_XIX_VLAN_Cockpit: start 51, 1 bit, little-endian, data-type-policy=OVERRIDE, i-signal-type=PRIMITIVE, init-value=0, base-type=BT_BT_FH_Block, compu {0=Cx0_Init (CM_BT_FH_Block_Cx0_Init), 1=Cx1_Fensterheber_Block (CM_BT_FH_Block_Cx1_Fensterheber_Block)}, range raw 0..1, transfer-property=TRIGGERED-WITHOUT-REPETITION  # Fensterscheibe befindet sich im mechanischen Block (oben oder unten)
    signal BT_FH_Thermo_XIX_DoorFunctions_BFS_01_XIX_VLAN_Cockpit: start 52, 1 bit, little-endian, data-type-policy=OVERRIDE, i-signal-type=PRIMITIVE, init-value=0, base-type=BT_BT_FH_Thermo, compu {0=Cx0_Init (CM_BT_FH_Thermo_Cx0_Init), 1=Cx1_Thermoschutz_aktiv (CM_BT_FH_Thermo_Cx1_Thermoschutz_aktiv)}, range raw 0..1, transfer-property=TRIGGERED-WITHOUT-REPETITION  # gibt an ob Fensterheber im Thermoschutz ist
    signal BT_UEKB_aktiviert_XIX_DoorFunctions_BFS_01_XIX_VLAN_Cockpit: start 53, 1 bit, little-endian, data-type-policy=OVERRIDE, i-signal-type=PRIMITIVE, init-value=0, base-type=BT_BT_UEKB_aktiviert, compu {0=Cx0_Init (CM_BT_UEKB_aktiviert_Cx0_Init), 1=Cx1_aktiv (CM_BT_UEKB_aktiviert_Cx1_aktiv)}, range raw 0..1, transfer-property=TRIGGERED-WITHOUT-REPETITION  # Überschutzbegrenzungskraft bei Reversieren
    signal BT_Kisi_Fehler_XIX_DoorFunctions_BFS_01_XIX_VLAN_Cockpit: start 54, 1 bit, little-endian, data-type-policy=OVERRIDE, i-signal-type=PRIMITIVE, init-value=0, base-type=BT_BT_Kisi_Fehler, invalid-value=Invalid_BT_Kisi_Fehler_XIX_DoorFunctions_BFS_01_XIX_VLAN_Cockpit:1, compu {1=Cx1_Fehler (CM_BT_Kisi_Fehler_Cx1_Fehler), 0=Cx0_kein_Fehler (CM_BT_Kisi_Fehler_Cx0_kein_Fehler)}, range raw 0..1, transfer-property=TRIGGERED-WITHOUT-REPETITION  # Fehlerstatus Kindersicherungsfunktion
    signal BT_FH_normiert_XIX_DoorFunctions_BFS_01_XIX_VLAN_Cockpit: start 55, 1 bit, little-endian, data-type-policy=OVERRIDE, i-signal-type=PRIMITIVE, init-value=0, base-type=BT_BT_FH_normiert, compu {1=Cx1_Fenster_normiert (CM_BT_FH_normiert_Cx1_Fenster_normiert), 0=Cx0_Init (CM_BT_FH_normiert_Cx0_Init)}, range raw 0..1, transfer-property=TRIGGERED-WITHOUT-REPETITION  # Die Position der Fensterheberscheibe ist bekannt
    signal BT_Zuziehhilfe_aktiv_XIX_DoorFunctions_BFS_01_XIX_VLAN_Cockpit: start 57, 1 bit, little-endian, data-type-policy=OVERRIDE, i-signal-type=PRIMITIVE, init-value=0, base-type=BT_BT_Zuziehhilfe_aktiv, compu {1=Cx1_Zuziehhilfe_aktiv (CM_BT_Zuziehhilfe_aktiv_Cx1_Zuziehhilfe_aktiv), 0=Cx0_Init (CM_BT_Zuziehhilfe_aktiv_Cx0_Init)}, range raw 0..1, transfer-property=TRIGGERED-WITHOUT-REPETITION  # Zuziehhilfe aktiv
    signal BT_SP_ausgerastet_XIX_DoorFunctions_BFS_01_XIX_VLAN_Cockpit: start 58, 1 bit, little-endian, data-type-policy=OVERRIDE, i-signal-type=PRIMITIVE, init-value=0, base-type=BT_BT_SP_ausgerastet, compu {0=Cx0_Init (CM_BT_SP_ausgerastet_Cx0_Init), 1=Cx1_Spiegel_ausgerastet (CM_BT_SP_ausgerastet_Cx1_Spiegel_ausgerastet)}, range raw 0..1, transfer-property=TRIGGERED-WITHOUT-REPETITION  # Spiegel ausgerastet
    signal BT_SP_lr_aktiv_XIX_DoorFunctions_BFS_01_XIX_VLAN_Cockpit: start 59, 1 bit, little-endian, data-type-policy=OVERRIDE, i-signal-type=PRIMITIVE, init-value=0, base-type=BT_BT_SP_lr_aktiv, compu {1=Cx1_Spiegel_xAchse_aktiv (CM_BT_SP_lr_aktiv_Cx1_Spiegel_xAchse_aktiv), 0=Cx0_Init (CM_BT_SP_lr_aktiv_Cx0_Init)}, range raw 0..1, transfer-property=TRIGGERED-WITHOUT-REPETITION  # Spiegelverstellung in Richtung links/rechts aktiv
    signal BT_SP_ht_aktiv_XIX_DoorFunctions_BFS_01_XIX_VLAN_Cockpit: start 60, 1 bit, little-endian, data-type-policy=OVERRIDE, i-signal-type=PRIMITIVE, init-value=0, base-type=BT_BT_SP_ht_aktiv, compu {1=Cx1_Spiegel_yAchse_aktiv (CM_BT_SP_ht_aktiv_Cx1_Spiegel_yAchse_aktiv), 0=Cx0_Init (CM_BT_SP_ht_aktiv_Cx0_Init)}, range raw 0..1, transfer-property=TRIGGERED-WITHOUT-REPETITION  # Spiegelverstellung in Richtung hoch/tief aktiv
    signal BT_Oben_Block_erw_XIX_DoorFunctions_BFS_01_XIX_VLAN_Cockpit: start 62, 1 bit, little-endian, data-type-policy=OVERRIDE, i-signal-type=PRIMITIVE, init-value=0, base-type=BT_BT_Oben_Block_erw, compu {0=Cx0_Fensterheber_nicht_in_Blockerwar (CM_BT_Oben_Block_erw_Cx0_Fensterheber_nicht_in_Blockerwar), 1=Cx1_Fensterheber_in_Blockerwartung_o (CM_BT_Oben_Block_erw_Cx1_Fensterheber_in_Blockerwartung_o)}, range raw 0..1, transfer-property=TRIGGERED-WITHOUT-REPETITION  # Fensterheber in Blockerwartung oben
    signal BT_Unten_Block_erw_XIX_DoorFunctions_BFS_01_XIX_VLAN_Cockpit: start 63, 1 bit, little-endian, data-type-policy=OVERRIDE, i-signal-type=PRIMITIVE, init-value=0, base-type=BT_BT_Unten_Block_erw, compu {0=Cx0_Fensterheber_nicht_in_Blockerwar (CM_BT_Unten_Block_erw_Cx0_Fensterheber_nicht_in_Blockerwar), 1=Cx1_Fensterheber_in_Blockerwartung_u (CM_BT_Unten_Block_erw_Cx1_Fensterheber_in_Blockerwartung_u)}, range raw 0..1, transfer-property=TRIGGERED-WITHOUT-REPETITION  # Fensterheber in Blockerwartung unten
    signal BT_Tuer_Status_QBit_XIX_DoorFunctions_BFS_01_XIX_VLAN_Cockpit: start 64, 1 bit, little-endian, data-type-policy=OVERRIDE, i-signal-type=PRIMITIVE, init-value=0, base-type=BT_BT_Tuer_Status_QBit, compu {0=Cx0_Status_Tuerkontakt_sicher (CM_BT_Tuer_Status_QBit_Cx0_Status_Tuerkontakt_sicher), 1=Cx1_Status_Tuerkontakt_unsicher (CM_BT_Tuer_Status_QBit_Cx1_Status_Tuerkontakt_unsicher)}, range raw 0..1, transfer-property=TRIGGERED-WITHOUT-REPETITION  # Dieses Bit gibt die Zuverlässigkeit des Türkontakts an. Ein auf dieses Bit folgender Fehlereintrag ist mit dem Sender des Bits abzustimmen (gültig ab PPE).
    signal BFS_Status_eTAG_XIX_DoorFunctions_BFS_01_XIX_VLAN_Cockpit: start 65, 2 bit, little-endian, data-type-policy=OVERRIDE, i-signal-type=PRIMITIVE, init-value=0, base-type=BT_BFS_Status_eTAG, invalid-value=Invalid_BFS_Status_eTAG_XIX_DoorFunctions_BFS_01_XIX_VLAN_Cockpit:3, compu {3=Cx3_Fehler (CM_BFS_Status_eTAG_Cx3_Fehler), 0=Cx0_Init (CM_BFS_Status_eTAG_Cx0_Init), 1=Cx1_Griff_ausgefahren (CM_BFS_Status_eTAG_Cx1_Griff_ausgefahren), 2=Cx2_Griff_eingefahren (CM_BFS_Status_eTAG_Cx2_Griff_eingefahren)}, range raw 0..3, transfer-property=TRIGGERED-WITHOUT-REPETITION  # Status des elektrischen Tueraussengriffes Beifahrertuer
    signal BT_TCR_Mode_aktiv_XIX_DoorFunctions_BFS_01_XIX_VLAN_Cockpit: start 67, 1 bit, little-endian, data-type-policy=OVERRIDE, i-signal-type=PRIMITIVE, init-value=0, base-type=BT_BT_TCR_Mode_aktiv, compu {1=Cx1_TCR_Mode_aktiv (CM_BT_TCR_Mode_aktiv_Cx1_TCR_Mode_aktiv), 0=Cx0_TCR_Mode_deaktiv (CM_BT_TCR_Mode_aktiv_Cx0_TCR_Mode_deaktiv)}, range raw 0..1, transfer-property=TRIGGERED-WITHOUT-REPETITION  # Signal zeigt eine aktive mechanische Redundanz am Türschloss an.
    signal BT_SP_Heizung_Status_XIX_DoorFunctions_BFS_01_XIX_VLAN_Cockpit: start 71, 1 bit, little-endian, data-type-policy=OVERRIDE, i-signal-type=PRIMITIVE, init-value=0, base-type=BT_BT_SP_Heizung_Status, compu {1=Cx1_Status_Spiegelheizung_ein (CM_BT_SP_Heizung_Status_Cx1_Status_Spiegelheizung_ein), 0=Cx0_Init (CM_BT_SP_Heizung_Status_Cx0_Init)}, range raw 0..1, transfer-property=TRIGGERED-WITHOUT-REPETITION  # Status der Spiegelheizung
    signal ASW_Warnung_aktiv_BFS_XIX_DoorFunctions_BFS_01_XIX_VLAN_Cockpit: start 72, 1 bit, little-endian, data-type-policy=OVERRIDE, i-signal-type=PRIMITIVE, init-value=0, base-type=BT_ASW_Warnung_aktiv_BFS, compu {0=Cx0_nicht_angefordert (CM_ASW_Warnung_aktiv_BFS_Cx0_nicht_angefordert), 1=Cx1_angefordert (CM_ASW_Warnung_aktiv_BFS_Cx1_angefordert)}, range raw 0..1, transfer-property=TRIGGERED-WITHOUT-REPETITION  # Abschaltung der Ambientefunktion Beifahrertür bei aktiver ASW Warnung an der Fahrertür
    signal BT_FH_Pos_oben_XIX_DoorFunctions_BFS_01_XIX_VLAN_Cockpit: start 73, 1 bit, little-endian, data-type-policy=OVERRIDE, i-signal-type=PRIMITIVE, init-value=0, base-type=BT_BT_FH_Pos_oben, compu {1=Cx1_Scheibe_oben_nach_Absenken_auf_Position (CM_BT_FH_Pos_oben_Cx1_Scheibe_oben_nach_Absenken_auf_Position) (Scheibe oben (nach Absenken auf Position))}, range raw 1, transfer-property=TRIGGERED-WITHOUT-REPETITION
    signal BT_Tuerschloss_defekt_XIX_DoorFunctions_BFS_01_XIX_VLAN_Cockpit: start 74, 1 bit, little-endian, data-type-policy=OVERRIDE, i-signal-type=PRIMITIVE, init-value=0, base-type=BT_BT_Tuerschloss_defekt, compu {0=Cx0_Tuerschloss_funktionsfaehig (CM_BT_Tuerschloss_defekt_Cx0_Tuerschloss_funktionsfaehig), 1=Cx1_Tuerschloss_defekt (CM_BT_Tuerschloss_defekt_Cx1_Tuerschloss_defekt)}, range raw 0..1, transfer-property=TRIGGERED-WITHOUT-REPETITION  # Das Beifahrertürschloss ist nicht mehr funktionsfähig.
    signal BT_Tueroeffnen_Warnung_XIX_DoorFunctions_BFS_01_XIX_VLAN_Cockpit: start 75, 1 bit, little-endian, data-type-policy=OVERRIDE, i-signal-type=PRIMITIVE, init-value=0, base-type=BT_BT_Tueroeffnen_Warnung, compu {0=Cx0_Tuerwarnung_nicht_aktiv (CM_BT_Tueroeffnen_Warnung_Cx0_Tuerwarnung_nicht_aktiv), 1=Cx1_Tuerwarnung_aktiv (CM_BT_Tueroeffnen_Warnung_Cx1_Tuerwarnung_aktiv)}, range raw 0..1, transfer-property=TRIGGERED-WITHOUT-REPETITION  # Bit wird gesetzt, wenn Tür während der Fahrt geoeffnet werden soll.
    signal BT_SWA_HMI_defekt_XIX_DoorFunctions_BFS_01_XIX_VLAN_Cockpit: start 78, 1 bit, little-endian, data-type-policy=OVERRIDE, i-signal-type=PRIMITIVE, init-value=0, base-type=BT_BT_SWA_HMI_defekt, compu {0=Cx0_SWA_kein_Fehler (CM_BT_SWA_HMI_defekt_Cx0_SWA_kein_Fehler), 1=Cx1_SWA_Fehler (CM_BT_SWA_HMI_defekt_Cx1_SWA_Fehler)}, range raw 0..1, transfer-property=TRIGGERED-WITHOUT-REPETITION  # Zeigt an, ob die SWA-Anzeige defekt ist.
    signal BT_ASW_HMI_defekt_XIX_DoorFunctions_BFS_01_XIX_VLAN_Cockpit: start 79, 1 bit, little-endian, data-type-policy=OVERRIDE, i-signal-type=PRIMITIVE, init-value=0, base-type=BT_BT_ASW_HMI_defekt, compu {0=Cx0_ASW_kein_Fehler (CM_BT_ASW_HMI_defekt_Cx0_ASW_kein_Fehler), 1=Cx1_ASW_Fehler (CM_BT_ASW_HMI_defekt_Cx1_ASW_Fehler)}, range raw 0..1, transfer-property=TRIGGERED-WITHOUT-REPETITION  # Zeigt an, ob die ASW-Anzeige defekt ist.
    signal MTBT_Pos1_XIX_DoorFunctions_BFS_01_XIX_VLAN_Cockpit: start 96, 1 bit, little-endian, data-type-policy=OVERRIDE, i-signal-type=PRIMITIVE, init-value=0, base-type=BT_MTBT_Pos1, compu {0=Cx0_Taste_nicht_gedrueckt (CM_MTBT_Pos1_Cx0_Taste_nicht_gedrueckt), 1=Cx1_Postionstaste_1_BT_gedrueckt (CM_MTBT_Pos1_Cx1_Postionstaste_1_BT_gedrueckt)}, range raw 0..1, transfer-property=TRIGGERED-WITHOUT-REPETITION  # Betätigung Postionstaste 1 BT
    signal MTBT_Pos2_XIX_DoorFunctions_BFS_01_XIX_VLAN_Cockpit: start 97, 1 bit, little-endian, data-type-policy=OVERRIDE, i-signal-type=PRIMITIVE, init-value=0, base-type=BT_MTBT_Pos2, compu {1=Cx1_Postionstaste_2_BT_gedrueckt (CM_MTBT_Pos2_Cx1_Postionstaste_2_BT_gedrueckt), 0=Cx0_Taste_nicht_gedrueckt (CM_MTBT_Pos2_Cx0_Taste_nicht_gedrueckt)}, range raw 0..1, transfer-property=TRIGGERED-WITHOUT-REPETITION  # Betätigung Postionstaste 2 BT
    signal MTBT_Pos3_XIX_DoorFunctions_BFS_01_XIX_VLAN_Cockpit: start 98, 1 bit, little-endian, data-type-policy=OVERRIDE, i-signal-type=PRIMITIVE, init-value=0, base-type=BT_MTBT_Pos3, compu {1=Cx1_Postionstaste_3_BT_gedrueckt (CM_MTBT_Pos3_Cx1_Postionstaste_3_BT_gedrueckt), 0=Cx0_Taste_nicht_gedrueckt (CM_MTBT_Pos3_Cx0_Taste_nicht_gedrueckt)}, range raw 0..1, transfer-property=TRIGGERED-WITHOUT-REPETITION  # Betätigung Postionstaste 3 BT
    signal MTBT_Pos4_XIX_DoorFunctions_BFS_01_XIX_VLAN_Cockpit: start 99, 1 bit, little-endian, data-type-policy=OVERRIDE, i-signal-type=PRIMITIVE, init-value=0, base-type=BT_MTBT_Pos4, compu {0=Cx0_Taste_nicht_gedrueckt (CM_MTBT_Pos4_Cx0_Taste_nicht_gedrueckt), 1=Cx1_Postionstaste_4_BT_gedrueckt (CM_MTBT_Pos4_Cx1_Postionstaste_4_BT_gedrueckt)}, range raw 0..1, transfer-property=TRIGGERED-WITHOUT-REPETITION  # Betätigung Postionstaste 4 BT
    signal MTBT_On_Off_XIX_DoorFunctions_BFS_01_XIX_VLAN_Cockpit: start 100, 1 bit, little-endian, data-type-policy=OVERRIDE, i-signal-type=PRIMITIVE, init-value=0, base-type=BT_MTBT_On_Off, compu {0=Cx0_Taste_nicht_gedrueckt (CM_MTBT_On_Off_Cx0_Taste_nicht_gedrueckt), 1=Cx1_OnOff_Taste_BT_gedrueckt (CM_MTBT_On_Off_Cx1_OnOff_Taste_BT_gedrueckt)}, range raw 0..1, transfer-property=TRIGGERED-WITHOUT-REPETITION  # Betätigung On-Off Taste BT
    signal MTBT_M_Taste_XIX_DoorFunctions_BFS_01_XIX_VLAN_Cockpit: start 103, 1 bit, little-endian, data-type-policy=OVERRIDE, i-signal-type=PRIMITIVE, init-value=0, base-type=BT_MTBT_M_Taste, compu {0=Cx0_Taste_nicht_gedrueckt (CM_MTBT_M_Taste_Cx0_Taste_nicht_gedrueckt), 1=Cx1_MTaste_BT_gedrueckt (CM_MTBT_M_Taste_Cx1_MTaste_BT_gedrueckt)}, range raw 0..1, transfer-property=TRIGGERED-WITHOUT-REPETITION  # Betätigung M-Taste BT
    signal SSA_BFT_FH_Oeffnungsweite_XIX_DoorFunctions_BFS_01_XIX_VLAN_Cockpit: start 104, 8 bit, little-endian, data-type-policy=OVERRIDE, i-signal-type=PRIMITIVE, init-value=0, base-type=BT_SSA_BFT_FH_Oeffnungsweite, compu {phys=raw*0.5 for raw 0..200; unit Unit_PerCent}, range phys 0..100 Unit_PerCent, raw 0..200, unit=Unit_PerCent, transfer-property=TRIGGERED-WITHOUT-REPETITION  # SmartSensorActor: Rückmeldung der Öffnungsweite des Fensterhebers (0% geschlossen, 100% geöffnet) Angabe gilt nur bei normierten Fensterheber
    signal SSA_BFT_ASP_Heizung_Status_XIX_DoorFunctions_BFS_01_XIX_VLAN_Cockpit: start 112, 7 bit, little-endian, data-type-policy=OVERRIDE, i-signal-type=PRIMITIVE, init-value=0, base-type=BT_SSA_BFT_ASP_Heizung_Status, invalid-value=Invalid_SSA_BFT_ASP_Heizung_Status_XIX_DoorFunctions_BFS_01_XIX_VLAN_Cockpit:127, compu {phys=raw for raw 0..100, 127=Cx7f_Fehler (CM_SSA_BFT_ASP_Heizung_Status_Cx7f_Fehler); unit Unit_PerCent}, range phys 0..100 Unit_PerCent, raw 0..127, unit=Unit_PerCent, transfer-property=TRIGGERED-WITHOUT-REPETITION  # SmartSensorActor: Rueckmeldung des Status der Spiegelheizung
    signal SSA_BFT_ASP_Spiegelglas_Pos_X_XIX_DoorFunctions_BFS_01_XIX_VLAN_Cockpit: start 119, 7 bit, little-endian, data-type-policy=OVERRIDE, i-signal-type=PRIMITIVE, init-value=0, base-type=BT_SSA_BFT_ASP_Spiegelglas_Pos_X, invalid-value=Invalid_SSA_BFT_ASP_Spiegelglas_Pos_X_XIX_DoorFunctions_BFS_01_XIX_VLAN_Cockpit:127, compu {phys=raw for raw 0..100, 127=Cx7f_Fehler (CM_SSA_BFT_ASP_Spiegelglas_Pos_X_Cx7f_Fehler); unit Unit_PerCent}, range phys 0..100 Unit_PerCent, raw 0..127, unit=Unit_PerCent, transfer-property=TRIGGERED-WITHOUT-REPETITION  # SmartSensorActor: Rückmeldung der Position des Spiegelglases auf der X-Achse
    signal SSA_BFT_ZV_Status_XIX_DoorFunctions_BFS_01_XIX_VLAN_Cockpit: start 128, 4 bit, little-endian, data-type-policy=OVERRIDE, i-signal-type=PRIMITIVE, init-value=0, base-type=BT_SSA_BFT_ZV_Status, invalid-value=Invalid_SSA_BFT_ZV_Status_XIX_DoorFunctions_BFS_01_XIX_VLAN_Cockpit:15, compu {15=Cxf_Fehler (CM_SSA_BFT_ZV_Status_Cxf_Fehler), 1=Cx1_entriegeltentsafet (CM_SSA_BFT_ZV_Status_Cx1_entriegeltentsafet), 0=Cx0_Init (CM_SSA_BFT_ZV_Status_Cx0_Init), 2=Cx2_verriegeltentsafet (CM_SSA_BFT_ZV_Status_Cx2_verriegeltentsafet), 3=Cx3_verriegeltgesafet (CM_SSA_BFT_ZV_Status_Cx3_verriegeltgesafet)}, range raw 0..15, transfer-property=TRIGGERED-WITHOUT-REPETITION  # SmartSensorActor: Zustand des Türschlosses der Beifahrertür
    signal TSG_FlHz_BFS_Unterbrech_HzK_A_XIX_DoorFunctions_BFS_01_XIX_VLAN_Cockpit: start 150, 1 bit, little-endian, data-type-policy=OVERRIDE, i-signal-type=PRIMITIVE, init-value=0, base-type=BT_TSG_FlHz_BFS_Unterbrech_HzK_A, compu {1=Cx1_Unterbrechung (CM_TSG_FlHz_BFS_Unterbrech_HzK_A_Cx1_Unterbrechung), 0=Cx0_keine_Unterbrechung (CM_TSG_FlHz_BFS_Unterbrech_HzK_A_Cx0_keine_Unterbrechung)}, range raw 0..1, transfer-property=TRIGGERED-WITHOUT-REPETITION  # Flächenheizung: Unterbrechungsstatus Heizkreis
    signal TSG_FlHz_BFS_Unterbrech_HzK_B_XIX_DoorFunctions_BFS_01_XIX_VLAN_Cockpit: start 151, 1 bit, little-endian, data-type-policy=OVERRIDE, i-signal-type=PRIMITIVE, init-value=0, base-type=BT_TSG_FlHz_BFS_Unterbrech_HzK_B, compu {1=Cx1_Unterbrechung (CM_TSG_FlHz_BFS_Unterbrech_HzK_B_Cx1_Unterbrechung), 0=Cx0_keine_Unterbrechung (CM_TSG_FlHz_BFS_Unterbrech_HzK_B_Cx0_keine_Unterbrechung)}, range raw 0..1, transfer-property=TRIGGERED-WITHOUT-REPETITION  # Flächenheizung: Unterbrechungsstatus Heizkreis
    signal TSG_FlHz_BFS_NTC_A_XIX_DoorFunctions_BFS_01_XIX_VLAN_Cockpit: start 152, 7 bit, little-endian, data-type-policy=OVERRIDE, i-signal-type=PRIMITIVE, init-value=127, base-type=BT_TSG_FlHz_BFS_NTC_A, compu {phys=raw-40 for raw 0..120, 127=Cx7f_Init (CM_TSG_FlHz_BFS_NTC_A_Cx7f_Init), 125=Cx7d_Fehler_NTC_OpenLoad_KS_Plus (CM_TSG_FlHz_BFS_NTC_A_Cx7d_Fehler_NTC_OpenLoad_KS_Plus), 126=Cx7e_Fehler_NTC_Overload_KS_Minus (CM_TSG_FlHz_BFS_NTC_A_Cx7e_Fehler_NTC_Overload_KS_Minus); unit Unit_DegreCelsi}, range phys -40..80 Unit_DegreCelsi, raw 0..127, unit=Unit_DegreCelsi, transfer-property=TRIGGERED-WITHOUT-REPETITION  # Flächenheizung: Temperatur und Fehlerwert des Heizaktors
    signal TSG_FlHz_BFS_FnAbbruchHzKreis_A_XIX_DoorFunctions_BFS_01_XIX_VLAN_Cockpit: start 159, 1 bit, little-endian, data-type-policy=OVERRIDE, i-signal-type=PRIMITIVE, init-value=0, base-type=BT_TSG_FlHz_BFS_FnAbbruchHzKreis_A, compu {0=Cx0_OK (CM_TSG_FlHz_BFS_FnAbbruchHzKreis_A_Cx0_OK), 1=Cx1_FunktionsAbbruch (CM_TSG_FlHz_BFS_FnAbbruchHzKreis_A_Cx1_FunktionsAbbruch)}, range raw 0..1, transfer-property=TRIGGERED-WITHOUT-REPETITION  # Flächenheizung: Status
    signal TSG_FlHz_BFS_NTC_B_XIX_DoorFunctions_BFS_01_XIX_VLAN_Cockpit: start 160, 7 bit, little-endian, data-type-policy=OVERRIDE, i-signal-type=PRIMITIVE, init-value=127, base-type=BT_TSG_FlHz_BFS_NTC_B, compu {phys=raw-40 for raw 0..120, 127=Cx7f_Init (CM_TSG_FlHz_BFS_NTC_B_Cx7f_Init), 125=Cx7d_Fehler_NTC_OpenLoad_KS_Plus (CM_TSG_FlHz_BFS_NTC_B_Cx7d_Fehler_NTC_OpenLoad_KS_Plus), 126=Cx7e_Fehler_NTC_Overload_KS_Minus (CM_TSG_FlHz_BFS_NTC_B_Cx7e_Fehler_NTC_Overload_KS_Minus); unit Unit_DegreCelsi}, range phys -40..80 Unit_DegreCelsi, raw 0..127, unit=Unit_DegreCelsi, transfer-property=TRIGGERED-WITHOUT-REPETITION  # Flächenheizung: Temperatur und Fehlerwert des Heizaktors
    signal TSG_FlHz_BFS_FnAbbruchHzKreis_B_XIX_DoorFunctions_BFS_01_XIX_VLAN_Cockpit: start 167, 1 bit, little-endian, data-type-policy=OVERRIDE, i-signal-type=PRIMITIVE, init-value=0, base-type=BT_TSG_FlHz_BFS_FnAbbruchHzKreis_B, compu {1=Cx1_FunktionsAbbruch (CM_TSG_FlHz_BFS_FnAbbruchHzKreis_B_Cx1_FunktionsAbbruch), 0=Cx0_OK (CM_TSG_FlHz_BFS_FnAbbruchHzKreis_B_Cx0_OK)}, range raw 0..1, transfer-property=TRIGGERED-WITHOUT-REPETITION  # Flächenheizung: Status
    signal SSA_BFT_ASP_Spiegelglas_Fehler_XIX_DoorFunctions_BFS_01_XIX_VLAN_Cockpit: start 168, 3 bit, little-endian, data-type-policy=OVERRIDE, i-signal-type=PRIMITIVE, init-value=0, base-type=BT_SSA_BFT_ASP_Spiegelglas_Fehler, compu {5=Cx5_Bedingung_nicht_erfuellt (CM_SSA_BFT_ASP_Spiegelglas_Fehler_Cx5_Bedingung_nicht_erfuellt), 4=Cx4_elektrischer_Fehler (CM_SSA_BFT_ASP_Spiegelglas_Fehler_Cx4_elektrischer_Fehler), 0=Cx0_in_Ordnung (CM_SSA_BFT_ASP_Spiegelglas_Fehler_Cx0_in_Ordnung), 2=Cx2_Unterspannung (CM_SSA_BFT_ASP_Spiegelglas_Fehler_Cx2_Unterspannung), 1=Cx1_nicht_verbaut (CM_SSA_BFT_ASP_Spiegelglas_Fehler_Cx1_nicht_verbaut), 3=Cx3_Ueberspannung (CM_SSA_BFT_ASP_Spiegelglas_Fehler_Cx3_Ueberspannung)}, range raw 0..5, transfer-property=TRIGGERED-WITHOUT-REPETITION  # SmartSensorActor: Rückmeldung des Fehlerzustand der Spiegelglasverstellung auf der Beifahrerseite
    signal SSA_BFT_ASW_Fehler_XIX_DoorFunctions_BFS_01_XIX_VLAN_Cockpit: start 171, 3 bit, little-endian, data-type-policy=OVERRIDE, i-signal-type=PRIMITIVE, init-value=0, base-type=BT_SSA_BFT_ASW_Fehler, compu {2=Cx2_Unterspannung (CM_SSA_BFT_ASW_Fehler_Cx2_Unterspannung), 5=Cx5_Bedingung_nicht_erfuellt (CM_SSA_BFT_ASW_Fehler_Cx5_Bedingung_nicht_erfuellt), 0=Cx0_iO (CM_SSA_BFT_ASW_Fehler_Cx0_iO), 4=Cx4_el_Fehler (CM_SSA_BFT_ASW_Fehler_Cx4_el_Fehler), 1=Cx1_nicht_verbaut (CM_SSA_BFT_ASW_Fehler_Cx1_nicht_verbaut), 3=Cx3_Ueberspannung (CM_SSA_BFT_ASW_Fehler_Cx3_Ueberspannung)}, range raw 0..5, transfer-property=TRIGGERED-WITHOUT-REPETITION  # SmartSensorActor: Rückmeldung des Fehlerzustand des Ausstiegswarners
    signal SSA_BFT_ASW_Status_XIX_DoorFunctions_BFS_01_XIX_VLAN_Cockpit: start 174, 2 bit, little-endian, data-type-policy=OVERRIDE, i-signal-type=PRIMITIVE, init-value=0, base-type=BT_SSA_BFT_ASW_Status, compu {0=Cx0_Init (CM_SSA_BFT_ASW_Status_Cx0_Init), 2=Cx2_Warnstufe_aktiv (CM_SSA_BFT_ASW_Status_Cx2_Warnstufe_aktiv), 1=Cx1_InfoStufe_aktiv (CM_SSA_BFT_ASW_Status_Cx1_InfoStufe_aktiv)}, range raw 0..2, transfer-property=TRIGGERED-WITHOUT-REPETITION  # SmartSensorActor: Rückmeldung des Status der ASW Anzyeige.
    signal SSA_BFT_el_Tuerantrieb_Fehler_XIX_DoorFunctions_BFS_01_XIX_VLAN_Cockpit: start 176, 3 bit, little-endian, data-type-policy=OVERRIDE, i-signal-type=PRIMITIVE, init-value=0, base-type=BT_SSA_BFT_el_Tuerantrieb_Fehler, compu {0=Cx0_iO (CM_SSA_BFT_el_Tuerantrieb_Fehler_Cx0_iO), 3=Cx3_Ueberspannung (CM_SSA_BFT_el_Tuerantrieb_Fehler_Cx3_Ueberspannung), 2=Cx2_Unterspannung (CM_SSA_BFT_el_Tuerantrieb_Fehler_Cx2_Unterspannung), 4=Cx4_el_Fehler (CM_SSA_BFT_el_Tuerantrieb_Fehler_Cx4_el_Fehler), 5=Cx5_Bedingung_nicht_erfuellt (CM_SSA_BFT_el_Tuerantrieb_Fehler_Cx5_Bedingung_nicht_erfuellt), 1=Cx1_nicht_verbaut (CM_SSA_BFT_el_Tuerantrieb_Fehler_Cx1_nicht_verbaut)}, range raw 0..5, transfer-property=TRIGGERED-WITHOUT-REPETITION  # SmartSensorActor: Rückmeldung des Fehlerzustand des el. Tuerantriebs
    signal SSA_BFT_FH_Bewegungsrichutng_XIX_DoorFunctions_BFS_01_XIX_VLAN_Cockpit: start 179, 2 bit, little-endian, data-type-policy=OVERRIDE, i-signal-type=PRIMITIVE, init-value=0, base-type=BT_SSA_BFT_FH_Bewegungsrichutng, compu {1=Cx1_FH_in_Bewegung_Schliessen (CM_SSA_BFT_FH_Bewegungsrichutng_Cx1_FH_in_Bewegung_Schliessen), 0=Cx0_Stillstand (CM_SSA_BFT_FH_Bewegungsrichutng_Cx0_Stillstand), 2=Cx2_FH_in_Bewegung_Oeffnen (CM_SSA_BFT_FH_Bewegungsrichutng_Cx2_FH_in_Bewegung_Oeffnen)}, range raw 0..2, transfer-property=TRIGGERED-WITHOUT-REPETITION  # SmartSensorActor: Rückmeldung der Bewegungsrichtung der Seitenscheibe
    signal SSA_BFT_FH_Fehler_XIX_DoorFunctions_BFS_01_XIX_VLAN_Cockpit: start 181, 3 bit, little-endian, data-type-policy=OVERRIDE, i-signal-type=PRIMITIVE, init-value=0, base-type=BT_SSA_BFT_FH_Fehler, compu {2=Cx2_Unterspannung (CM_SSA_BFT_FH_Fehler_Cx2_Unterspannung), 3=Cx3_Ueberspannung (CM_SSA_BFT_FH_Fehler_Cx3_Ueberspannung), 4=Cx4_el_Fehler (CM_SSA_BFT_FH_Fehler_Cx4_el_Fehler), 0=Cx0_iO (CM_SSA_BFT_FH_Fehler_Cx0_iO), 5=Cx5_Bedingung_nicht_erfuellt (CM_SSA_BFT_FH_Fehler_Cx5_Bedingung_nicht_erfuellt), 1=Cx1_nicht_verbaut (CM_SSA_BFT_FH_Fehler_Cx1_nicht_verbaut)}, range raw 0..5, transfer-property=TRIGGERED-WITHOUT-REPETITION  # SmartSensorActor: Rückmeldung des Fehlerzustandes der Fensterheberfunktion
    signal SSA_BFT_Tuerverschluss_Status_XIX_DoorFunctions_BFS_01_XIX_VLAN_Cockpit: start 184, 2 bit, little-endian, data-type-policy=OVERRIDE, i-signal-type=PRIMITIVE, init-value=0, base-type=BT_SSA_BFT_Tuerverschluss_Status, compu {2=Cx2_Tuer_offen (CM_SSA_BFT_Tuerverschluss_Status_Cx2_Tuer_offen), 0=Cx0_Init (CM_SSA_BFT_Tuerverschluss_Status_Cx0_Init), 1=Cx1_Tuer_geschlossen (CM_SSA_BFT_Tuerverschluss_Status_Cx1_Tuer_geschlossen)}, range raw 0..2, transfer-property=TRIGGERED-WITHOUT-REPETITION  # SmartSensorActor: Türstatus der Beifahrertür (geschlossen, geöffnet)
    signal SSA_BFT_ZZH_Fehler_XIX_DoorFunctions_BFS_01_XIX_VLAN_Cockpit: start 186, 3 bit, little-endian, data-type-policy=OVERRIDE, i-signal-type=PRIMITIVE, init-value=0, base-type=BT_SSA_BFT_ZZH_Fehler, compu {3=Cx3_Ueberspannung (CM_SSA_BFT_ZZH_Fehler_Cx3_Ueberspannung), 0=Cx0_in_Ordnung (CM_SSA_BFT_ZZH_Fehler_Cx0_in_Ordnung), 1=Cx1_nicht_verbaut (CM_SSA_BFT_ZZH_Fehler_Cx1_nicht_verbaut), 5=Cx5_Bedingung_nicht_erfuellt (CM_SSA_BFT_ZZH_Fehler_Cx5_Bedingung_nicht_erfuellt), 2=Cx2_Unterspannung (CM_SSA_BFT_ZZH_Fehler_Cx2_Unterspannung), 4=Cx4_elektrischer_Fehler (CM_SSA_BFT_ZZH_Fehler_Cx4_elektrischer_Fehler)}, range raw 0..5, transfer-property=TRIGGERED-WITHOUT-REPETITION  # SmartSensorActor: Rückmeldung des Fehlerzustandes des ZZH Systems
    signal SSA_BFT_ZZH_Status_XIX_DoorFunctions_BFS_01_XIX_VLAN_Cockpit: start 189, 1 bit, little-endian, data-type-policy=OVERRIDE, i-signal-type=PRIMITIVE, init-value=0, base-type=BT_SSA_BFT_ZZH_Status, compu {0=Cx0_Init (CM_SSA_BFT_ZZH_Status_Cx0_Init), 1=Cx1_Zuziehvorgang_aktiv (CM_SSA_BFT_ZZH_Status_Cx1_Zuziehvorgang_aktiv)}, range raw 0..1, transfer-property=TRIGGERED-WITHOUT-REPETITION  # SmartSensorActor: Status des ZZH Motors
    signal BFT_HSK_Taste_XIX_DoorFunctions_BFS_01_XIX_VLAN_Cockpit: start 190, 1 bit, little-endian, data-type-policy=OVERRIDE, i-signal-type=PRIMITIVE, init-value=0, base-type=BT_BFT_HSK_Taste, compu {1=Cx1_Taste_HSK_auf_gedrueckt (CM_BFT_HSK_Taste_Cx1_Taste_HSK_auf_gedrueckt), 0=Cx0_Taste_HSK_auf_nicht_gedrueckt (CM_BFT_HSK_Taste_Cx0_Taste_HSK_auf_nicht_gedrueckt)}, range raw 0..1, transfer-property=TRIGGERED-WITHOUT-REPETITION  # Taster zum Öffnen des Handschufachkasten
    signal SSA_BFT_ASP_Klappung_Status_XIX_DoorFunctions_BFS_01_XIX_VLAN_Cockpit: start 192, 2 bit, little-endian, data-type-policy=OVERRIDE, i-signal-type=PRIMITIVE, init-value=0, base-type=BT_SSA_BFT_ASP_Klappung_Status, compu {3=Cx3_In_Bewegung (CM_SSA_BFT_ASP_Klappung_Status_Cx3_In_Bewegung), 0=Cx0_Init (CM_SSA_BFT_ASP_Klappung_Status_Cx0_Init), 1=Cx1_angeklappt_Garagenstellung (CM_SSA_BFT_ASP_Klappung_Status_Cx1_angeklappt_Garagenstellung), 2=Cx2_abgeklappt_Fahrstellung (CM_SSA_BFT_ASP_Klappung_Status_Cx2_abgeklappt_Fahrstellung)}, range raw 0..3, transfer-property=TRIGGERED-WITHOUT-REPETITION  # SmartSensorActor: Spiegelt die Position und Ansteuerug der Antriebs für die Speigelklappung wieder
    signal SSA_BFT_ASP_Spiegelglas_Pos_Y_XIX_DoorFunctions_BFS_01_XIX_VLAN_Cockpit: start 200, 7 bit, little-endian, data-type-policy=OVERRIDE, i-signal-type=PRIMITIVE, init-value=0, base-type=BT_SSA_BFT_ASP_Spiegelglas_Pos_Y, invalid-value=Invalid_SSA_BFT_ASP_Spiegelglas_Pos_Y_XIX_DoorFunctions_BFS_01_XIX_VLAN_Cockpit:127, compu {phys=raw for raw 0..100, 127=Cx7f_Fehler (CM_SSA_BFT_ASP_Spiegelglas_Pos_Y_Cx7f_Fehler); unit Unit_PerCent}, range phys 0..100 Unit_PerCent, raw 0..127, unit=Unit_PerCent, transfer-property=TRIGGERED-WITHOUT-REPETITION  # SmartSensorActor: Rückmeldung der Position des Spiegelglases auf der Y-Achse
    signal SSA_BFT_ZV_Ansteuern_XIX_DoorFunctions_BFS_01_XIX_VLAN_Cockpit: start 208, 8 bit, little-endian, data-type-policy=OVERRIDE, i-signal-type=PRIMITIVE, init-value=0, base-type=BT_SSA_BFT_ZV_Ansteuern, invalid-value=Invalid_SSA_BFT_ZV_Ansteuern_XIX_DoorFunctions_BFS_01_XIX_VLAN_Cockpit:255, compu {255=Cxff_Fehler (CM_SSA_BFT_ZV_Ansteuern_Cxff_Fehler), 1=Cx1_entriegelnentsafen (CM_SSA_BFT_ZV_Ansteuern_Cx1_entriegelnentsafen), 0=Cx0_Init (CM_SSA_BFT_ZV_Ansteuern_Cx0_Init), 2=Cx2_verriegelnentsafen (CM_SSA_BFT_ZV_Ansteuern_Cx2_verriegelnentsafen), 3=Cx3_verriegelnsafen (CM_SSA_BFT_ZV_Ansteuern_Cx3_verriegelnsafen)}, range raw 0..255, transfer-property=TRIGGERED-WITHOUT-REPETITION  # SmartSensorActor: Kommando zur Ansteuerung des Türschlosses der Beifahrertür
    signal SSA_BFT_FH_Thermoschutz_XIX_DoorFunctions_BFS_01_XIX_VLAN_Cockpit: start 216, 1 bit, little-endian, data-type-policy=OVERRIDE, i-signal-type=PRIMITIVE, init-value=0, base-type=BT_SSA_BFT_FH_Thermoschutz, compu {1=Cx1_Thermoschutz_aktiv (CM_SSA_BFT_FH_Thermoschutz_Cx1_Thermoschutz_aktiv), 0=Cx0_Thermoschutz_deaktiv (CM_SSA_BFT_FH_Thermoschutz_Cx0_Thermoschutz_deaktiv)}, range raw 0..1, transfer-property=TRIGGERED-WITHOUT-REPETITION  # SmartSensorActor: Rückmeldung Status Thermoschutz
    signal SSA_BFT_Amb_Bel_Status_XIX_DoorFunctions_BFS_01_XIX_VLAN_Cockpit: start 217, 2 bit, little-endian, data-type-policy=OVERRIDE, i-signal-type=PRIMITIVE, init-value=0, base-type=BT_SSA_BFT_Amb_Bel_Status, compu {0=Cx0_Init (CM_SSA_BFT_Amb_Bel_Status_Cx0_Init), 2=Cx2_aus (CM_SSA_BFT_Amb_Bel_Status_Cx2_aus), 1=Cx1_an (CM_SSA_BFT_Amb_Bel_Status_Cx1_an)}, range raw 0..2, transfer-property=TRIGGERED-WITHOUT-REPETITION  # SmartSensorActor: Rückmeldung des Status der Ambiente Beleuchtung
    signal SSA_BFT_Tuerverschluss_Fehler_XIX_DoorFunctions_BFS_01_XIX_VLAN_Cockpit: start 219, 3 bit, little-endian, data-type-policy=OVERRIDE, i-signal-type=PRIMITIVE, init-value=0, base-type=BT_SSA_BFT_Tuerverschluss_Fehler, compu {5=Cx5_Bedingung_nicht_erfuellt (CM_SSA_BFT_Tuerverschluss_Fehler_Cx5_Bedingung_nicht_erfuellt) (Bedingung nicht erfuellt), 1=Cx1_nicht_verbaut (CM_SSA_BFT_Tuerverschluss_Fehler_Cx1_nicht_verbaut) (nicht verbaut), 3=Cx3_Ueberspannung (CM_SSA_BFT_Tuerverschluss_Fehler_Cx3_Ueberspannung), 0=Cx0_i_O (CM_SSA_BFT_Tuerverschluss_Fehler_Cx0_i_O) (i.O.), 2=Cx2_Unterspannung (CM_SSA_BFT_Tuerverschluss_Fehler_Cx2_Unterspannung), 4=Cx4_el_Fehler (CM_SSA_BFT_Tuerverschluss_Fehler_Cx4_el_Fehler) (el. Fehler)}, range raw 0..5, transfer-property=TRIGGERED-WITHOUT-REPETITION  # SmartSensorActor: Fehlerzustand der Beifahrertür
    signal SSA_BFT_FH_Normierung_XIX_DoorFunctions_BFS_01_XIX_VLAN_Cockpit: start 222, 1 bit, little-endian, data-type-policy=OVERRIDE, i-signal-type=PRIMITIVE, init-value=0, base-type=BT_SSA_BFT_FH_Normierung, compu {1=Cx1_normiert (CM_SSA_BFT_FH_Normierung_Cx1_normiert), 0=Cx0_nicht_normiert (CM_SSA_BFT_FH_Normierung_Cx0_nicht_normiert)}, range raw 0..1, transfer-property=TRIGGERED-WITHOUT-REPETITION  # SmartSensorActor: Rückmeldung des Normierungszustandes des Fensterhebers
    signal SSA_BFT_el_Tuerantrieb_Status_XIX_DoorFunctions_BFS_01_XIX_VLAN_Cockpit: start 223, 2 bit, little-endian, data-type-policy=OVERRIDE, i-signal-type=PRIMITIVE, init-value=0, base-type=BT_SSA_BFT_el_Tuerantrieb_Status, compu {2=Cx2_geschlossen (CM_SSA_BFT_el_Tuerantrieb_Status_Cx2_geschlossen), 0=Cx0_Init (CM_SSA_BFT_el_Tuerantrieb_Status_Cx0_Init), 1=Cx1_offen (CM_SSA_BFT_el_Tuerantrieb_Status_Cx1_offen)}, range raw 0..2, transfer-property=TRIGGERED-WITHOUT-REPETITION  # SmartSensorActor: Rückmeldung des Status des el. Tuerantriebes
    signal SSA_BFT_ASP_Klappung_Fehler_XIX_DoorFunctions_BFS_01_XIX_VLAN_Cockpit: start 225, 3 bit, little-endian, data-type-policy=OVERRIDE, i-signal-type=PRIMITIVE, init-value=0, base-type=BT_SSA_BFT_ASP_Klappung_Fehler, compu {5=Cx5_Bedingung_nicht_erfuellt (CM_SSA_BFT_ASP_Klappung_Fehler_Cx5_Bedingung_nicht_erfuellt) (Bedingung nicht erfuellt), 0=Cx0_i_O (CM_SSA_BFT_ASP_Klappung_Fehler_Cx0_i_O) (i.O.), 2=Cx2_Unterspannung (CM_SSA_BFT_ASP_Klappung_Fehler_Cx2_Unterspannung), 3=Cx3_Ueberspannung (CM_SSA_BFT_ASP_Klappung_Fehler_Cx3_Ueberspannung), 4=Cx4_el_Fehler (CM_SSA_BFT_ASP_Klappung_Fehler_Cx4_el_Fehler) (el. Fehler), 1=Cx1_nicht_verbaut (CM_SSA_BFT_ASP_Klappung_Fehler_Cx1_nicht_verbaut) (nicht verbaut)}, range raw 0..5, transfer-property=TRIGGERED-WITHOUT-REPETITION  # SmartSensorActor: Rückmeldung des Fehlerzustandes der Spiegelklappung Aussenspiegel
    signal SSA_BFT_ZV_Fehler_XIX_DoorFunctions_BFS_01_XIX_VLAN_Cockpit: start 228, 3 bit, little-endian, data-type-policy=OVERRIDE, i-signal-type=PRIMITIVE, init-value=0, base-type=BT_SSA_BFT_ZV_Fehler, compu {2=Cx2_Unterspannung (CM_SSA_BFT_ZV_Fehler_Cx2_Unterspannung), 5=Cx5_Bedingung_nicht_erfuellt (CM_SSA_BFT_ZV_Fehler_Cx5_Bedingung_nicht_erfuellt) (Bedingung nicht erfuellt), 3=Cx3_Ueberspannung (CM_SSA_BFT_ZV_Fehler_Cx3_Ueberspannung), 1=Cx1_nicht_verbaut (CM_SSA_BFT_ZV_Fehler_Cx1_nicht_verbaut) (nicht verbaut), 4=Cx4_el_Fehler (CM_SSA_BFT_ZV_Fehler_Cx4_el_Fehler) (el. Fehler), 0=Cx0_i_O (CM_SSA_BFT_ZV_Fehler_Cx0_i_O) (i.O.)}, range raw 0..5, transfer-property=TRIGGERED-WITHOUT-REPETITION  # SmartSensorActor: Rückmeldung des Fehlerzustandes des Türschlosses der Beifahrertür
    signal SSA_BFT_Amb_Bel_Fehler_XIX_DoorFunctions_BFS_01_XIX_VLAN_Cockpit: start 231, 3 bit, little-endian, data-type-policy=OVERRIDE, i-signal-type=PRIMITIVE, init-value=0, base-type=BT_SSA_BFT_Amb_Bel_Fehler, compu {3=Cx3_Ueberspannung (CM_SSA_BFT_Amb_Bel_Fehler_Cx3_Ueberspannung), 5=Cx5_Bedingung_nicht_erfuellt (CM_SSA_BFT_Amb_Bel_Fehler_Cx5_Bedingung_nicht_erfuellt), 0=Cx0_iO (CM_SSA_BFT_Amb_Bel_Fehler_Cx0_iO), 2=Cx2_Unterspannung (CM_SSA_BFT_Amb_Bel_Fehler_Cx2_Unterspannung), 1=Cx1_nicht_verbaut (CM_SSA_BFT_Amb_Bel_Fehler_Cx1_nicht_verbaut), 4=Cx4_el_Fehler (CM_SSA_BFT_Amb_Bel_Fehler_Cx4_el_Fehler)}, range raw 0..5, transfer-property=TRIGGERED-WITHOUT-REPETITION  # SmartSensorActor: Rückmeldung des Fehlerzustand der Ambiente Beleuchtung
    signal ASW_Warnung_Aussenlicht_BFS_Li_XIX_DoorFunctions_BFS_01_XIX_VLAN_Cockpit: start 234, 1 bit, little-endian, data-type-policy=OVERRIDE, i-signal-type=PRIMITIVE, init-value=0, base-type=BT_ASW_Warnung_Aussenlicht_BFS_Li, compu {1=Cx1_ASW_Warnung_aktiv (CM_ASW_Warnung_Aussenlicht_BFS_Li_Cx1_ASW_Warnung_aktiv), 0=Cx0_ASW_Warnung_nicht_aktiv (CM_ASW_Warnung_Aussenlicht_BFS_Li_Cx0_ASW_Warnung_nicht_aktiv)}, range raw 0..1, transfer-property=TRIGGERED-WITHOUT-REPETITION  # Anzeige Ausstiegwarnung nach aussen, z.B. Heckleuchte
    signal ASW_Warnung_Aussenlicht_BFS_Re_XIX_DoorFunctions_BFS_01_XIX_VLAN_Cockpit: start 235, 1 bit, little-endian, data-type-policy=OVERRIDE, i-signal-type=PRIMITIVE, init-value=0, base-type=BT_ASW_Warnung_Aussenlicht_BFS_Re, compu {0=Cx0_ASW_Warnung_nicht_aktiv (CM_ASW_Warnung_Aussenlicht_BFS_Re_Cx0_ASW_Warnung_nicht_aktiv), 1=Cx1_ASW_Warnung_aktiv (CM_ASW_Warnung_Aussenlicht_BFS_Re_Cx1_ASW_Warnung_aktiv)}, range raw 0..1, transfer-property=TRIGGERED-WITHOUT-REPETITION  # Anzeige Ausstiegwarnung nach aussen, z.B. Heckleuchte
    signal SSA_BFT_ASP_Heizung_Fehler_XIX_DoorFunctions_BFS_01_XIX_VLAN_Cockpit: start 236, 3 bit, little-endian, data-type-policy=OVERRIDE, i-signal-type=PRIMITIVE, init-value=0, base-type=BT_SSA_BFT_ASP_Heizung_Fehler, compu {1=Cx1_nicht_verbaut (CM_SSA_BFT_ASP_Heizung_Fehler_Cx1_nicht_verbaut), 4=Cx4_el_Fehler (CM_SSA_BFT_ASP_Heizung_Fehler_Cx4_el_Fehler), 3=Cx3_Ueberspannung (CM_SSA_BFT_ASP_Heizung_Fehler_Cx3_Ueberspannung), 5=Cx5_Bedingung_nicht_erfuellt (CM_SSA_BFT_ASP_Heizung_Fehler_Cx5_Bedingung_nicht_erfuellt), 0=Cx0_iO (CM_SSA_BFT_ASP_Heizung_Fehler_Cx0_iO), 2=Cx2_Unterspannung (CM_SSA_BFT_ASP_Heizung_Fehler_Cx2_Unterspannung)}, range raw 0..5, transfer-property=TRIGGERED-WITHOUT-REPETITION  # SmartSensorActor: Rückmeldung des Fehlerzustand der Spiegelglasheizung
    signal BT_ASW_Warnton_XIX_DoorFunctions_BFS_01_XIX_VLAN_Cockpit: start 239, 2 bit, little-endian, data-type-policy=OVERRIDE, i-signal-type=PRIMITIVE, init-value=0, base-type=BT_BT_ASW_Warnton, invalid-value=Invalid_BT_ASW_Warnton_XIX_DoorFunctions_BFS_01_XIX_VLAN_Cockpit:3, compu {3=Cx3_Fehler (CM_BT_ASW_Warnton_Cx3_Fehler), 0=Cx0_kein_warnton (CM_BT_ASW_Warnton_Cx0_kein_warnton), 2=Cx2_warnton_rechts (CM_BT_ASW_Warnton_Cx2_warnton_rechts), 1=Cx1_warnton_links (CM_BT_ASW_Warnton_Cx1_warnton_links)}, range raw 0..3, transfer-property=TRIGGERED-WITHOUT-REPETITION  # erzeugt ein Warnton bei AS Warnung
    signal BT_ASW_Warnung_Aussenlicht_XIX_DoorFunctions_BFS_01_XIX_VLAN_Cockpit: start 241, 2 bit, little-endian, data-type-policy=OVERRIDE, i-signal-type=PRIMITIVE, init-value=0, base-type=BT_BT_ASW_Warnung_Aussenlicht, invalid-value=Invalid_BT_ASW_Warnung_Aussenlicht_XIX_DoorFunctions_BFS_01_XIX_VLAN_Cockpit:3, compu {3=Cx3_Fehler (CM_BT_ASW_Warnung_Aussenlicht_Cx3_Fehler), 0=Cx0_kein_licht (CM_BT_ASW_Warnung_Aussenlicht_Cx0_kein_licht), 1=Cx1_licht_links (CM_BT_ASW_Warnung_Aussenlicht_Cx1_licht_links), 2=Cx2_licht_rechts (CM_BT_ASW_Warnung_Aussenlicht_Cx2_licht_rechts)}, range raw 0..3, transfer-property=TRIGGERED-WITHOUT-REPETITION  # zeigt in den Heckleuchte ein Symbol an
    signal BT_ASW_Warnung_VAS_XIX_DoorFunctions_BFS_01_XIX_VLAN_Cockpit: start 243, 2 bit, little-endian, data-type-policy=OVERRIDE, i-signal-type=PRIMITIVE, init-value=0, base-type=BT_BT_ASW_Warnung_VAS, invalid-value=Invalid_BT_ASW_Warnung_VAS_XIX_DoorFunctions_BFS_01_XIX_VLAN_Cockpit:3, compu {3=Cx3_Fehler (CM_BT_ASW_Warnung_VAS_Cx3_Fehler), 1=Cx1_Info (CM_BT_ASW_Warnung_VAS_Cx1_Info), 2=Cx2_Warnung (CM_BT_ASW_Warnung_VAS_Cx2_Warnung), 0=Cx0_Keine_Warnung (CM_BT_ASW_Warnung_VAS_Cx0_Keine_Warnung)}, range raw 0..3, transfer-property=TRIGGERED-WITHOUT-REPETITION  # Abschaltung der VAS Beifahrertür bei aktiver ASW Warnung an der Beifahrertür
  pdu DoorFunctions_FS_01_XIX_VLAN_Cockpit: length=60, minimum-delay=0.02, transmission-mode-false-timing={cyclic-timing={time-offset=0.0, time-period=0.1}, event-controlled-timing={number-of-repetitions=10, repetition-period=0.02}}, transmission-mode-true-timing={cyclic-timing={time-offset=0.0, time-period=0.02}, event-controlled-timing={number-of-repetitions=10, repetition-period=0.02}}, unused-bit-pattern=0
    transmission-mode-conditions:
      {data-filter={data-filter-type=MASKED-NEW-DIFFERS-X, mask=1, x=0}, i-signal-in-i-pdu=FT_HD_Taste_auf}
      {data-filter={data-filter-type=MASKED-NEW-DIFFERS-X, mask=1, x=0}, i-signal-in-i-pdu=FT_HD_Taste_zu}
    signal DoorFunctions_FS_01_CRC_XIX_DoorFunctions_FS_01_XIX_VLAN_Cockpit: start 0, 8 bit, little-endian, data-type-policy=OVERRIDE, i-signal-type=PRIMITIVE, init-value=0, base-type=BT_DoorFunctions_FS_01_CRC, compu {phys=raw for raw 0..255}, range phys 0..255, raw 0..255, transfer-property=TRIGGERED-WITHOUT-REPETITION  # Für MLB: Berechnung siehe Lastenheft "Kommunikationsabsicherung für FlexRay und CAN" Ab MQB und MLBevo: Berechnung siehe Lastenheft "End-to-End Kommunikationsabsicherung" Endwerte siehe Begleitdokument "S-PDU Kennungsfolgen"
    signal DoorFunctions_FS_01_BZ_XIX_DoorFunctions_FS_01_XIX_VLAN_Cockpit: start 8, 4 bit, little-endian, data-type-policy=OVERRIDE, i-signal-type=PRIMITIVE, init-value=0, base-type=BT_DoorFunctions_FS_01_BZ, compu {phys=raw for raw 0..15}, range phys 0..15, raw 0..15, transfer-property=TRIGGERED-WITHOUT-REPETITION  # 4bit Botschaftszähler, wird mit jeder Sendebotschaft inkrementiert
    signal eTAB_FS_Oeffnen_Annaeh_XIX_DoorFunctions_FS_01_XIX_VLAN_Cockpit: start 12, 1 bit, little-endian, data-type-policy=OVERRIDE, i-signal-type=PRIMITIVE, init-value=0, base-type=BT_eTAB_FS_Oeffnen_Annaeh, compu {1=Cx1_Annaeherung_Oeffnen_erkannt (CM_eTAB_FS_Oeffnen_Annaeh_Cx1_Annaeherung_Oeffnen_erkannt), 0=Cx0_Init_keine_Annaeherung (CM_eTAB_FS_Oeffnen_Annaeh_Cx0_Init_keine_Annaeherung)}, range raw 0..1, transfer-property=TRIGGERED-WITHOUT-REPETITION  # Der Türgriffsensor hat eine Annaeherung zum Oeffnen erkannt.
    signal eTAB_FS_Oeffnen_Betaet_XIX_DoorFunctions_FS_01_XIX_VLAN_Cockpit: start 13, 1 bit, little-endian, data-type-policy=OVERRIDE, i-signal-type=PRIMITIVE, init-value=0, base-type=BT_eTAB_FS_Oeffnen_Betaet, compu {0=Cx0_Init_keine_Annaeherung (CM_eTAB_FS_Oeffnen_Betaet_Cx0_Init_keine_Annaeherung), 1=Cx1_Betaetigung_Oeffnen_erkannt (CM_eTAB_FS_Oeffnen_Betaet_Cx1_Betaetigung_Oeffnen_erkannt)}, range raw 0..1, transfer-property=TRIGGERED-WITHOUT-REPETITION  # Der Türgriffsensor hat eine Betaetigung zum Oeffnen erkannt.
    signal eTAB_FS_Schliessen_Annaeh_XIX_DoorFunctions_FS_01_XIX_VLAN_Cockpit: start 14, 1 bit, little-endian, data-type-policy=OVERRIDE, i-signal-type=PRIMITIVE, init-value=0, base-type=BT_eTAB_FS_Schliessen_Annaeh, compu {1=Cx1_Annaeherung_Schliessen_erkannt (CM_eTAB_FS_Schliessen_Annaeh_Cx1_Annaeherung_Schliessen_erkannt), 0=Cx0_Init_keine_Annaeherung (CM_eTAB_FS_Schliessen_Annaeh_Cx0_Init_keine_Annaeherung)}, range raw 0..1, transfer-property=TRIGGERED-WITHOUT-REPETITION  # Der Türgriffsensor hat eine Annaeherung zum Schliessen erkannt.
    signal eTAB_FS_Schliessen_Betaet_XIX_DoorFunctions_FS_01_XIX_VLAN_Cockpit: start 15, 1 bit, little-endian, data-type-policy=OVERRIDE, i-signal-type=PRIMITIVE, init-value=0, base-type=BT_eTAB_FS_Schliessen_Betaet, compu {1=Cx1_Betaetigung_Schliessen_erkannt (CM_eTAB_FS_Schliessen_Betaet_Cx1_Betaetigung_Schliessen_erkannt), 0=Cx0_Init_keine_Annaeherung (CM_eTAB_FS_Schliessen_Betaet_Cx0_Init_keine_Annaeherung)}, range raw 0..1, transfer-property=TRIGGERED-WITHOUT-REPETITION  # Der Türgriffsensor hat eine Betaetigung zum Schliessen erkannt.
    signal FT_Tuer_geoeffnet_XIX_DoorFunctions_FS_01_XIX_VLAN_Cockpit: start 16, 1 bit, little-endian, data-type-policy=OVERRIDE, i-signal-type=PRIMITIVE, init-value=0, base-type=BT_FT_Tuer_geoeffnet, compu {1=Cx1_Tuer_offen (CM_FT_Tuer_geoeffnet_Cx1_Tuer_offen), 0=Cx0_geschlossen (CM_FT_Tuer_geoeffnet_Cx0_geschlossen)}, range raw 0..1, transfer-property=TRIGGERED-WITHOUT-REPETITION, to HCP3_IONode(timeout 1 s)  # Zeigt eine geöffnete Tür an
    signal FT_verriegelt_XIX_DoorFunctions_FS_01_XIX_VLAN_Cockpit: start 17, 1 bit, little-endian, data-type-policy=OVERRIDE, i-signal-type=PRIMITIVE, init-value=0, base-type=BT_FT_verriegelt, compu {0=Cx0_Init (CM_FT_verriegelt_Cx0_Init), 1=Cx1_verriegelt (CM_FT_verriegelt_Cx1_verriegelt)}, range raw 0..1, transfer-property=TRIGGERED-WITHOUT-REPETITION  # Zeigt eine verriegelte Tür an ( Status wird erst nach vollständiger Schlossansteuerung ausgegeben (<=1,5sek))
    signal FT_gesafet_XIX_DoorFunctions_FS_01_XIX_VLAN_Cockpit: start 18, 1 bit, little-endian, data-type-policy=OVERRIDE, i-signal-type=PRIMITIVE, init-value=0, base-type=BT_FT_gesafet, compu {0=Cx0_Init (CM_FT_gesafet_Cx0_Init), 1=Cx1_gesafet (CM_FT_gesafet_Cx1_gesafet)}, range raw 0..1, transfer-property=TRIGGERED-WITHOUT-REPETITION  # Im Zustand Safe wird auch das Signal FT_verriegelt = 1 gesendet
    signal FT_Schluesselschalter_auf_XIX_DoorFunctions_FS_01_XIX_VLAN_Cockpit: start 19, 1 bit, little-endian, data-type-policy=OVERRIDE, i-signal-type=PRIMITIVE, init-value=0, base-type=BT_FT_Schluesselschalter_auf, compu {0=Cx0_Init (CM_FT_Schluesselschalter_auf_Cx0_Init), 1=Cx1_Schluesselschalter_auf_betaetigt (CM_FT_Schluesselschalter_auf_Cx1_Schluesselschalter_auf_betaetigt)}, range raw 0..1, transfer-property=TRIGGERED-WITHOUT-REPETITION  # Schlüsselschalter Richtung auf betätigt
    signal FT_Schluesselschalter_zu_XIX_DoorFunctions_FS_01_XIX_VLAN_Cockpit: start 20, 1 bit, little-endian, data-type-policy=OVERRIDE, i-signal-type=PRIMITIVE, init-value=0, base-type=BT_FT_Schluesselschalter_zu, compu {1=Cx1_Schluesselschalter_zu_betaetigt (CM_FT_Schluesselschalter_zu_Cx1_Schluesselschalter_zu_betaetigt) (Schluesselschalter zu betaetigt)}, range raw 1, transfer-property=TRIGGERED-WITHOUT-REPETITION
    signal FT_Unlock_Taster_XIX_DoorFunctions_FS_01_XIX_VLAN_Cockpit: start 21, 1 bit, little-endian, data-type-policy=OVERRIDE, i-signal-type=PRIMITIVE, init-value=0, base-type=BT_FT_Unlock_Taster, compu {0=Cx0_Init (CM_FT_Unlock_Taster_Cx0_Init), 1=Cx1_Unlock_Taster_betaetigt (CM_FT_Unlock_Taster_Cx1_Unlock_Taster_betaetigt)}, range raw 0..1, transfer-property=TRIGGERED-WITHOUT-REPETITION  # Entriegelungstaster betätigt
    signal FT_Lock_Taster_XIX_DoorFunctions_FS_01_XIX_VLAN_Cockpit: start 22, 1 bit, little-endian, data-type-policy=OVERRIDE, i-signal-type=PRIMITIVE, init-value=0, base-type=BT_FT_Lock_Taster, compu {0=Cx0_Init (CM_FT_Lock_Taster_Cx0_Init), 1=Cx1_Lock_Taster_betaetigt (CM_FT_Lock_Taster_Cx1_Lock_Taster_betaetigt)}, range raw 0..1, transfer-property=TRIGGERED-WITHOUT-REPETITION  # Verriegelungstaster betätigt
    signal FT_Sperrklinke_XIX_DoorFunctions_FS_01_XIX_VLAN_Cockpit: start 23, 1 bit, little-endian, data-type-policy=OVERRIDE, i-signal-type=PRIMITIVE, init-value=0, base-type=BT_FT_Sperrklinke, compu {1=Cx1_Tuer_auf_oder_Tuer_Position_zwischen_Vor_und_Hauptraste (CM_FT_Sperrklinke_Cx1_Tuer_auf_oder_Tuer_Position_zwischen_Vor_und_Hauptraste), 0=Cx0_Schloss_in_Vorraste_und_Hauptraste (CM_FT_Sperrklinke_Cx0_Schloss_in_Vorraste_und_Hauptraste)}, range raw 0..1, transfer-property=TRIGGERED-WITHOUT-REPETITION  # Vorraste für Schloß zwischen Vor- und Hauptraste Signal kurz auf 1, danach wieder auf 0 wenn Tür in Hauptraste (Tür ist sicher zu wenn Sperrklinke und Türkontakt auf 0 sind)
    signal FT_TAG_betaetigt_XIX_DoorFunctions_FS_01_XIX_VLAN_Cockpit: start 24, 1 bit, little-endian, data-type-policy=OVERRIDE, i-signal-type=PRIMITIVE, init-value=0, base-type=BT_FT_TAG_betaetigt, compu {1=Cx1_betaetigt (CM_FT_TAG_betaetigt_Cx1_betaetigt), 0=Cx0_nicht_betaetigt (CM_FT_TAG_betaetigt_Cx0_nicht_betaetigt)}, range raw 0..1, transfer-property=TRIGGERED-WITHOUT-REPETITION  # Türaussengriff wird nicht im MLB-B8 verwendet
    signal FT_TIG_betaetigt_XIX_DoorFunctions_FS_01_XIX_VLAN_Cockpit: start 25, 1 bit, little-endian, data-type-policy=OVERRIDE, i-signal-type=PRIMITIVE, init-value=0, base-type=BT_FT_TIG_betaetigt, compu {1=Cx1_betaetigt (CM_FT_TIG_betaetigt_Cx1_betaetigt), 0=Cx0_nicht_betaetigt (CM_FT_TIG_betaetigt_Cx0_nicht_betaetigt)}, range raw 0..1, transfer-property=TRIGGERED-WITHOUT-REPETITION  # Türinnengriff wird nicht im MLB-B8 verwendet
    signal FT_IRUE_Taste_XIX_DoorFunctions_FS_01_XIX_VLAN_Cockpit: start 26, 1 bit, little-endian, data-type-policy=OVERRIDE, i-signal-type=PRIMITIVE, init-value=0, base-type=BT_FT_IRUE_Taste, compu {1=Cx1_IRUE_Taste_betaetigt (CM_FT_IRUE_Taste_Cx1_IRUE_Taste_betaetigt), 0=Cx0_Init (CM_FT_IRUE_Taste_Cx0_Init)}, range raw 0..1, transfer-property=TRIGGERED-WITHOUT-REPETITION  # Betätigung IRUE-Taster (Innenraumüberwachung) MQB: Bei Verbau eines einzelnen Taster zur Deaktivierung von IRUE und NGS wird dieses Signal als Deaktivierungsanforderung beider DWA-Alarmquellen gesendet.
    signal FT_HD_Taste_XIX_DoorFunctions_FS_01_XIX_VLAN_Cockpit: start 27, 1 bit, little-endian, data-type-policy=OVERRIDE, i-signal-type=PRIMITIVE, init-value=0, base-type=BT_FT_HD_Taste, compu {0=Cx0_nicht_betaetigt (CM_FT_HD_Taste_Cx0_nicht_betaetigt), 1=Cx1_Heckdeckeltaste_betaetigt (CM_FT_HD_Taste_Cx1_Heckdeckeltaste_betaetigt)}, range raw 0..1, transfer-property=TRIGGERED-WITHOUT-REPETITION  # Taste in der Fahrertür zum Öffnen des Heckschlosses
    signal FT_TD_Taste_Fehler_XIX_DoorFunctions_FS_01_XIX_VLAN_Cockpit: start 28, 1 bit, little-endian, data-type-policy=OVERRIDE, i-signal-type=PRIMITIVE, init-value=0, base-type=BT_FT_TD_Taste_Fehler, compu {1=Cx1_defekt (CM_FT_TD_Taste_Fehler_Cx1_defekt), 0=Cx0_iO (CM_FT_TD_Taste_Fehler_Cx0_iO)}, range raw 0..1, transfer-property=TRIGGERED-WITHOUT-REPETITION  # Fehlerstatus des Tankdeckelentriegelungstasters. Wird bei Drucktankkonzepten vom MSG zusammen mit dem Signal FT_TD_Taste ausgewertet, um Tankbereitschaft herzustellen. Der Fehler beschreibt einen hängenden TD_Taster. Ein Kurzschluss oder Leitungsunterbrechung kann nicht diagnostiziert werden.
    signal FT_TD_Taste_XIX_DoorFunctions_FS_01_XIX_VLAN_Cockpit: start 29, 1 bit, little-endian, data-type-policy=OVERRIDE, i-signal-type=PRIMITIVE, init-value=0, base-type=BT_FT_TD_Taste, compu {1=Cx1_Tankdeckel_Taster_betaetigt (CM_FT_TD_Taste_Cx1_Tankdeckel_Taster_betaetigt), 0=Cx0_Init (CM_FT_TD_Taste_Cx0_Init)}, range raw 0..1, transfer-property=TRIGGERED-WITHOUT-REPETITION  # Tankdeckelentriegelungs-Taste betätigt
    signal eTAB_FS_Bowdenzug_Auswerfen_XIX_DoorFunctions_FS_01_XIX_VLAN_Cockpit: start 30, 1 bit, little-endian, data-type-policy=OVERRIDE, i-signal-type=PRIMITIVE, init-value=0, base-type=BT_eTAB_FS_Bowdenzug_Auswerfen, compu {0=Cx0_nicht_auswerfen (CM_eTAB_FS_Bowdenzug_Auswerfen_Cx0_nicht_auswerfen), 1=Cx1_auswerfen (CM_eTAB_FS_Bowdenzug_Auswerfen_Cx1_auswerfen)}, range raw 0..1, transfer-property=TRIGGERED-WITHOUT-REPETITION  # Soll den Bowdenzug für die mechanische Redundanz
    signal FT_Sp_Heizung_Anf_XIX_DoorFunctions_FS_01_XIX_VLAN_Cockpit: start 31, 1 bit, little-endian, data-type-policy=OVERRIDE, i-signal-type=PRIMITIVE, init-value=0, base-type=BT_FT_Sp_Heizung_Anf, compu {phys=raw*100 for raw 0..1; unit Unit_PerCent}, range phys 0..100 Unit_PerCent, raw 0..1, unit=Unit_PerCent, transfer-property=TRIGGERED-WITHOUT-REPETITION  # Kundenanforderung der Außenspiegelheizung Fahrertür
    signal FT_Sp_Blk_def_XIX_DoorFunctions_FS_01_XIX_VLAN_Cockpit: start 35, 1 bit, little-endian, data-type-policy=OVERRIDE, i-signal-type=PRIMITIVE, init-value=0, base-type=BT_FT_Sp_Blk_def, compu {1=Cx1_defekt (CM_FT_Sp_Blk_def_Cx1_defekt), 0=Cx0_iO (CM_FT_Sp_Blk_def_Cx0_iO)}, range raw 0..1, transfer-property=TRIGGERED-WITHOUT-REPETITION  # Blinker am Spiegel defekt
    signal FT_FH_S_ManHoch_XIX_DoorFunctions_FS_01_XIX_VLAN_Cockpit: start 36, 1 bit, little-endian, data-type-policy=OVERRIDE, i-signal-type=PRIMITIVE, init-value=0, base-type=BT_FT_FH_S_ManHoch, compu {0=Cx0_Init (CM_FT_FH_S_ManHoch_Cx0_Init), 1=Cx1_FH_Schalter_man_hoch_betaetigt (CM_FT_FH_S_ManHoch_Cx1_FH_Schalter_man_hoch_betaetigt)}, range raw 0..1, transfer-property=TRIGGERED-WITHOUT-REPETITION  # FH Schalter manuell hoch gedrückt
    signal FT_FH_S_AutoHoch_XIX_DoorFunctions_FS_01_XIX_VLAN_Cockpit: start 37, 1 bit, little-endian, data-type-policy=OVERRIDE, i-signal-type=PRIMITIVE, init-value=0, base-type=BT_FT_FH_S_AutoHoch, compu {1=Cx1_FH_Schalter_auto_hoch_betaetigt (CM_FT_FH_S_AutoHoch_Cx1_FH_Schalter_auto_hoch_betaetigt), 0=Cx0_Init (CM_FT_FH_S_AutoHoch_Cx0_Init)}, range raw 0..1, transfer-property=TRIGGERED-WITHOUT-REPETITION  # FH Schalter automatisch hoch gedrückt
    signal FT_FH_S_ManTief_XIX_DoorFunctions_FS_01_XIX_VLAN_Cockpit: start 38, 1 bit, little-endian, data-type-policy=OVERRIDE, i-signal-type=PRIMITIVE, init-value=0, base-type=BT_FT_FH_S_ManTief, compu {0=Cx0_Init (CM_FT_FH_S_ManTief_Cx0_Init), 1=Cx1_FH_Schalter_man_tief_betaetigt (CM_FT_FH_S_ManTief_Cx1_FH_Schalter_man_tief_betaetigt)}, range raw 0..1, transfer-property=TRIGGERED-WITHOUT-REPETITION  # FH Schalter manuell tief gedrückt
    signal FT_FH_S_AutoTief_XIX_DoorFunctions_FS_01_XIX_VLAN_Cockpit: start 39, 1 bit, little-endian, data-type-policy=OVERRIDE, i-signal-type=PRIMITIVE, init-value=0, base-type=BT_FT_FH_S_AutoTief, compu {1=Cx1_FH_Schalter_auto_tief_betaetigt (CM_FT_FH_S_AutoTief_Cx1_FH_Schalter_auto_tief_betaetigt), 0=Cx0_Init (CM_FT_FH_S_AutoTief_Cx0_Init)}, range raw 0..1, transfer-property=TRIGGERED-WITHOUT-REPETITION  # FH Schalter automatisch tief gedrückt
    signal FT_FH_Oeffnung_XIX_DoorFunctions_FS_01_XIX_VLAN_Cockpit: start 40, 8 bit, little-endian, data-type-policy=OVERRIDE, i-signal-type=PRIMITIVE, init-value=0, base-type=BT_FT_FH_Oeffnung, compu {phys=raw*0.5 for raw 0..200; unit Unit_PerCent}, range phys 0..100 Unit_PerCent, raw 0..200, unit=Unit_PerCent, transfer-property=TRIGGERED-WITHOUT-REPETITION  # Gibt den Fensteröffnungswert in % an.
    signal FT_FH_Bew_hoch_XIX_DoorFunctions_FS_01_XIX_VLAN_Cockpit: start 48, 1 bit, little-endian, data-type-policy=OVERRIDE, i-signal-type=PRIMITIVE, init-value=0, base-type=BT_FT_FH_Bew_hoch, compu {0=Cx0_Init (CM_FT_FH_Bew_hoch_Cx0_Init), 1=Cx1_FH_in_Bewegung_hoch (CM_FT_FH_Bew_hoch_Cx1_FH_in_Bewegung_hoch)}, range raw 0..1, transfer-property=TRIGGERED-WITHOUT-REPETITION  # Fensterheber in Bewegung Richtung hoch
    signal FT_FH_Bew_tief_XIX_DoorFunctions_FS_01_XIX_VLAN_Cockpit: start 49, 1 bit, little-endian, data-type-policy=OVERRIDE, i-signal-type=PRIMITIVE, init-value=0, base-type=BT_FT_FH_Bew_tief, compu {0=Cx0_Init (CM_FT_FH_Bew_tief_Cx0_Init), 1=Cx1_FH_in_Bewegung_tief (CM_FT_FH_Bew_tief_Cx1_FH_in_Bewegung_tief)}, range raw 0..1, transfer-property=TRIGGERED-WITHOUT-REPETITION  # Fensterheber in Bewegung Richtung tief
    signal FT_FH_Fang_XIX_DoorFunctions_FS_01_XIX_VLAN_Cockpit: start 50, 1 bit, little-endian, data-type-policy=OVERRIDE, i-signal-type=PRIMITIVE, init-value=0, base-type=BT_FT_FH_Fang, compu {0=Cx0_ausserhalb_Fangbereich (CM_FT_FH_Fang_Cx0_ausserhalb_Fangbereich), 1=Cx1_innerhalb_Fangbereich (CM_FT_FH_Fang_Cx1_innerhalb_Fangbereich)}, range raw 0..1, transfer-property=TRIGGERED-WITHOUT-REPETITION  # Fangbereich ist 4mm von oberer Lippendichtung
    signal FT_FH_Block_XIX_DoorFunctions_FS_01_XIX_VLAN_Cockpit: start 51, 1 bit, little-endian, data-type-policy=OVERRIDE, i-signal-type=PRIMITIVE, init-value=0, base-type=BT_FT_FH_Block, compu {1=Cx1_Fenster_Block (CM_FT_FH_Block_Cx1_Fenster_Block), 0=Cx0_Init (CM_FT_FH_Block_Cx0_Init)}, range raw 0..1, transfer-property=TRIGGERED-WITHOUT-REPETITION  # Fensterscheibe befindet sich im mechanischen Block (oben oder unten)
    signal FT_FH_Thermo_XIX_DoorFunctions_FS_01_XIX_VLAN_Cockpit: start 52, 1 bit, little-endian, data-type-policy=OVERRIDE, i-signal-type=PRIMITIVE, init-value=0, base-type=BT_FT_FH_Thermo, compu {1=Cx1_Thermoschutz_aktiv (CM_FT_FH_Thermo_Cx1_Thermoschutz_aktiv), 0=Cx0_Init (CM_FT_FH_Thermo_Cx0_Init)}, range raw 0..1, transfer-property=TRIGGERED-WITHOUT-REPETITION  # gibt an ob Fensterheber im Thermoschutz ist
    signal FT_UEKB_aktiviert_XIX_DoorFunctions_FS_01_XIX_VLAN_Cockpit: start 53, 1 bit, little-endian, data-type-policy=OVERRIDE, i-signal-type=PRIMITIVE, init-value=0, base-type=BT_FT_UEKB_aktiviert, compu {1=Cx1_UEKB_aktiv (CM_FT_UEKB_aktiviert_Cx1_UEKB_aktiv), 0=Cx0_Init (CM_FT_UEKB_aktiviert_Cx0_Init)}, range raw 0..1, transfer-property=TRIGGERED-WITHOUT-REPETITION  # Überschutzbegrenzungskraft bei Reversieren
    signal ASW_HMI_defekt_XIX_DoorFunctions_FS_01_XIX_VLAN_Cockpit: start 54, 1 bit, little-endian, data-type-policy=OVERRIDE, i-signal-type=PRIMITIVE, init-value=0, base-type=BT_ASW_HMI_defekt, compu {0=Cx0_iO (CM_ASW_HMI_defekt_Cx0_iO), 1=Cx1_defekt (CM_ASW_HMI_defekt_Cx1_defekt)}, range raw 0..1, transfer-property=TRIGGERED-WITHOUT-REPETITION  # HMI Status der Funktion AusstiegsWarnung (ASW). HMI wird durch das TSG angesteuert.
    signal FT_FH_normiert_XIX_DoorFunctions_FS_01_XIX_VLAN_Cockpit: start 55, 1 bit, little-endian, data-type-policy=OVERRIDE, i-signal-type=PRIMITIVE, init-value=0, base-type=BT_FT_FH_normiert, compu {1=Cx1_Fenster_normiert (CM_FT_FH_normiert_Cx1_Fenster_normiert), 0=Cx0_Init (CM_FT_FH_normiert_Cx0_Init)}, range raw 0..1, transfer-property=TRIGGERED-WITHOUT-REPETITION  # Die Position der Fensterheberscheibe ist bekannt
    signal FT_Schliesstaster_XIX_DoorFunctions_FS_01_XIX_VLAN_Cockpit: start 56, 1 bit, little-endian, data-type-policy=OVERRIDE, i-signal-type=PRIMITIVE, init-value=0, base-type=BT_FT_Schliesstaster, compu {1=Cx1_Schliesstaster_betaetigt (CM_FT_Schliesstaster_Cx1_Schliesstaster_betaetigt)}, range raw 1, transfer-property=TRIGGERED-WITHOUT-REPETITION  # Vorhalt
    signal FT_Zuziehhilfe_aktiv_XIX_DoorFunctions_FS_01_XIX_VLAN_Cockpit: start 57, 1 bit, little-endian, data-type-policy=OVERRIDE, i-signal-type=PRIMITIVE, init-value=0, base-type=BT_FT_Zuziehhilfe_aktiv, compu {1=Cx1_Zuziehilfe_aktiv (CM_FT_Zuziehhilfe_aktiv_Cx1_Zuziehilfe_aktiv), 0=Cx0_Init (CM_FT_Zuziehhilfe_aktiv_Cx0_Init)}, range raw 0..1, transfer-property=TRIGGERED-WITHOUT-REPETITION  # Zuziehhilfe aktiv
    signal FT_SP_ausgerastet_XIX_DoorFunctions_FS_01_XIX_VLAN_Cockpit: start 58, 1 bit, little-endian, data-type-policy=OVERRIDE, i-signal-type=PRIMITIVE, init-value=0, base-type=BT_FT_SP_ausgerastet, compu {0=Cx0_Init (CM_FT_SP_ausgerastet_Cx0_Init), 1=Cx1_Spiegel_ausgerastet (CM_FT_SP_ausgerastet_Cx1_Spiegel_ausgerastet)}, range raw 0..1, transfer-property=TRIGGERED-WITHOUT-REPETITION  # Spiegel ausgerastet
    signal FT_SP_lr_aktiv_XIX_DoorFunctions_FS_01_XIX_VLAN_Cockpit: start 59, 1 bit, little-endian, data-type-policy=OVERRIDE, i-signal-type=PRIMITIVE, init-value=0, base-type=BT_FT_SP_lr_aktiv, compu {1=Cx1_Spiegel_xAchse_aktiv (CM_FT_SP_lr_aktiv_Cx1_Spiegel_xAchse_aktiv), 0=Cx0_Init (CM_FT_SP_lr_aktiv_Cx0_Init)}, range raw 0..1, transfer-property=TRIGGERED-WITHOUT-REPETITION  # Spiegelverstellung in Richtung links/rechts aktiv
    signal FT_SP_ht_aktiv_XIX_DoorFunctions_FS_01_XIX_VLAN_Cockpit: start 60, 1 bit, little-endian, data-type-policy=OVERRIDE, i-signal-type=PRIMITIVE, init-value=0, base-type=BT_FT_SP_ht_aktiv, compu {1=Cx1_Spiegel_yAchse_aktiv (CM_FT_SP_ht_aktiv_Cx1_Spiegel_yAchse_aktiv), 0=Cx0_Init (CM_FT_SP_ht_aktiv_Cx0_Init)}, range raw 0..1, transfer-property=TRIGGERED-WITHOUT-REPETITION  # Spiegelverstellung in Richtung hoch/tief aktiv
    signal ASW_wakeup_XIX_DoorFunctions_FS_01_XIX_VLAN_Cockpit: start 61, 1 bit, little-endian, data-type-policy=OVERRIDE, i-signal-type=PRIMITIVE, init-value=0, base-type=BT_ASW_wakeup, compu {0=Cx0_Sleep (CM_ASW_wakeup_Cx0_Sleep), 1=Cx1_Wakeup (CM_ASW_wakeup_Cx1_Wakeup)}, range raw 0..1, transfer-property=TRIGGERED-WITHOUT-REPETITION  # Trigger Start Nachlaufzeit t_1 für die Funktion Ausstieswarnung (ASW)
    signal FT_Oben_Block_erw_XIX_DoorFunctions_FS_01_XIX_VLAN_Cockpit: start 62, 1 bit, little-endian, data-type-policy=OVERRIDE, i-signal-type=PRIMITIVE, init-value=0, base-type=BT_FT_Oben_Block_erw, compu {1=Cx1_Fensterheber_in_Blockerwartung_o (CM_FT_Oben_Block_erw_Cx1_Fensterheber_in_Blockerwartung_o), 0=Cx0_Fensterheber_nicht_in_Blockerwar (CM_FT_Oben_Block_erw_Cx0_Fensterheber_nicht_in_Blockerwar)}, range raw 0..1, transfer-property=TRIGGERED-WITHOUT-REPETITION  # Fensterheber in Blockerwartung oben
    signal FT_Unten_Block_erw_XIX_DoorFunctions_FS_01_XIX_VLAN_Cockpit: start 63, 1 bit, little-endian, data-type-policy=OVERRIDE, i-signal-type=PRIMITIVE, init-value=0, base-type=BT_FT_Unten_Block_erw, compu {1=Cx1_Fensterheber_in_Blockerwartung_u (CM_FT_Unten_Block_erw_Cx1_Fensterheber_in_Blockerwartung_u), 0=Cx0_Fensterheber_nicht_in_Blockerwar (CM_FT_Unten_Block_erw_Cx0_Fensterheber_nicht_in_Blockerwar)}, range raw 0..1, transfer-property=TRIGGERED-WITHOUT-REPETITION  # Fensterheber in Blockerwartung unten
    signal FT_Kisi_li_aktiv_XIX_DoorFunctions_FS_01_XIX_VLAN_Cockpit: start 64, 1 bit, little-endian, data-type-policy=OVERRIDE, i-signal-type=PRIMITIVE, init-value=0, base-type=BT_FT_Kisi_li_aktiv, compu {0=Cx0_inaktiv (CM_FT_Kisi_li_aktiv_Cx0_inaktiv), 1=Cx1_aktiv (CM_FT_Kisi_li_aktiv_Cx1_aktiv)}, range raw 0..1, transfer-property=TRIGGERED-WITHOUT-REPETITION  # Aktivierungsstatus der Kindersicherung links
    signal FT_Kisi_re_aktiv_XIX_DoorFunctions_FS_01_XIX_VLAN_Cockpit: start 65, 1 bit, little-endian, data-type-policy=OVERRIDE, i-signal-type=PRIMITIVE, init-value=0, base-type=BT_FT_Kisi_re_aktiv, compu {0=Cx0_inaktiv (CM_FT_Kisi_re_aktiv_Cx0_inaktiv), 1=Cx1_aktiv (CM_FT_Kisi_re_aktiv_Cx1_aktiv)}, range raw 0..1, transfer-property=TRIGGERED-WITHOUT-REPETITION  # Aktivierungsstatus der Kindersicherung rechts
    signal FT_BFS_Fond_Freigabe_XIX_DoorFunctions_FS_01_XIX_VLAN_Cockpit: start 68, 1 bit, little-endian, data-type-policy=OVERRIDE, i-signal-type=PRIMITIVE, init-value=0, base-type=BT_FT_BFS_Fond_Freigabe, compu {0=Cx0_Init (CM_FT_BFS_Fond_Freigabe_Cx0_Init), 1=Cx1_Freigabe_fuer_Fondbedienung_BFS (CM_FT_BFS_Fond_Freigabe_Cx1_Freigabe_fuer_Fondbedienung_BFS)}, range raw 0..1, transfer-property=TRIGGERED-WITHOUT-REPETITION  # Freigabe für Fondverstellung
    signal FT_Kisi_Fehler_XIX_DoorFunctions_FS_01_XIX_VLAN_Cockpit: start 69, 1 bit, little-endian, data-type-policy=OVERRIDE, i-signal-type=PRIMITIVE, init-value=0, base-type=BT_FT_Kisi_Fehler, invalid-value=Invalid_FT_Kisi_Fehler_XIX_DoorFunctions_FS_01_XIX_VLAN_Cockpit:1, compu {1=Cx1_Fehler (CM_FT_Kisi_Fehler_Cx1_Fehler), 0=Cx0_kein_Fehler (CM_FT_Kisi_Fehler_Cx0_kein_Fehler)}, range raw 0..1, transfer-property=TRIGGERED-WITHOUT-REPETITION  # Fehlerstatus Kindersicherungsfunktion
    signal FT_Daemmglas_XIX_DoorFunctions_FS_01_XIX_VLAN_Cockpit: start 70, 1 bit, little-endian, data-type-policy=OVERRIDE, i-signal-type=PRIMITIVE, init-value=0, base-type=BT_FT_Daemmglas, compu {1=Cx1_Daemmglas_verbaut (CM_FT_Daemmglas_Cx1_Daemmglas_verbaut), 0=Cx0_Normalglas_verbaut (CM_FT_Daemmglas_Cx0_Normalglas_verbaut)}, range raw 0..1, transfer-property=TRIGGERED-WITHOUT-REPETITION  # Daemmglas verbaut
    signal FT_SP_Heizung_Status_XIX_DoorFunctions_FS_01_XIX_VLAN_Cockpit: start 71, 1 bit, little-endian, data-type-policy=OVERRIDE, i-signal-type=PRIMITIVE, init-value=0, base-type=BT_FT_SP_Heizung_Status, compu {1=Cx1_Status_Spiegelheizung_ein (CM_FT_SP_Heizung_Status_Cx1_Status_Spiegelheizung_ein), 0=Cx0_Init (CM_FT_SP_Heizung_Status_Cx0_Init)}, range raw 0..1, transfer-property=TRIGGERED-WITHOUT-REPETITION  # Status der Spiegelheizung
    signal ASW_Warnung_aktiv_FS_XIX_DoorFunctions_FS_01_XIX_VLAN_Cockpit: start 72, 1 bit, little-endian, data-type-policy=OVERRIDE, i-signal-type=PRIMITIVE, init-value=0, base-type=BT_ASW_Warnung_aktiv_FS, compu {0=Cx0_nicht_angefordert (CM_ASW_Warnung_aktiv_FS_Cx0_nicht_angefordert), 1=Cx1_angefordert (CM_ASW_Warnung_aktiv_FS_Cx1_angefordert)}, range raw 0..1, transfer-property=TRIGGERED-WITHOUT-REPETITION  # Abschaltung der Ambientefunktion Fahrertür bei aktiver ASW Warnung an der Fahrertür
    signal FT_FH_Pos_oben_XIX_DoorFunctions_FS_01_XIX_VLAN_Cockpit: start 73, 1 bit, little-endian, data-type-policy=OVERRIDE, i-signal-type=PRIMITIVE, init-value=0, base-type=BT_FT_FH_Pos_oben, compu {1=Cx1_Scheibe_oben_nach_Absenken_auf_Position (CM_FT_FH_Pos_oben_Cx1_Scheibe_oben_nach_Absenken_auf_Position) (Scheibe oben (nach Absenken auf Position))}, range raw 1, transfer-property=TRIGGERED-WITHOUT-REPETITION
    signal FT_Tuerschloss_defekt_XIX_DoorFunctions_FS_01_XIX_VLAN_Cockpit: start 74, 1 bit, little-endian, data-type-policy=OVERRIDE, i-signal-type=PRIMITIVE, init-value=0, base-type=BT_FT_Tuerschloss_defekt, compu {0=Cx0_Tuerschloss_funktionsfaehig (CM_FT_Tuerschloss_defekt_Cx0_Tuerschloss_funktionsfaehig), 1=Cx1_Tuerschloss_defekt (CM_FT_Tuerschloss_defekt_Cx1_Tuerschloss_defekt)}, range raw 0..1, transfer-property=TRIGGERED-WITHOUT-REPETITION  # Das Fahrertürschloss ist nicht mehr funktionsfähig.
    signal FT_SWA_Taster_XIX_DoorFunctions_FS_01_XIX_VLAN_Cockpit: start 75, 1 bit, little-endian, data-type-policy=OVERRIDE, i-signal-type=PRIMITIVE, init-value=0, base-type=BT_FT_SWA_Taster, compu {1=Cx1_Taster_betaetigt (CM_FT_SWA_Taster_Cx1_Taster_betaetigt), 0=Cx0_Taster_nicht_betaetigt (CM_FT_SWA_Taster_Cx0_Taster_nicht_betaetigt)}, range raw 0..1, transfer-property=TRIGGERED-WITHOUT-REPETITION  # SWA/ASW Taster Fahrertür
    signal SWA_HMI_Diagnose_XIX_DoorFunctions_FS_01_XIX_VLAN_Cockpit: start 76, 2 bit, little-endian, data-type-policy=OVERRIDE, i-signal-type=PRIMITIVE, init-value=0, base-type=BT_SWA_HMI_Diagnose, compu {3=Cx3_Fehler_LED_und_Taster_erkannt (CM_SWA_HMI_Diagnose_Cx3_Fehler_LED_und_Taster_erkannt), 1=Cx1_Fehler_Taster_erkannt (CM_SWA_HMI_Diagnose_Cx1_Fehler_Taster_erkannt), 2=Cx2_Fehler_LED_erkannt (CM_SWA_HMI_Diagnose_Cx2_Fehler_LED_erkannt), 0=Cx0_kein_Fehler_erkannt (CM_SWA_HMI_Diagnose_Cx0_kein_Fehler_erkannt)}, range raw 0..3, transfer-property=TRIGGERED-WITHOUT-REPETITION  # SWA HMI Diagnose beim TSG
    signal FS_Status_eTAG_XIX_DoorFunctions_FS_01_XIX_VLAN_Cockpit: start 78, 2 bit, little-endian, data-type-policy=OVERRIDE, i-signal-type=PRIMITIVE, init-value=0, base-type=BT_FS_Status_eTAG, invalid-value=Invalid_FS_Status_eTAG_XIX_DoorFunctions_FS_01_XIX_VLAN_Cockpit:3, compu {3=Cx3_Fehler (CM_FS_Status_eTAG_Cx3_Fehler), 0=Cx0_Init (CM_FS_Status_eTAG_Cx0_Init), 1=Cx1_Griff_ausgefahren (CM_FS_Status_eTAG_Cx1_Griff_ausgefahren), 2=Cx2_Griff_eingefahren (CM_FS_Status_eTAG_Cx2_Griff_eingefahren)}, range raw 0..3, transfer-property=TRIGGERED-WITHOUT-REPETITION  # Status des elektrischen Tueraussengriffes Fahrertuer
    signal MTFT_Pos1_EE_XIX_DoorFunctions_FS_01_XIX_VLAN_Cockpit: start 96, 1 bit, little-endian, data-type-policy=OVERRIDE, i-signal-type=PRIMITIVE, init-value=0, base-type=BT_MTFT_Pos1_EE, compu {1=Cx1_Postionstaste_1_FT_gedrueckt (CM_MTFT_Pos1_EE_Cx1_Postionstaste_1_FT_gedrueckt), 0=Cx0_Taste_nicht_gedrueckt (CM_MTFT_Pos1_EE_Cx0_Taste_nicht_gedrueckt)}, range raw 0..1, transfer-property=TRIGGERED-WITHOUT-REPETITION  # Betätigung Postionstaste 1 FT
    signal MTFT_Pos2_XIX_DoorFunctions_FS_01_XIX_VLAN_Cockpit: start 97, 1 bit, little-endian, data-type-policy=OVERRIDE, i-signal-type=PRIMITIVE, init-value=0, base-type=BT_MTFT_Pos2, compu {0=Cx0_Taste_nicht_gedrueckt (CM_MTFT_Pos2_Cx0_Taste_nicht_gedrueckt), 1=Cx1_Postionstaste_2_FT_gedrueckt (CM_MTFT_Pos2_Cx1_Postionstaste_2_FT_gedrueckt)}, range raw 0..1, transfer-property=TRIGGERED-WITHOUT-REPETITION  # Betätigung Postionstaste 2 FT
    signal MTFT_Pos3_XIX_DoorFunctions_FS_01_XIX_VLAN_Cockpit: start 98, 1 bit, little-endian, data-type-policy=OVERRIDE, i-signal-type=PRIMITIVE, init-value=0, base-type=BT_MTFT_Pos3, compu {1=Cx1_Postionstaste_3_FT_gedrueckt (CM_MTFT_Pos3_Cx1_Postionstaste_3_FT_gedrueckt), 0=Cx0_Taste_nicht_gedrueckt (CM_MTFT_Pos3_Cx0_Taste_nicht_gedrueckt)}, range raw 0..1, transfer-property=TRIGGERED-WITHOUT-REPETITION  # Betätigung Postionstaste 3 FT
    signal MTFT_Pos4_XIX_DoorFunctions_FS_01_XIX_VLAN_Cockpit: start 99, 1 bit, little-endian, data-type-policy=OVERRIDE, i-signal-type=PRIMITIVE, init-value=0, base-type=BT_MTFT_Pos4, compu {1=Cx1_Postionstaste_4_FT_gedrueckt (CM_MTFT_Pos4_Cx1_Postionstaste_4_FT_gedrueckt), 0=Cx0_Taste_nicht_gedrueckt (CM_MTFT_Pos4_Cx0_Taste_nicht_gedrueckt)}, range raw 0..1, transfer-property=TRIGGERED-WITHOUT-REPETITION  # Betätigung Postionstaste 4 FT
    signal MTFT_On_Off_XIX_DoorFunctions_FS_01_XIX_VLAN_Cockpit: start 100, 1 bit, little-endian, data-type-policy=OVERRIDE, i-signal-type=PRIMITIVE, init-value=0, base-type=BT_MTFT_On_Off, compu {1=Cx1_On_Off_Taste_FT_gedrueckt (CM_MTFT_On_Off_Cx1_On_Off_Taste_FT_gedrueckt) (On-Off Taste FT gedrückt), 0=Cx0_Taste_nicht_gedrueckt (CM_MTFT_On_Off_Cx0_Taste_nicht_gedrueckt)}, range raw 0..1, transfer-property=TRIGGERED-WITHOUT-REPETITION  # Betätigung On-Off Taste FT
    signal MTFT_Verst_akt_XIX_DoorFunctions_FS_01_XIX_VLAN_Cockpit: start 101, 1 bit, little-endian, data-type-policy=OVERRIDE, i-signal-type=PRIMITIVE, init-value=0, base-type=BT_MTFT_Verst_akt, compu {1=Cx1_Verstellung_aktiv (CM_MTFT_Verst_akt_Cx1_Verstellung_aktiv), 0=Cx0_Verstellung_nicht_aktiv (CM_MTFT_Verst_akt_Cx0_Verstellung_nicht_aktiv)}, range raw 0..1, transfer-property=TRIGGERED-WITHOUT-REPETITION  # Mem Taster Verstellung aktiv
    signal MTFT_M_Taste_XIX_DoorFunctions_FS_01_XIX_VLAN_Cockpit: start 103, 1 bit, little-endian, data-type-policy=OVERRIDE, i-signal-type=PRIMITIVE, init-value=0, base-type=BT_MTFT_M_Taste, compu {1=Cx1_MTaste_FT_gedrueckt (CM_MTFT_M_Taste_Cx1_MTaste_FT_gedrueckt), 0=Cx0_Taste_nicht_gedrueckt (CM_MTFT_M_Taste_Cx0_Taste_nicht_gedrueckt)}, range raw 0..1, transfer-property=TRIGGERED-WITHOUT-REPETITION  # Betätigung M-Taste FT
    signal TSG_FlHz_FS_Unterbrech_HzK_A_XIX_DoorFunctions_FS_01_XIX_VLAN_Cockpit: start 150, 1 bit, little-endian, data-type-policy=OVERRIDE, i-signal-type=PRIMITIVE, init-value=0, base-type=BT_TSG_FlHz_FS_Unterbrech_HzK_A, compu {1=Cx1_Unterbrechung (CM_TSG_FlHz_FS_Unterbrech_HzK_A_Cx1_Unterbrechung), 0=Cx0_keine_Unterbrechung (CM_TSG_FlHz_FS_Unterbrech_HzK_A_Cx0_keine_Unterbrechung)}, range raw 0..1, transfer-property=TRIGGERED-WITHOUT-REPETITION  # Flächenheizung: Unterbrechungsstatus Heizkreis
    signal TSG_FlHz_FS_Unterbrech_HzK_B_XIX_DoorFunctions_FS_01_XIX_VLAN_Cockpit: start 151, 1 bit, little-endian, data-type-policy=OVERRIDE, i-signal-type=PRIMITIVE, init-value=0, base-type=BT_TSG_FlHz_FS_Unterbrech_HzK_B, compu {0=Cx0_keine_Unterbrechung (CM_TSG_FlHz_FS_Unterbrech_HzK_B_Cx0_keine_Unterbrechung), 1=Cx1_Unterbrechung (CM_TSG_FlHz_FS_Unterbrech_HzK_B_Cx1_Unterbrechung)}, range raw 0..1, transfer-property=TRIGGERED-WITHOUT-REPETITION  # Flächenheizung: Unterbrechungsstatus Heizkreis
    signal TSG_FlHz_FS_NTC_A_XIX_DoorFunctions_FS_01_XIX_VLAN_Cockpit: start 152, 7 bit, little-endian, data-type-policy=OVERRIDE, i-signal-type=PRIMITIVE, init-value=127, base-type=BT_TSG_FlHz_FS_NTC_A, compu {phys=raw-40 for raw 0..120, 127=Cx7f_Init (CM_TSG_FlHz_FS_NTC_A_Cx7f_Init), 126=Cx7e_Fehler_NTC_Overload_KS_Minus (CM_TSG_FlHz_FS_NTC_A_Cx7e_Fehler_NTC_Overload_KS_Minus), 125=Cx7d_Fehler_NTC_OpenLoad_KS_Plus (CM_TSG_FlHz_FS_NTC_A_Cx7d_Fehler_NTC_OpenLoad_KS_Plus); unit Unit_DegreCelsi}, range phys -40..80 Unit_DegreCelsi, raw 0..127, unit=Unit_DegreCelsi, transfer-property=TRIGGERED-WITHOUT-REPETITION  # Flächenheizung: Temperatur und Fehlerwert des Heizaktors
    signal TSG_FlHz_FS_FnAbbruchHzKreis_A_XIX_DoorFunctions_FS_01_XIX_VLAN_Cockpit: start 159, 1 bit, little-endian, data-type-policy=OVERRIDE, i-signal-type=PRIMITIVE, init-value=0, base-type=BT_TSG_FlHz_FS_FnAbbruchHzKreis_A, compu {0=Cx0_OK (CM_TSG_FlHz_FS_FnAbbruchHzKreis_A_Cx0_OK), 1=Cx1_FunktionsAbbruch (CM_TSG_FlHz_FS_FnAbbruchHzKreis_A_Cx1_FunktionsAbbruch)}, range raw 0..1, transfer-property=TRIGGERED-WITHOUT-REPETITION  # Flächenheizung: Status
    signal TSG_FlHz_FS_NTC_B_XIX_DoorFunctions_FS_01_XIX_VLAN_Cockpit: start 160, 7 bit, little-endian, data-type-policy=OVERRIDE, i-signal-type=PRIMITIVE, init-value=127, base-type=BT_TSG_FlHz_FS_NTC_B, compu {phys=raw-40 for raw 0..120, 125=Cx7d_Fehler_NTC_OpenLoad_KS_Plus (CM_TSG_FlHz_FS_NTC_B_Cx7d_Fehler_NTC_OpenLoad_KS_Plus), 127=Cx7f_Init (CM_TSG_FlHz_FS_NTC_B_Cx7f_Init), 126=Cx7e_Fehler_NTC_Overload_KS_Minus (CM_TSG_FlHz_FS_NTC_B_Cx7e_Fehler_NTC_Overload_KS_Minus); unit Unit_DegreCelsi}, range phys -40..80 Unit_DegreCelsi, raw 0..127, unit=Unit_DegreCelsi, transfer-property=TRIGGERED-WITHOUT-REPETITION  # Flächenheizung: Temperatur und Fehlerwert des Heizaktors
    signal TSG_FlHz_FS_FnAbbruchHzKreis_B_XIX_DoorFunctions_FS_01_XIX_VLAN_Cockpit: start 167, 1 bit, little-endian, data-type-policy=OVERRIDE, i-signal-type=PRIMITIVE, init-value=0, base-type=BT_TSG_FlHz_FS_FnAbbruchHzKreis_B, compu {1=Cx1_FunktionsAbbruch (CM_TSG_FlHz_FS_FnAbbruchHzKreis_B_Cx1_FunktionsAbbruch), 0=Cx0_OK (CM_TSG_FlHz_FS_FnAbbruchHzKreis_B_Cx0_OK)}, range raw 0..1, transfer-property=TRIGGERED-WITHOUT-REPETITION  # Flächenheizung: Status
    signal SSA_FT_ASP_Klappung_Fehler_XIX_DoorFunctions_FS_01_XIX_VLAN_Cockpit: start 168, 3 bit, little-endian, data-type-policy=OVERRIDE, i-signal-type=PRIMITIVE, init-value=0, base-type=BT_SSA_FT_ASP_Klappung_Fehler, compu {0=Cx0_in_Ordnung (CM_SSA_FT_ASP_Klappung_Fehler_Cx0_in_Ordnung), 4=Cx4_elektrischer_Fehler (CM_SSA_FT_ASP_Klappung_Fehler_Cx4_elektrischer_Fehler), 1=Cx1_nicht_verbaut (CM_SSA_FT_ASP_Klappung_Fehler_Cx1_nicht_verbaut), 3=Cx3_Ueberspannung (CM_SSA_FT_ASP_Klappung_Fehler_Cx3_Ueberspannung), 5=Cx5_Bedingung_nicht_erfuellt (CM_SSA_FT_ASP_Klappung_Fehler_Cx5_Bedingung_nicht_erfuellt), 2=Cx2_Unterspannung (CM_SSA_FT_ASP_Klappung_Fehler_Cx2_Unterspannung)}, range raw 0..5, transfer-property=TRIGGERED-WITHOUT-REPETITION  # SmartSensorActor: Rückmeldung des Fehlerzustandes der Spiegelklappung Aussenspiegel
    signal SSA_FT_ASP_Spiegelglas_Fehler_XIX_DoorFunctions_FS_01_XIX_VLAN_Cockpit: start 171, 3 bit, little-endian, data-type-policy=OVERRIDE, i-signal-type=PRIMITIVE, init-value=0, base-type=BT_SSA_FT_ASP_Spiegelglas_Fehler, compu {2=Cx2_Unterspannung (CM_SSA_FT_ASP_Spiegelglas_Fehler_Cx2_Unterspannung), 5=Cx5_Bedingung_nicht_erfuellt (CM_SSA_FT_ASP_Spiegelglas_Fehler_Cx5_Bedingung_nicht_erfuellt), 0=Cx0_in_Ordnung (CM_SSA_FT_ASP_Spiegelglas_Fehler_Cx0_in_Ordnung), 1=Cx1_nicht_verbaut (CM_SSA_FT_ASP_Spiegelglas_Fehler_Cx1_nicht_verbaut), 4=Cx4_elektrischer_Fehler (CM_SSA_FT_ASP_Spiegelglas_Fehler_Cx4_elektrischer_Fehler), 3=Cx3_Ueberspannung (CM_SSA_FT_ASP_Spiegelglas_Fehler_Cx3_Ueberspannung)}, range raw 0..5, transfer-property=TRIGGERED-WITHOUT-REPETITION  # SmartSensorActor: Rückmeldung des Fehlerzustand der Spiegelglasverstellung auf der Fahrerseite
    signal SSA_FT_ASW_Fehler_XIX_DoorFunctions_FS_01_XIX_VLAN_Cockpit: start 174, 3 bit, little-endian, data-type-policy=OVERRIDE, i-signal-type=PRIMITIVE, init-value=0, base-type=BT_SSA_FT_ASW_Fehler, compu {3=Cx3_Ueberspannung (CM_SSA_FT_ASW_Fehler_Cx3_Ueberspannung), 5=Cx5_Bedingung_nicht_erfuellt (CM_SSA_FT_ASW_Fehler_Cx5_Bedingung_nicht_erfuellt), 1=Cx1_nicht_verbaut (CM_SSA_FT_ASW_Fehler_Cx1_nicht_verbaut), 4=Cx4_el_Fehler (CM_SSA_FT_ASW_Fehler_Cx4_el_Fehler), 0=Cx0_iO (CM_SSA_FT_ASW_Fehler_Cx0_iO), 2=Cx2_Unterspannung (CM_SSA_FT_ASW_Fehler_Cx2_Unterspannung)}, range raw 0..5, transfer-property=TRIGGERED-WITHOUT-REPETITION  # SmartSensorActor: Rückmeldung des Fehlerzustand des Ausstiegswarners
    signal SSA_FT_ASW_Status_XIX_DoorFunctions_FS_01_XIX_VLAN_Cockpit: start 177, 2 bit, little-endian, data-type-policy=OVERRIDE, i-signal-type=PRIMITIVE, init-value=0, base-type=BT_SSA_FT_ASW_Status, compu {0=Cx0_Init (CM_SSA_FT_ASW_Status_Cx0_Init), 1=Cx1_InfoStufe_aktiv (CM_SSA_FT_ASW_Status_Cx1_InfoStufe_aktiv), 2=Cx2_Warnstufe_aktiv (CM_SSA_FT_ASW_Status_Cx2_Warnstufe_aktiv)}, range raw 0..2, transfer-property=TRIGGERED-WITHOUT-REPETITION  # SmartSensorActor: Rückmeldung des Status der ASW Anzeige.
    signal SSA_FT_el_Tuerantrieb_Fehler_XIX_DoorFunctions_FS_01_XIX_VLAN_Cockpit: start 179, 3 bit, little-endian, data-type-policy=OVERRIDE, i-signal-type=PRIMITIVE, init-value=0, base-type=BT_SSA_FT_el_Tuerantrieb_Fehler, compu {2=Cx2_Unterspannung (CM_SSA_FT_el_Tuerantrieb_Fehler_Cx2_Unterspannung), 0=Cx0_iO (CM_SSA_FT_el_Tuerantrieb_Fehler_Cx0_iO), 3=Cx3_Ueberspannung (CM_SSA_FT_el_Tuerantrieb_Fehler_Cx3_Ueberspannung), 1=Cx1_nicht_verbaut (CM_SSA_FT_el_Tuerantrieb_Fehler_Cx1_nicht_verbaut), 5=Cx5_Bedingung_nicht_erfuellt (CM_SSA_FT_el_Tuerantrieb_Fehler_Cx5_Bedingung_nicht_erfuellt), 4=Cx4_el_Fehler (CM_SSA_FT_el_Tuerantrieb_Fehler_Cx4_el_Fehler)}, range raw 0..5, transfer-property=TRIGGERED-WITHOUT-REPETITION  # SmartSensorActor: Rückmeldung des Fehlerzustand des el. Tuerantriebs
    signal SSA_FT_el_Tuerantrieb_Status_XIX_DoorFunctions_FS_01_XIX_VLAN_Cockpit: start 182, 2 bit, little-endian, data-type-policy=OVERRIDE, i-signal-type=PRIMITIVE, init-value=0, base-type=BT_SSA_FT_el_Tuerantrieb_Status, compu {0=Cx0_Init (CM_SSA_FT_el_Tuerantrieb_Status_Cx0_Init), 1=Cx1_offen (CM_SSA_FT_el_Tuerantrieb_Status_Cx1_offen), 2=Cx2_geschlossen (CM_SSA_FT_el_Tuerantrieb_Status_Cx2_geschlossen)}, range raw 0..2, transfer-property=TRIGGERED-WITHOUT-REPETITION  # SmartSensorActor: Rückmeldung des Status des el. Tuerantriebes
    signal SSA_FT_FH_Bewegungsrichutng_XIX_DoorFunctions_FS_01_XIX_VLAN_Cockpit: start 184, 2 bit, little-endian, data-type-policy=OVERRIDE, i-signal-type=PRIMITIVE, init-value=0, base-type=BT_SSA_FT_FH_Bewegungsrichutng, compu {2=Cx2_FH_in_Bewegung_Oeffnen (CM_SSA_FT_FH_Bewegungsrichutng_Cx2_FH_in_Bewegung_Oeffnen), 1=Cx1_FH_in_Bewegung_Schliessen (CM_SSA_FT_FH_Bewegungsrichutng_Cx1_FH_in_Bewegung_Schliessen), 0=Cx0_Stillstand (CM_SSA_FT_FH_Bewegungsrichutng_Cx0_Stillstand)}, range raw 0..2, transfer-property=TRIGGERED-WITHOUT-REPETITION  # SmartSensorActor: Rückmeldung der Bewegungsrichtung der Seitenscheibe
    signal SSA_FT_FH_Fehler_XIX_DoorFunctions_FS_01_XIX_VLAN_Cockpit: start 186, 3 bit, little-endian, data-type-policy=OVERRIDE, i-signal-type=PRIMITIVE, init-value=0, base-type=BT_SSA_FT_FH_Fehler, compu {5=Cx5_Bedingung_nicht_erfuellt (CM_SSA_FT_FH_Fehler_Cx5_Bedingung_nicht_erfuellt), 4=Cx4_el_Fehler (CM_SSA_FT_FH_Fehler_Cx4_el_Fehler), 3=Cx3_Ueberspannung (CM_SSA_FT_FH_Fehler_Cx3_Ueberspannung), 1=Cx1_nicht_verbaut (CM_SSA_FT_FH_Fehler_Cx1_nicht_verbaut), 0=Cx0_iO (CM_SSA_FT_FH_Fehler_Cx0_iO), 2=Cx2_Unterspannung (CM_SSA_FT_FH_Fehler_Cx2_Unterspannung)}, range raw 0..5, transfer-property=TRIGGERED-WITHOUT-REPETITION  # SmartSensorActor: Rückmeldung des Fehlerzustandes der Fensterheberfunktion
    signal SSA_FT_FH_Normierung_XIX_DoorFunctions_FS_01_XIX_VLAN_Cockpit: start 189, 1 bit, little-endian, data-type-policy=OVERRIDE, i-signal-type=PRIMITIVE, init-value=0, base-type=BT_SSA_FT_FH_Normierung, compu {0=Cx0_nicht_normiert (CM_SSA_FT_FH_Normierung_Cx0_nicht_normiert), 1=Cx1_normiert (CM_SSA_FT_FH_Normierung_Cx1_normiert)}, range raw 0..1, transfer-property=TRIGGERED-WITHOUT-REPETITION  # SmartSensorActor: Rückmeldung des Normierungszustandes des Fensterhebers
    signal SSA_FT_FH_Thermoschutz_XIX_DoorFunctions_FS_01_XIX_VLAN_Cockpit: start 190, 1 bit, little-endian, data-type-policy=OVERRIDE, i-signal-type=PRIMITIVE, init-value=0, base-type=BT_SSA_FT_FH_Thermoschutz, compu {1=Cx1_Thermoschutz_aktiv (CM_SSA_FT_FH_Thermoschutz_Cx1_Thermoschutz_aktiv), 0=Cx0_Thermoschutz_deaktiv (CM_SSA_FT_FH_Thermoschutz_Cx0_Thermoschutz_deaktiv)}, range raw 0..1, transfer-property=TRIGGERED-WITHOUT-REPETITION  # SmartSensorActor: Rückmeldung Status Thermoschutz
    signal SSA_FT_Tuerverschluss_Status_XIX_DoorFunctions_FS_01_XIX_VLAN_Cockpit: start 191, 2 bit, little-endian, data-type-policy=OVERRIDE, i-signal-type=PRIMITIVE, init-value=0, base-type=BT_SSA_FT_Tuerverschluss_Status, compu {1=Cx1_Tuer_geschlossen (CM_SSA_FT_Tuerverschluss_Status_Cx1_Tuer_geschlossen), 2=Cx2_Tuer_offen (CM_SSA_FT_Tuerverschluss_Status_Cx2_Tuer_offen), 0=Cx0_Init (CM_SSA_FT_Tuerverschluss_Status_Cx0_Init)}, range raw 0..2, transfer-property=TRIGGERED-WITHOUT-REPETITION  # SmartSensorActor: Türstatus der Fahrertür (geschlossen, geöffnet)
    signal SSA_FT_ZZH_Fehler_XIX_DoorFunctions_FS_01_XIX_VLAN_Cockpit: start 193, 3 bit, little-endian, data-type-policy=OVERRIDE, i-signal-type=PRIMITIVE, init-value=0, base-type=BT_SSA_FT_ZZH_Fehler, compu {3=Cx3_Ueberspannung (CM_SSA_FT_ZZH_Fehler_Cx3_Ueberspannung), 4=Cx4_elektrischer_Fehler (CM_SSA_FT_ZZH_Fehler_Cx4_elektrischer_Fehler), 0=Cx0_in_Ordnung (CM_SSA_FT_ZZH_Fehler_Cx0_in_Ordnung), 2=Cx2_Unterspannung (CM_SSA_FT_ZZH_Fehler_Cx2_Unterspannung), 5=Cx5_Bedingung_nicht_erfuellt (CM_SSA_FT_ZZH_Fehler_Cx5_Bedingung_nicht_erfuellt), 1=Cx1_nicht_verbaut (CM_SSA_FT_ZZH_Fehler_Cx1_nicht_verbaut)}, range raw 0..5, transfer-property=TRIGGERED-WITHOUT-REPETITION  # SmartSensorActor: Rückmeldung des Fehlerzustandes des ZZH Systems
    signal SSA_FT_ZZH_Status_XIX_DoorFunctions_FS_01_XIX_VLAN_Cockpit: start 196, 1 bit, little-endian, data-type-policy=OVERRIDE, i-signal-type=PRIMITIVE, init-value=0, base-type=BT_SSA_FT_ZZH_Status, compu {1=Cx1_Zuziehvorgang_aktiv (CM_SSA_FT_ZZH_Status_Cx1_Zuziehvorgang_aktiv), 0=Cx0_Init (CM_SSA_FT_ZZH_Status_Cx0_Init)}, range raw 0..1, transfer-property=TRIGGERED-WITHOUT-REPETITION  # SmartSensorActor: Status des ZZH Motors
    signal SSR_Temp_Freigabe_XIX_DoorFunctions_FS_01_XIX_VLAN_Cockpit: start 197, 1 bit, little-endian, data-type-policy=OVERRIDE, i-signal-type=PRIMITIVE, init-value=0, base-type=BT_SSR_Temp_Freigabe, compu {1=Cx1_SSR_Freigegeben (CM_SSR_Temp_Freigabe_Cx1_SSR_Freigegeben), 0=Cx0_SSR_Deaktiviert (CM_SSR_Temp_Freigabe_Cx0_SSR_Deaktiviert)}, range raw 0..1, transfer-property=TRIGGERED-WITHOUT-REPETITION  # Freigabe des Seitenscheibenrollos. Bit wird für die Deaktivierung des SSR bei Innenraumtemperaturen kleiner -10 Grad verwendet.
    signal ASW_Warnung_Aussenlicht_FS_Li_XIX_DoorFunctions_FS_01_XIX_VLAN_Cockpit: start 198, 1 bit, little-endian, data-type-policy=OVERRIDE, i-signal-type=PRIMITIVE, init-value=0, base-type=BT_ASW_Warnung_Aussenlicht_FS_Li, compu {1=Cx1_ASW_Warnung_aktiv (CM_ASW_Warnung_Aussenlicht_FS_Li_Cx1_ASW_Warnung_aktiv), 0=Cx0_ASW_Warnung_nicht_aktiv (CM_ASW_Warnung_Aussenlicht_FS_Li_Cx0_ASW_Warnung_nicht_aktiv)}, range raw 0..1, transfer-property=TRIGGERED-WITHOUT-REPETITION  # Anzeige Ausstiegwarnung nach aussen, z.B. Heckleuchte
    signal ASW_Warnung_Aussenlicht_FS_Re_XIX_DoorFunctions_FS_01_XIX_VLAN_Cockpit: start 199, 1 bit, little-endian, data-type-policy=OVERRIDE, i-signal-type=PRIMITIVE, init-value=0, base-type=BT_ASW_Warnung_Aussenlicht_FS_Re, compu {1=Cx1_ASW_Warnung_aktiv (CM_ASW_Warnung_Aussenlicht_FS_Re_Cx1_ASW_Warnung_aktiv), 0=Cx0_ASW_Warnung_nicht_aktiv (CM_ASW_Warnung_Aussenlicht_FS_Re_Cx0_ASW_Warnung_nicht_aktiv)}, range raw 0..1, transfer-property=TRIGGERED-WITHOUT-REPETITION  # Anzeige Ausstiegwarnung nach aussen, z.B. Heckleuchte
    signal MemFT_Pos3_XIX_DoorFunctions_FS_01_XIX_VLAN_Cockpit: start 210, 2 bit, little-endian, data-type-policy=OVERRIDE, i-signal-type=PRIMITIVE, init-value=2, base-type=BT_MemFT_Pos3, invalid-value=Invalid_MemFT_Pos3_XIX_DoorFunctions_FS_01_XIX_VLAN_Cockpit:3, compu {3=Cx3_Fehler (CM_MemFT_Pos3_Cx3_Fehler), 0=Cx0_aus (CM_MemFT_Pos3_Cx0_aus), 1=Cx1_ein (CM_MemFT_Pos3_Cx1_ein), 2=Cx2_Init (CM_MemFT_Pos3_Cx2_Init)}, range raw 0..3, transfer-property=TRIGGERED-WITHOUT-REPETITION  # Betätigung Postionstaste 3 FT
    signal FT_ASW_Warnton_XIX_DoorFunctions_FS_01_XIX_VLAN_Cockpit: start 212, 2 bit, little-endian, data-type-policy=OVERRIDE, i-signal-type=PRIMITIVE, init-value=0, base-type=BT_FT_ASW_Warnton, invalid-value=Invalid_FT_ASW_Warnton_XIX_DoorFunctions_FS_01_XIX_VLAN_Cockpit:3, compu {3=Cx3_Fehler (CM_FT_ASW_Warnton_Cx3_Fehler), 0=Cx0_kein_warnton (CM_FT_ASW_Warnton_Cx0_kein_warnton), 2=Cx2_warnton_rechts (CM_FT_ASW_Warnton_Cx2_warnton_rechts), 1=Cx1_warnton_links (CM_FT_ASW_Warnton_Cx1_warnton_links)}, range raw 0..3, transfer-property=TRIGGERED-WITHOUT-REPETITION  # erzeugt ein Warnton bei AS Warnung
    signal FT_ASW_Warnung_Aussenlicht_XIX_DoorFunctions_FS_01_XIX_VLAN_Cockpit: start 214, 2 bit, little-endian, data-type-policy=OVERRIDE, i-signal-type=PRIMITIVE, init-value=0, base-type=BT_FT_ASW_Warnung_Aussenlicht, invalid-value=Invalid_FT_ASW_Warnung_Aussenlicht_XIX_DoorFunctions_FS_01_XIX_VLAN_Cockpit:3, compu {3=Cx3_Fehler (CM_FT_ASW_Warnung_Aussenlicht_Cx3_Fehler), 2=Cx2_licht_rechts (CM_FT_ASW_Warnung_Aussenlicht_Cx2_licht_rechts), 0=Cx0_kein_licht (CM_FT_ASW_Warnung_Aussenlicht_Cx0_kein_licht), 1=Cx1_licht_links (CM_FT_ASW_Warnung_Aussenlicht_Cx1_licht_links)}, range raw 0..3, transfer-property=TRIGGERED-WITHOUT-REPETITION  # zeigt in den Heckleuchte ein Symbol an
    signal MemFT_Pos2_XIX_DoorFunctions_FS_01_XIX_VLAN_Cockpit: start 216, 2 bit, little-endian, data-type-policy=OVERRIDE, i-signal-type=PRIMITIVE, init-value=2, base-type=BT_MemFT_Pos2, invalid-value=Invalid_MemFT_Pos2_XIX_DoorFunctions_FS_01_XIX_VLAN_Cockpit:3, compu {3=Cx3_Fehler (CM_MemFT_Pos2_Cx3_Fehler), 0=Cx0_aus (CM_MemFT_Pos2_Cx0_aus), 1=Cx1_ein (CM_MemFT_Pos2_Cx1_ein), 2=Cx2_Init (CM_MemFT_Pos2_Cx2_Init)}, range raw 0..3, transfer-property=TRIGGERED-WITHOUT-REPETITION  # Betätigung Postionstaste 2 FT
    signal MemFT_Pos4_XIX_DoorFunctions_FS_01_XIX_VLAN_Cockpit: start 221, 2 bit, little-endian, data-type-policy=OVERRIDE, i-signal-type=PRIMITIVE, init-value=2, base-type=BT_MemFT_Pos4, invalid-value=Invalid_MemFT_Pos4_XIX_DoorFunctions_FS_01_XIX_VLAN_Cockpit:3, compu {3=Cx3_Fehler (CM_MemFT_Pos4_Cx3_Fehler), 1=Cx1_ein (CM_MemFT_Pos4_Cx1_ein), 0=Cx0_aus (CM_MemFT_Pos4_Cx0_aus), 2=Cx2_Init (CM_MemFT_Pos4_Cx2_Init)}, range raw 0..3, transfer-property=TRIGGERED-WITHOUT-REPETITION  # Betätigung Postionstaste 4 FT
    signal MemFT_Pos1_EE_XIX_DoorFunctions_FS_01_XIX_VLAN_Cockpit: start 223, 2 bit, little-endian, data-type-policy=OVERRIDE, i-signal-type=PRIMITIVE, init-value=2, base-type=BT_MemFT_Pos1_EE, invalid-value=Invalid_MemFT_Pos1_EE_XIX_DoorFunctions_FS_01_XIX_VLAN_Cockpit:3, compu {3=Cx3_Fehler (CM_MemFT_Pos1_EE_Cx3_Fehler), 0=Cx0_aus (CM_MemFT_Pos1_EE_Cx0_aus), 2=Cx2_Init (CM_MemFT_Pos1_EE_Cx2_Init), 1=Cx1_ein (CM_MemFT_Pos1_EE_Cx1_ein)}, range raw 0..3, transfer-property=TRIGGERED-WITHOUT-REPETITION  # Betätigung Postionstaste 1 FT
    signal SP_FT_oben_XIX_DoorFunctions_FS_01_XIX_VLAN_Cockpit: start 280, 1 bit, little-endian, data-type-policy=OVERRIDE, i-signal-type=PRIMITIVE, init-value=0, base-type=BT_SP_FT_oben, compu {1=Cx1_betaetigt (CM_SP_FT_oben_Cx1_betaetigt), 0=Cx0_nicht_betaetigt (CM_SP_FT_oben_Cx0_nicht_betaetigt)}, range raw 0..1, transfer-property=TRIGGERED-WITHOUT-REPETITION  # Spiegel Fahrertür nach oben
    signal SP_FT_unten_XIX_DoorFunctions_FS_01_XIX_VLAN_Cockpit: start 281, 1 bit, little-endian, data-type-policy=OVERRIDE, i-signal-type=PRIMITIVE, init-value=0, base-type=BT_SP_FT_unten, compu {1=Cx1_betaetigt (CM_SP_FT_unten_Cx1_betaetigt), 0=Cx0_nicht_betaetigt (CM_SP_FT_unten_Cx0_nicht_betaetigt)}, range raw 0..1, transfer-property=TRIGGERED-WITHOUT-REPETITION  # Spiegel Fahrertür nach unten
    signal SP_FT_links_XIX_DoorFunctions_FS_01_XIX_VLAN_Cockpit: start 282, 1 bit, little-endian, data-type-policy=OVERRIDE, i-signal-type=PRIMITIVE, init-value=0, base-type=BT_SP_FT_links, compu {1=Cx1_betaetigt (CM_SP_FT_links_Cx1_betaetigt), 0=Cx0_nicht_betaetigt (CM_SP_FT_links_Cx0_nicht_betaetigt)}, range raw 0..1, transfer-property=TRIGGERED-WITHOUT-REPETITION  # Spiegel Fahrertür nach links
    signal SP_FT_rechts_XIX_DoorFunctions_FS_01_XIX_VLAN_Cockpit: start 283, 1 bit, little-endian, data-type-policy=OVERRIDE, i-signal-type=PRIMITIVE, init-value=0, base-type=BT_SP_FT_rechts, compu {1=Cx1_betaetigt (CM_SP_FT_rechts_Cx1_betaetigt), 0=Cx0_nicht_betaetigt (CM_SP_FT_rechts_Cx0_nicht_betaetigt)}, range raw 0..1, transfer-property=TRIGGERED-WITHOUT-REPETITION  # Spiegel Fahrertür nach rechts
    signal SP_BT_oben_XIX_DoorFunctions_FS_01_XIX_VLAN_Cockpit: start 284, 1 bit, little-endian, data-type-policy=OVERRIDE, i-signal-type=PRIMITIVE, init-value=0, base-type=BT_SP_BT_oben, compu {1=Cx1_betaetigt (CM_SP_BT_oben_Cx1_betaetigt), 0=Cx0_nicht_betaetigt (CM_SP_BT_oben_Cx0_nicht_betaetigt)}, range raw 0..1, transfer-property=TRIGGERED-WITHOUT-REPETITION  # Spiegel Beifahrertür nach oben
    signal SP_BT_unten_XIX_DoorFunctions_FS_01_XIX_VLAN_Cockpit: start 285, 1 bit, little-endian, data-type-policy=OVERRIDE, i-signal-type=PRIMITIVE, init-value=0, base-type=BT_SP_BT_unten, compu {1=Cx1_betaetigt (CM_SP_BT_unten_Cx1_betaetigt), 0=Cx0_nicht_betaetigt (CM_SP_BT_unten_Cx0_nicht_betaetigt)}, range raw 0..1, transfer-property=TRIGGERED-WITHOUT-REPETITION  # Spiegel Beifahrertür nach unten
    signal SP_BT_links_XIX_DoorFunctions_FS_01_XIX_VLAN_Cockpit: start 286, 1 bit, little-endian, data-type-policy=OVERRIDE, i-signal-type=PRIMITIVE, init-value=0, base-type=BT_SP_BT_links, compu {1=Cx1_betaetigt (CM_SP_BT_links_Cx1_betaetigt), 0=Cx0_nicht_betaetigt (CM_SP_BT_links_Cx0_nicht_betaetigt)}, range raw 0..1, transfer-property=TRIGGERED-WITHOUT-REPETITION  # Spiegel Beifahrertür nach links
    signal SP_BT_rechts_XIX_DoorFunctions_FS_01_XIX_VLAN_Cockpit: start 287, 1 bit, little-endian, data-type-policy=OVERRIDE, i-signal-type=PRIMITIVE, init-value=0, base-type=BT_SP_BT_rechts, compu {1=Cx1_betaetigt (CM_SP_BT_rechts_Cx1_betaetigt), 0=Cx0_nicht_betaetigt (CM_SP_BT_rechts_Cx0_nicht_betaetigt)}, range raw 0..1, transfer-property=TRIGGERED-WITHOUT-REPETITION  # Spiegel Beifahrertür nach rechts
    signal SP_abklappen_XIX_DoorFunctions_FS_01_XIX_VLAN_Cockpit: start 288, 1 bit, little-endian, data-type-policy=OVERRIDE, i-signal-type=PRIMITIVE, init-value=0, base-type=BT_SP_abklappen, compu {0=Cx0_Spiegel_abklappen_nicht_aktiv (CM_SP_abklappen_Cx0_Spiegel_abklappen_nicht_aktiv), 1=Cx1_Spiegel_abklappen_aktiv (CM_SP_abklappen_Cx1_Spiegel_abklappen_aktiv)}, range raw 0..1, transfer-property=TRIGGERED-WITHOUT-REPETITION  # Spiegel abklappen
    signal SP_anklappen_XIX_DoorFunctions_FS_01_XIX_VLAN_Cockpit: start 289, 1 bit, little-endian, data-type-policy=OVERRIDE, i-signal-type=PRIMITIVE, init-value=0, base-type=BT_SP_anklappen, compu {0=Cx0_Spiegle_anklappen_nicht_aktiv (CM_SP_anklappen_Cx0_Spiegle_anklappen_nicht_aktiv), 1=Cx1_Spiegel_anklappen_aktiv (CM_SP_anklappen_Cx1_Spiegel_anklappen_aktiv)}, range raw 0..1, transfer-property=TRIGGERED-WITHOUT-REPETITION  # Spiegel anklappen
    signal SP_normieren_XIX_DoorFunctions_FS_01_XIX_VLAN_Cockpit: start 290, 1 bit, little-endian, data-type-policy=OVERRIDE, i-signal-type=PRIMITIVE, init-value=0, base-type=BT_SP_normieren, compu {0=Cx0_Spiegel_nicht_normiert (CM_SP_normieren_Cx0_Spiegel_nicht_normiert), 1=Cx1_Spiegel_normiert (CM_SP_normieren_Cx1_Spiegel_normiert)}, range raw 0..1, transfer-property=TRIGGERED-WITHOUT-REPETITION  # Spiegel normieren
    signal SP_Spg_Verstellschalter_Fehler_XIX_DoorFunctions_FS_01_XIX_VLAN_Cockpit: start 291, 1 bit, little-endian, data-type-policy=OVERRIDE, i-signal-type=PRIMITIVE, init-value=0, base-type=BT_SP_Spg_Verstellschalter_Fehler, invalid-value=Invalid_SP_Spg_Verstellschalter_Fehler_XIX_DoorFunctions_FS_01_XIX_VLAN_Cockpit:1, compu {1=Cx1_Fehler (CM_SP_Spg_Verstellschalter_Fehler_Cx1_Fehler), 0=Cx0_kein_Fehler (CM_SP_Spg_Verstellschalter_Fehler_Cx0_kein_Fehler)}, range raw 0..1, transfer-property=TRIGGERED-WITHOUT-REPETITION  # Erkennung eines hängenden Spiegelverstellschalters
    signal SP_Hzg_Taster_XIX_DoorFunctions_FS_01_XIX_VLAN_Cockpit: start 292, 1 bit, little-endian, data-type-policy=OVERRIDE, i-signal-type=PRIMITIVE, init-value=0, base-type=BT_SP_Hzg_Taster, compu {1=Cx1_betaetigt (CM_SP_Hzg_Taster_Cx1_betaetigt), 0=Cx0_nicht_betaetigt (CM_SP_Hzg_Taster_Cx0_nicht_betaetigt)}, range raw 0..1, transfer-property=TRIGGERED-WITHOUT-REPETITION  # Heizungstaster/schalter aktiv
    signal SP_Bordsteinfunktion_XIX_DoorFunctions_FS_01_XIX_VLAN_Cockpit: start 293, 2 bit, little-endian, data-type-policy=OVERRIDE, i-signal-type=PRIMITIVE, init-value=0, base-type=BT_SP_Bordsteinfunktion, compu {2=Cx2_Bordsteinfunktion_FS_aktiv (CM_SP_Bordsteinfunktion_Cx2_Bordsteinfunktion_FS_aktiv), 3=Cx3_Bordsteinfunktion_FS_BFS_aktiv (CM_SP_Bordsteinfunktion_Cx3_Bordsteinfunktion_FS_BFS_aktiv) (Bordsteinfunktion_FS/BFS_aktiv), 0=Cx0_Bordsteinfunktion_FS_BFS_inaktiv (CM_SP_Bordsteinfunktion_Cx0_Bordsteinfunktion_FS_BFS_inaktiv) (Bordsteinfunktion_FS/BFS_inaktiv), 1=Cx1_Bordsteinfunktion_BFS_aktiv (CM_SP_Bordsteinfunktion_Cx1_Bordsteinfunktion_BFS_aktiv)}, range raw 0..3, transfer-property=TRIGGERED-WITHOUT-REPETITION  # Bordsteinfunktion Status
    signal SP_S_oben_XIX_DoorFunctions_FS_01_XIX_VLAN_Cockpit: start 296, 1 bit, little-endian, data-type-policy=OVERRIDE, i-signal-type=PRIMITIVE, init-value=0, base-type=BT_SP_S_oben, compu {1=Cx1_Spiegelschalter_in_Stellung_oben (CM_SP_S_oben_Cx1_Spiegelschalter_in_Stellung_oben) (Spiegelschalter in Stellung oben)}, range raw 1, transfer-property=TRIGGERED-WITHOUT-REPETITION  # Spiegelschalter in Stellung oben
    signal SP_S_unten_XIX_DoorFunctions_FS_01_XIX_VLAN_Cockpit: start 297, 1 bit, little-endian, data-type-policy=OVERRIDE, i-signal-type=PRIMITIVE, init-value=0, base-type=BT_SP_S_unten, compu {1=Cx1_Spiegelschalter_in_Stellung_unten (CM_SP_S_unten_Cx1_Spiegelschalter_in_Stellung_unten) (Spiegelschalter in Stellung unten)}, range raw 1, transfer-property=TRIGGERED-WITHOUT-REPETITION  # Spiegelschalter in Stellung unten
    signal SP_S_links_XIX_DoorFunctions_FS_01_XIX_VLAN_Cockpit: start 298, 1 bit, little-endian, data-type-policy=OVERRIDE, i-signal-type=PRIMITIVE, init-value=0, base-type=BT_SP_S_links, compu {1=Cx1_Spiegelschalter_in_Stellung_links (CM_SP_S_links_Cx1_Spiegelschalter_in_Stellung_links) (Spiegelschalter in Stellung links)}, range raw 1, transfer-property=TRIGGERED-WITHOUT-REPETITION  # Spiegelschalter in Stellung links
    signal SP_S_rechts_XIX_DoorFunctions_FS_01_XIX_VLAN_Cockpit: start 299, 1 bit, little-endian, data-type-policy=OVERRIDE, i-signal-type=PRIMITIVE, init-value=0, base-type=BT_SP_S_rechts, compu {1=Cx1_Spiegelschalter_in_Stellung_rechts (CM_SP_S_rechts_Cx1_Spiegelschalter_in_Stellung_rechts) (Spiegelschalter in Stellung rechts)}, range raw 1, transfer-property=TRIGGERED-WITHOUT-REPETITION  # Spiegelschalter in Stellung rechts
    signal SP_Auswahl_li_XIX_DoorFunctions_FS_01_XIX_VLAN_Cockpit: start 300, 1 bit, little-endian, data-type-policy=OVERRIDE, i-signal-type=PRIMITIVE, init-value=0, base-type=BT_SP_Auswahl_li, compu {1=Cx1_Spiegelschalter_in_Stellung_Auswahl_links (CM_SP_Auswahl_li_Cx1_Spiegelschalter_in_Stellung_Auswahl_links) (Spiegelschalter in Stellung Auswahl links)}, range raw 1, transfer-property=TRIGGERED-WITHOUT-REPETITION  # Spiegelschalter in Stellung Auswahl links
    signal SP_Auswahl_re_XIX_DoorFunctions_FS_01_XIX_VLAN_Cockpit: start 301, 1 bit, little-endian, data-type-policy=OVERRIDE, i-signal-type=PRIMITIVE, init-value=0, base-type=BT_SP_Auswahl_re, compu {1=Cx1_Spiegelschalter_in_Stellung_Auswahl_rechts (CM_SP_Auswahl_re_Cx1_Spiegelschalter_in_Stellung_Auswahl_rechts) (Spiegelschalter in Stellung Auswahl rechts)}, range raw 1, transfer-property=TRIGGERED-WITHOUT-REPETITION  # Spiegelschalter in Stellung Auswahl rechts
    signal SP_ARA_Status_XIX_DoorFunctions_FS_01_XIX_VLAN_Cockpit: start 302, 1 bit, little-endian, data-type-policy=OVERRIDE, i-signal-type=PRIMITIVE, init-value=0, base-type=BT_SP_ARA_Status, compu {0=Cx0_TSG_nicht_im_ARA_Modus (CM_SP_ARA_Status_Cx0_TSG_nicht_im_ARA_Modus) (TSG nicht im ARA-Modus), 1=Cx1_TSG_im_ARA_Modus (CM_SP_ARA_Status_Cx1_TSG_im_ARA_Modus) (TSG im ARA-Modus)}, range raw 0..1, transfer-property=TRIGGERED-WITHOUT-REPETITION  # Rückkanal TSG im ARA-Modus
    signal SP_S_Klappen_XIX_DoorFunctions_FS_01_XIX_VLAN_Cockpit: start 303, 1 bit, little-endian, data-type-policy=OVERRIDE, i-signal-type=PRIMITIVE, init-value=0, base-type=BT_SP_S_Klappen, compu {1=Cx1_Spiegelschalter_in_Stellung_Klappen (CM_SP_S_Klappen_Cx1_Spiegelschalter_in_Stellung_Klappen) (Spiegelschalter in Stellung Klappen)}, range raw 1, transfer-property=TRIGGERED-WITHOUT-REPETITION  # Spiegelschalter in Stellung Klappen
    signal SP_Verstellschalter_Fehler_XIX_DoorFunctions_FS_01_XIX_VLAN_Cockpit: start 304, 1 bit, little-endian, data-type-policy=OVERRIDE, i-signal-type=PRIMITIVE, init-value=0, base-type=BT_SP_Verstellschalter_Fehler, invalid-value=Invalid_SP_Verstellschalter_Fehler_XIX_DoorFunctions_FS_01_XIX_VLAN_Cockpit:1, compu {1=Cx1_Fehler (CM_SP_Verstellschalter_Fehler_Cx1_Fehler), 0=Cx0_kein_Fehler (CM_SP_Verstellschalter_Fehler_Cx0_kein_Fehler)}, range raw 0..1, transfer-property=TRIGGERED-WITHOUT-REPETITION  # Erkennung eines hängenden Spiegelverstellschalters
    signal SP_Status_Bordsteinfunktion_XIX_DoorFunctions_FS_01_XIX_VLAN_Cockpit: start 305, 2 bit, little-endian, data-type-policy=OVERRIDE, i-signal-type=PRIMITIVE, init-value=0, base-type=BT_SP_Status_Bordsteinfunktion, compu {0=Cx0_Status_Bordsteinfunktion_FS_BFS_inaktiv (CM_SP_Status_Bordsteinfunktion_Cx0_Status_Bordsteinfunktion_FS_BFS_inaktiv) (Status_Bordsteinfunktion_FS/BFS_inaktiv), 1=Cx1_Status_Bordsteinfunktion_BFS_aktiv (CM_SP_Status_Bordsteinfunktion_Cx1_Status_Bordsteinfunktion_BFS_aktiv), 2=Cx2_Status_Bordsteinfunktion_FS_aktiv (CM_SP_Status_Bordsteinfunktion_Cx2_Status_Bordsteinfunktion_FS_aktiv), 3=Cx3_Status_Bordsteinfunktion_FS_BFS_aktiv (CM_SP_Status_Bordsteinfunktion_Cx3_Status_Bordsteinfunktion_FS_BFS_aktiv) (Status_Bordsteinfunktion_FS/BFS_aktiv)}, range raw 0..3, transfer-property=TRIGGERED-WITHOUT-REPETITION  # Zeigt den allgemeinen Aktivierungs-Status der Bordsteinfunktion an.
    signal FT_Tuer_Status_XIX_DoorFunctions_FS_01_XIX_VLAN_Cockpit: start 340, 2 bit, little-endian, data-type-policy=OVERRIDE, i-signal-type=PRIMITIVE, init-value=0, base-type=BT_FT_Tuer_Status, invalid-value=Invalid_FT_Tuer_Status_XIX_DoorFunctions_FS_01_XIX_VLAN_Cockpit:3, compu {3=Cx3_Fehler (CM_FT_Tuer_Status_Cx3_Fehler), 1=Cx1_Tuer_geschlossen (CM_FT_Tuer_Status_Cx1_Tuer_geschlossen), 0=Cx0_Init (CM_FT_Tuer_Status_Cx0_Init), 2=Cx2_Tuer_offen (CM_FT_Tuer_Status_Cx2_Tuer_offen)}, range raw 0..3, transfer-property=TRIGGERED-WITHOUT-REPETITION, to HCP3_IONode(timeout 1 s)  # Tür geöffnet oder Tür geschlossen
    signal FT_Tuer_Status_QBit_XIX_DoorFunctions_FS_01_XIX_VLAN_Cockpit: start 342, 1 bit, little-endian, data-type-policy=OVERRIDE, i-signal-type=PRIMITIVE, init-value=0, base-type=BT_FT_Tuer_Status_QBit, compu {1=Cx1_Status_Tuerkontakt_unsicher (CM_FT_Tuer_Status_QBit_Cx1_Status_Tuerkontakt_unsicher), 0=Cx0_Status_Tuerkontakt_sicher (CM_FT_Tuer_Status_QBit_Cx0_Status_Tuerkontakt_sicher)}, range raw 0..1, transfer-property=TRIGGERED-WITHOUT-REPETITION  # Dieses Bit gibt die Zuverlässigkeit des Türkontakts an.
    signal FT_Tuer_nwakeup_geoeffnet_XIX_DoorFunctions_FS_01_XIX_VLAN_Cockpit: start 343, 1 bit, little-endian, data-type-policy=OVERRIDE, i-signal-type=PRIMITIVE, init-value=0, base-type=BT_FT_Tuer_nwakeup_geoeffnet, compu {0=Cx0_geschlossen (CM_FT_Tuer_nwakeup_geoeffnet_Cx0_geschlossen), 1=Cx1_Tuer_nwake_offen (CM_FT_Tuer_nwakeup_geoeffnet_Cx1_Tuer_nwake_offen)}, range raw 0..1, transfer-property=TRIGGERED-WITHOUT-REPETITION  # Tuer_wurde_innerhalb_eines_Wakezyklus_geoeffnet
    signal FT_BFS_Tuer_Status_XIX_DoorFunctions_FS_01_XIX_VLAN_Cockpit: start 345, 2 bit, little-endian, data-type-policy=OVERRIDE, i-signal-type=PRIMITIVE, init-value=0, base-type=BT_FT_BFS_Tuer_Status, invalid-value=Invalid_FT_BFS_Tuer_Status_XIX_DoorFunctions_FS_01_XIX_VLAN_Cockpit:3, compu {3=Cx3_Fehler (CM_FT_BFS_Tuer_Status_Cx3_Fehler), 1=Cx1_Tuer_geschlossen (CM_FT_BFS_Tuer_Status_Cx1_Tuer_geschlossen), 0=Cx0_Init (CM_FT_BFS_Tuer_Status_Cx0_Init), 2=Cx2_Tuer_offen (CM_FT_BFS_Tuer_Status_Cx2_Tuer_offen)}, range raw 0..3, transfer-property=TRIGGERED-WITHOUT-REPETITION  # Gesammelte Türstatusbotschaft
    signal FT_HBFS_Tuer_Status_XIX_DoorFunctions_FS_01_XIX_VLAN_Cockpit: start 347, 2 bit, little-endian, data-type-policy=OVERRIDE, i-signal-type=PRIMITIVE, init-value=0, base-type=BT_FT_HBFS_Tuer_Status, invalid-value=Invalid_FT_HBFS_Tuer_Status_XIX_DoorFunctions_FS_01_XIX_VLAN_Cockpit:3, compu {3=Cx3_Fehler (CM_FT_HBFS_Tuer_Status_Cx3_Fehler), 0=Cx0_Init (CM_FT_HBFS_Tuer_Status_Cx0_Init), 2=Cx2_Tuer_offen (CM_FT_HBFS_Tuer_Status_Cx2_Tuer_offen), 1=Cx1_Tuer_geschlossen (CM_FT_HBFS_Tuer_Status_Cx1_Tuer_geschlossen)}, range raw 0..3, transfer-property=TRIGGERED-WITHOUT-REPETITION  # Türstatus mit Fehler und Initwert
    signal FT_HFS_Tuer_Status_XIX_DoorFunctions_FS_01_XIX_VLAN_Cockpit: start 349, 2 bit, little-endian, data-type-policy=OVERRIDE, i-signal-type=PRIMITIVE, init-value=0, base-type=BT_FT_HFS_Tuer_Status, invalid-value=Invalid_FT_HFS_Tuer_Status_XIX_DoorFunctions_FS_01_XIX_VLAN_Cockpit:3, compu {3=Cx3_Fehler (CM_FT_HFS_Tuer_Status_Cx3_Fehler), 0=Cx0_Init (CM_FT_HFS_Tuer_Status_Cx0_Init), 2=Cx2_Tuer_offen (CM_FT_HFS_Tuer_Status_Cx2_Tuer_offen), 1=Cx1_Tuer_geschlossen (CM_FT_HFS_Tuer_Status_Cx1_Tuer_geschlossen)}, range raw 0..3, transfer-property=TRIGGERED-WITHOUT-REPETITION  # Türstatus mit Fehler und Initwert
    signal FT_Tueroeffnen_Warnung_XIX_DoorFunctions_FS_01_XIX_VLAN_Cockpit: start 351, 1 bit, little-endian, data-type-policy=OVERRIDE, i-signal-type=PRIMITIVE, init-value=0, base-type=BT_FT_Tueroeffnen_Warnung, compu {0=Cx0_Tuerwarnung_nicht_aktiv (CM_FT_Tueroeffnen_Warnung_Cx0_Tuerwarnung_nicht_aktiv), 1=Cx1_Tuerwarnung_aktiv (CM_FT_Tueroeffnen_Warnung_Cx1_Tuerwarnung_aktiv)}, range raw 0..1, transfer-property=TRIGGERED-WITHOUT-REPETITION  # Bit wird gesetzt, wenn Tür während der Fahrt geoeffnet werden soll.
    signal FT_SP_Heizung_ein_XIX_DoorFunctions_FS_01_XIX_VLAN_Cockpit: start 352, 1 bit, little-endian, data-type-policy=OVERRIDE, i-signal-type=PRIMITIVE, init-value=0, base-type=BT_FT_SP_Heizung_ein, compu {0=Cx0_Aus (CM_FT_SP_Heizung_ein_Cx0_Aus), 1=Cx1_Ein (CM_FT_SP_Heizung_ein_Cx1_Ein)}, range raw 0..1, transfer-property=TRIGGERED-WITHOUT-REPETITION  # Dieses Signal zeigt die tatsächliche Ansteuerung der Spiegelheizung incl. PWM an. Zudem wird aufgrund des Teilnetzbetriebs das Signal zur Ansteuerung der Beifahrer-Spiegelheizung benutzt.
    signal FT_Kisi_Taster_li_02_XIX_DoorFunctions_FS_01_XIX_VLAN_Cockpit: start 353, 1 bit, little-endian, data-type-policy=OVERRIDE, i-signal-type=PRIMITIVE, init-value=0, base-type=BT_FT_Kisi_Taster_li_02, compu {1=Cx1_betaetigt (CM_FT_Kisi_Taster_li_02_Cx1_betaetigt), 0=Cx0_nicht_betaetigt (CM_FT_Kisi_Taster_li_02_Cx0_nicht_betaetigt)}, range raw 0..1, transfer-property=TRIGGERED-WITHOUT-REPETITION  # Der Kindersicherungstaster hinten links aktiv.
    signal FT_Kisi_Taster_re_02_XIX_DoorFunctions_FS_01_XIX_VLAN_Cockpit: start 354, 1 bit, little-endian, data-type-policy=OVERRIDE, i-signal-type=PRIMITIVE, init-value=0, base-type=BT_FT_Kisi_Taster_re_02, compu {1=Cx1_betaetigt (CM_FT_Kisi_Taster_re_02_Cx1_betaetigt), 0=Cx0_nicht_betaetigt (CM_FT_Kisi_Taster_re_02_Cx0_nicht_betaetigt)}, range raw 0..1, transfer-property=TRIGGERED-WITHOUT-REPETITION  # Der Kindersicherungstaster hinten rechts aktiv.
    signal FT_TD_Taste_Status_XIX_DoorFunctions_FS_01_XIX_VLAN_Cockpit: start 355, 2 bit, little-endian, data-type-policy=OVERRIDE, i-signal-type=PRIMITIVE, init-value=0, base-type=BT_FT_TD_Taste_Status, compu {2=Cx2_Kurzschluss_nach_Plus (CM_FT_TD_Taste_Status_Cx2_Kurzschluss_nach_Plus), 1=Cx1_Kurzschluss_nach_Minus (CM_FT_TD_Taste_Status_Cx1_Kurzschluss_nach_Minus), 3=Cx3_Leitungsunterbrechung (CM_FT_TD_Taste_Status_Cx3_Leitungsunterbrechung), 0=Cx0_kein_Fehler (CM_FT_TD_Taste_Status_Cx0_kein_Fehler)}, range raw 0..3, transfer-property=TRIGGERED-WITHOUT-REPETITION  # Status Taste für Tankdeckel
    signal FT_TCR_Mode_aktiv_XIX_DoorFunctions_FS_01_XIX_VLAN_Cockpit: start 357, 1 bit, little-endian, data-type-policy=OVERRIDE, i-signal-type=PRIMITIVE, init-value=0, base-type=BT_FT_TCR_Mode_aktiv, compu {1=Cx1_TCR_Mode_aktiv (CM_FT_TCR_Mode_aktiv_Cx1_TCR_Mode_aktiv), 0=Cx0_TCR_Mode_deaktiv (CM_FT_TCR_Mode_aktiv_Cx0_TCR_Mode_deaktiv)}, range raw 0..1, transfer-property=TRIGGERED-WITHOUT-REPETITION  # Signal zeigt eine aktive mechanische Redundanz am Türschloss an.
    signal TSG_FS_Spiegel_angeklappt_XIX_DoorFunctions_FS_01_XIX_VLAN_Cockpit: start 365, 1 bit, little-endian, data-type-policy=OVERRIDE, i-signal-type=PRIMITIVE, init-value=0, base-type=BT_TSG_FS_Spiegel_angeklappt, compu {0=Cx0_Spiegel_ausgeklappt (CM_TSG_FS_Spiegel_angeklappt_Cx0_Spiegel_ausgeklappt), 1=Cx1_Spiegel_eingeklappt (CM_TSG_FS_Spiegel_angeklappt_Cx1_Spiegel_eingeklappt)}, range raw 0..1, transfer-property=TRIGGERED-WITHOUT-REPETITION  # Funktionsrückmeldung TSG_FS über Spiegelstellung angeklappt
    signal FT_FD_Taste_XIX_DoorFunctions_FS_01_XIX_VLAN_Cockpit: start 367, 1 bit, little-endian, data-type-policy=OVERRIDE, i-signal-type=PRIMITIVE, init-value=0, base-type=BT_FT_FD_Taste, compu {0=Cx0_Taste_nicht_gedrueckt (CM_FT_FD_Taste_Cx0_Taste_nicht_gedrueckt), 1=Cx1_Taste_gedrueckt (CM_FT_FD_Taste_Cx1_Taste_gedrueckt)}, range raw 0..1, transfer-property=TRIGGERED-WITHOUT-REPETITION  # Taste in der Fahrertuer zum Oeffnen des Frontdeckels
    signal SSA_FT_ASP_Heizung_Fehler_XIX_DoorFunctions_FS_01_XIX_VLAN_Cockpit: start 384, 3 bit, little-endian, data-type-policy=OVERRIDE, i-signal-type=PRIMITIVE, init-value=0, base-type=BT_SSA_FT_ASP_Heizung_Fehler, compu {0=Cx0_i_O (CM_SSA_FT_ASP_Heizung_Fehler_Cx0_i_O) (i.O.), 3=Cx3_Ueberspannung (CM_SSA_FT_ASP_Heizung_Fehler_Cx3_Ueberspannung), 5=Cx5_Bedingung_nicht_erfuellt (CM_SSA_FT_ASP_Heizung_Fehler_Cx5_Bedingung_nicht_erfuellt) (Bedingung nicht erfuellt), 4=Cx4_el_Fehler (CM_SSA_FT_ASP_Heizung_Fehler_Cx4_el_Fehler) (el. Fehler), 2=Cx2_Unterspannung (CM_SSA_FT_ASP_Heizung_Fehler_Cx2_Unterspannung), 1=Cx1_nicht_verbaut (CM_SSA_FT_ASP_Heizung_Fehler_Cx1_nicht_verbaut) (nicht verbaut)}, range raw 0..5, transfer-property=TRIGGERED-WITHOUT-REPETITION  # SmartSensorActor: Rückmeldung des Fehlerzustand der Spiegelglasheizung
    signal SSA_FT_Amb_Bel_Fehler_XIX_DoorFunctions_FS_01_XIX_VLAN_Cockpit: start 387, 3 bit, little-endian, data-type-policy=OVERRIDE, i-signal-type=PRIMITIVE, init-value=0, base-type=BT_SSA_FT_Amb_Bel_Fehler, compu {3=Cx3_Ueberspannung (CM_SSA_FT_Amb_Bel_Fehler_Cx3_Ueberspannung), 4=Cx4_el_Fehler (CM_SSA_FT_Amb_Bel_Fehler_Cx4_el_Fehler), 5=Cx5_Bedingung_nicht_erfuellt (CM_SSA_FT_Amb_Bel_Fehler_Cx5_Bedingung_nicht_erfuellt), 1=Cx1_nicht_verbaut (CM_SSA_FT_Amb_Bel_Fehler_Cx1_nicht_verbaut), 2=Cx2_Unterspannung (CM_SSA_FT_Amb_Bel_Fehler_Cx2_Unterspannung), 0=Cx0_iO (CM_SSA_FT_Amb_Bel_Fehler_Cx0_iO)}, range raw 0..5, transfer-property=TRIGGERED-WITHOUT-REPETITION  # SmartSensorActor: Rückmeldung des Fehlerzustand der Ambiente Beleuchtung
    signal SSA_FT_Amb_Bel_Status_XIX_DoorFunctions_FS_01_XIX_VLAN_Cockpit: start 390, 2 bit, little-endian, data-type-policy=OVERRIDE, i-signal-type=PRIMITIVE, init-value=0, base-type=BT_SSA_FT_Amb_Bel_Status, compu {2=Cx2_aus (CM_SSA_FT_Amb_Bel_Status_Cx2_aus), 1=Cx1_an (CM_SSA_FT_Amb_Bel_Status_Cx1_an), 0=Cx0_Init (CM_SSA_FT_Amb_Bel_Status_Cx0_Init)}, range raw 0..2, transfer-property=TRIGGERED-WITHOUT-REPETITION  # SmartSensorActor: Rückmeldung des Status der Ambiente Beleuchtung
    signal SSA_FT_ASP_Spiegelglas_Pos_X_XIX_DoorFunctions_FS_01_XIX_VLAN_Cockpit: start 392, 7 bit, little-endian, data-type-policy=OVERRIDE, i-signal-type=PRIMITIVE, init-value=0, base-type=BT_SSA_FT_ASP_Spiegelglas_Pos_X, invalid-value=Invalid_SSA_FT_ASP_Spiegelglas_Pos_X_XIX_DoorFunctions_FS_01_XIX_VLAN_Cockpit:127, compu {phys=raw for raw 0..100, 127=Cx7f_Fehler (CM_SSA_FT_ASP_Spiegelglas_Pos_X_Cx7f_Fehler); unit Unit_PerCent}, range phys 0..100 Unit_PerCent, raw 0..127, unit=Unit_PerCent, transfer-property=TRIGGERED-WITHOUT-REPETITION  # SmartSensorActor: Rückmeldung der Position des Spiegelglases auf der X-Achse
    signal SSA_FT_ZV_Status_XIX_DoorFunctions_FS_01_XIX_VLAN_Cockpit: start 408, 4 bit, little-endian, data-type-policy=OVERRIDE, i-signal-type=PRIMITIVE, init-value=0, base-type=BT_SSA_FT_ZV_Status, invalid-value=Invalid_SSA_FT_ZV_Status_XIX_DoorFunctions_FS_01_XIX_VLAN_Cockpit:15, compu {15=Cxf_Fehler (CM_SSA_FT_ZV_Status_Cxf_Fehler), 0=Cx0_Init (CM_SSA_FT_ZV_Status_Cx0_Init), 2=Cx2_verriegeltentsafet (CM_SSA_FT_ZV_Status_Cx2_verriegeltentsafet), 1=Cx1_entriegeltentsafet (CM_SSA_FT_ZV_Status_Cx1_entriegeltentsafet), 3=Cx3_verriegeltgesafet (CM_SSA_FT_ZV_Status_Cx3_verriegeltgesafet)}, range raw 0..15, transfer-property=TRIGGERED-WITHOUT-REPETITION  # SmartSensorActor: Zustand des Türschlosses der Fahrertür
    signal SSA_FT_Tuerverschluss_Fehler_XIX_DoorFunctions_FS_01_XIX_VLAN_Cockpit: start 416, 3 bit, little-endian, data-type-policy=OVERRIDE, i-signal-type=PRIMITIVE, init-value=0, base-type=BT_SSA_FT_Tuerverschluss_Fehler, compu {0=Cx0_i_O (CM_SSA_FT_Tuerverschluss_Fehler_Cx0_i_O) (i.O.), 2=Cx2_Unterspannung (CM_SSA_FT_Tuerverschluss_Fehler_Cx2_Unterspannung), 4=Cx4_el_Fehler (CM_SSA_FT_Tuerverschluss_Fehler_Cx4_el_Fehler) (el. Fehler), 5=Cx5_Bedingung_nicht_erfuellt (CM_SSA_FT_Tuerverschluss_Fehler_Cx5_Bedingung_nicht_erfuellt) (Bedingung nicht erfuellt), 1=Cx1_nicht_verbaut (CM_SSA_FT_Tuerverschluss_Fehler_Cx1_nicht_verbaut) (nicht verbaut), 3=Cx3_Ueberspannung (CM_SSA_FT_Tuerverschluss_Fehler_Cx3_Ueberspannung)}, range raw 0..5, transfer-property=TRIGGERED-WITHOUT-REPETITION  # SmartSensorActor: Fehlerzustand der Fahrertür
    signal SSA_FT_ZV_Fehler_XIX_DoorFunctions_FS_01_XIX_VLAN_Cockpit: start 419, 3 bit, little-endian, data-type-policy=OVERRIDE, i-signal-type=PRIMITIVE, init-value=0, base-type=BT_SSA_FT_ZV_Fehler, compu {5=Cx5_Bedingung_nicht_erfuellt (CM_SSA_FT_ZV_Fehler_Cx5_Bedingung_nicht_erfuellt) (Bedingung nicht erfuellt), 0=Cx0_i_O (CM_SSA_FT_ZV_Fehler_Cx0_i_O) (i.O.), 1=Cx1_nicht_verbaut (CM_SSA_FT_ZV_Fehler_Cx1_nicht_verbaut) (nicht verbaut), 4=Cx4_el_Fehler (CM_SSA_FT_ZV_Fehler_Cx4_el_Fehler) (el. Fehler), 2=Cx2_Unterspannung (CM_SSA_FT_ZV_Fehler_Cx2_Unterspannung), 3=Cx3_Ueberspannung (CM_SSA_FT_ZV_Fehler_Cx3_Ueberspannung)}, range raw 0..5, transfer-property=TRIGGERED-WITHOUT-REPETITION  # SmartSensorActor: Rückmeldung des Fehlerzustandes des Türschlosses der Fahrertür
    signal FT_HD_Taste_auf_XIX_DoorFunctions_FS_01_XIX_VLAN_Cockpit: start 422, 1 bit, little-endian, data-type-policy=OVERRIDE, i-signal-type=PRIMITIVE, init-value=0, base-type=BT_FT_HD_Taste_auf, compu {1=Cx1_Taste_HD_auf_gedrueckt (CM_FT_HD_Taste_auf_Cx1_Taste_HD_auf_gedrueckt), 0=Cx0_Taste_HD_auf_nicht_gedrueckt (CM_FT_HD_Taste_auf_Cx0_Taste_HD_auf_nicht_gedrueckt)}, range raw 0..1, transfer-property=TRIGGERED-WITHOUT-REPETITION  # 2. HD-Taste im Bedienfeld: Heckdeckel oeffnen
    signal FT_HD_Taste_zu_XIX_DoorFunctions_FS_01_XIX_VLAN_Cockpit: start 423, 1 bit, little-endian, data-type-policy=OVERRIDE, i-signal-type=PRIMITIVE, init-value=0, base-type=BT_FT_HD_Taste_zu, compu {0=Cx0_Taste_HD_zu_nicht_gedrueckt (CM_FT_HD_Taste_zu_Cx0_Taste_HD_zu_nicht_gedrueckt), 1=Cx1_Taste_HD_zu_gedrueckt (CM_FT_HD_Taste_zu_Cx1_Taste_HD_zu_gedrueckt)}, range raw 0..1, transfer-property=TRIGGERED-WITHOUT-REPETITION  # 2. HD-Taste im Bedienfeld Funktion: Heckdeckel schließen
    signal SSA_FT_FH_Oeffnungsweite_XIX_DoorFunctions_FS_01_XIX_VLAN_Cockpit: start 424, 8 bit, little-endian, data-type-policy=OVERRIDE, i-signal-type=PRIMITIVE, init-value=0, base-type=BT_SSA_FT_FH_Oeffnungsweite, compu {phys=raw*0.5 for raw 0..200; unit Unit_PerCent}, range phys 0..100 Unit_PerCent, raw 0..200, unit=Unit_PerCent, transfer-property=TRIGGERED-WITHOUT-REPETITION  # SmartSensorActor: Rückmeldung der Öffnungsweite des Fensterhebers (0% geschlossen, 100% geöffnet) Angabe gilt nur bei normierten Fensterheber
    signal SSA_FT_ASP_Heizung_Status_XIX_DoorFunctions_FS_01_XIX_VLAN_Cockpit: start 432, 7 bit, little-endian, data-type-policy=OVERRIDE, i-signal-type=PRIMITIVE, init-value=0, base-type=BT_SSA_FT_ASP_Heizung_Status, invalid-value=Invalid_SSA_FT_ASP_Heizung_Status_XIX_DoorFunctions_FS_01_XIX_VLAN_Cockpit:127, compu {phys=raw for raw 0..100, 127=Cx7f_Fehler (CM_SSA_FT_ASP_Heizung_Status_Cx7f_Fehler); unit Unit_PerCent}, range phys 0..100 Unit_PerCent, raw 0..127, unit=Unit_PerCent, transfer-property=TRIGGERED-WITHOUT-REPETITION  # SmartSensorActor: Rueckmeldung des Status der Spiegelheizung
    signal SSA_FT_ASP_Spiegelglas_Pos_Y_XIX_DoorFunctions_FS_01_XIX_VLAN_Cockpit: start 439, 7 bit, little-endian, data-type-policy=OVERRIDE, i-signal-type=PRIMITIVE, init-value=0, base-type=BT_SSA_FT_ASP_Spiegelglas_Pos_Y, invalid-value=Invalid_SSA_FT_ASP_Spiegelglas_Pos_Y_XIX_DoorFunctions_FS_01_XIX_VLAN_Cockpit:127, compu {phys=raw for raw 0..100, 127=Cx7f_Fehler (CM_SSA_FT_ASP_Spiegelglas_Pos_Y_Cx7f_Fehler); unit Unit_PerCent}, range phys 0..100 Unit_PerCent, raw 0..127, unit=Unit_PerCent, transfer-property=TRIGGERED-WITHOUT-REPETITION  # SmartSensorActor: Rückmeldung der Position des Spiegelglases auf der Y-Achse
    signal FT_ASW_Warnung_VAS_XIX_DoorFunctions_FS_01_XIX_VLAN_Cockpit: start 446, 2 bit, little-endian, data-type-policy=OVERRIDE, i-signal-type=PRIMITIVE, init-value=0, base-type=BT_FT_ASW_Warnung_VAS, invalid-value=Invalid_FT_ASW_Warnung_VAS_XIX_DoorFunctions_FS_01_XIX_VLAN_Cockpit:3, compu {3=Cx3_Fehler (CM_FT_ASW_Warnung_VAS_Cx3_Fehler), 0=Cx0_Keine_Warnung (CM_FT_ASW_Warnung_VAS_Cx0_Keine_Warnung), 1=Cx1_Info (CM_FT_ASW_Warnung_VAS_Cx1_Info), 2=Cx2_Warnung (CM_FT_ASW_Warnung_VAS_Cx2_Warnung)}, range raw 0..3, transfer-property=TRIGGERED-WITHOUT-REPETITION  # Abschaltung der VAS Fahrertür bei aktiver ASW Warnung an der Fahrertür
    signal SSA_FT_ASP_Klappung_Status_XIX_DoorFunctions_FS_01_XIX_VLAN_Cockpit: start 448, 2 bit, little-endian, data-type-policy=OVERRIDE, i-signal-type=PRIMITIVE, init-value=0, base-type=BT_SSA_FT_ASP_Klappung_Status, compu {2=Cx2_abgeklappt_Fahrstellung (CM_SSA_FT_ASP_Klappung_Status_Cx2_abgeklappt_Fahrstellung), 3=Cx3_In_Bewegung (CM_SSA_FT_ASP_Klappung_Status_Cx3_In_Bewegung), 0=Cx0_Init (CM_SSA_FT_ASP_Klappung_Status_Cx0_Init), 1=Cx1_angeklappt_Garagenstellung (CM_SSA_FT_ASP_Klappung_Status_Cx1_angeklappt_Garagenstellung)}, range raw 0..3, transfer-property=TRIGGERED-WITHOUT-REPETITION  # SmartSensorActor: Spiegelt die Position und Ansteuerug der Antriebs für die Speigelklappung wieder
  pdu DoorFunctions_HBFS_01_XIX_VLAN_Cockpit: length=28, minimum-delay=0.02, transmission-mode-true-timing={cyclic-timing={time-offset=0.0, time-period=0.1}, event-controlled-timing={number-of-repetitions=10, repetition-period=0.02}}, unused-bit-pattern=0
    signal DoorFunctions_HBFS_01_CRC_XIX_DoorFunctions_HBFS_01_XIX_VLAN_Cockpit: start 0, 8 bit, little-endian, data-type-policy=OVERRIDE, i-signal-type=PRIMITIVE, init-value=0, base-type=BT_DoorFunctions_HBFS_01_CRC, compu {phys=raw for raw 0..255}, range phys 0..255, raw 0..255, transfer-property=TRIGGERED-WITHOUT-REPETITION
    signal DoorFunctions_HBFS_01_BZ_XIX_DoorFunctions_HBFS_01_XIX_VLAN_Cockpit: start 8, 4 bit, little-endian, data-type-policy=OVERRIDE, i-signal-type=PRIMITIVE, init-value=0, base-type=BT_DoorFunctions_HBFS_01_BZ, compu {phys=raw for raw 0..15}, range phys 0..15, raw 0..15, transfer-property=TRIGGERED-WITHOUT-REPETITION
    signal HBFS_FH_S_HFS_ManHoch_XIX_DoorFunctions_HBFS_01_XIX_VLAN_Cockpit: start 12, 1 bit, little-endian, data-type-policy=OVERRIDE, i-signal-type=PRIMITIVE, init-value=0, base-type=BT_HBFS_FH_S_HFS_ManHoch, compu {0=Cx0_keine_Bedienung (CM_HBFS_FH_S_HFS_ManHoch_Cx0_keine_Bedienung), 1=Cx1_Manueller_Lauf_Angefordert (CM_HBFS_FH_S_HFS_ManHoch_Cx1_Manueller_Lauf_Angefordert)}, range raw 0..1, transfer-property=TRIGGERED-WITHOUT-REPETITION  # Manuelles Hochfahren der Seitenscheibe HFS
    signal HBFS_FH_S_HFS_ManTief_XIX_DoorFunctions_HBFS_01_XIX_VLAN_Cockpit: start 13, 1 bit, little-endian, data-type-policy=OVERRIDE, i-signal-type=PRIMITIVE, init-value=0, base-type=BT_HBFS_FH_S_HFS_ManTief, compu {0=Cx0_keine_Bedienung (CM_HBFS_FH_S_HFS_ManTief_Cx0_keine_Bedienung), 1=Cx1_Manueller_Lauf_Angefordert (CM_HBFS_FH_S_HFS_ManTief_Cx1_Manueller_Lauf_Angefordert)}, range raw 0..1, transfer-property=TRIGGERED-WITHOUT-REPETITION  # Manuelles Absenken der Seitenscheibe HFS
    signal HBFS_Tuer_Status_XIX_DoorFunctions_HBFS_01_XIX_VLAN_Cockpit: start 14, 2 bit, little-endian, data-type-policy=OVERRIDE, i-signal-type=PRIMITIVE, init-value=0, base-type=BT_HBFS_Tuer_Status, invalid-value=Invalid_HBFS_Tuer_Status_XIX_DoorFunctions_HBFS_01_XIX_VLAN_Cockpit:3, compu {3=Cx3_Fehler (CM_HBFS_Tuer_Status_Cx3_Fehler), 0=Cx0_Init (CM_HBFS_Tuer_Status_Cx0_Init), 2=Cx2_Tuer_offen (CM_HBFS_Tuer_Status_Cx2_Tuer_offen), 1=Cx1_Tuer_geschlossen (CM_HBFS_Tuer_Status_Cx1_Tuer_geschlossen)}, range raw 0..3, transfer-property=TRIGGERED-WITHOUT-REPETITION, to HCP3_IONode(timeout 1 s)  # Türstatus mit Fehler und Initwert
    signal HBFS_SAD_Schalter_XIX_DoorFunctions_HBFS_01_XIX_VLAN_Cockpit: start 16, 4 bit, little-endian, data-type-policy=OVERRIDE, i-signal-type=PRIMITIVE, init-value=14, base-type=BT_HBFS_SAD_Schalter, invalid-value=Invalid_HBFS_SAD_Schalter_XIX_DoorFunctions_HBFS_01_XIX_VLAN_Cockpit:15, compu {15=Cxf_Fehler (CM_HBFS_SAD_Schalter_Cxf_Fehler), 7=Cx7_ZU_manuell (CM_HBFS_SAD_Schalter_Cx7_ZU_manuell), 5=Cx5_AUF_manuell (CM_HBFS_SAD_Schalter_Cx5_AUF_manuell), 8=Cx8_ZU_automatik (CM_HBFS_SAD_Schalter_Cx8_ZU_automatik), 0=Cx0_nicht_betaetigt (CM_HBFS_SAD_Schalter_Cx0_nicht_betaetigt), 14=Cxe_Init (CM_HBFS_SAD_Schalter_Cxe_Init), 6=Cx6_AUF_automatik (CM_HBFS_SAD_Schalter_Cx6_AUF_automatik), 13=Cxd_nicht_verfuegbar (CM_HBFS_SAD_Schalter_Cxd_nicht_verfuegbar)}, range raw 0..15, transfer-property=TRIGGERED-WITHOUT-REPETITION  # | Ausstelldach MD3 ----------------------------- 0 | nicht_betaetigt 1 | 2 | 3 | 4 | 5 | (m) Auf 6 | (a) Auf 7 | (m) Zu 8 | (a) Zu 13| Schalter nicht verfuegbar 14| Init 15| Fehlerfall
    signal HBFS_FH_S_ManHoch_XIX_DoorFunctions_HBFS_01_XIX_VLAN_Cockpit: start 20, 1 bit, little-endian, data-type-policy=OVERRIDE, i-signal-type=PRIMITIVE, init-value=0, base-type=BT_HBFS_FH_S_ManHoch, compu {1=Cx1_betaetigt (CM_HBFS_FH_S_ManHoch_Cx1_betaetigt), 0=Cx0_nicht_betaetigt (CM_HBFS_FH_S_ManHoch_Cx0_nicht_betaetigt)}, range raw 0..1, transfer-property=TRIGGERED-WITHOUT-REPETITION  # Betaetigung FH Schalter man hoch
    signal HBFS_FH_S_AutoHoch_XIX_DoorFunctions_HBFS_01_XIX_VLAN_Cockpit: start 21, 1 bit, little-endian, data-type-policy=OVERRIDE, i-signal-type=PRIMITIVE, init-value=0, base-type=BT_HBFS_FH_S_AutoHoch, compu {1=Cx1_betaetigt (CM_HBFS_FH_S_AutoHoch_Cx1_betaetigt), 0=Cx0_nicht_betaetigt (CM_HBFS_FH_S_AutoHoch_Cx0_nicht_betaetigt)}, range raw 0..1, transfer-property=TRIGGERED-WITHOUT-REPETITION  # Betaetigung FH Schalter auto tief
    signal HBFS_FH_S_ManTief_XIX_DoorFunctions_HBFS_01_XIX_VLAN_Cockpit: start 22, 1 bit, little-endian, data-type-policy=OVERRIDE, i-signal-type=PRIMITIVE, init-value=0, base-type=BT_HBFS_FH_S_ManTief, compu {1=Cx1_betaetigt (CM_HBFS_FH_S_ManTief_Cx1_betaetigt), 0=Cx0_nicht_betaetigt (CM_HBFS_FH_S_ManTief_Cx0_nicht_betaetigt)}, range raw 0..1, transfer-property=TRIGGERED-WITHOUT-REPETITION  # Betaetigung FH Schalter man tief
    signal HBFS_FH_S_AutoTief_XIX_DoorFunctions_HBFS_01_XIX_VLAN_Cockpit: start 23, 1 bit, little-endian, data-type-policy=OVERRIDE, i-signal-type=PRIMITIVE, init-value=0, base-type=BT_HBFS_FH_S_AutoTief, compu {1=Cx1_betaetigt (CM_HBFS_FH_S_AutoTief_Cx1_betaetigt), 0=Cx0_nicht_betaetigt (CM_HBFS_FH_S_AutoTief_Cx0_nicht_betaetigt)}, range raw 0..1, transfer-property=TRIGGERED-WITHOUT-REPETITION  # Betaetigung FH Schalter auto hoch
    signal HBFS_FH_Oeffnung_XIX_DoorFunctions_HBFS_01_XIX_VLAN_Cockpit: start 24, 8 bit, little-endian, data-type-policy=OVERRIDE, i-signal-type=PRIMITIVE, init-value=0, base-type=BT_HBFS_FH_Oeffnung, compu {phys=raw*0.5 for raw 0..200; unit Unit_PerCent}, range phys 0..100 Unit_PerCent, raw 0..200, unit=Unit_PerCent, transfer-property=TRIGGERED-WITHOUT-REPETITION  # Gibt den Fensteröffnungswert in % an.
    signal HBFS_FH_Bew_hoch_XIX_DoorFunctions_HBFS_01_XIX_VLAN_Cockpit: start 32, 1 bit, little-endian, data-type-policy=OVERRIDE, i-signal-type=PRIMITIVE, init-value=0, base-type=BT_HBFS_FH_Bew_hoch, compu {0=Cx0_inaktiv (CM_HBFS_FH_Bew_hoch_Cx0_inaktiv), 1=Cx1_aktiv (CM_HBFS_FH_Bew_hoch_Cx1_aktiv)}, range raw 0..1, transfer-property=TRIGGERED-WITHOUT-REPETITION  # HBFS Fenster bewegt sich in Richtung hoch
    signal HBFS_FH_Bew_tief_XIX_DoorFunctions_HBFS_01_XIX_VLAN_Cockpit: start 33, 1 bit, little-endian, data-type-policy=OVERRIDE, i-signal-type=PRIMITIVE, init-value=0, base-type=BT_HBFS_FH_Bew_tief, compu {1=Cx1_aktiv (CM_HBFS_FH_Bew_tief_Cx1_aktiv), 0=Cx0_inaktiv (CM_HBFS_FH_Bew_tief_Cx0_inaktiv)}, range raw 0..1, transfer-property=TRIGGERED-WITHOUT-REPETITION  # HBFS Fenster bewegt sich in Richtung tief
    signal HBFS_FH_Fang_XIX_DoorFunctions_HBFS_01_XIX_VLAN_Cockpit: start 34, 1 bit, little-endian, data-type-policy=OVERRIDE, i-signal-type=PRIMITIVE, init-value=0, base-type=BT_HBFS_FH_Fang, compu {0=Cx0_ausserhalb_Fangbereich (CM_HBFS_FH_Fang_Cx0_ausserhalb_Fangbereich), 1=Cx1_innerhalb_Fangbereich (CM_HBFS_FH_Fang_Cx1_innerhalb_Fangbereich)}, range raw 0..1, transfer-property=TRIGGERED-WITHOUT-REPETITION  # Fangbereich ist 4mm von oberer Lippendichtung
    signal HBFS_FH_Block_XIX_DoorFunctions_HBFS_01_XIX_VLAN_Cockpit: start 35, 1 bit, little-endian, data-type-policy=OVERRIDE, i-signal-type=PRIMITIVE, init-value=0, base-type=BT_HBFS_FH_Block, compu {0=Cx0_inaktiv (CM_HBFS_FH_Block_Cx0_inaktiv), 1=Cx1_aktiv (CM_HBFS_FH_Block_Cx1_aktiv)}, range raw 0..1, transfer-property=TRIGGERED-WITHOUT-REPETITION  # Fensterscheibe befindet sich im mechanischen Block (oben oder unten)
    signal HBFS_FH_Thermo_XIX_DoorFunctions_HBFS_01_XIX_VLAN_Cockpit: start 36, 1 bit, little-endian, data-type-policy=OVERRIDE, i-signal-type=PRIMITIVE, init-value=0, base-type=BT_HBFS_FH_Thermo, compu {0=Cx0_inaktiv (CM_HBFS_FH_Thermo_Cx0_inaktiv), 1=Cx1_aktiv (CM_HBFS_FH_Thermo_Cx1_aktiv)}, range raw 0..1, transfer-property=TRIGGERED-WITHOUT-REPETITION  # gibt an ob Fensterheber im Thermoschutz ist
    signal HBFS_UEKB_aktiviert_XIX_DoorFunctions_HBFS_01_XIX_VLAN_Cockpit: start 37, 1 bit, little-endian, data-type-policy=OVERRIDE, i-signal-type=PRIMITIVE, init-value=0, base-type=BT_HBFS_UEKB_aktiviert, compu {0=Cx0_inaktiv (CM_HBFS_UEKB_aktiviert_Cx0_inaktiv), 1=Cx1_aktiv (CM_HBFS_UEKB_aktiviert_Cx1_aktiv)}, range raw 0..1, transfer-property=TRIGGERED-WITHOUT-REPETITION  # Überschutzbegrenzungskraft bei Reversieren
    signal HBFS_Tueroeffnen_Warnung_XIX_DoorFunctions_HBFS_01_XIX_VLAN_Cockpit: start 38, 1 bit, little-endian, data-type-policy=OVERRIDE, i-signal-type=PRIMITIVE, init-value=0, base-type=BT_HBFS_Tueroeffnen_Warnung, compu {0=Cx0_Tuerwarnung_nicht_aktiv (CM_HBFS_Tueroeffnen_Warnung_Cx0_Tuerwarnung_nicht_aktiv), 1=Cx1_Tuerwarnung_aktiv (CM_HBFS_Tueroeffnen_Warnung_Cx1_Tuerwarnung_aktiv)}, range raw 0..1, transfer-property=TRIGGERED-WITHOUT-REPETITION  # Bit wird gesetzt, wenn Tür während der Fahrt geoeffnet werden soll.
    signal HBFS_FH_normiert_XIX_DoorFunctions_HBFS_01_XIX_VLAN_Cockpit: start 39, 1 bit, little-endian, data-type-policy=OVERRIDE, i-signal-type=PRIMITIVE, init-value=0, base-type=BT_HBFS_FH_normiert, compu {0=Cx0_inaktiv (CM_HBFS_FH_normiert_Cx0_inaktiv), 1=Cx1_aktiv (CM_HBFS_FH_normiert_Cx1_aktiv)}, range raw 0..1, transfer-property=TRIGGERED-WITHOUT-REPETITION  # Die Position der Fensterheberscheibe ist bekannt.
    signal ASW_Warnung_aktiv_HBFS_XIX_DoorFunctions_HBFS_01_XIX_VLAN_Cockpit: start 40, 1 bit, little-endian, data-type-policy=OVERRIDE, i-signal-type=PRIMITIVE, init-value=0, base-type=BT_ASW_Warnung_aktiv_HBFS, compu {0=Cx0_nicht_angefordert (CM_ASW_Warnung_aktiv_HBFS_Cx0_nicht_angefordert), 1=Cx1_angefordert (CM_ASW_Warnung_aktiv_HBFS_Cx1_angefordert)}, range raw 0..1, transfer-property=TRIGGERED-WITHOUT-REPETITION  # Abschaltung der Ambientefunktion Tür hinten der Beifahrerseite bei aktiver ASW Warnung an der Fahrertür
    signal HBFS_Zuziehhilfe_aktiv_XIX_DoorFunctions_HBFS_01_XIX_VLAN_Cockpit: start 41, 1 bit, little-endian, data-type-policy=OVERRIDE, i-signal-type=PRIMITIVE, init-value=0, base-type=BT_HBFS_Zuziehhilfe_aktiv, compu {0=Cx0_Init (CM_HBFS_Zuziehhilfe_aktiv_Cx0_Init), 1=Cx1_Zuziehhilfe_aktiv (CM_HBFS_Zuziehhilfe_aktiv_Cx1_Zuziehhilfe_aktiv)}, range raw 0..1, transfer-property=TRIGGERED-WITHOUT-REPETITION  # Zuziehhilfe aktiv
    signal HBFS_Seitenrollo_hoch_XIX_DoorFunctions_HBFS_01_XIX_VLAN_Cockpit: start 42, 1 bit, little-endian, data-type-policy=OVERRIDE, i-signal-type=PRIMITIVE, init-value=0, base-type=BT_HBFS_Seitenrollo_hoch, compu {1=Cx1_Seitenrollo_in_Bewegung_hoch (CM_HBFS_Seitenrollo_hoch_Cx1_Seitenrollo_in_Bewegung_hoch)}, range raw 1, transfer-property=TRIGGERED-WITHOUT-REPETITION
    signal HBFS_Seitenrollo_tief_XIX_DoorFunctions_HBFS_01_XIX_VLAN_Cockpit: start 43, 1 bit, little-endian, data-type-policy=OVERRIDE, i-signal-type=PRIMITIVE, init-value=0, base-type=BT_HBFS_Seitenrollo_tief, compu {1=Cx1_Seitenrollo_in_Bewegung_tief (CM_HBFS_Seitenrollo_tief_Cx1_Seitenrollo_in_Bewegung_tief), 0=Cx0_Init (CM_HBFS_Seitenrollo_tief_Cx0_Init)}, range raw 0..1, transfer-property=TRIGGERED-WITHOUT-REPETITION  # Seitenrollo in Bewegung Richtung tief
    signal HBFS_Status_KiSi_XIX_DoorFunctions_HBFS_01_XIX_VLAN_Cockpit: start 44, 1 bit, little-endian, data-type-policy=OVERRIDE, i-signal-type=PRIMITIVE, init-value=0, base-type=BT_HBFS_Status_KiSi, compu {0=Cx0_inaktiv (CM_HBFS_Status_KiSi_Cx0_inaktiv), 1=Cx1_aktiv (CM_HBFS_Status_KiSi_Cx1_aktiv)}, range raw 0..1, transfer-property=TRIGGERED-WITHOUT-REPETITION  # Status Kindersicherung HBFS
    signal SSR_HBFS_Pos_Unten_XIX_DoorFunctions_HBFS_01_XIX_VLAN_Cockpit: start 45, 1 bit, little-endian, data-type-policy=OVERRIDE, i-signal-type=PRIMITIVE, init-value=0, base-type=BT_SSR_HBFS_Pos_Unten, compu {1=Cx1_SSR_Unten (CM_SSR_HBFS_Pos_Unten_Cx1_SSR_Unten), 0=Cx0_SSR_Oben (CM_SSR_HBFS_Pos_Unten_Cx0_SSR_Oben)}, range raw 0..1, transfer-property=TRIGGERED-WITHOUT-REPETITION  # Signal für die "Global Close". Über dieses Bit wissen die anderen TSGs, ob der SSR oder der FH verfahren werden darf.
    signal HBFS_Oben_Block_erw_XIX_DoorFunctions_HBFS_01_XIX_VLAN_Cockpit: start 46, 1 bit, little-endian, data-type-policy=OVERRIDE, i-signal-type=PRIMITIVE, init-value=0, base-type=BT_HBFS_Oben_Block_erw, compu {0=Cx0_Fensterheber_nicht_in_Blockerwar (CM_HBFS_Oben_Block_erw_Cx0_Fensterheber_nicht_in_Blockerwar), 1=Cx1_Fensterheber_in_Blockerwartung_o (CM_HBFS_Oben_Block_erw_Cx1_Fensterheber_in_Blockerwartung_o)}, range raw 0..1, transfer-property=TRIGGERED-WITHOUT-REPETITION  # Fensterheber in Blockerwartung oben
    signal HBFS_Unten_Block_erw_XIX_DoorFunctions_HBFS_01_XIX_VLAN_Cockpit: start 47, 1 bit, little-endian, data-type-policy=OVERRIDE, i-signal-type=PRIMITIVE, init-value=0, base-type=BT_HBFS_Unten_Block_erw, compu {0=Cx0_Fensterheber_nicht_in_Blockerwar (CM_HBFS_Unten_Block_erw_Cx0_Fensterheber_nicht_in_Blockerwar), 1=Cx1_Fensterheber_in_Blockerwartung_u (CM_HBFS_Unten_Block_erw_Cx1_Fensterheber_in_Blockerwartung_u)}, range raw 0..1, transfer-property=TRIGGERED-WITHOUT-REPETITION  # Fensterheber in Blockerwartung unten
    signal MTHBFS_M_Taste_XIX_DoorFunctions_HBFS_01_XIX_VLAN_Cockpit: start 48, 1 bit, little-endian, data-type-policy=OVERRIDE, i-signal-type=PRIMITIVE, init-value=0, base-type=BT_MTHBFS_M_Taste, compu {1=Cx1_betaetigt (CM_MTHBFS_M_Taste_Cx1_betaetigt), 0=Cx0_nicht_betaetigt (CM_MTHBFS_M_Taste_Cx0_nicht_betaetigt)}, range raw 0..1, transfer-property=TRIGGERED-WITHOUT-REPETITION  # Betätigung M-Taste HBFS
    signal MTHBFS_Pos1_XIX_DoorFunctions_HBFS_01_XIX_VLAN_Cockpit: start 49, 1 bit, little-endian, data-type-policy=OVERRIDE, i-signal-type=PRIMITIVE, init-value=0, base-type=BT_MTHBFS_Pos1, compu {1=Cx1_betaetigt (CM_MTHBFS_Pos1_Cx1_betaetigt), 0=Cx0_nicht_betaetigt (CM_MTHBFS_Pos1_Cx0_nicht_betaetigt)}, range raw 0..1, transfer-property=TRIGGERED-WITHOUT-REPETITION  # Betätigung Postionstaste 1 HBFS
    signal MTHBFS_Pos2_XIX_DoorFunctions_HBFS_01_XIX_VLAN_Cockpit: start 50, 1 bit, little-endian, data-type-policy=OVERRIDE, i-signal-type=PRIMITIVE, init-value=0, base-type=BT_MTHBFS_Pos2, compu {1=Cx1_betaetigt (CM_MTHBFS_Pos2_Cx1_betaetigt), 0=Cx0_nicht_betaetigt (CM_MTHBFS_Pos2_Cx0_nicht_betaetigt)}, range raw 0..1, transfer-property=TRIGGERED-WITHOUT-REPETITION  # Betätigung Postionstaste 2 HBFS
    signal MTHBFS_Pos3_XIX_DoorFunctions_HBFS_01_XIX_VLAN_Cockpit: start 51, 1 bit, little-endian, data-type-policy=OVERRIDE, i-signal-type=PRIMITIVE, init-value=0, base-type=BT_MTHBFS_Pos3, compu {1=Cx1_betaetigt (CM_MTHBFS_Pos3_Cx1_betaetigt), 0=Cx0_nicht_betaetigt (CM_MTHBFS_Pos3_Cx0_nicht_betaetigt)}, range raw 0..1, transfer-property=TRIGGERED-WITHOUT-REPETITION  # Betätigung Postionstaste 3 HBFS
    signal HBFS_MRollo_Schalter_XIX_DoorFunctions_HBFS_01_XIX_VLAN_Cockpit: start 52, 3 bit, little-endian, data-type-policy=OVERRIDE, i-signal-type=PRIMITIVE, init-value=6, base-type=BT_HBFS_MRollo_Schalter, invalid-value=Invalid_HBFS_MRollo_Schalter_XIX_DoorFunctions_HBFS_01_XIX_VLAN_Cockpit:7, compu {7=Cx7_Fehler (CM_HBFS_MRollo_Schalter_Cx7_Fehler), 6=Cx6_Init (CM_HBFS_MRollo_Schalter_Cx6_Init), 3=Cx3_AUF_manuell (CM_HBFS_MRollo_Schalter_Cx3_AUF_manuell), 2=Cx2_ZU_automatik (CM_HBFS_MRollo_Schalter_Cx2_ZU_automatik), 0=Cx0_nicht_betaetigt (CM_HBFS_MRollo_Schalter_Cx0_nicht_betaetigt), 4=Cx4_AUF_automatik (CM_HBFS_MRollo_Schalter_Cx4_AUF_automatik), 1=Cx1_ZU_manuell (CM_HBFS_MRollo_Schalter_Cx1_ZU_manuell), 5=Cx5_nicht_verfuegbar (CM_HBFS_MRollo_Schalter_Cx5_nicht_verfuegbar)}, range raw 0..7, transfer-property=TRIGGERED-WITHOUT-REPETITION  # | MRollo2 ----------------------------- 0 | nicht_betaetigt 1 | (m) Zu 2 | (a) Zu 3 | (m) Auf 4 | (a) Auf 5 | Schalter nicht verfuegbar 6 | Init 7 | Fehlerfall
    signal HBFS_Status_KiSi_inv_XIX_DoorFunctions_HBFS_01_XIX_VLAN_Cockpit: start 56, 1 bit, little-endian, data-type-policy=OVERRIDE, i-signal-type=PRIMITIVE, init-value=1, base-type=BT_HBFS_Status_KiSi_inv, compu {0=Cx0_aktiv (CM_HBFS_Status_KiSi_inv_Cx0_aktiv), 1=Cx1_inaktiv (CM_HBFS_Status_KiSi_inv_Cx1_inaktiv)}, range raw 0..1, transfer-property=TRIGGERED-WITHOUT-REPETITION  # Inverser Status der elektrischen Kindersicherung Beifahrerseite hinten
    signal HBFS_Status_eTAG_XIX_DoorFunctions_HBFS_01_XIX_VLAN_Cockpit: start 57, 2 bit, little-endian, data-type-policy=OVERRIDE, i-signal-type=PRIMITIVE, init-value=0, base-type=BT_HBFS_Status_eTAG, invalid-value=Invalid_HBFS_Status_eTAG_XIX_DoorFunctions_HBFS_01_XIX_VLAN_Cockpit:3, compu {3=Cx3_Fehler (CM_HBFS_Status_eTAG_Cx3_Fehler), 0=Cx0_Init (CM_HBFS_Status_eTAG_Cx0_Init), 1=Cx1_Griff_ausgefahren (CM_HBFS_Status_eTAG_Cx1_Griff_ausgefahren), 2=Cx2_Griff_eingefahren (CM_HBFS_Status_eTAG_Cx2_Griff_eingefahren)}, range raw 0..3, transfer-property=TRIGGERED-WITHOUT-REPETITION  # Status des elektrischen Tueraussengriffes Tuer Beifahrerseite hinten
    signal HBFS_Tuer_Status_QBit_XIX_DoorFunctions_HBFS_01_XIX_VLAN_Cockpit: start 59, 1 bit, little-endian, data-type-policy=OVERRIDE, i-signal-type=PRIMITIVE, init-value=0, base-type=BT_HBFS_Tuer_Status_QBit, compu {1=Cx1_Status_Tuerkontakt_unsicher (CM_HBFS_Tuer_Status_QBit_Cx1_Status_Tuerkontakt_unsicher), 0=Cx0_Status_Tuerkontakt_sicher (CM_HBFS_Tuer_Status_QBit_Cx0_Status_Tuerkontakt_sicher)}, range raw 0..1, transfer-property=TRIGGERED-WITHOUT-REPETITION  # Dieses Bit gibt die Zuverlässigkeit des Türkontakts an. Ein auf dieses Bit folgender Fehlereintrag ist mit dem Sender des Bits abzustimmen (gültig ab PPE).
    signal HBFS_TCR_Mode_aktiv_XIX_DoorFunctions_HBFS_01_XIX_VLAN_Cockpit: start 65, 1 bit, little-endian, data-type-policy=OVERRIDE, i-signal-type=PRIMITIVE, init-value=0, base-type=BT_HBFS_TCR_Mode_aktiv, compu {1=Cx1_TCR_Mode_aktiv (CM_HBFS_TCR_Mode_aktiv_Cx1_TCR_Mode_aktiv), 0=Cx0_TCR_Mode_deaktiv (CM_HBFS_TCR_Mode_aktiv_Cx0_TCR_Mode_deaktiv)}, range raw 0..1, transfer-property=TRIGGERED-WITHOUT-REPETITION  # Signal zeigt eine aktive mechanische Redundanz am Türschloss an.
    signal SSA_HBFT_FH_Thermoschutz_XIX_DoorFunctions_HBFS_01_XIX_VLAN_Cockpit: start 66, 1 bit, little-endian, data-type-policy=OVERRIDE, i-signal-type=PRIMITIVE, init-value=0, base-type=BT_SSA_HBFT_FH_Thermoschutz, compu {0=Cx0_Thermoschutz_deaktiv (CM_SSA_HBFT_FH_Thermoschutz_Cx0_Thermoschutz_deaktiv), 1=Cx1_Thermoschutz_aktiv (CM_SSA_HBFT_FH_Thermoschutz_Cx1_Thermoschutz_aktiv)}, range raw 0..1, transfer-property=TRIGGERED-WITHOUT-REPETITION  # SmartSensorActor: Rückmeldung Status Thermoschutz
    signal SSA_HBFT_ZZH_Status_XIX_DoorFunctions_HBFS_01_XIX_VLAN_Cockpit: start 67, 1 bit, little-endian, data-type-policy=OVERRIDE, i-signal-type=PRIMITIVE, init-value=0, base-type=BT_SSA_HBFT_ZZH_Status, compu {1=Cx1_Zuziehvorgang_aktiv (CM_SSA_HBFT_ZZH_Status_Cx1_Zuziehvorgang_aktiv), 0=Cx0_Init (CM_SSA_HBFT_ZZH_Status_Cx0_Init)}, range raw 0..1, transfer-property=TRIGGERED-WITHOUT-REPETITION  # SmartSensorActor: Status des ZZH Motors
    signal SSA_HBFT_SSR_Status_XIX_DoorFunctions_HBFS_01_XIX_VLAN_Cockpit: start 68, 2 bit, little-endian, data-type-policy=OVERRIDE, i-signal-type=PRIMITIVE, init-value=0, base-type=BT_SSA_HBFT_SSR_Status, compu {1=Cx1_oben (CM_SSA_HBFT_SSR_Status_Cx1_oben), 0=Cx0_Init (CM_SSA_HBFT_SSR_Status_Cx0_Init), 2=Cx2_unten (CM_SSA_HBFT_SSR_Status_Cx2_unten)}, range raw 0..2, transfer-property=TRIGGERED-WITHOUT-REPETITION  # SmartSensorActor: Rueckmeldung des Status des Seitenscheibenrollos
    signal SSA_HBFT_ASW_Status_XIX_DoorFunctions_HBFS_01_XIX_VLAN_Cockpit: start 70, 2 bit, little-endian, data-type-policy=OVERRIDE, i-signal-type=PRIMITIVE, init-value=0, base-type=BT_SSA_HBFT_ASW_Status, compu {1=Cx1_InfoStufe_aktiv (CM_SSA_HBFT_ASW_Status_Cx1_InfoStufe_aktiv), 0=Cx0_Init (CM_SSA_HBFT_ASW_Status_Cx0_Init), 2=Cx2_Warnstufe_aktiv (CM_SSA_HBFT_ASW_Status_Cx2_Warnstufe_aktiv)}, range raw 0..2, transfer-property=TRIGGERED-WITHOUT-REPETITION  # SmartSensorActor: Rückmeldung des Status der ASW Anzyeige.
    signal TSG_FlHz_HBFS_NTC_A_XIX_DoorFunctions_HBFS_01_XIX_VLAN_Cockpit: start 72, 7 bit, little-endian, data-type-policy=OVERRIDE, i-signal-type=PRIMITIVE, init-value=127, base-type=BT_TSG_FlHz_HBFS_NTC_A, compu {phys=raw-40 for raw 0..120, 126=Cx7e_Fehler_NTC_Overload_KS_Minus (CM_TSG_FlHz_HBFS_NTC_A_Cx7e_Fehler_NTC_Overload_KS_Minus) (Fehler_NTC_Overload__KS_Minus), 127=Cx7f_Init (CM_TSG_FlHz_HBFS_NTC_A_Cx7f_Init), 125=Cx7d_Fehler_NTC_OpenLoad_KS_Plus (CM_TSG_FlHz_HBFS_NTC_A_Cx7d_Fehler_NTC_OpenLoad_KS_Plus) (Fehler_NTC_OpenLoad__KS_Plus); unit Unit_DegreCelsi}, range phys -40..80 Unit_DegreCelsi, raw 0..127, unit=Unit_DegreCelsi, transfer-property=TRIGGERED-WITHOUT-REPETITION  # Flächenheizung: Temperatur und Fehlerwert des Heizaktors
    signal TSG_FlHz_HBFS_FnAbbruchHzKreis_A_XIX_DoorFunctions_HBFS_01_XIX_VLAN_Cockpit: start 79, 1 bit, little-endian, data-type-policy=OVERRIDE, i-signal-type=PRIMITIVE, init-value=0, base-type=BT_TSG_FlHz_HBFS_FnAbbruchHzKreis_A, compu {1=Cx1_FunktionsAbbruch (CM_TSG_FlHz_HBFS_FnAbbruchHzKreis_A_Cx1_FunktionsAbbruch), 0=Cx0_OK (CM_TSG_FlHz_HBFS_FnAbbruchHzKreis_A_Cx0_OK)}, range raw 0..1, transfer-property=TRIGGERED-WITHOUT-REPETITION  # Flächenheizung: Status
    signal TSG_FlHz_HBFS_NTC_B_XIX_DoorFunctions_HBFS_01_XIX_VLAN_Cockpit: start 80, 7 bit, little-endian, data-type-policy=OVERRIDE, i-signal-type=PRIMITIVE, init-value=127, base-type=BT_TSG_FlHz_HBFS_NTC_B, compu {phys=raw-40 for raw 0..120, 126=Cx7e_Fehler_NTC_Overload_KS_Minus (CM_TSG_FlHz_HBFS_NTC_B_Cx7e_Fehler_NTC_Overload_KS_Minus) (Fehler_NTC_Overload__KS_Minus), 127=Cx7f_Init (CM_TSG_FlHz_HBFS_NTC_B_Cx7f_Init), 125=Cx7d_Fehler_NTC_OpenLoad_KS_Plus (CM_TSG_FlHz_HBFS_NTC_B_Cx7d_Fehler_NTC_OpenLoad_KS_Plus) (Fehler_NTC_OpenLoad__KS_Plus); unit Unit_DegreCelsi}, range phys -40..80 Unit_DegreCelsi, raw 0..127, unit=Unit_DegreCelsi, transfer-property=TRIGGERED-WITHOUT-REPETITION  # Flächenheizung: Temperatur und Fehlerwert des Heizaktors
    signal TSG_FlHz_HBFS_FnAbbruchHzKreis_B_XIX_DoorFunctions_HBFS_01_XIX_VLAN_Cockpit: start 87, 1 bit, little-endian, data-type-policy=OVERRIDE, i-signal-type=PRIMITIVE, init-value=0, base-type=BT_TSG_FlHz_HBFS_FnAbbruchHzKreis_B, compu {0=Cx0_OK (CM_TSG_FlHz_HBFS_FnAbbruchHzKreis_B_Cx0_OK), 1=Cx1_FunktionsAbbruch (CM_TSG_FlHz_HBFS_FnAbbruchHzKreis_B_Cx1_FunktionsAbbruch)}, range raw 0..1, transfer-property=TRIGGERED-WITHOUT-REPETITION  # Flächenheizung: Status
    signal SSA_HBFT_Tuerverschluss_Status_XIX_DoorFunctions_HBFS_01_XIX_VLAN_Cockpit: start 88, 2 bit, little-endian, data-type-policy=OVERRIDE, i-signal-type=PRIMITIVE, init-value=0, base-type=BT_SSA_HBFT_Tuerverschluss_Status, compu {0=Cx0_Init (CM_SSA_HBFT_Tuerverschluss_Status_Cx0_Init), 1=Cx1_Tuer_geschlossen (CM_SSA_HBFT_Tuerverschluss_Status_Cx1_Tuer_geschlossen), 2=Cx2_Tuer_offen (CM_SSA_HBFT_Tuerverschluss_Status_Cx2_Tuer_offen)}, range raw 0..2, transfer-property=TRIGGERED-WITHOUT-REPETITION  # SmartSensorActor: Türstatus der hinteren Beifahrertür (geschlossen, geöffnet)
    signal SSA_HBFT_el_Tuerantrieb_Status_XIX_DoorFunctions_HBFS_01_XIX_VLAN_Cockpit: start 90, 2 bit, little-endian, data-type-policy=OVERRIDE, i-signal-type=PRIMITIVE, init-value=0, base-type=BT_SSA_HBFT_el_Tuerantrieb_Status, compu {1=Cx1_offen (CM_SSA_HBFT_el_Tuerantrieb_Status_Cx1_offen), 2=Cx2_geschlossen (CM_SSA_HBFT_el_Tuerantrieb_Status_Cx2_geschlossen), 0=Cx0_Init (CM_SSA_HBFT_el_Tuerantrieb_Status_Cx0_Init)}, range raw 0..2, transfer-property=TRIGGERED-WITHOUT-REPETITION  # SmartSensorActor: Rückmeldung des Status des el. Tuerantriebes
    signal SSA_HBFT_Amb_Bel_Status_XIX_DoorFunctions_HBFS_01_XIX_VLAN_Cockpit: start 92, 2 bit, little-endian, data-type-policy=OVERRIDE, i-signal-type=PRIMITIVE, init-value=0, base-type=BT_SSA_HBFT_Amb_Bel_Status, compu {2=Cx2_aus (CM_SSA_HBFT_Amb_Bel_Status_Cx2_aus), 0=Cx0_Init (CM_SSA_HBFT_Amb_Bel_Status_Cx0_Init), 1=Cx1_an (CM_SSA_HBFT_Amb_Bel_Status_Cx1_an)}, range raw 0..2, transfer-property=TRIGGERED-WITHOUT-REPETITION  # SmartSensorActor: Rückmeldung des Status der Ambiente Beleuchtung
    signal SSA_HBFT_FH_Bewegungsrichutng_XIX_DoorFunctions_HBFS_01_XIX_VLAN_Cockpit: start 94, 2 bit, little-endian, data-type-policy=OVERRIDE, i-signal-type=PRIMITIVE, init-value=0, base-type=BT_SSA_HBFT_FH_Bewegungsrichutng, compu {1=Cx1_FH_in_Bewegung_Schliessen (CM_SSA_HBFT_FH_Bewegungsrichutng_Cx1_FH_in_Bewegung_Schliessen), 0=Cx0_Stillstand (CM_SSA_HBFT_FH_Bewegungsrichutng_Cx0_Stillstand), 2=Cx2_FH_in_Bewegung_Oeffnen (CM_SSA_HBFT_FH_Bewegungsrichutng_Cx2_FH_in_Bewegung_Oeffnen)}, range raw 0..2, transfer-property=TRIGGERED-WITHOUT-REPETITION  # SmartSensorActor: Rückmeldung der Bewegungsrichtung der Seitenscheibe
    signal SSA_HBFS_eKisi_Status_XIX_DoorFunctions_HBFS_01_XIX_VLAN_Cockpit: start 107, 2 bit, little-endian, data-type-policy=OVERRIDE, i-signal-type=PRIMITIVE, init-value=0, base-type=BT_SSA_HBFS_eKisi_Status, compu {2=Cx2_aktiv (CM_SSA_HBFS_eKisi_Status_Cx2_aktiv), 0=Cx0_Init (CM_SSA_HBFS_eKisi_Status_Cx0_Init), 1=Cx1_inaktiv (CM_SSA_HBFS_eKisi_Status_Cx1_inaktiv)}, range raw 0..2, transfer-property=TRIGGERED-WITHOUT-REPETITION  # SmartSensorActor: Rückmeldung des Status der elektrischen Kindersicherung auf der Beifahrerseite hinten
    signal SSA_HBFT_Tuerverschluss_Fehler_XIX_DoorFunctions_HBFS_01_XIX_VLAN_Cockpit: start 109, 3 bit, little-endian, data-type-policy=OVERRIDE, i-signal-type=PRIMITIVE, init-value=0, base-type=BT_SSA_HBFT_Tuerverschluss_Fehler, compu {3=Cx3_Ueberspannung (CM_SSA_HBFT_Tuerverschluss_Fehler_Cx3_Ueberspannung), 4=Cx4_elektrischer_Fehler (CM_SSA_HBFT_Tuerverschluss_Fehler_Cx4_elektrischer_Fehler), 2=Cx2_Unterspannung (CM_SSA_HBFT_Tuerverschluss_Fehler_Cx2_Unterspannung), 5=Cx5_Bedingung_nicht_erfuellt (CM_SSA_HBFT_Tuerverschluss_Fehler_Cx5_Bedingung_nicht_erfuellt), 1=Cx1_nicht_verbaut (CM_SSA_HBFT_Tuerverschluss_Fehler_Cx1_nicht_verbaut), 0=Cx0_in_Ordnung (CM_SSA_HBFT_Tuerverschluss_Fehler_Cx0_in_Ordnung)}, range raw 0..5, transfer-property=TRIGGERED-WITHOUT-REPETITION  # SmartSensorActor: Fehlerzustand der hinteren Beifahrertür
    signal SSA_HBFT_FH_Fehler_XIX_DoorFunctions_HBFS_01_XIX_VLAN_Cockpit: start 112, 3 bit, little-endian, data-type-policy=OVERRIDE, i-signal-type=PRIMITIVE, init-value=0, base-type=BT_SSA_HBFT_FH_Fehler, compu {2=Cx2_Unterspannung (CM_SSA_HBFT_FH_Fehler_Cx2_Unterspannung), 4=Cx4_el_Fehler (CM_SSA_HBFT_FH_Fehler_Cx4_el_Fehler), 3=Cx3_Ueberspannung (CM_SSA_HBFT_FH_Fehler_Cx3_Ueberspannung), 1=Cx1_nicht_verbaut (CM_SSA_HBFT_FH_Fehler_Cx1_nicht_verbaut), 5=Cx5_Bedingung_nicht_erfuellt (CM_SSA_HBFT_FH_Fehler_Cx5_Bedingung_nicht_erfuellt), 0=Cx0_iO (CM_SSA_HBFT_FH_Fehler_Cx0_iO)}, range raw 0..5, transfer-property=TRIGGERED-WITHOUT-REPETITION  # SmartSensorActor: Rückmeldung des Fehlerzustandes der Fensterheberfunktion
    signal SSA_HBFS_eKisi_Fehler_XIX_DoorFunctions_HBFS_01_XIX_VLAN_Cockpit: start 115, 3 bit, little-endian, data-type-policy=OVERRIDE, i-signal-type=PRIMITIVE, init-value=0, base-type=BT_SSA_HBFS_eKisi_Fehler, compu {3=Cx3_Ueberspannung (CM_SSA_HBFS_eKisi_Fehler_Cx3_Ueberspannung), 5=Cx5_Bedingung_nicht_erfuellt (CM_SSA_HBFS_eKisi_Fehler_Cx5_Bedingung_nicht_erfuellt), 0=Cx0_iO (CM_SSA_HBFS_eKisi_Fehler_Cx0_iO), 1=Cx1_nicht_verbaut (CM_SSA_HBFS_eKisi_Fehler_Cx1_nicht_verbaut), 4=Cx4_el_Fehler (CM_SSA_HBFS_eKisi_Fehler_Cx4_el_Fehler), 2=Cx2_Unterspannung (CM_SSA_HBFS_eKisi_Fehler_Cx2_Unterspannung)}, range raw 0..5, transfer-property=TRIGGERED-WITHOUT-REPETITION  # SmartSensorActor: Rückmeldung des Fehlerzustandes der elektrischen Kindersicherung auf der Beifahrerseite hinten
    signal SSA_HBFT_Amb_Bel_Fehler_XIX_DoorFunctions_HBFS_01_XIX_VLAN_Cockpit: start 118, 3 bit, little-endian, data-type-policy=OVERRIDE, i-signal-type=PRIMITIVE, init-value=0, base-type=BT_SSA_HBFT_Amb_Bel_Fehler, compu {5=Cx5_Bedingung_nicht_erfuellt (CM_SSA_HBFT_Amb_Bel_Fehler_Cx5_Bedingung_nicht_erfuellt), 0=Cx0_in_Ordnung (CM_SSA_HBFT_Amb_Bel_Fehler_Cx0_in_Ordnung), 2=Cx2_Unterspannung (CM_SSA_HBFT_Amb_Bel_Fehler_Cx2_Unterspannung), 4=Cx4_elektrischer_Fehler (CM_SSA_HBFT_Amb_Bel_Fehler_Cx4_elektrischer_Fehler), 3=Cx3_Ueberspannung (CM_SSA_HBFT_Amb_Bel_Fehler_Cx3_Ueberspannung), 1=Cx1_nicht_verbaut (CM_SSA_HBFT_Amb_Bel_Fehler_Cx1_nicht_verbaut)}, range raw 0..5, transfer-property=TRIGGERED-WITHOUT-REPETITION  # SmartSensorActor: Rückmeldung des Fehlerzustand der Ambiente Beleuchtung
    signal SSA_HBFT_FH_Normierung_XIX_DoorFunctions_HBFS_01_XIX_VLAN_Cockpit: start 121, 1 bit, little-endian, data-type-policy=OVERRIDE, i-signal-type=PRIMITIVE, init-value=0, base-type=BT_SSA_HBFT_FH_Normierung, compu {0=Cx0_nicht_normiert (CM_SSA_HBFT_FH_Normierung_Cx0_nicht_normiert), 1=Cx1_normiert (CM_SSA_HBFT_FH_Normierung_Cx1_normiert)}, range raw 0..1, transfer-property=TRIGGERED-WITHOUT-REPETITION  # SmartSensorActor: Rückmeldung des Normierungszustandes des Fensterhebers
    signal SSA_HBFT_el_Tuerantrieb_Fehler_XIX_DoorFunctions_HBFS_01_XIX_VLAN_Cockpit: start 122, 3 bit, little-endian, data-type-policy=OVERRIDE, i-signal-type=PRIMITIVE, init-value=0, base-type=BT_SSA_HBFT_el_Tuerantrieb_Fehler, compu {0=Cx0_iO (CM_SSA_HBFT_el_Tuerantrieb_Fehler_Cx0_iO), 2=Cx2_Unterspannung (CM_SSA_HBFT_el_Tuerantrieb_Fehler_Cx2_Unterspannung), 5=Cx5_Bedingung_nicht_erfuellt (CM_SSA_HBFT_el_Tuerantrieb_Fehler_Cx5_Bedingung_nicht_erfuellt), 3=Cx3_Ueberspannung (CM_SSA_HBFT_el_Tuerantrieb_Fehler_Cx3_Ueberspannung), 4=Cx4_el_Fehler (CM_SSA_HBFT_el_Tuerantrieb_Fehler_Cx4_el_Fehler), 1=Cx1_nicht_verbaut (CM_SSA_HBFT_el_Tuerantrieb_Fehler_Cx1_nicht_verbaut)}, range raw 0..5, transfer-property=TRIGGERED-WITHOUT-REPETITION  # SmartSensorActor: Rückmeldung des Fehlerzustand des el. Tuerantriebs
    signal SSA_HBFT_ZZH_Fehler_XIX_DoorFunctions_HBFS_01_XIX_VLAN_Cockpit: start 125, 3 bit, little-endian, data-type-policy=OVERRIDE, i-signal-type=PRIMITIVE, init-value=0, base-type=BT_SSA_HBFT_ZZH_Fehler, compu {1=Cx1_nicht_verbaut (CM_SSA_HBFT_ZZH_Fehler_Cx1_nicht_verbaut), 4=Cx4_elektrischer_Fehler (CM_SSA_HBFT_ZZH_Fehler_Cx4_elektrischer_Fehler), 5=Cx5_Bedingung_nicht_erfuellt (CM_SSA_HBFT_ZZH_Fehler_Cx5_Bedingung_nicht_erfuellt), 2=Cx2_Unterspannung (CM_SSA_HBFT_ZZH_Fehler_Cx2_Unterspannung), 3=Cx3_Ueberspannung (CM_SSA_HBFT_ZZH_Fehler_Cx3_Ueberspannung), 0=Cx0_in_Ordnung (CM_SSA_HBFT_ZZH_Fehler_Cx0_in_Ordnung)}, range raw 0..5, transfer-property=TRIGGERED-WITHOUT-REPETITION  # SmartSensorActor: Rückmeldung des Fehlerzustandes des ZZH Systems
    signal SSA_HBFT_ZV_Fehler_XIX_DoorFunctions_HBFS_01_XIX_VLAN_Cockpit: start 128, 3 bit, little-endian, data-type-policy=OVERRIDE, i-signal-type=PRIMITIVE, init-value=0, base-type=BT_SSA_HBFT_ZV_Fehler, compu {3=Cx3_Ueberspannung (CM_SSA_HBFT_ZV_Fehler_Cx3_Ueberspannung), 1=Cx1_nicht_verbaut (CM_SSA_HBFT_ZV_Fehler_Cx1_nicht_verbaut), 4=Cx4_elektrischer_Fehler (CM_SSA_HBFT_ZV_Fehler_Cx4_elektrischer_Fehler), 0=Cx0_in_Ordnung (CM_SSA_HBFT_ZV_Fehler_Cx0_in_Ordnung), 5=Cx5_Bedingung_nicht_erfuellt (CM_SSA_HBFT_ZV_Fehler_Cx5_Bedingung_nicht_erfuellt), 2=Cx2_Unterspannung (CM_SSA_HBFT_ZV_Fehler_Cx2_Unterspannung)}, range raw 0..5, transfer-property=TRIGGERED-WITHOUT-REPETITION  # SmartSensorActor: Rückmeldung des Fehlerzustandes des Türschlosses der hinteren Beifahrertür
    signal SSA_HBFT_ASW_Fehler_XIX_DoorFunctions_HBFS_01_XIX_VLAN_Cockpit: start 131, 3 bit, little-endian, data-type-policy=OVERRIDE, i-signal-type=PRIMITIVE, init-value=0, base-type=BT_SSA_HBFT_ASW_Fehler, compu {2=Cx2_Unterspannung (CM_SSA_HBFT_ASW_Fehler_Cx2_Unterspannung), 5=Cx5_Bedingung_nicht_erfuellt (CM_SSA_HBFT_ASW_Fehler_Cx5_Bedingung_nicht_erfuellt), 3=Cx3_Ueberspannung (CM_SSA_HBFT_ASW_Fehler_Cx3_Ueberspannung), 0=Cx0_iO (CM_SSA_HBFT_ASW_Fehler_Cx0_iO), 4=Cx4_el_Fehler (CM_SSA_HBFT_ASW_Fehler_Cx4_el_Fehler), 1=Cx1_nicht_verbaut (CM_SSA_HBFT_ASW_Fehler_Cx1_nicht_verbaut)}, range raw 0..5, transfer-property=TRIGGERED-WITHOUT-REPETITION  # SmartSensorActor: Rückmeldung des Fehlerzustand des Ausstiegswarners
    signal SSA_HBFT_SSR_Fehler_XIX_DoorFunctions_HBFS_01_XIX_VLAN_Cockpit: start 134, 3 bit, little-endian, data-type-policy=OVERRIDE, i-signal-type=PRIMITIVE, init-value=0, base-type=BT_SSA_HBFT_SSR_Fehler, compu {4=Cx4_elektrischer_Fehler (CM_SSA_HBFT_SSR_Fehler_Cx4_elektrischer_Fehler), 3=Cx3_Ueberspannung (CM_SSA_HBFT_SSR_Fehler_Cx3_Ueberspannung), 2=Cx2_Unterspannung (CM_SSA_HBFT_SSR_Fehler_Cx2_Unterspannung), 1=Cx1_nicht_verbaut (CM_SSA_HBFT_SSR_Fehler_Cx1_nicht_verbaut), 0=Cx0_in_Ordnung (CM_SSA_HBFT_SSR_Fehler_Cx0_in_Ordnung), 5=Cx5_Bedingung_nicht_erfuellt (CM_SSA_HBFT_SSR_Fehler_Cx5_Bedingung_nicht_erfuellt)}, range raw 0..5, transfer-property=TRIGGERED-WITHOUT-REPETITION  # SmartSensorActor: Rückmeldung des Fehlerzustand des Seitenscheibenrollos
    signal eTAB_HBFS_Oeffnen_Annaeh_XIX_DoorFunctions_HBFS_01_XIX_VLAN_Cockpit: start 137, 1 bit, little-endian, data-type-policy=OVERRIDE, i-signal-type=PRIMITIVE, init-value=0, base-type=BT_eTAB_HBFS_Oeffnen_Annaeh, compu {0=Cx0_Init_keine_Annaeherung (CM_eTAB_HBFS_Oeffnen_Annaeh_Cx0_Init_keine_Annaeherung), 1=Cx1_Annaeherung_Oeffnen_erkannt (CM_eTAB_HBFS_Oeffnen_Annaeh_Cx1_Annaeherung_Oeffnen_erkannt)}, range raw 0..1, transfer-property=TRIGGERED-WITHOUT-REPETITION  # Der Türgriffsensor hat eine Annaeherung zum Oeffnen erkannt.
    signal eTAB_HBFS_Oeffnen_Betaet_XIX_DoorFunctions_HBFS_01_XIX_VLAN_Cockpit: start 138, 1 bit, little-endian, data-type-policy=OVERRIDE, i-signal-type=PRIMITIVE, init-value=0, base-type=BT_eTAB_HBFS_Oeffnen_Betaet, compu {1=Cx1_Betaetigung_Oeffnen_erkannt (CM_eTAB_HBFS_Oeffnen_Betaet_Cx1_Betaetigung_Oeffnen_erkannt), 0=Cx0_Init_keine_Annaeherung (CM_eTAB_HBFS_Oeffnen_Betaet_Cx0_Init_keine_Annaeherung)}, range raw 0..1, transfer-property=TRIGGERED-WITHOUT-REPETITION  # Der Türgriffsensor hat eine Betaetigung zum Oeffnen erkannt.
    signal eTAB_HBFS_Schliessen_Annaeh_XIX_DoorFunctions_HBFS_01_XIX_VLAN_Cockpit: start 139, 1 bit, little-endian, data-type-policy=OVERRIDE, i-signal-type=PRIMITIVE, init-value=0, base-type=BT_eTAB_HBFS_Schliessen_Annaeh, compu {0=Cx0_Init_keine_Annaeherung (CM_eTAB_HBFS_Schliessen_Annaeh_Cx0_Init_keine_Annaeherung), 1=Cx1_Annaeherung_Schliessen_erkannt (CM_eTAB_HBFS_Schliessen_Annaeh_Cx1_Annaeherung_Schliessen_erkannt)}, range raw 0..1, transfer-property=TRIGGERED-WITHOUT-REPETITION  # Der Türgriffsensor hat eine Annaeherung zum Schliessen erkannt.
    signal HBFS_ASW_Warnung_Aussenlicht_XIX_DoorFunctions_HBFS_01_XIX_VLAN_Cockpit: start 140, 2 bit, little-endian, data-type-policy=OVERRIDE, i-signal-type=PRIMITIVE, init-value=0, base-type=BT_HBFS_ASW_Warnung_Aussenlicht, invalid-value=Invalid_HBFS_ASW_Warnung_Aussenlicht_XIX_DoorFunctions_HBFS_01_XIX_VLAN_Cockpit:3, compu {3=Cx3_Fehler (CM_HBFS_ASW_Warnung_Aussenlicht_Cx3_Fehler), 0=Cx0_kein_licht (CM_HBFS_ASW_Warnung_Aussenlicht_Cx0_kein_licht), 2=Cx2_licht_rechts (CM_HBFS_ASW_Warnung_Aussenlicht_Cx2_licht_rechts), 1=Cx1_licht_links (CM_HBFS_ASW_Warnung_Aussenlicht_Cx1_licht_links)}, range raw 0..3, transfer-property=TRIGGERED-WITHOUT-REPETITION  # zeigt in den Heckleuchte ein Symbol an
    signal HBFS_ASW_Warnton_XIX_DoorFunctions_HBFS_01_XIX_VLAN_Cockpit: start 142, 2 bit, little-endian, data-type-policy=OVERRIDE, i-signal-type=PRIMITIVE, init-value=0, base-type=BT_HBFS_ASW_Warnton, invalid-value=Invalid_HBFS_ASW_Warnton_XIX_DoorFunctions_HBFS_01_XIX_VLAN_Cockpit:3, compu {3=Cx3_Fehler (CM_HBFS_ASW_Warnton_Cx3_Fehler), 0=Cx0_kein_warnton (CM_HBFS_ASW_Warnton_Cx0_kein_warnton), 1=Cx1_warnton_links (CM_HBFS_ASW_Warnton_Cx1_warnton_links), 2=Cx2_warnton_rechts (CM_HBFS_ASW_Warnton_Cx2_warnton_rechts)}, range raw 0..3, transfer-property=TRIGGERED-WITHOUT-REPETITION  # erzeugt ein Warnton bei AS Warnung
    signal HBFS_Tuer_geoeffnet_XIX_DoorFunctions_HBFS_01_XIX_VLAN_Cockpit: start 144, 1 bit, little-endian, data-type-policy=OVERRIDE, i-signal-type=PRIMITIVE, init-value=0, base-type=BT_HBFS_Tuer_geoeffnet, compu {1=Cx1_offen (CM_HBFS_Tuer_geoeffnet_Cx1_offen), 0=Cx0_geschlossen (CM_HBFS_Tuer_geoeffnet_Cx0_geschlossen)}, range raw 0..1, transfer-property=TRIGGERED-WITHOUT-REPETITION  # HBFS Tuer geoeffnet
    signal HBFS_verriegelt_XIX_DoorFunctions_HBFS_01_XIX_VLAN_Cockpit: start 145, 1 bit, little-endian, data-type-policy=OVERRIDE, i-signal-type=PRIMITIVE, init-value=0, base-type=BT_HBFS_verriegelt, compu {1=Cx1_verriegelt (CM_HBFS_verriegelt_Cx1_verriegelt), 0=Cx0_nicht_verriegelt (CM_HBFS_verriegelt_Cx0_nicht_verriegelt)}, range raw 0..1, transfer-property=TRIGGERED-WITHOUT-REPETITION  # Verriegelungsstatus Tür
    signal HBFS_gesafet_XIX_DoorFunctions_HBFS_01_XIX_VLAN_Cockpit: start 146, 1 bit, little-endian, data-type-policy=OVERRIDE, i-signal-type=PRIMITIVE, init-value=0, base-type=BT_HBFS_gesafet, compu {0=Cx0_nicht_gesafet (CM_HBFS_gesafet_Cx0_nicht_gesafet), 1=Cx1_gesafet (CM_HBFS_gesafet_Cx1_gesafet)}, range raw 0..1, transfer-property=TRIGGERED-WITHOUT-REPETITION  # HBFS Tuer gesafet. Im Zustand Safe wird auch das Signal HBFS_verriegelt = 1 gesendet.
    signal HBFS_Heckrollotaster_betaetigt_XIX_DoorFunctions_HBFS_01_XIX_VLAN_Cockpit: start 147, 1 bit, little-endian, data-type-policy=OVERRIDE, i-signal-type=PRIMITIVE, init-value=0, base-type=BT_HBFS_Heckrollotaster_betaetigt, compu {1=Cx1_In_Richtung_Hoch_Verfahren (CM_HBFS_Heckrollotaster_betaetigt_Cx1_In_Richtung_Hoch_Verfahren), 0=Cx0_keine_Verfahranweisung_in_Richtung_Hoch (CM_HBFS_Heckrollotaster_betaetigt_Cx0_keine_Verfahranweisung_in_Richtung_Hoch)}, range raw 0..1, transfer-property=TRIGGERED-WITHOUT-REPETITION  # Verfahren des Heckrollos in Richtung Hoch Bei Einfachtaster wird Bit als Togglebit verwendet (Heckrollo hoch, tief)
    signal HBFS_Tuerschloss_defekt_XIX_DoorFunctions_HBFS_01_XIX_VLAN_Cockpit: start 148, 1 bit, little-endian, data-type-policy=OVERRIDE, i-signal-type=PRIMITIVE, init-value=0, base-type=BT_HBFS_Tuerschloss_defekt, compu {0=Cx0_Tuerschloss_funktionsfaehig (CM_HBFS_Tuerschloss_defekt_Cx0_Tuerschloss_funktionsfaehig), 1=Cx1_Tuerschloss_defekt (CM_HBFS_Tuerschloss_defekt_Cx1_Tuerschloss_defekt)}, range raw 0..1, transfer-property=TRIGGERED-WITHOUT-REPETITION  # Das hintere Tuerschloss auf der Beifahrerseite ist nicht mehr funktionsfähig.
    signal HBFS_Unlock_Taster_XIX_DoorFunctions_HBFS_01_XIX_VLAN_Cockpit: start 149, 1 bit, little-endian, data-type-policy=OVERRIDE, i-signal-type=PRIMITIVE, init-value=0, base-type=BT_HBFS_Unlock_Taster, compu {1=Cx1_betaetigt (CM_HBFS_Unlock_Taster_Cx1_betaetigt), 0=Cx0_nicht_betaetigt (CM_HBFS_Unlock_Taster_Cx0_nicht_betaetigt)}, range raw 0..1, transfer-property=TRIGGERED-WITHOUT-REPETITION  # Betaetigung Unlock Taster
    signal HBFS_Lock_Taster_XIX_DoorFunctions_HBFS_01_XIX_VLAN_Cockpit: start 150, 1 bit, little-endian, data-type-policy=OVERRIDE, i-signal-type=PRIMITIVE, init-value=0, base-type=BT_HBFS_Lock_Taster, compu {1=Cx1_betaetigt (CM_HBFS_Lock_Taster_Cx1_betaetigt), 0=Cx0_nicht_betaetigt (CM_HBFS_Lock_Taster_Cx0_nicht_betaetigt)}, range raw 0..1, transfer-property=TRIGGERED-WITHOUT-REPETITION  # Betaetigung Lock-Taster
    signal HBFS_Sperrklinke_XIX_DoorFunctions_HBFS_01_XIX_VLAN_Cockpit: start 151, 1 bit, little-endian, data-type-policy=OVERRIDE, i-signal-type=PRIMITIVE, init-value=0, base-type=BT_HBFS_Sperrklinke, compu {0=Cx0_Schloss_in_Vorraste_und_Hauptraste (CM_HBFS_Sperrklinke_Cx0_Schloss_in_Vorraste_und_Hauptraste), 1=Cx1_Tuer_auf_oder_Tuer_Position_zwischen_Vor_und_Hauptraste (CM_HBFS_Sperrklinke_Cx1_Tuer_auf_oder_Tuer_Position_zwischen_Vor_und_Hauptraste)}, range raw 0..1, transfer-property=TRIGGERED-WITHOUT-REPETITION  # Vorraste für Schloß zwischen Vor- und Hauptraste Signal kurz auf 1, danach wieder auf 0 wenn Tür in Hauptraste (Tür ist sicher zu wenn Sperrklinke und Türkontakt auf 0 sind)
    signal HBFS_TAG_betaetigt_XIX_DoorFunctions_HBFS_01_XIX_VLAN_Cockpit: start 152, 1 bit, little-endian, data-type-policy=OVERRIDE, i-signal-type=PRIMITIVE, init-value=0, base-type=BT_HBFS_TAG_betaetigt, compu {1=Cx1_betaetigt (CM_HBFS_TAG_betaetigt_Cx1_betaetigt), 0=Cx0_nicht_betaetigt (CM_HBFS_TAG_betaetigt_Cx0_nicht_betaetigt)}, range raw 0..1, transfer-property=TRIGGERED-WITHOUT-REPETITION  # Betaetigung Türaussengriff
    signal HBFS_TIG_betaetigt_XIX_DoorFunctions_HBFS_01_XIX_VLAN_Cockpit: start 153, 1 bit, little-endian, data-type-policy=OVERRIDE, i-signal-type=PRIMITIVE, init-value=0, base-type=BT_HBFS_TIG_betaetigt, compu {1=Cx1_betaetigt (CM_HBFS_TIG_betaetigt_Cx1_betaetigt), 0=Cx0_nicht_betaetigt (CM_HBFS_TIG_betaetigt_Cx0_nicht_betaetigt)}, range raw 0..1, transfer-property=TRIGGERED-WITHOUT-REPETITION  # Betaetigung Tuerinnengriff
    signal HBFS_FH_S_HFS_AutoHoch_XIX_DoorFunctions_HBFS_01_XIX_VLAN_Cockpit: start 154, 1 bit, little-endian, data-type-policy=OVERRIDE, i-signal-type=PRIMITIVE, init-value=0, base-type=BT_HBFS_FH_S_HFS_AutoHoch, compu {1=Cx1_Automatiklauf_Angefordert (CM_HBFS_FH_S_HFS_AutoHoch_Cx1_Automatiklauf_Angefordert), 0=Cx0_keine_Bedienung (CM_HBFS_FH_S_HFS_AutoHoch_Cx0_keine_Bedienung)}, range raw 0..1, transfer-property=TRIGGERED-WITHOUT-REPETITION  # Automatisches Hochfahren der Seitenscheibe HFS
    signal HBFS_FH_S_HFS_AutoTief_XIX_DoorFunctions_HBFS_01_XIX_VLAN_Cockpit: start 155, 1 bit, little-endian, data-type-policy=OVERRIDE, i-signal-type=PRIMITIVE, init-value=0, base-type=BT_HBFS_FH_S_HFS_AutoTief, compu {0=Cx0_keine_Bedienung (CM_HBFS_FH_S_HFS_AutoTief_Cx0_keine_Bedienung), 1=Cx1_Automatiklauf_Angefordert (CM_HBFS_FH_S_HFS_AutoTief_Cx1_Automatiklauf_Angefordert)}, range raw 0..1, transfer-property=TRIGGERED-WITHOUT-REPETITION  # Automatisches Absenken der Seitenscheibe HFS
    signal SSA_HBFT_FH_Oeffnungsweite_XIX_DoorFunctions_HBFS_01_XIX_VLAN_Cockpit: start 156, 8 bit, little-endian, data-type-policy=OVERRIDE, i-signal-type=PRIMITIVE, init-value=0, base-type=BT_SSA_HBFT_FH_Oeffnungsweite, compu {phys=raw*0.5 for raw 0..200; unit Unit_PerCent}, range phys 0..100 Unit_PerCent, raw 0..200, unit=Unit_PerCent, transfer-property=TRIGGERED-WITHOUT-REPETITION  # SmartSensorActor: Rückmeldung der Öffnungsweite des Fensterhebers (0% geschlossen, 100% geöffnet) Angabe gilt nur bei normierten Fensterheber
    signal TSG_FlHz_HBFS_Unterbrech_HzK_A_XIX_DoorFunctions_HBFS_01_XIX_VLAN_Cockpit: start 164, 1 bit, little-endian, data-type-policy=OVERRIDE, i-signal-type=PRIMITIVE, init-value=0, base-type=BT_TSG_FlHz_HBFS_Unterbrech_HzK_A, compu {1=Cx1_Unterbrechung (CM_TSG_FlHz_HBFS_Unterbrech_HzK_A_Cx1_Unterbrechung), 0=Cx0_keine_Unterbrechung (CM_TSG_FlHz_HBFS_Unterbrech_HzK_A_Cx0_keine_Unterbrechung)}, range raw 0..1, transfer-property=TRIGGERED-WITHOUT-REPETITION  # Flächenheizung: Unterbrechungsstatus Heizkreis
    signal TSG_FlHz_HBFS_Unterbrech_HzK_B_XIX_DoorFunctions_HBFS_01_XIX_VLAN_Cockpit: start 165, 1 bit, little-endian, data-type-policy=OVERRIDE, i-signal-type=PRIMITIVE, init-value=0, base-type=BT_TSG_FlHz_HBFS_Unterbrech_HzK_B, compu {1=Cx1_Unterbrechung (CM_TSG_FlHz_HBFS_Unterbrech_HzK_B_Cx1_Unterbrechung), 0=Cx0_keine_Unterbrechung (CM_TSG_FlHz_HBFS_Unterbrech_HzK_B_Cx0_keine_Unterbrechung)}, range raw 0..1, transfer-property=TRIGGERED-WITHOUT-REPETITION  # Flächenheizung: Unterbrechungsstatus Heizkreis
    signal SSA_HBFT_ZV_Ansteuern_XIX_DoorFunctions_HBFS_01_XIX_VLAN_Cockpit: start 166, 4 bit, little-endian, data-type-policy=OVERRIDE, i-signal-type=PRIMITIVE, init-value=0, base-type=BT_SSA_HBFT_ZV_Ansteuern, invalid-value=Invalid_SSA_HBFT_ZV_Ansteuern_XIX_DoorFunctions_HBFS_01_XIX_VLAN_Cockpit:15, compu {15=Cxf_Fehler (CM_SSA_HBFT_ZV_Ansteuern_Cxf_Fehler), 1=Cx1_entriegeln_entsafen (CM_SSA_HBFT_ZV_Ansteuern_Cx1_entriegeln_entsafen), 2=Cx2_verriegeln_entsafen (CM_SSA_HBFT_ZV_Ansteuern_Cx2_verriegeln_entsafen), 3=Cx3_verriegeln_safen (CM_SSA_HBFT_ZV_Ansteuern_Cx3_verriegeln_safen), 0=Cx0_Init (CM_SSA_HBFT_ZV_Ansteuern_Cx0_Init)}, range raw 0..15, transfer-property=TRIGGERED-WITHOUT-REPETITION  # SmartSensorActor: Kommando zur Ansteuerung des Türschlosses der hinteren Beifahrertür
    signal SSA_HBFT_ZV_Status_XIX_DoorFunctions_HBFS_01_XIX_VLAN_Cockpit: start 170, 4 bit, little-endian, data-type-policy=OVERRIDE, i-signal-type=PRIMITIVE, init-value=0, base-type=BT_SSA_HBFT_ZV_Status, invalid-value=Invalid_SSA_HBFT_ZV_Status_XIX_DoorFunctions_HBFS_01_XIX_VLAN_Cockpit:15, compu {15=Cxf_Fehler (CM_SSA_HBFT_ZV_Status_Cxf_Fehler), 2=Cx2_verriegelt_entsafet (CM_SSA_HBFT_ZV_Status_Cx2_verriegelt_entsafet), 0=Cx0_Init (CM_SSA_HBFT_ZV_Status_Cx0_Init), 1=Cx1_entriegelt_entsafet (CM_SSA_HBFT_ZV_Status_Cx1_entriegelt_entsafet), 3=Cx3_verriegelt_gesafet (CM_SSA_HBFT_ZV_Status_Cx3_verriegelt_gesafet)}, range raw 0..15, transfer-property=TRIGGERED-WITHOUT-REPETITION  # SmartSensorActor: Zustand des Türschlosses der hinteren Beifahrertür
    signal HBFS_ASW_Warnung_VAS_XIX_DoorFunctions_HBFS_01_XIX_VLAN_Cockpit: start 174, 2 bit, little-endian, data-type-policy=OVERRIDE, i-signal-type=PRIMITIVE, init-value=0, base-type=BT_HBFS_ASW_Warnung_VAS, invalid-value=Invalid_HBFS_ASW_Warnung_VAS_XIX_DoorFunctions_HBFS_01_XIX_VLAN_Cockpit:3, compu {3=Cx3_Fehler (CM_HBFS_ASW_Warnung_VAS_Cx3_Fehler), 2=Cx2_Warnung (CM_HBFS_ASW_Warnung_VAS_Cx2_Warnung), 0=Cx0_Keine_Warnung (CM_HBFS_ASW_Warnung_VAS_Cx0_Keine_Warnung), 1=Cx1_Info (CM_HBFS_ASW_Warnung_VAS_Cx1_Info)}, range raw 0..3, transfer-property=TRIGGERED-WITHOUT-REPETITION  # Abschaltung der VAS Hinter Beifahrertür bei aktiver ASW Warnung an der Hinter Beifahrertür
    signal HBFS_ASW_HMI_defekt_XIX_DoorFunctions_HBFS_01_XIX_VLAN_Cockpit: start 176, 1 bit, little-endian, data-type-policy=OVERRIDE, i-signal-type=PRIMITIVE, init-value=0, base-type=BT_HBFS_ASW_HMI_defekt, compu {0=Cx0_ASW_kein_Fehler (CM_HBFS_ASW_HMI_defekt_Cx0_ASW_kein_Fehler), 1=Cx1_ASW_Fehler (CM_HBFS_ASW_HMI_defekt_Cx1_ASW_Fehler)}, range raw 0..1, transfer-property=TRIGGERED-WITHOUT-REPETITION  # HMI Status der Funktion AusstiegsWarnung (ASW), HMI wird durch das TSG angesteuert.
    signal eTAB_HBFS_Schliessen_Betaet_XIX_DoorFunctions_HBFS_01_XIX_VLAN_Cockpit: start 177, 1 bit, little-endian, data-type-policy=OVERRIDE, i-signal-type=PRIMITIVE, init-value=0, base-type=BT_eTAB_HBFS_Schliessen_Betaet, compu {1=Cx1_Betaetigung_Schliessen_erkannt (CM_eTAB_HBFS_Schliessen_Betaet_Cx1_Betaetigung_Schliessen_erkannt), 0=Cx0_Init_keine_Annaeherung (CM_eTAB_HBFS_Schliessen_Betaet_Cx0_Init_keine_Annaeherung)}, range raw 0..1, transfer-property=TRIGGERED-WITHOUT-REPETITION  # Der Türgriffsensor hat eine Betaetigung zum Schliessen erkannt.
    signal HBFT_Kisi_Fehler_XIX_DoorFunctions_HBFS_01_XIX_VLAN_Cockpit: start 178, 1 bit, little-endian, data-type-policy=OVERRIDE, i-signal-type=PRIMITIVE, init-value=0, base-type=BT_HBFT_Kisi_Fehler, invalid-value=Invalid_HBFT_Kisi_Fehler_XIX_DoorFunctions_HBFS_01_XIX_VLAN_Cockpit:1, compu {1=Cx1_Fehler (CM_HBFT_Kisi_Fehler_Cx1_Fehler), 0=Cx0_kein_Fehler (CM_HBFT_Kisi_Fehler_Cx0_kein_Fehler)}, range raw 0..1, transfer-property=TRIGGERED-WITHOUT-REPETITION  # Fehlerstatus Kindersicherungsfunktion
