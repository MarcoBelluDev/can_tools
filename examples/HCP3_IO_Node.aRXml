[part 7 of 15: package /PDU]
AUTOSAR XML (schema 4-3-0)
package /PDU  (continued)
  pdu ACA_02_XIX_VLAN_Cockpit: length=16, transmission-mode-true-timing=cyclic-timing={time-offset=0.0, time-period=0.02}, unused-bit-pattern=0
    signal ACA_02_CRC_XIX_ACA_02_XIX_VLAN_Cockpit: start 0, 8 bit, little-endian, data-type-policy=OVERRIDE, i-signal-type=PRIMITIVE, init-value=0, base-type=BT_ACA_02_CRC, compu {phys=raw for raw 0..255}, range phys 0..255, raw 0..255, transfer-property=TRIGGERED-WITHOUT-REPETITION  # Für MLB: "Berechnung siehe Lastenheft "Kommunikationsabsicherung für FlexRay und CAN"" Ab MQB und MLBevo: "Berechnung siehe Lastenheft "End-to-End Kommunikationsabsicherung"" Endwerte siehe Begleitdokument "S-PDU Kennungsfolgen"
    signal ACA_02_BZ_XIX_ACA_02_XIX_VLAN_Cockpit: start 8, 4 bit, little-endian, data-type-policy=OVERRIDE, i-signal-type=PRIMITIVE, init-value=0, base-type=BT_ACA_02_BZ, compu {phys=raw for raw 0..15}, range phys 0..15, raw 0..15, transfer-property=TRIGGERED-WITHOUT-REPETITION  # 4bit Botschaftszähler, wird mit jeder Sendebotschaft inkrementiert
    signal ACA_Hands_off_LED_XIX_ACA_02_XIX_VLAN_Cockpit: start 12, 2 bit, little-endian, data-type-policy=OVERRIDE, i-signal-type=PRIMITIVE, init-value=0, base-type=BT_ACA_Hands_off_LED, compu {3=Cx3_weiss (CM_ACA_Hands_off_LED_Cx3_weiss), 1=Cx1_gelb (CM_ACA_Hands_off_LED_Cx1_gelb), 0=Cx0_keine_Anzeige (CM_ACA_Hands_off_LED_Cx0_keine_Anzeige), 2=Cx2_rot (CM_ACA_Hands_off_LED_Cx2_rot)}, range raw 0..3, transfer-property=TRIGGERED-WITHOUT-REPETITION  # LED which indicates a persistent lack of attention
    signal ACA_StgWhlVib_IdxProfReq_XIX_ACA_02_XIX_VLAN_Cockpit: start 14, 3 bit, little-endian, data-type-policy=OVERRIDE, i-signal-type=PRIMITIVE, init-value=6, base-type=BT_ACA_StgWhlVib_IdxProfReq, invalid-value=Invalid_ACA_StgWhlVib_IdxProfReq_XIX_ACA_02_XIX_VLAN_Cockpit:7, compu {7=Cx7_Fehler (CM_ACA_StgWhlVib_IdxProfReq_Cx7_Fehler), 1=Cx1_Profile1 (CM_ACA_StgWhlVib_IdxProfReq_Cx1_Profile1), 3=Cx3_Profile3 (CM_ACA_StgWhlVib_IdxProfReq_Cx3_Profile3), 5=Cx5_Profile5 (CM_ACA_StgWhlVib_IdxProfReq_Cx5_Profile5), 6=Cx6_Init (CM_ACA_StgWhlVib_IdxProfReq_Cx6_Init), 4=Cx4_Profile4 (CM_ACA_StgWhlVib_IdxProfReq_Cx4_Profile4), 2=Cx2_Profile2 (CM_ACA_StgWhlVib_IdxProfReq_Cx2_Profile2), 0=Cx0_NoReq (CM_ACA_StgWhlVib_IdxProfReq_Cx0_NoReq)}, range raw 0..7, transfer-property=TRIGGERED-WITHOUT-REPETITION  # Index of the requested steering wheel vibration profile
    signal ACA_HndFre_StDiReq_XIX_ACA_02_XIX_VLAN_Cockpit: start 17, 3 bit, little-endian, data-type-policy=OVERRIDE, i-signal-type=PRIMITIVE, init-value=6, base-type=BT_ACA_HndFre_StDiReq, invalid-value=Invalid_ACA_HndFre_StDiReq_XIX_ACA_02_XIX_VLAN_Cockpit:7, compu {7=Cx7_Fehler (CM_ACA_HndFre_StDiReq_Cx7_Fehler), 1=Cx1_Disable (CM_ACA_HndFre_StDiReq_Cx1_Disable), 6=Cx6_Init (CM_ACA_HndFre_StDiReq_Cx6_Init), 0=Cx0_NoRequest (CM_ACA_HndFre_StDiReq_Cx0_NoRequest), 4=Cx4_tbd (CM_ACA_HndFre_StDiReq_Cx4_tbd), 5=Cx5_tbd (CM_ACA_HndFre_StDiReq_Cx5_tbd), 2=Cx2_Escalation (CM_ACA_HndFre_StDiReq_Cx2_Escalation), 3=Cx3_tbd (CM_ACA_HndFre_StDiReq_Cx3_tbd)}, range raw 0..7, transfer-property=TRIGGERED-WITHOUT-REPETITION  # Request to disable VMM hands-free mode
    signal ACA_Akustik_XIX_ACA_02_XIX_VLAN_Cockpit: start 20, 3 bit, little-endian, data-type-policy=OVERRIDE, i-signal-type=PRIMITIVE, init-value=0, base-type=BT_ACA_Akustik, compu {4=Cx4_Hochprior (CM_ACA_Akustik_Cx4_Hochprior), 0=Cx0_keine_Akustik (CM_ACA_Akustik_Cx0_keine_Akustik), 2=Cx2_Niederprior_Abschaltung (CM_ACA_Akustik_Cx2_Niederprior_Abschaltung), 3=Cx3_Mittelprior (CM_ACA_Akustik_Cx3_Mittelprior), 1=Cx1_Niederprior_Hinweis (CM_ACA_Akustik_Cx1_Niederprior_Hinweis), 5=Cx5_Hochpriore_Daueraktustik (CM_ACA_Akustik_Cx5_Hochpriore_Daueraktustik)}, range raw 0..5, transfer-property=TRIGGERED-WITHOUT-REPETITION  # ASIL acoustics for ACA Warning
    signal ACA_CrvtCtl_CrvtDmd_XIX_ACA_02_XIX_VLAN_Cockpit: start 24, 16 bit, little-endian, data-type-policy=OVERRIDE, i-signal-type=PRIMITIVE, init-value=65534, base-type=BT_ACA_CrvtCtl_CrvtDmd, invalid-value=Invalid_ACA_CrvtCtl_CrvtDmd_XIX_ACA_02_XIX_VLAN_Cockpit:65535, compu {phys=raw/160000-0.2 for raw 0..64000, 65535=Cxffff_Fehler (CM_ACA_CrvtCtl_CrvtDmd_Cxffff_Fehler), 65534=Cxfffe_Init (CM_ACA_CrvtCtl_CrvtDmd_Cxfffe_Init), 65533=Cxfffd_Neutral (CM_ACA_CrvtCtl_CrvtDmd_Cxfffd_Neutral); unit Unit_MeterInver}, range phys -0.2..0.2 Unit_MeterInver, raw 0..65535, unit=Unit_MeterInver, transfer-property=TRIGGERED-WITHOUT-REPETITION  # Curvature demand lateral
    signal ACA_CrvtCtl_CrvtGrdDmd_XIX_ACA_02_XIX_VLAN_Cockpit: start 40, 8 bit, little-endian, data-type-policy=OVERRIDE, i-signal-type=PRIMITIVE, init-value=254, base-type=BT_ACA_CrvtCtl_CrvtGrdDmd, invalid-value=Invalid_ACA_CrvtCtl_CrvtGrdDmd_XIX_ACA_02_XIX_VLAN_Cockpit:255, compu {phys=raw/3125-0.04 for raw 0..250, 255=Cxff_Fehler (CM_ACA_CrvtCtl_CrvtGrdDmd_Cxff_Fehler), 253=Cxfd_Neutral (CM_ACA_CrvtCtl_CrvtGrdDmd_Cxfd_Neutral), 254=Cxfe_Init (CM_ACA_CrvtCtl_CrvtGrdDmd_Cxfe_Init); unit Unit_MeterSeconInver}, range phys -0.04..0.04 Unit_MeterSeconInver, raw 0..255, unit=Unit_MeterSeconInver, transfer-property=TRIGGERED-WITHOUT-REPETITION  # Curvature gradient demand for lateral control
    signal ACA_CrvtCtl_FacSsty_XIX_ACA_02_XIX_VLAN_Cockpit: start 48, 8 bit, little-endian, data-type-policy=OVERRIDE, i-signal-type=PRIMITIVE, init-value=254, base-type=BT_ACA_CrvtCtl_FacSsty, invalid-value=Invalid_ACA_CrvtCtl_FacSsty_XIX_ACA_02_XIX_VLAN_Cockpit:255, compu {phys=raw*0.004 for raw 0..250, 255=Cxff_Fehler (CM_ACA_CrvtCtl_FacSsty_Cxff_Fehler), 253=Cxfd_Neutral (CM_ACA_CrvtCtl_FacSsty_Cxfd_Neutral), 254=Cxfe_Init (CM_ACA_CrvtCtl_FacSsty_Cxfe_Init); unit Unit_None}, range phys 0..1 Unit_None, raw 0..255, unit=Unit_None, transfer-property=TRIGGERED-WITHOUT-REPETITION  # Sensitivity factor for reduction of controller force
    signal ACA_Status_LDW_XIX_ACA_02_XIX_VLAN_Cockpit: start 56, 3 bit, little-endian, data-type-policy=OVERRIDE, i-signal-type=PRIMITIVE, init-value=0, base-type=BT_ACA_Status_LDW, invalid-value=Invalid_ACA_Status_LDW_XIX_ACA_02_XIX_VLAN_Cockpit:7, compu {7=Cx7_Fehler (CM_ACA_Status_LDW_Cx7_Fehler), 1=Cx1_Off (CM_ACA_Status_LDW_Cx1_Off), 3=Cx3_On_Warning_left (CM_ACA_Status_LDW_Cx3_On_Warning_left), 4=Cx4_On_Warning_right (CM_ACA_Status_LDW_Cx4_On_Warning_right), 0=Cx0_Init (CM_ACA_Status_LDW_Cx0_Init), 2=Cx2_On_but_not_warning (CM_ACA_Status_LDW_Cx2_On_but_not_warning)}, range raw 0..7, transfer-property=TRIGGERED-WITHOUT-REPETITION  # Status Spurverlassenswarnung im ACA
    signal ACA_CrvtCtl_StLimCtlFReq_XIX_ACA_02_XIX_VLAN_Cockpit: start 59, 3 bit, little-endian, data-type-policy=OVERRIDE, i-signal-type=PRIMITIVE, init-value=6, base-type=BT_ACA_CrvtCtl_StLimCtlFReq, invalid-value=Invalid_ACA_CrvtCtl_StLimCtlFReq_XIX_ACA_02_XIX_VLAN_Cockpit:7, compu {7=Cx7_Fehler (CM_ACA_CrvtCtl_StLimCtlFReq_Cx7_Fehler), 2=Cx2_LimitationRight (CM_ACA_CrvtCtl_StLimCtlFReq_Cx2_LimitationRight), 0=Cx0_NoRequest (CM_ACA_CrvtCtl_StLimCtlFReq_Cx0_NoRequest), 1=Cx1_LimitationLeft (CM_ACA_CrvtCtl_StLimCtlFReq_Cx1_LimitationLeft), 6=Cx6_Init (CM_ACA_CrvtCtl_StLimCtlFReq_Cx6_Init)}, range raw 0..7, transfer-property=TRIGGERED-WITHOUT-REPETITION  # Status of controller
    signal ACA_LatCtl_stAcv_XIX_ACA_02_XIX_VLAN_Cockpit: start 62, 2 bit, little-endian, data-type-policy=OVERRIDE, i-signal-type=PRIMITIVE, init-value=2, base-type=BT_ACA_LatCtl_stAcv, invalid-value=Invalid_ACA_LatCtl_stAcv_XIX_ACA_02_XIX_VLAN_Cockpit:3, compu {3=Cx3_Fehler (CM_ACA_LatCtl_stAcv_Cx3_Fehler), 1=Cx1_Active (CM_ACA_LatCtl_stAcv_Cx1_Active), 2=Cx2_Init (CM_ACA_LatCtl_stAcv_Cx2_Init), 0=Cx0_Passive (CM_ACA_LatCtl_stAcv_Cx0_Passive)}, range raw 0..3, transfer-property=TRIGGERED-WITHOUT-REPETITION  # Activation demand for lateral control
    signal ACA_HMI_Color_XIX_ACA_02_XIX_VLAN_Cockpit: start 64, 3 bit, little-endian, data-type-policy=OVERRIDE, i-signal-type=PRIMITIVE, init-value=0, base-type=BT_ACA_HMI_Color, invalid-value=Invalid_ACA_HMI_Color_XIX_ACA_02_XIX_VLAN_Cockpit:7, compu {7=Cx7_Fehler (CM_ACA_HMI_Color_Cx7_Fehler), 5=Cx5_Red_Static (CM_ACA_HMI_Color_Cx5_Red_Static), 4=Cx4_Yellow_Static (CM_ACA_HMI_Color_Cx4_Yellow_Static), 2=Cx2_White_Static (CM_ACA_HMI_Color_Cx2_White_Static), 3=Cx3_Green_Static (CM_ACA_HMI_Color_Cx3_Green_Static), 1=Cx1_Off (CM_ACA_HMI_Color_Cx1_Off), 6=Cx6_Reserved (CM_ACA_HMI_Color_Cx6_Reserved), 0=Cx0_Init (CM_ACA_HMI_Color_Cx0_Init)}, range raw 0..7, transfer-property=TRIGGERED-WITHOUT-REPETITION, to HCP3_IONode(timeout 0.5 s)  # ASIL brackets for ACA
    signal ACA_Status_Quer_XIX_ACA_02_XIX_VLAN_Cockpit: start 67, 3 bit, little-endian, data-type-policy=OVERRIDE, i-signal-type=PRIMITIVE, init-value=0, base-type=BT_ACA_Status_Quer, invalid-value=Invalid_ACA_Status_Quer_XIX_ACA_02_XIX_VLAN_Cockpit:7, compu {7=Cx7_Fehler (CM_ACA_Status_Quer_Cx7_Fehler), 6=Cx6_Reserve (CM_ACA_Status_Quer_Cx6_Reserve), 5=Cx5_Reserve (CM_ACA_Status_Quer_Cx5_Reserve), 1=Cx1_Aus (CM_ACA_Status_Quer_Cx1_Aus), 3=Cx3_Aktiv (CM_ACA_Status_Quer_Cx3_Aktiv), 4=Cx4_Reserve (CM_ACA_Status_Quer_Cx4_Reserve), 2=Cx2_Passiv (CM_ACA_Status_Quer_Cx2_Passiv), 0=Cx0_Init (CM_ACA_Status_Quer_Cx0_Init)}, range raw 0..7, transfer-property=TRIGGERED-WITHOUT-REPETITION  # ACA Funktionsstatus Querführung
    signal ACA_Status_Laengs_XIX_ACA_02_XIX_VLAN_Cockpit: start 70, 3 bit, little-endian, data-type-policy=OVERRIDE, i-signal-type=PRIMITIVE, init-value=0, base-type=BT_ACA_Status_Laengs, invalid-value=Invalid_ACA_Status_Laengs_XIX_ACA_02_XIX_VLAN_Cockpit:7, compu {7=Cx7_Fehler (CM_ACA_Status_Laengs_Cx7_Fehler), 5=Cx5_Ueberstimmt (CM_ACA_Status_Laengs_Cx5_Ueberstimmt), 6=Cx6_Abschaltreaktion (CM_ACA_Status_Laengs_Cx6_Abschaltreaktion), 2=Cx2_Passiv (CM_ACA_Status_Laengs_Cx2_Passiv), 0=Cx0_Init (CM_ACA_Status_Laengs_Cx0_Init), 4=Cx4_Boost (CM_ACA_Status_Laengs_Cx4_Boost), 3=Cx3_Aktiv (CM_ACA_Status_Laengs_Cx3_Aktiv), 1=Cx1_Aus (CM_ACA_Status_Laengs_Cx1_Aus)}, range raw 0..7, transfer-property=TRIGGERED-WITHOUT-REPETITION  # ACA Funktionsstatus Längsführung
    signal ACA_IntruMon_CamObj_ID_XIX_ACA_02_XIX_VLAN_Cockpit: start 73, 11 bit, little-endian, data-type-policy=OVERRIDE, i-signal-type=PRIMITIVE, init-value=2047, base-type=BT_ACA_IntruMon_CamObj_ID, compu {phys=raw for raw 0..2046, 2047=Cx7ff_Init (CM_ACA_IntruMon_CamObj_ID_Cx7ff_Init); unit Unit_None}, range phys 0..2046 Unit_None, raw 0..2047, unit=Unit_None, transfer-property=TRIGGERED-WITHOUT-REPETITION  # Kameraobjekt-ID (OD) für Intrudermonitoring
    signal ACA_EA_Fahrerinaktivitaet_XIX_ACA_02_XIX_VLAN_Cockpit: start 84, 1 bit, little-endian, data-type-policy=OVERRIDE, i-signal-type=PRIMITIVE, init-value=0, base-type=BT_ACA_EA_Fahrerinaktivitaet, compu {1=Cx1_Fahrerinaktivitaet_EA (CM_ACA_EA_Fahrerinaktivitaet_Cx1_Fahrerinaktivitaet_EA), 0=Cx0_Keine_Fahrerinaktivitaet (CM_ACA_EA_Fahrerinaktivitaet_Cx0_Keine_Fahrerinaktivitaet)}, range raw 0..1, transfer-property=TRIGGERED-WITHOUT-REPETITION  # ACA Fahrerinaktivitaet fuer Emergency Assist
    signal ACA_RDR_Status_XIX_ACA_02_XIX_VLAN_Cockpit: start 85, 1 bit, little-endian, data-type-policy=OVERRIDE, i-signal-type=PRIMITIVE, init-value=0, base-type=BT_ACA_RDR_Status, compu {1=Cx1_niO (CM_ACA_RDR_Status_Cx1_niO), 0=Cx0_iO (CM_ACA_RDR_Status_Cx0_iO)}, range raw 0..1, transfer-property=TRIGGERED-WITHOUT-REPETITION  # Gibt den Status des Frontradar an
    signal ACA_HndFre_StHndDet1_XIX_ACA_02_XIX_VLAN_Cockpit: start 86, 2 bit, little-endian, data-type-policy=OVERRIDE, i-signal-type=PRIMITIVE, init-value=2, base-type=BT_ACA_HndFre_StHndDet1, invalid-value=Invalid_ACA_HndFre_StHndDet1_XIX_ACA_02_XIX_VLAN_Cockpit:3, compu {3=Cx3_Fehler (CM_ACA_HndFre_StHndDet1_Cx3_Fehler), 0=Cx0_HandsOn (CM_ACA_HndFre_StHndDet1_Cx0_HandsOn), 2=Cx2_Init (CM_ACA_HndFre_StHndDet1_Cx2_Init), 1=Cx1_HandsOff (CM_ACA_HndFre_StHndDet1_Cx1_HandsOff)}, range raw 0..3, transfer-property=TRIGGERED-WITHOUT-REPETITION  # Hands detection state to enable or disable hands-free mode
    signal ACA_HndFre_StHndDet2_XIX_ACA_02_XIX_VLAN_Cockpit: start 88, 2 bit, little-endian, data-type-policy=OVERRIDE, i-signal-type=PRIMITIVE, init-value=2, base-type=BT_ACA_HndFre_StHndDet2, invalid-value=Invalid_ACA_HndFre_StHndDet2_XIX_ACA_02_XIX_VLAN_Cockpit:3, compu {3=Cx3_Fehler (CM_ACA_HndFre_StHndDet2_Cx3_Fehler), 2=Cx2_Init (CM_ACA_HndFre_StHndDet2_Cx2_Init), 0=Cx0_HandsOn (CM_ACA_HndFre_StHndDet2_Cx0_HandsOn), 1=Cx1_HandsOff (CM_ACA_HndFre_StHndDet2_Cx1_HandsOff)}, range raw 0..3, transfer-property=TRIGGERED-WITHOUT-REPETITION  # Hands detection state to enable or disable hands-free mode
    signal ACA_PreCrash_Anf_XIX_ACA_02_XIX_VLAN_Cockpit: start 90, 3 bit, little-endian, data-type-policy=OVERRIDE, i-signal-type=PRIMITIVE, init-value=0, base-type=BT_ACA_PreCrash_Anf, compu {2=Cx2_Aktionsgenerierte_Warnung_2 (CM_ACA_PreCrash_Anf_Cx2_Aktionsgenerierte_Warnung_2), 6=Cx6_Aktionsgenerierte_Warnung_6 (CM_ACA_PreCrash_Anf_Cx6_Aktionsgenerierte_Warnung_6), 3=Cx3_Aktionsgenerierte_Warnung_3 (CM_ACA_PreCrash_Anf_Cx3_Aktionsgenerierte_Warnung_3), 7=Cx7_Aktionsgenerierte_Warnung_7 (CM_ACA_PreCrash_Anf_Cx7_Aktionsgenerierte_Warnung_7), 4=Cx4_Aktionsgenerierte_Warnung_4 (CM_ACA_PreCrash_Anf_Cx4_Aktionsgenerierte_Warnung_4), 1=Cx1_Aktionsgenerierte_Warnung_1 (CM_ACA_PreCrash_Anf_Cx1_Aktionsgenerierte_Warnung_1), 5=Cx5_Aktionsgenerierte_Warnung_5 (CM_ACA_PreCrash_Anf_Cx5_Aktionsgenerierte_Warnung_5), 0=Cx0_keine_Anforderung (CM_ACA_PreCrash_Anf_Cx0_keine_Anforderung)}, range raw 0..7, transfer-property=TRIGGERED-WITHOUT-REPETITION  # Adaptive Cruise Assist 4.1 Anforderung PreCrash Gurtstraffer
    signal ACA_Laengsregelmodus_XIX_ACA_02_XIX_VLAN_Cockpit: start 93, 2 bit, little-endian, data-type-policy=OVERRIDE, i-signal-type=PRIMITIVE, init-value=0, base-type=BT_ACA_Laengsregelmodus, invalid-value=Invalid_ACA_Laengsregelmodus_XIX_ACA_02_XIX_VLAN_Cockpit:3, compu {3=Cx3_Fehler (CM_ACA_Laengsregelmodus_Cx3_Fehler), 0=Cx0_Aus (CM_ACA_Laengsregelmodus_Cx0_Aus), 1=Cx1_Abstandsregelung (CM_ACA_Laengsregelmodus_Cx1_Abstandsregelung), 2=Cx2_Geschwindigkeitsregelung (CM_ACA_Laengsregelmodus_Cx2_Geschwindigkeitsregelung)}, range raw 0..3, transfer-property=TRIGGERED-WITHOUT-REPETITION  # ACA/GRA Modus der Längsregelung
    signal ACA_Status_TriggeredLaneChange_XIX_ACA_02_XIX_VLAN_Cockpit: start 95, 3 bit, little-endian, data-type-policy=OVERRIDE, i-signal-type=PRIMITIVE, init-value=0, base-type=BT_ACA_Status_TriggeredLaneChange, invalid-value=Invalid_ACA_Status_TriggeredLaneChange_XIX_ACA_02_XIX_VLAN_Cockpit:7, compu {7=Cx7_Fehler (CM_ACA_Status_TriggeredLaneChange_Cx7_Fehler), 3=Cx3_MANEUVER_ACTIVE (CM_ACA_Status_TriggeredLaneChange_Cx3_MANEUVER_ACTIVE), 1=Cx1_NOT_AVAILABLE (CM_ACA_Status_TriggeredLaneChange_Cx1_NOT_AVAILABLE), 0=Cx0_Init (CM_ACA_Status_TriggeredLaneChange_Cx0_Init), 6=Cx6_AdditionalState2 (CM_ACA_Status_TriggeredLaneChange_Cx6_AdditionalState2), 4=Cx4_AVAILABLE_but_not_ACTIVE (CM_ACA_Status_TriggeredLaneChange_Cx4_AVAILABLE_but_not_ACTIVE), 2=Cx2_TEMPORARILY_BLOCKED (CM_ACA_Status_TriggeredLaneChange_Cx2_TEMPORARILY_BLOCKED), 5=Cx5_AdditionalState1 (CM_ACA_Status_TriggeredLaneChange_Cx5_AdditionalState1)}, range raw 0..7, transfer-property=TRIGGERED-WITHOUT-REPETITION  # Status Getriggerter Fahrstreifenwechsel im ACA
    signal ACA_Status_Color_XIX_ACA_02_XIX_VLAN_Cockpit: start 98, 4 bit, little-endian, data-type-policy=OVERRIDE, i-signal-type=PRIMITIVE, init-value=0, base-type=BT_ACA_Status_Color, invalid-value=Invalid_ACA_Status_Color_XIX_ACA_02_XIX_VLAN_Cockpit:15, compu {15=Cxf_Fehler (CM_ACA_Status_Color_Cxf_Fehler), 6=Cx6_Yellow_Flashing (CM_ACA_Status_Color_Cx6_Yellow_Flashing), 7=Cx7_Red_Flashing (CM_ACA_Status_Color_Cx7_Red_Flashing), 4=Cx4_Green_Static (CM_ACA_Status_Color_Cx4_Green_Static), 5=Cx5_Green_Flashing (CM_ACA_Status_Color_Cx5_Green_Flashing), 2=Cx2_White_Static (CM_ACA_Status_Color_Cx2_White_Static), 3=Cx3_White_Pulsing (CM_ACA_Status_Color_Cx3_White_Pulsing), 0=Cx0_Init (CM_ACA_Status_Color_Cx0_Init), 1=Cx1_Off (CM_ACA_Status_Color_Cx1_Off)}, range raw 0..15, transfer-property=TRIGGERED-WITHOUT-REPETITION  # Color signaling of the ACA4_1 Status
    signal ACA_PaCo_VideoRequest_XIX_ACA_02_XIX_VLAN_Cockpit: start 102, 2 bit, little-endian, data-type-policy=OVERRIDE, i-signal-type=PRIMITIVE, init-value=2, base-type=BT_ACA_PaCo_VideoRequest, invalid-value=Invalid_ACA_PaCo_VideoRequest_XIX_ACA_02_XIX_VLAN_Cockpit:3, compu {3=Cx3_Fehler (CM_ACA_PaCo_VideoRequest_Cx3_Fehler), 1=Cx1_Video_Request_active (CM_ACA_PaCo_VideoRequest_Cx1_Video_Request_active), 0=Cx0_Video_Request_not_active (CM_ACA_PaCo_VideoRequest_Cx0_Video_Request_not_active), 2=Cx2_Init (CM_ACA_PaCo_VideoRequest_Cx2_Init)}, range raw 0..3, transfer-property=TRIGGERED-WITHOUT-REPETITION  # Request video-data for ACA function
  pdu CentralLocking_01_XIX_VLAN_Cockpit: length=20, minimum-delay=0.02, transmission-mode-false-timing={cyclic-timing={time-offset=0.0, time-period=0.2}, event-controlled-timing={number-of-repetitions=11, repetition-period=0.02}}, transmission-mode-true-timing={cyclic-timing={time-offset=0.0, time-period=0.02}, event-controlled-timing={number-of-repetitions=11, repetition-period=0.02}}, unused-bit-pattern=0
    transmission-mode-conditions:
      {data-filter={data-filter-type=MASKED-NEW-DIFFERS-X, mask=1, x=0}, i-signal-in-i-pdu=ZV_auto_Ansteuerung}
      {data-filter={data-filter-type=MASKED-NEW-DIFFERS-X, mask=255, x=0}, i-signal-in-i-pdu=ZV_Bedienstelle_auf}
      {data-filter={data-filter-type=MASKED-NEW-DIFFERS-X, mask=255, x=0}, i-signal-in-i-pdu=ZV_Bedienstelle_zu}
      {data-filter={data-filter-type=MASKED-NEW-DIFFERS-X, mask=1, x=0}, i-signal-in-i-pdu=ZV_BT_entriegeln}
      {data-filter={data-filter-type=MASKED-NEW-DIFFERS-X, mask=1, x=0}, i-signal-in-i-pdu=ZV_BT_verriegeln}
      {data-filter={data-filter-type=MASKED-NEW-DIFFERS-X, mask=1, x=0}, i-signal-in-i-pdu=ZV_Crashfall_erkannt}
      {data-filter={data-filter-type=MASKED-NEW-DIFFERS-X, mask=1, x=0}, i-signal-in-i-pdu=ZV_Frontschloss_Taste}
      {data-filter={data-filter-type=MASKED-NEW-DIFFERS-X, mask=1, x=0}, i-signal-in-i-pdu=ZV_FT_entriegeln}
      {data-filter={data-filter-type=MASKED-NEW-DIFFERS-X, mask=1, x=0}, i-signal-in-i-pdu=ZV_FT_verriegeln}
      {data-filter={data-filter-type=MASKED-NEW-DIFFERS-X, mask=1, x=0}, i-signal-in-i-pdu=ZV_HBFS_entriegeln}
      {data-filter={data-filter-type=MASKED-NEW-DIFFERS-X, mask=1, x=0}, i-signal-in-i-pdu=ZV_HBFS_verriegeln}
      {data-filter={data-filter-type=MASKED-NEW-DIFFERS-X, mask=1, x=0}, i-signal-in-i-pdu=ZV_HFS_entriegeln}
      {data-filter={data-filter-type=MASKED-NEW-DIFFERS-X, mask=1, x=0}, i-signal-in-i-pdu=ZV_HFS_verriegeln}
      {data-filter={data-filter-type=MASKED-NEW-DIFFERS-X, mask=1, x=0}, i-signal-in-i-pdu=ZV_HD_Taste_zu}
      {data-filter={data-filter-type=MASKED-NEW-DIFFERS-X, mask=1, x=0}, i-signal-in-i-pdu=ZV_Heckentriegelunsanforderung}
      {data-filter={data-filter-type=MASKED-NEW-DIFFERS-X, mask=1, x=0}, i-signal-in-i-pdu=ZV_LED_Steuerung}
      {data-filter={data-filter-type=MASKED-NEW-DIFFERS-X, mask=1, x=0}, i-signal-in-i-pdu=ZV_LED_Uebernahme}
      {data-filter={data-filter-type=MASKED-NEW-DIFFERS-X, mask=65535, x=0}, i-signal-in-i-pdu=ZV_Signatur}
      {data-filter={data-filter-type=MASKED-NEW-DIFFERS-X, mask=1, x=0}, i-signal-in-i-pdu=ZV_Spg_Anklappen}
      {data-filter={data-filter-type=MASKED-NEW-DIFFERS-X, mask=1, x=0}, i-signal-in-i-pdu=ZV_Heckschloss_Taste_auf}
      {data-filter={data-filter-type=MASKED-NEW-DIFFERS-X, mask=1, x=0}, i-signal-in-i-pdu=ZV_zentral_entsafen}
      {data-filter={data-filter-type=MASKED-NEW-DIFFERS-X, mask=1, x=0}, i-signal-in-i-pdu=ZV_zentral_safen}
      {data-filter={data-filter-type=MASKED-NEW-DIFFERS-X, mask=1, x=0}, i-signal-in-i-pdu=ZV_zu_Zeitl_Nachverr}
      {data-filter={data-filter-type=MASKED-NEW-DIFFERS-X, mask=255, x=0}, i-signal-in-i-pdu=ZV_TAG_BT_verfahren}
      {data-filter={data-filter-type=MASKED-NEW-DIFFERS-X, mask=255, x=0}, i-signal-in-i-pdu=ZV_TAG_HBFS_verfahren}
      {data-filter={data-filter-type=MASKED-NEW-DIFFERS-X, mask=255, x=0}, i-signal-in-i-pdu=ZV_TAG_FT_verfahren}
      {data-filter={data-filter-type=MASKED-NEW-DIFFERS-X, mask=255, x=0}, i-signal-in-i-pdu=ZV_TAG_HFS_verfahren}
      {data-filter={data-filter-type=MASKED-NEW-DIFFERS-X, mask=255, x=0}, i-signal-in-i-pdu=SSA_Heckschloss_ansteuern}
      {data-filter={data-filter-type=MASKED-NEW-DIFFERS-X, mask=255, x=0}, i-signal-in-i-pdu=SSA_Tankklappe_ansteuern}
      {data-filter={data-filter-type=MASKED-NEW-DIFFERS-X, mask=255, x=0}, i-signal-in-i-pdu=ZV_Anf_HSK}
      {data-filter={data-filter-type=MASKED-NEW-DIFFERS-X, mask=1, x=0}, i-signal-in-i-pdu=ZV_Tasten_HMI_Anf}
    signal CentralLocking_01_CRC_XIX_CentralLocking_01_XIX_VLAN_Cockpit: start 0, 8 bit, little-endian, data-type-policy=OVERRIDE, i-signal-type=PRIMITIVE, init-value=0, base-type=BT_CentralLocking_01_CRC, compu {phys=raw for raw 0..255}, range phys 0..255, raw 0..255, transfer-property=TRIGGERED-WITHOUT-REPETITION
    signal CentralLocking_01_BZ_XIX_CentralLocking_01_XIX_VLAN_Cockpit: start 8, 4 bit, little-endian, data-type-policy=OVERRIDE, i-signal-type=PRIMITIVE, init-value=0, base-type=BT_CentralLocking_01_BZ, compu {phys=raw for raw 0..15}, range phys 0..15, raw 0..15, transfer-property=TRIGGERED-WITHOUT-REPETITION
    signal ZV_FD_Taste_auf_XIX_CentralLocking_01_XIX_VLAN_Cockpit: start 12, 1 bit, little-endian, data-type-policy=OVERRIDE, i-signal-type=PRIMITIVE, init-value=0, base-type=BT_ZV_FD_Taste_auf, compu {0=Cx0_Taste_FD_auf_nicht_gedrueckt (CM_ZV_FD_Taste_auf_Cx0_Taste_FD_auf_nicht_gedrueckt), 1=Cx1_Taste_FD_auf_gedrueckt (CM_ZV_FD_Taste_auf_Cx1_Taste_FD_auf_gedrueckt)}, range raw 0..1, transfer-property=TRIGGERED-WITHOUT-REPETITION  # Taster zum Öffnen der Frontklappe über BAP
    signal ZV_Freigabe_Heckschloss_XIX_CentralLocking_01_XIX_VLAN_Cockpit: start 13, 1 bit, little-endian, data-type-policy=OVERRIDE, i-signal-type=PRIMITIVE, init-value=0, base-type=BT_ZV_Freigabe_Heckschloss, compu {0=Cx0_keine_Freigabe_Heckschloss_ansteuern (CM_ZV_Freigabe_Heckschloss_Cx0_keine_Freigabe_Heckschloss_ansteuern), 1=Cx1_Freigabe_Heckschloss_ansteuern (CM_ZV_Freigabe_Heckschloss_Cx1_Freigabe_Heckschloss_ansteuern)}, range raw 0..1, transfer-property=TRIGGERED-WITHOUT-REPETITION  # ASI L Freigabe zur Ansteuerung des Heckschlosses
    signal ZV_Anf_Fanghaken_Frontschloss_XIX_CentralLocking_01_XIX_VLAN_Cockpit: start 14, 3 bit, little-endian, data-type-policy=OVERRIDE, i-signal-type=PRIMITIVE, init-value=0, base-type=BT_ZV_Anf_Fanghaken_Frontschloss, invalid-value=Invalid_ZV_Anf_Fanghaken_Frontschloss_XIX_CentralLocking_01_XIX_VLAN_Cockpit:4, compu {4=Cx4_Fehler (CM_ZV_Anf_Fanghaken_Frontschloss_Cx4_Fehler), 3=Cx3_Ansteuerung_in_Richtung_zu_Sperrklinke_koppeln (CM_ZV_Anf_Fanghaken_Frontschloss_Cx3_Ansteuerung_in_Richtung_zu_Sperrklinke_koppeln) (Ansteuerung_in_Richtung_zu _(Sperrklinke_koppeln)), 2=Cx2_Ansteuerung_in_Richtung_auf (CM_ZV_Anf_Fanghaken_Frontschloss_Cx2_Ansteuerung_in_Richtung_auf), 0=Cx0_Init_oder_nicht_verbaut (CM_ZV_Anf_Fanghaken_Frontschloss_Cx0_Init_oder_nicht_verbaut), 1=Cx1_keine_Freigabe (CM_ZV_Anf_Fanghaken_Frontschloss_Cx1_keine_Freigabe)}, range raw 0..4, transfer-property=TRIGGERED-WITHOUT-REPETITION  # Freigabe und Anforderung der Ansteuerung Frontschloss (TrunkEntrapment und ZV) Das SAR prüft als 2. Instanz die Geschwindigkeit und kann die Ansteuerung der Sekundärverriegelung freigeben (FUSI-Anforderungen). Muss über eine E2E-Absicherung verfügen.
    signal ZV_Anf_Heckschloss_ansteuern_XIX_CentralLocking_01_XIX_VLAN_Cockpit: start 20, 3 bit, little-endian, data-type-policy=OVERRIDE, i-signal-type=PRIMITIVE, init-value=0, base-type=BT_ZV_Anf_Heckschloss_ansteuern, compu {0=Cx0_Init_oder_nicht_verbaut (CM_ZV_Anf_Heckschloss_ansteuern_Cx0_Init_oder_nicht_verbaut), 2=Cx2_Ansteuerung_in_Richtung_auf (CM_ZV_Anf_Heckschloss_ansteuern_Cx2_Ansteuerung_in_Richtung_auf), 3=Cx3_Ansteuerung_in_Richtung_zu (CM_ZV_Anf_Heckschloss_ansteuern_Cx3_Ansteuerung_in_Richtung_zu), 1=Cx1_keine_Freigabe (CM_ZV_Anf_Heckschloss_ansteuern_Cx1_keine_Freigabe)}, range raw 0..3, transfer-property=TRIGGERED-WITHOUT-REPETITION  # Freigabe und Anforderung der Ansteuerung des Heckschlosses Das Signal muss über eine E2E-Absicherung verfügen.
    signal ZV_auto_Ansteuerung_XIX_CentralLocking_01_XIX_VLAN_Cockpit: start 23, 1 bit, little-endian, data-type-policy=OVERRIDE, i-signal-type=PRIMITIVE, init-value=0, base-type=BT_ZV_auto_Ansteuerung, compu {0=Cx0_Kein_Autolock_Unlock (CM_ZV_auto_Ansteuerung_Cx0_Kein_Autolock_Unlock), 1=Cx1_Autolock_Unlock (CM_ZV_auto_Ansteuerung_Cx1_Autolock_Unlock)}, range raw 0..1, transfer-property=TRIGGERED-WITHOUT-REPETITION  # Kennung für die automatische Ansteuerung der Zentralverriegelung (Autolock/Autounlock)
    signal ZV_Bedienstelle_auf_XIX_CentralLocking_01_XIX_VLAN_Cockpit: start 24, 4 bit, little-endian, data-type-policy=OVERRIDE, i-signal-type=PRIMITIVE, init-value=0, base-type=BT_ZV_Bedienstelle_auf, compu {0=Cx0_keine_ZV_Bedienstelle_in_Richtung_auf_betaetigt (CM_ZV_Bedienstelle_auf_Cx0_keine_ZV_Bedienstelle_in_Richtung_auf_betaetigt) (keine ZV Bedienstelle in Richtung auf betaetigt), 3=Cx3_Bedienstelle_Funk_betaetigt (CM_ZV_Bedienstelle_auf_Cx3_Bedienstelle_Funk_betaetigt) (Bedienstelle Funk betaetigt), 1=Cx1_Bedienstelle_FT_betaetigt (CM_ZV_Bedienstelle_auf_Cx1_Bedienstelle_FT_betaetigt) (Bedienstelle FT betaetigt), 5=Cx5_Bedienstelle_Mobile_Device_Key_erkannt (CM_ZV_Bedienstelle_auf_Cx5_Bedienstelle_Mobile_Device_Key_erkannt) (Bedienstelle Mobile Device Key erkannt), 6=Cx6_Bedienstelle_Notentriegelung_Transponder_erkannt (CM_ZV_Bedienstelle_auf_Cx6_Bedienstelle_Notentriegelung_Transponder_erkannt) (Bedienstelle Notentriegelung Transponder erkannt), 2=Cx2_Bedienstelle_Kessy_erkannt (CM_ZV_Bedienstelle_auf_Cx2_Bedienstelle_Kessy_erkannt) (Bedienstelle Kessy erkannt), 7=Cx7_Bedienstelle_Remote_Unlock_erkannt (CM_ZV_Bedienstelle_auf_Cx7_Bedienstelle_Remote_Unlock_erkannt) (Bedienstelle Remote Unlock erkannt), 8=Cx8_Bedienstelle_Emergency_Assist_erkannt (CM_ZV_Bedienstelle_auf_Cx8_Bedienstelle_Emergency_Assist_erkannt) (Bedienstelle Emergency Assist erkannt), 4=Cx4_Bedienstelle_NFC_erkannt (CM_ZV_Bedienstelle_auf_Cx4_Bedienstelle_NFC_erkannt) (Bedienstelle NFC erkannt), 9=Cx9_Bedienstelle_VIP_erkannt (CM_ZV_Bedienstelle_auf_Cx9_Bedienstelle_VIP_erkannt) (Bedienstelle VIP erkannt)}, range raw 0..9, transfer-property=TRIGGERED-WITHOUT-REPETITION  # ZV Schliessstellen in Richtung auf
    signal ZV_Bedienstelle_zu_XIX_CentralLocking_01_XIX_VLAN_Cockpit: start 28, 4 bit, little-endian, data-type-policy=OVERRIDE, i-signal-type=PRIMITIVE, init-value=0, base-type=BT_ZV_Bedienstelle_zu, compu {7=Cx7_Bedienstelle_Remote_Lock_erkannt (CM_ZV_Bedienstelle_zu_Cx7_Bedienstelle_Remote_Lock_erkannt) (Bedienstelle Remote Lock erkannt), 8=Cx8_Bedienstelle_Precrash_erkannt (CM_ZV_Bedienstelle_zu_Cx8_Bedienstelle_Precrash_erkannt) (Bedienstelle Precrash erkannt), 4=Cx4_Bedienstelle_NFC_erkannt (CM_ZV_Bedienstelle_zu_Cx4_Bedienstelle_NFC_erkannt) (Bedienstelle NFC erkannt), 2=Cx2_Bedienstelle_Kessy_erkannt (CM_ZV_Bedienstelle_zu_Cx2_Bedienstelle_Kessy_erkannt) (Bedienstelle Kessy erkannt), 0=Cx0_keine_ZV_Bedienstelle_in_Richtung_zu_betaetigt (CM_ZV_Bedienstelle_zu_Cx0_keine_ZV_Bedienstelle_in_Richtung_zu_betaetigt) (keine ZV Bedienstelle in Richtung zu betaetigt), 5=Cx5_Bedienstelle_Mobile_Device_Key_erkannt (CM_ZV_Bedienstelle_zu_Cx5_Bedienstelle_Mobile_Device_Key_erkannt) (Bedienstelle Mobile Device Key erkannt), 11=Cxb_Bedienstelle_PiloPa_erkannt (CM_ZV_Bedienstelle_zu_Cxb_Bedienstelle_PiloPa_erkannt) (Bedienstelle PiloPa erkannt), 1=Cx1_Bedienstelle_FT_betaetigt (CM_ZV_Bedienstelle_zu_Cx1_Bedienstelle_FT_betaetigt) (Bedienstelle FT betaetigt), 10=Cxa_Bedienstelle_ECL_erkannt (CM_ZV_Bedienstelle_zu_Cxa_Bedienstelle_ECL_erkannt) (Bedienstelle ECL erkannt), 6=Cx6_Bedienstelle_Notverriegelung_Transponder_erkannt (CM_ZV_Bedienstelle_zu_Cx6_Bedienstelle_Notverriegelung_Transponder_erkannt) (Bedienstelle Notverriegelung Transponder erkannt), 9=Cx9_Bedienstelle_VIP_erkannt (CM_ZV_Bedienstelle_zu_Cx9_Bedienstelle_VIP_erkannt) (Bedienstelle VIP erkannt), 3=Cx3_Bedienstelle_Funk_betaetigt (CM_ZV_Bedienstelle_zu_Cx3_Bedienstelle_Funk_betaetigt) (Bedienstelle Funk betaetigt)}, range raw 0..11, transfer-property=TRIGGERED-WITHOUT-REPETITION  # ZV Schliessstellen in Richtung zu
    signal ZV_BT_entriegeln_XIX_CentralLocking_01_XIX_VLAN_Cockpit: start 32, 1 bit, little-endian, data-type-policy=OVERRIDE, i-signal-type=PRIMITIVE, init-value=0, base-type=BT_ZV_BT_entriegeln, compu {1=Cx1_BT_ist_zu_entriegeln (CM_ZV_BT_entriegeln_Cx1_BT_ist_zu_entriegeln), 0=Cx0_BT_nicht_entriegeln (CM_ZV_BT_entriegeln_Cx0_BT_nicht_entriegeln)}, range raw 0..1, transfer-property=TRIGGERED-WITHOUT-REPETITION  # Beifahrertür entriegeln (Anforderung ZV)
    signal ZV_BT_offen_XIX_CentralLocking_01_XIX_VLAN_Cockpit: start 33, 1 bit, little-endian, data-type-policy=OVERRIDE, i-signal-type=PRIMITIVE, init-value=0, base-type=BT_ZV_BT_offen, compu {0=Cx0_BT_geschlossen (CM_ZV_BT_offen_Cx0_BT_geschlossen), 1=Cx1_BT_geoeffnet (CM_ZV_BT_offen_Cx1_BT_geoeffnet)}, range raw 0..1, transfer-property=TRIGGERED-WITHOUT-REPETITION  # gespiegeltes Bit BT_Tuer_geoeffnet TSG_BT_1 Botschaft
    signal ZV_BT_verriegeln_XIX_CentralLocking_01_XIX_VLAN_Cockpit: start 34, 1 bit, little-endian, data-type-policy=OVERRIDE, i-signal-type=PRIMITIVE, init-value=0, base-type=BT_ZV_BT_verriegeln, compu {1=Cx1_BT_verriegeln (CM_ZV_BT_verriegeln_Cx1_BT_verriegeln), 0=Cx0_BT_nicht_verriegeln (CM_ZV_BT_verriegeln_Cx0_BT_nicht_verriegeln)}, range raw 0..1, transfer-property=TRIGGERED-WITHOUT-REPETITION  # Verriegelungsanforderung ZV für BT
    signal ZV_Crashfall_erkannt_XIX_CentralLocking_01_XIX_VLAN_Cockpit: start 35, 1 bit, little-endian, data-type-policy=OVERRIDE, i-signal-type=PRIMITIVE, init-value=0, base-type=BT_ZV_Crashfall_erkannt, compu {1=Cx1_Crashfall_erkannt (CM_ZV_Crashfall_erkannt_Cx1_Crashfall_erkannt) (Crashfall erkannt), 0=Cx0_kein_Crashfall_erkannt (CM_ZV_Crashfall_erkannt_Cx0_kein_Crashfall_erkannt)}, range raw 0..1, transfer-property=TRIGGERED-WITHOUT-REPETITION  # Crasherkennung ZV
    signal ZV_Txt_Handbremse_Hinweis_XIX_CentralLocking_01_XIX_VLAN_Cockpit: start 36, 1 bit, little-endian, data-type-policy=OVERRIDE, i-signal-type=PRIMITIVE, init-value=0, base-type=BT_ZV_Txt_Handbremse_Hinweis, compu {1=Cx1_aktiv (CM_ZV_Txt_Handbremse_Hinweis_Cx1_aktiv), 0=Cx0_inaktiv (CM_ZV_Txt_Handbremse_Hinweis_Cx0_inaktiv)}, range raw 0..1, transfer-property=TRIGGERED-WITHOUT-REPETITION  # Infotext NAR für die Vorbedingung "Handbremse" für Öffnen des Frontdeckesl oder des Heckdeckels / der Heckklappe über die Fahrerrauminnentaster.
    signal ZV_Frontdeckel_offen_XIX_CentralLocking_01_XIX_VLAN_Cockpit: start 37, 1 bit, little-endian, data-type-policy=OVERRIDE, i-signal-type=PRIMITIVE, init-value=0, base-type=BT_ZV_Frontdeckel_offen, compu {0=Cx0_Frontdeckel_zu (CM_ZV_Frontdeckel_offen_Cx0_Frontdeckel_zu), 1=Cx1_Frontdeckel_auf (CM_ZV_Frontdeckel_offen_Cx1_Frontdeckel_auf)}, range raw 0..1, transfer-property=TRIGGERED-WITHOUT-REPETITION  # Status Frontdeckel
    signal ZV_Frontschloss_Hauptraste_XIX_CentralLocking_01_XIX_VLAN_Cockpit: start 38, 2 bit, little-endian, data-type-policy=OVERRIDE, i-signal-type=PRIMITIVE, init-value=2, base-type=BT_ZV_Frontschloss_Hauptraste, invalid-value=Invalid_ZV_Frontschloss_Hauptraste_XIX_CentralLocking_01_XIX_VLAN_Cockpit:3, compu {3=Cx3_Fehler (CM_ZV_Frontschloss_Hauptraste_Cx3_Fehler), 0=Cx0_geschlossen (CM_ZV_Frontschloss_Hauptraste_Cx0_geschlossen), 1=Cx1_offen (CM_ZV_Frontschloss_Hauptraste_Cx1_offen), 2=Cx2_Init_oder_nicht_verbaut (CM_ZV_Frontschloss_Hauptraste_Cx2_Init_oder_nicht_verbaut)}, range raw 0..3, transfer-property=TRIGGERED-WITHOUT-REPETITION  # Drehfalle oder Hauptraste Frontchloss Das Signal muss über eine E2E-Absicherung verfügen.
    signal ZV_Frontschloss_Sperrklinke_XIX_CentralLocking_01_XIX_VLAN_Cockpit: start 40, 2 bit, little-endian, data-type-policy=OVERRIDE, i-signal-type=PRIMITIVE, init-value=0, base-type=BT_ZV_Frontschloss_Sperrklinke, invalid-value=Invalid_ZV_Frontschloss_Sperrklinke_XIX_CentralLocking_01_XIX_VLAN_Cockpit:3, compu {3=Cx3_Fehler (CM_ZV_Frontschloss_Sperrklinke_Cx3_Fehler), 2=Cx2_Sperrklinke_entkoppelt (CM_ZV_Frontschloss_Sperrklinke_Cx2_Sperrklinke_entkoppelt), 1=Cx1_Sperrklinke_gekoppelt (CM_ZV_Frontschloss_Sperrklinke_Cx1_Sperrklinke_gekoppelt), 0=Cx0_Init_oder_nicht_verbaut (CM_ZV_Frontschloss_Sperrklinke_Cx0_Init_oder_nicht_verbaut)}, range raw 0..3, transfer-property=TRIGGERED-WITHOUT-REPETITION  # Status Sperrklinke Frontchloss Das Signal muss über eine E2E-Absicherung verfügen.
    signal ZV_Frontschloss_Taste_XIX_CentralLocking_01_XIX_VLAN_Cockpit: start 42, 1 bit, little-endian, data-type-policy=OVERRIDE, i-signal-type=PRIMITIVE, init-value=0, base-type=BT_ZV_Frontschloss_Taste, compu {1=Cx1_Taste_entprellt_betaetigt (CM_ZV_Frontschloss_Taste_Cx1_Taste_entprellt_betaetigt), 0=Cx0_Taste_nicht_betaetigt (CM_ZV_Frontschloss_Taste_Cx0_Taste_nicht_betaetigt)}, range raw 0..1, transfer-property=TRIGGERED-WITHOUT-REPETITION  # Betätigung Taster für Frontdeckel im Innenraum (Schweller)
    signal ZV_Frontschlossstatus_XIX_CentralLocking_01_XIX_VLAN_Cockpit: start 43, 2 bit, little-endian, data-type-policy=OVERRIDE, i-signal-type=PRIMITIVE, init-value=2, base-type=BT_ZV_Frontschlossstatus, invalid-value=Invalid_ZV_Frontschlossstatus_XIX_CentralLocking_01_XIX_VLAN_Cockpit:3, compu {3=Cx3_Fehler (CM_ZV_Frontschlossstatus_Cx3_Fehler), 1=Cx1_offen (CM_ZV_Frontschlossstatus_Cx1_offen), 0=Cx0_geschlossen (CM_ZV_Frontschlossstatus_Cx0_geschlossen), 2=Cx2_Init_oder_nicht_verbaut (CM_ZV_Frontschlossstatus_Cx2_Init_oder_nicht_verbaut)}, range raw 0..3, transfer-property=TRIGGERED-WITHOUT-REPETITION  # Rückmeldung Status Frontschloss
    signal ZV_FT_entriegeln_XIX_CentralLocking_01_XIX_VLAN_Cockpit: start 45, 1 bit, little-endian, data-type-policy=OVERRIDE, i-signal-type=PRIMITIVE, init-value=0, base-type=BT_ZV_FT_entriegeln, compu {1=Cx1_FT_entriegeln (CM_ZV_FT_entriegeln_Cx1_FT_entriegeln), 0=Cx0_FT_nicht_entriegeln (CM_ZV_FT_entriegeln_Cx0_FT_nicht_entriegeln)}, range raw 0..1, transfer-property=TRIGGERED-WITHOUT-REPETITION  # Entriegelungsanforderung ZV für FT
    signal ZV_FT_offen_XIX_CentralLocking_01_XIX_VLAN_Cockpit: start 46, 1 bit, little-endian, data-type-policy=OVERRIDE, i-signal-type=PRIMITIVE, init-value=0, base-type=BT_ZV_FT_offen, compu {0=Cx0_FT_geschlossen (CM_ZV_FT_offen_Cx0_FT_geschlossen), 1=Cx1_FT_geoeffnet (CM_ZV_FT_offen_Cx1_FT_geoeffnet)}, range raw 0..1, transfer-property=TRIGGERED-WITHOUT-REPETITION  # gespiegeltes Bit FT_Tuer_geoeffnet TSG_FT_1 Botschaft
    signal ZV_FT_verriegeln_XIX_CentralLocking_01_XIX_VLAN_Cockpit: start 47, 1 bit, little-endian, data-type-policy=OVERRIDE, i-signal-type=PRIMITIVE, init-value=0, base-type=BT_ZV_FT_verriegeln, compu {1=Cx1_FT_verriegeln (CM_ZV_FT_verriegeln_Cx1_FT_verriegeln), 0=Cx0_FT_nicht_verriegeln (CM_ZV_FT_verriegeln_Cx0_FT_nicht_verriegeln)}, range raw 0..1, transfer-property=TRIGGERED-WITHOUT-REPETITION  # Verriegelungsanforderung ZV für FT
    signal ZV_HBFS_entriegeln_XIX_CentralLocking_01_XIX_VLAN_Cockpit: start 48, 1 bit, little-endian, data-type-policy=OVERRIDE, i-signal-type=PRIMITIVE, init-value=0, base-type=BT_ZV_HBFS_entriegeln, compu {0=Cx0_inaktiv (CM_ZV_HBFS_entriegeln_Cx0_inaktiv), 1=Cx1_aktiv (CM_ZV_HBFS_entriegeln_Cx1_aktiv)}, range raw 0..1, transfer-property=TRIGGERED-WITHOUT-REPETITION  # Entriegelungsanforderung ZV für HBFS
    signal ZV_HBFS_offen_XIX_CentralLocking_01_XIX_VLAN_Cockpit: start 49, 1 bit, little-endian, data-type-policy=OVERRIDE, i-signal-type=PRIMITIVE, init-value=0, base-type=BT_ZV_HBFS_offen, compu {1=Cx1_offen (CM_ZV_HBFS_offen_Cx1_offen), 0=Cx0_geschlossen (CM_ZV_HBFS_offen_Cx0_geschlossen)}, range raw 0..1, transfer-property=TRIGGERED-WITHOUT-REPETITION  # gespiegeltes Bit HBFS_Tuer_geoeffnet TSG_HBFS_1 Botschaft
    signal ZV_HBFS_verriegeln_XIX_CentralLocking_01_XIX_VLAN_Cockpit: start 50, 1 bit, little-endian, data-type-policy=OVERRIDE, i-signal-type=PRIMITIVE, init-value=0, base-type=BT_ZV_HBFS_verriegeln, compu {0=Cx0_inaktiv (CM_ZV_HBFS_verriegeln_Cx0_inaktiv), 1=Cx1_aktiv (CM_ZV_HBFS_verriegeln_Cx1_aktiv)}, range raw 0..1, transfer-property=TRIGGERED-WITHOUT-REPETITION  # Verriegelungsanforderung ZV für HBFS
    signal ZV_HFS_entriegeln_XIX_CentralLocking_01_XIX_VLAN_Cockpit: start 51, 1 bit, little-endian, data-type-policy=OVERRIDE, i-signal-type=PRIMITIVE, init-value=0, base-type=BT_ZV_HFS_entriegeln, compu {0=Cx0_inaktiv (CM_ZV_HFS_entriegeln_Cx0_inaktiv), 1=Cx1_aktiv (CM_ZV_HFS_entriegeln_Cx1_aktiv)}, range raw 0..1, transfer-property=TRIGGERED-WITHOUT-REPETITION  # Entriegelungsanforderung ZV für HFS
    signal ZV_HFS_verriegeln_XIX_CentralLocking_01_XIX_VLAN_Cockpit: start 53, 1 bit, little-endian, data-type-policy=OVERRIDE, i-signal-type=PRIMITIVE, init-value=0, base-type=BT_ZV_HFS_verriegeln, compu {0=Cx0_inaktiv (CM_ZV_HFS_verriegeln_Cx0_inaktiv), 1=Cx1_aktiv (CM_ZV_HFS_verriegeln_Cx1_aktiv)}, range raw 0..1, transfer-property=TRIGGERED-WITHOUT-REPETITION  # Verriegelungsanforderung ZV für HFS
    signal ZV_HD_Taste_zu_XIX_CentralLocking_01_XIX_VLAN_Cockpit: start 54, 1 bit, little-endian, data-type-policy=OVERRIDE, i-signal-type=PRIMITIVE, init-value=0, base-type=BT_ZV_HD_Taste_zu, compu {0=Cx0_Taste_HD_zu_nicht_gedrueckt (CM_ZV_HD_Taste_zu_Cx0_Taste_HD_zu_nicht_gedrueckt), 1=Cx1_Taste_HD_zu_gedrueckt (CM_ZV_HD_Taste_zu_Cx1_Taste_HD_zu_gedrueckt)}, range raw 0..1, transfer-property=TRIGGERED-WITHOUT-REPETITION  # Taster zum Schliessen der Heckklappe über BAP
    signal ZV_Heckentriegelunsanforderung_XIX_CentralLocking_01_XIX_VLAN_Cockpit: start 55, 1 bit, little-endian, data-type-policy=OVERRIDE, i-signal-type=PRIMITIVE, init-value=0, base-type=BT_ZV_Heckentriegelunsanforderung, compu {0=Cx0_Taste_Heckschloss_auf_nicht_gedrueckt (CM_ZV_Heckentriegelunsanforderung_Cx0_Taste_Heckschloss_auf_nicht_gedrueckt), 1=Cx1_Taste_Heckschloss_auf_gedrueckt (CM_ZV_Heckentriegelunsanforderung_Cx1_Taste_Heckschloss_auf_gedrueckt)}, range raw 0..1, transfer-property=TRIGGERED-WITHOUT-REPETITION  # Taster zum Öffnen der Heckklappe über BAP oder einem diskret angeschlossen Schalter
    signal ZV_Heckoeffnungsfreigabe_XIX_CentralLocking_01_XIX_VLAN_Cockpit: start 56, 1 bit, little-endian, data-type-policy=OVERRIDE, i-signal-type=PRIMITIVE, init-value=0, base-type=BT_ZV_Heckoeffnungsfreigabe, compu {1=Cx1_Heckoeffnungsfreigabe (CM_ZV_Heckoeffnungsfreigabe_Cx1_Heckoeffnungsfreigabe) (Hecköffnungsfreigabe), 0=Cx0_keine_Freigabe (CM_ZV_Heckoeffnungsfreigabe_Cx0_keine_Freigabe) (keine Freigabe)}, range raw 0..1, transfer-property=TRIGGERED-WITHOUT-REPETITION  # Heckeinzelentriegelung oder Heckschlosseinzelentriegelung
    signal ZV_HSK_Freigabe_XIX_CentralLocking_01_XIX_VLAN_Cockpit: start 57, 1 bit, little-endian, data-type-policy=OVERRIDE, i-signal-type=PRIMITIVE, init-value=0, base-type=BT_ZV_HSK_Freigabe, compu {0=Cx0_erlauben (CM_ZV_HSK_Freigabe_Cx0_erlauben), 1=Cx1_sperren (CM_ZV_HSK_Freigabe_Cx1_sperren)}, range raw 0..1, transfer-property=TRIGGERED-WITHOUT-REPETITION  # Handschuhkastenfreigabe
    signal ZV_LED_Steuerung_XIX_CentralLocking_01_XIX_VLAN_Cockpit: start 58, 1 bit, little-endian, data-type-policy=OVERRIDE, i-signal-type=PRIMITIVE, init-value=0, base-type=BT_ZV_LED_Steuerung, compu {1=Cx1_LED_ein (CM_ZV_LED_Steuerung_Cx1_LED_ein), 0=Cx0_LED_aus (CM_ZV_LED_Steuerung_Cx0_LED_aus)}, range raw 0..1, transfer-property=TRIGGERED-WITHOUT-REPETITION  # Ansteuerung der LED's in den Tueren; BAF gilt nicht für dieses Bit
    signal ZV_LED_Uebernahme_XIX_CentralLocking_01_XIX_VLAN_Cockpit: start 59, 1 bit, little-endian, data-type-policy=OVERRIDE, i-signal-type=PRIMITIVE, init-value=0, base-type=BT_ZV_LED_Uebernahme, compu {0=Cx0_Init (CM_ZV_LED_Uebernahme_Cx0_Init), 1=Cx1_TSG_uebernimmt_LED_Steuerung (CM_ZV_LED_Uebernahme_Cx1_TSG_uebernimmt_LED_Steuerung)}, range raw 0..1, transfer-property=TRIGGERED-WITHOUT-REPETITION  # Uebernahme der LED Steuerung durch das TSG FT
    signal ZV_gesafet_extern_ist_02_XIX_CentralLocking_01_XIX_VLAN_Cockpit: start 60, 2 bit, little-endian, data-type-policy=OVERRIDE, i-signal-type=PRIMITIVE, init-value=2, base-type=BT_ZV_gesafet_extern_ist_02, invalid-value=Invalid_ZV_gesafet_extern_ist_02_XIX_CentralLocking_01_XIX_VLAN_Cockpit:3, compu {3=Cx3_Fehler (CM_ZV_gesafet_extern_ist_02_Cx3_Fehler), 2=Cx2_Init (CM_ZV_gesafet_extern_ist_02_Cx2_Init), 0=Cx0_Fahrzeug_nicht_gesafet (CM_ZV_gesafet_extern_ist_02_Cx0_Fahrzeug_nicht_gesafet), 1=Cx1_Fahrzeug_gesafet_Istzustand (CM_ZV_gesafet_extern_ist_02_Cx1_Fahrzeug_gesafet_Istzustand)}, range raw 0..3, transfer-property=TRIGGERED-WITHOUT-REPETITION  # Istzustand: Fahrzeug aussen gesafet
    signal ZV_SafeFunktion_aktiv_XIX_CentralLocking_01_XIX_VLAN_Cockpit: start 62, 1 bit, little-endian, data-type-policy=OVERRIDE, i-signal-type=PRIMITIVE, base-type=BT_ZV_SafeFunktion_aktiv, compu {0=Cx0_inaktiv (CM_ZV_SafeFunktion_aktiv_Cx0_inaktiv), 1=Cx1_aktiv (CM_ZV_SafeFunktion_aktiv_Cx1_aktiv)}, range raw 0..1, transfer-property=TRIGGERED-WITHOUT-REPETITION  # Statusübermittlung ob die Safe Funktion im Fzg. aktiv ist. Das Kombi benötigt das Signal, um den Text Safelock aktiv anzuzeigen.
    signal ZV_Signatur_XIX_CentralLocking_01_XIX_VLAN_Cockpit: start 67, 11 bit, little-endian, data-type-policy=OVERRIDE, i-signal-type=PRIMITIVE, init-value=0, base-type=BT_ZV_Signatur, compu {phys=raw for raw 0..2047}, range phys 0..2047, raw 0..2047, transfer-property=TRIGGERED-WITHOUT-REPETITION  # Signatur der ZV
    signal ZV_Spg_Anklappen_XIX_CentralLocking_01_XIX_VLAN_Cockpit: start 78, 1 bit, little-endian, data-type-policy=OVERRIDE, i-signal-type=PRIMITIVE, init-value=0, base-type=BT_ZV_Spg_Anklappen, compu {0=Cx0_inaktiv (CM_ZV_Spg_Anklappen_Cx0_inaktiv), 1=Cx1_aktiv (CM_ZV_Spg_Anklappen_Cx1_aktiv)}, range raw 0..1, transfer-property=TRIGGERED-WITHOUT-REPETITION  # Anforderung über ZV: Spiegel sind anzuklappen
    signal APP_Kundenwarnung_Panik_XIX_CentralLocking_01_XIX_VLAN_Cockpit: start 79, 1 bit, little-endian, data-type-policy=OVERRIDE, i-signal-type=PRIMITIVE, init-value=1, base-type=BT_APP_Kundenwarnung_Panik, compu {0=Cx0_Nicht_aktiv (CM_APP_Kundenwarnung_Panik_Cx0_Nicht_aktiv), 1=Cx1_Aktiv (CM_APP_Kundenwarnung_Panik_Cx1_Aktiv)}, range raw 0..1, transfer-property=TRIGGERED-WITHOUT-REPETITION  # Kundenwarnung Panik signal
    signal ZV_APP_Kundenwarnung_Notein_XIX_CentralLocking_01_XIX_VLAN_Cockpit: start 80, 1 bit, little-endian, data-type-policy=OVERRIDE, i-signal-type=PRIMITIVE, init-value=0, base-type=BT_ZV_APP_Kundenwarnung_Notein, compu {1=Cx1_Aktiv (CM_ZV_APP_Kundenwarnung_Notein_Cx1_Aktiv), 0=Cx0_Nicht_aktiv (CM_ZV_APP_Kundenwarnung_Notein_Cx0_Nicht_aktiv) (Nicht aktiv)}, range raw 0..1, transfer-property=TRIGGERED-WITHOUT-REPETITION  # Information an den Kunden dass eine Noteinspeisung erkannt wurde, um in der APP die Handlungsanweisung anzuzeigen.
    signal ZV_Heckschloss_Taste_auf_XIX_CentralLocking_01_XIX_VLAN_Cockpit: start 81, 1 bit, little-endian, data-type-policy=OVERRIDE, i-signal-type=PRIMITIVE, init-value=0, base-type=BT_ZV_Heckschloss_Taste_auf, compu {0=Cx0_Taste_Heckschloss_auf_nicht_gedrueckt (CM_ZV_Heckschloss_Taste_auf_Cx0_Taste_Heckschloss_auf_nicht_gedrueckt), 1=Cx1_Taste_Heckschloss_auf_gedrueckt (CM_ZV_Heckschloss_Taste_auf_Cx1_Taste_Heckschloss_auf_gedrueckt)}, range raw 0..1, transfer-property=TRIGGERED-WITHOUT-REPETITION  # Taster zum Öffnen der Heckklappe über BAP oder einem diskret angeschlossen Schalter
    signal ZV_ValetTaster_Fkts_LED_XIX_CentralLocking_01_XIX_VLAN_Cockpit: start 82, 1 bit, little-endian, data-type-policy=OVERRIDE, i-signal-type=PRIMITIVE, init-value=0, base-type=BT_ZV_ValetTaster_Fkts_LED, compu {1=Cx1_LED_ein (CM_ZV_ValetTaster_Fkts_LED_Cx1_LED_ein), 0=Cx0_LED_aus (CM_ZV_ValetTaster_Fkts_LED_Cx0_LED_aus)}, range raw 0..1, transfer-property=TRIGGERED-WITHOUT-REPETITION  # Im MQB beschreibt das Signal nur den Zustand der Funktion Valet Parking (aktiv/ inaktiv) Im MLBevo wird über das Signal zusätzlich die ValetTaster_Fkts_LED (an/ aus) gesteuert
    signal ZV_verriegelt_extern_soll_03_XIX_CentralLocking_01_XIX_VLAN_Cockpit: start 83, 2 bit, little-endian, data-type-policy=OVERRIDE, i-signal-type=PRIMITIVE, init-value=2, base-type=BT_ZV_verriegelt_extern_soll_03, invalid-value=Invalid_ZV_verriegelt_extern_soll_03_XIX_CentralLocking_01_XIX_VLAN_Cockpit:3, compu {3=Cx3_Fehler (CM_ZV_verriegelt_extern_soll_03_Cx3_Fehler), 0=Cx0_Fahrzeug_nicht_extern_verriegelt (CM_ZV_verriegelt_extern_soll_03_Cx0_Fahrzeug_nicht_extern_verriegelt), 1=Cx1_Fahrzeug_extern_verriegelt_Sollz (CM_ZV_verriegelt_extern_soll_03_Cx1_Fahrzeug_extern_verriegelt_Sollz), 2=Cx2_Init (CM_ZV_verriegelt_extern_soll_03_Cx2_Init)}, range raw 0..3, transfer-property=TRIGGERED-WITHOUT-REPETITION  # Sollzustand: Verriegelung Fahrzeug aussen
    signal ZV_Anf_Auffindbel_TE_hinten_XIX_CentralLocking_01_XIX_VLAN_Cockpit: start 85, 1 bit, little-endian, data-type-policy=OVERRIDE, i-signal-type=PRIMITIVE, init-value=0, base-type=BT_ZV_Anf_Auffindbel_TE_hinten, compu {1=Cx1_angefordert (CM_ZV_Anf_Auffindbel_TE_hinten_Cx1_angefordert), 0=Cx0_nicht_angefordert (CM_ZV_Anf_Auffindbel_TE_hinten_Cx0_nicht_angefordert)}, range raw 0..1, transfer-property=TRIGGERED-WITHOUT-REPETITION  # Anforderung der Trunk Entrapment Auffindbeleuchtung im Bedientaster TE hinten Das Signal muss über eine E2E-Absicherung verfügen.
    signal ZV_zentral_entsafen_XIX_CentralLocking_01_XIX_VLAN_Cockpit: start 86, 1 bit, little-endian, data-type-policy=OVERRIDE, i-signal-type=PRIMITIVE, init-value=0, base-type=BT_ZV_zentral_entsafen, compu {0=Cx0_Init (CM_ZV_zentral_entsafen_Cx0_Init), 1=Cx1_Befehl_zentral_entsafen (CM_ZV_zentral_entsafen_Cx1_Befehl_zentral_entsafen)}, range raw 0..1, transfer-property=TRIGGERED-WITHOUT-REPETITION  # Zentral entsafen
    signal ZV_zentral_safen_XIX_CentralLocking_01_XIX_VLAN_Cockpit: start 87, 1 bit, little-endian, data-type-policy=OVERRIDE, i-signal-type=PRIMITIVE, init-value=0, base-type=BT_ZV_zentral_safen, compu {1=Cx1_Befehl_zentral_safen (CM_ZV_zentral_safen_Cx1_Befehl_zentral_safen), 0=Cx0_nicht_safen (CM_ZV_zentral_safen_Cx0_nicht_safen)}, range raw 0..1, transfer-property=TRIGGERED-WITHOUT-REPETITION  # Zentral safen
    signal ZV_Heck_offen_XIX_CentralLocking_01_XIX_VLAN_Cockpit: start 88, 1 bit, little-endian, data-type-policy=OVERRIDE, i-signal-type=PRIMITIVE, init-value=0, base-type=BT_ZV_Heck_offen, compu {1=Cx1_Heckdeckel_klappe_auf (CM_ZV_Heck_offen_Cx1_Heckdeckel_klappe_auf), 0=Cx0_Heckdeckel_klappe_zu (CM_ZV_Heck_offen_Cx0_Heckdeckel_klappe_zu)}, range raw 0..1, transfer-property=TRIGGERED-WITHOUT-REPETITION, to HCP3_IONode(timeout 2 s)  # Status Heckdeckel/-klappe
    signal ZV_Anf_Auffindbel_TE_vorne_XIX_CentralLocking_01_XIX_VLAN_Cockpit: start 89, 1 bit, little-endian, data-type-policy=OVERRIDE, i-signal-type=PRIMITIVE, init-value=0, base-type=BT_ZV_Anf_Auffindbel_TE_vorne, compu {0=Cx0_nicht_angefordert (CM_ZV_Anf_Auffindbel_TE_vorne_Cx0_nicht_angefordert), 1=Cx1_angefordert (CM_ZV_Anf_Auffindbel_TE_vorne_Cx1_angefordert)}, range raw 0..1, transfer-property=TRIGGERED-WITHOUT-REPETITION  # Anforderung der Trunk Entrapment Auffindbeleuchtung im Bedientaster TE vorne Das Signal muss über eine E2E-Absicherung verfügen.
    signal ZV_zu_Zeitl_Nachverr_XIX_CentralLocking_01_XIX_VLAN_Cockpit: start 90, 1 bit, little-endian, data-type-policy=OVERRIDE, i-signal-type=PRIMITIVE, init-value=0, base-type=BT_ZV_zu_Zeitl_Nachverr, compu {0=Cx0_Init (CM_ZV_zu_Zeitl_Nachverr_Cx0_Init), 1=Cx1_Nachverriegeln (CM_ZV_zu_Zeitl_Nachverr_Cx1_Nachverriegeln)}, range raw 0..1, transfer-property=TRIGGERED-WITHOUT-REPETITION  # ZV Schliessstelle
    signal ZV_TAG_BT_verfahren_XIX_CentralLocking_01_XIX_VLAN_Cockpit: start 91, 2 bit, little-endian, data-type-policy=OVERRIDE, i-signal-type=PRIMITIVE, init-value=0, base-type=BT_ZV_TAG_BT_verfahren, compu {0=Cx0_Init (CM_ZV_TAG_BT_verfahren_Cx0_Init), 2=Cx2_TAG_einfahren (CM_ZV_TAG_BT_verfahren_Cx2_TAG_einfahren), 1=Cx1_TAG_ausfahren (CM_ZV_TAG_BT_verfahren_Cx1_TAG_ausfahren)}, range raw 0..2, transfer-property=TRIGGERED-WITHOUT-REPETITION  # Türaussengriff BT Trigger zum Aus- und Einfahren
    signal ZV_TAG_HBFS_verfahren_XIX_CentralLocking_01_XIX_VLAN_Cockpit: start 93, 2 bit, little-endian, data-type-policy=OVERRIDE, i-signal-type=PRIMITIVE, init-value=0, base-type=BT_ZV_TAG_HBFS_verfahren, compu {2=Cx2_TAG_einfahren (CM_ZV_TAG_HBFS_verfahren_Cx2_TAG_einfahren), 0=Cx0_Init (CM_ZV_TAG_HBFS_verfahren_Cx0_Init), 1=Cx1_TAG_ausfahren (CM_ZV_TAG_HBFS_verfahren_Cx1_TAG_ausfahren)}, range raw 0..2, transfer-property=TRIGGERED-WITHOUT-REPETITION  # Türaussengriff HBFS Trigger zum Aus- und Einfahren
    signal ZV_TAG_FT_verfahren_XIX_CentralLocking_01_XIX_VLAN_Cockpit: start 95, 2 bit, little-endian, data-type-policy=OVERRIDE, i-signal-type=PRIMITIVE, init-value=0, base-type=BT_ZV_TAG_FT_verfahren, invalid-value=Invalid_ZV_TAG_FT_verfahren_XIX_CentralLocking_01_XIX_VLAN_Cockpit:3, compu {3=Cx3_Fehler (CM_ZV_TAG_FT_verfahren_Cx3_Fehler), 1=Cx1_TAG_ausfahren (CM_ZV_TAG_FT_verfahren_Cx1_TAG_ausfahren), 2=Cx2_TAG_einfahren (CM_ZV_TAG_FT_verfahren_Cx2_TAG_einfahren), 0=Cx0_Init (CM_ZV_TAG_FT_verfahren_Cx0_Init)}, range raw 0..3, transfer-property=TRIGGERED-WITHOUT-REPETITION  # Türaussengriff FT Trigger zum Aus- und Einfahren
    signal ZV_TAG_HFS_verfahren_XIX_CentralLocking_01_XIX_VLAN_Cockpit: start 97, 2 bit, little-endian, data-type-policy=OVERRIDE, i-signal-type=PRIMITIVE, init-value=0, base-type=BT_ZV_TAG_HFS_verfahren, compu {0=Cx0_Init (CM_ZV_TAG_HFS_verfahren_Cx0_Init), 1=Cx1_TAG_ausfahren (CM_ZV_TAG_HFS_verfahren_Cx1_TAG_ausfahren), 2=Cx2_TAG_einfahren (CM_ZV_TAG_HFS_verfahren_Cx2_TAG_einfahren)}, range raw 0..2, transfer-property=TRIGGERED-WITHOUT-REPETITION  # Türaussengriff HFS Trigger zum Aus- und Einfahren
    signal IRUE_Taster_Fkts_LED_XIX_CentralLocking_01_XIX_VLAN_Cockpit: start 99, 1 bit, little-endian, data-type-policy=OVERRIDE, i-signal-type=PRIMITIVE, init-value=0, base-type=BT_IRUE_Taster_Fkts_LED, compu {1=Cx1_LED_ein (CM_IRUE_Taster_Fkts_LED_Cx1_LED_ein), 0=Cx0_LED_aus (CM_IRUE_Taster_Fkts_LED_Cx0_LED_aus)}, range raw 0..1, transfer-property=TRIGGERED-WITHOUT-REPETITION  # Anforderung Funktions-LED IRUE-Taster (LED wird vom TSG angesteuert) MQB: Bei Verbau eines einzelnen Taster zur Deaktivierung von IRUE und NGS wird dieses Signal zur Ansteuerung der Funktions-LED gesendet.
    signal SSA_Heckschloss_ansteuern_XIX_CentralLocking_01_XIX_VLAN_Cockpit: start 100, 2 bit, little-endian, data-type-policy=OVERRIDE, i-signal-type=PRIMITIVE, init-value=0, base-type=BT_SSA_Heckschloss_ansteuern, compu {0=Cx0_nicht_angefordert (CM_SSA_Heckschloss_ansteuern_Cx0_nicht_angefordert) (nicht angefordert), 1=Cx1_Entriegeln (CM_SSA_Heckschloss_ansteuern_Cx1_Entriegeln), 2=Cx2_Verriegeln (CM_SSA_Heckschloss_ansteuern_Cx2_Verriegeln)}, range raw 0..2, transfer-property=TRIGGERED-WITHOUT-REPETITION  # SmartSensorActor: Anforderung zum Ent-/Verriegeln des Heckschlosses
    signal SSA_Tankklappe_ansteuern_XIX_CentralLocking_01_XIX_VLAN_Cockpit: start 102, 2 bit, little-endian, data-type-policy=OVERRIDE, i-signal-type=PRIMITIVE, init-value=0, base-type=BT_SSA_Tankklappe_ansteuern, compu {0=Cx0_nicht_angefordert (CM_SSA_Tankklappe_ansteuern_Cx0_nicht_angefordert) (nicht angefordert), 2=Cx2_Verriegeln (CM_SSA_Tankklappe_ansteuern_Cx2_Verriegeln), 1=Cx1_Entriegeln (CM_SSA_Tankklappe_ansteuern_Cx1_Entriegeln)}, range raw 0..2, transfer-property=TRIGGERED-WITHOUT-REPETITION  # SmartSensorActor: Anforderung zum Ent-/Verriegeln der Tankklappe
    signal ZV_auf_Funk_XIX_CentralLocking_01_XIX_VLAN_Cockpit: start 104, 1 bit, little-endian, data-type-policy=OVERRIDE, i-signal-type=PRIMITIVE, init-value=0, base-type=BT_ZV_auf_Funk, compu {1=Cx1_betaetigt (CM_ZV_auf_Funk_Cx1_betaetigt), 0=Cx0_nicht_betaetigt (CM_ZV_auf_Funk_Cx0_nicht_betaetigt)}, range raw 0..1, transfer-property=TRIGGERED-WITHOUT-REPETITION  # ZV Schliessstelle
    signal DWA_aktiv_XIX_CentralLocking_01_XIX_VLAN_Cockpit: start 105, 1 bit, little-endian, data-type-policy=OVERRIDE, i-signal-type=PRIMITIVE, init-value=0, base-type=BT_DWA_aktiv, compu {1=Cx1_scharf (CM_DWA_aktiv_Cx1_scharf), 0=Cx0_unscharf (CM_DWA_aktiv_Cx0_unscharf)}, range raw 0..1, transfer-property=TRIGGERED-WITHOUT-REPETITION  # Status DWA aktiv
    signal DWA_Alarmquelle_02_XIX_CentralLocking_01_XIX_VLAN_Cockpit: start 106, 5 bit, little-endian, data-type-policy=OVERRIDE, i-signal-type=PRIMITIVE, init-value=30, base-type=BT_DWA_Alarmquelle_02, invalid-value=Invalid_DWA_Alarmquelle_02_XIX_CentralLocking_01_XIX_VLAN_Cockpit:31, compu {31=Cx1f_Fehler (CM_DWA_Alarmquelle_02_Cx1f_Fehler), 3=Cx3_Tuerkontakt_HFS (CM_DWA_Alarmquelle_02_Cx3_Tuerkontakt_HFS), 0=Cx0_kein_Ausloesegrund (CM_DWA_Alarmquelle_02_Cx0_kein_Ausloesegrund), 13=Cxd_BT_keine_Kommunikation (CM_DWA_Alarmquelle_02_Cxd_BT_keine_Kommunikation), 22=Cx16_Handschuhkasten (CM_DWA_Alarmquelle_02_Cx16_Handschuhkasten), 17=Cx11_Klemme_15sig (CM_DWA_Alarmquelle_02_Cx11_Klemme_15sig), 25=Cx19_Power_on_Reset (CM_DWA_Alarmquelle_02_Cx19_Power_on_Reset), 10=Cxa_Backuphorn (CM_DWA_Alarmquelle_02_Cxa_Backuphorn), 19=Cx13_Anhaengerueberwachung (CM_DWA_Alarmquelle_02_Cx13_Anhaengerueberwachung), 4=Cx4_Tuerkontakt_HBFS (CM_DWA_Alarmquelle_02_Cx4_Tuerkontakt_HBFS), 15=Cxf_HBFS_keine_Kommunikation (CM_DWA_Alarmquelle_02_Cxf_HBFS_keine_Kommunikation), 14=Cxe_HFS_keine_Kommunikation (CM_DWA_Alarmquelle_02_Cxe_HFS_keine_Kommunikation), 5=Cx5_Frontdeckelkontakt (CM_DWA_Alarmquelle_02_Cx5_Frontdeckelkontakt), 2=Cx2_Tuerkontakt_BT (CM_DWA_Alarmquelle_02_Cx2_Tuerkontakt_BT), 11=Cxb_Neigungssensor (CM_DWA_Alarmquelle_02_Cxb_Neigungssensor), 6=Cx6_Heckdeckel_klappenkontakt (CM_DWA_Alarmquelle_02_Cx6_Heckdeckel_klappenkontakt) (Heckdeckel-/klappenkontakt), 30=Cx1e_Init (CM_DWA_Alarmquelle_02_Cx1e_Init), 18=Cx12_frei (CM_DWA_Alarmquelle_02_Cx12_frei), 26=Cx1a_Heckkontakt_keine_Kommunikation (CM_DWA_Alarmquelle_02_Cx1a_Heckkontakt_keine_Kommunikation), 7=Cx7_Heckscheibenbruch (CM_DWA_Alarmquelle_02_Cx7_Heckscheibenbruch), 20=Cx14_Scheinwerferueberwachung_links (CM_DWA_Alarmquelle_02_Cx14_Scheinwerferueberwachung_links), 21=Cx15_Scheinwerferueberwachung_rechts (CM_DWA_Alarmquelle_02_Cx15_Scheinwerferueberwachung_rechts), 24=Cx18_OBD_Alarm (CM_DWA_Alarmquelle_02_Cx18_OBD_Alarm), 8=Cx8_Innenraumueberwachung (CM_DWA_Alarmquelle_02_Cx8_Innenraumueberwachung), 16=Cx10_Klemme_15 (CM_DWA_Alarmquelle_02_Cx10_Klemme_15), 1=Cx1_Tuerkontakt_FT (CM_DWA_Alarmquelle_02_Cx1_Tuerkontakt_FT), 12=Cxc_FT_keine_Kommunikation (CM_DWA_Alarmquelle_02_Cxc_FT_keine_Kommunikation), 9=Cx9_Alarm_durch_Noteinstieg (CM_DWA_Alarmquelle_02_Cx9_Alarm_durch_Noteinstieg), 23=Cx17_Verdeckueberwachung (CM_DWA_Alarmquelle_02_Cx17_Verdeckueberwachung)}, range raw 0..31, transfer-property=TRIGGERED-WITHOUT-REPETITION  # Signalisiert den Auslösegrund der DWA
    signal ZV_APP_Kundenwarnung_Funk_XIX_CentralLocking_01_XIX_VLAN_Cockpit: start 111, 1 bit, little-endian, data-type-policy=OVERRIDE, i-signal-type=PRIMITIVE, init-value=0, base-type=BT_ZV_APP_Kundenwarnung_Funk, compu {1=Cx1_Funkstorer_aktiv (CM_ZV_APP_Kundenwarnung_Funk_Cx1_Funkstorer_aktiv), 0=Cx0_Funkstorer_nicht_aktiv (CM_ZV_APP_Kundenwarnung_Funk_Cx0_Funkstorer_nicht_aktiv)}, range raw 0..1, transfer-property=TRIGGERED-WITHOUT-REPETITION  # Information an den Kunden dass ein Funkstoerer erkannt wurde, um in der APP die Handlungsanweisung anzuzeigen.
    signal ZV_verriegelt_intern_soll_02_XIX_CentralLocking_01_XIX_VLAN_Cockpit: start 112, 2 bit, little-endian, data-type-policy=OVERRIDE, i-signal-type=PRIMITIVE, init-value=2, base-type=BT_ZV_verriegelt_intern_soll_02, invalid-value=Invalid_ZV_verriegelt_intern_soll_02_XIX_CentralLocking_01_XIX_VLAN_Cockpit:3, compu {3=Cx3_Fehler (CM_ZV_verriegelt_intern_soll_02_Cx3_Fehler), 2=Cx2_Init (CM_ZV_verriegelt_intern_soll_02_Cx2_Init), 0=Cx0_Fahrzeug_nicht_innen_verriegelt (CM_ZV_verriegelt_intern_soll_02_Cx0_Fahrzeug_nicht_innen_verriegelt), 1=Cx1_Fahrzeug_innen_verriegelt_Sollzu (CM_ZV_verriegelt_intern_soll_02_Cx1_Fahrzeug_innen_verriegelt_Sollzu)}, range raw 0..3, transfer-property=TRIGGERED-WITHOUT-REPETITION  # Sollzustand: Verriegelung Fahrzeug innen
    signal ZV_Status_eTAG_ist_XIX_CentralLocking_01_XIX_VLAN_Cockpit: start 114, 2 bit, little-endian, data-type-policy=OVERRIDE, i-signal-type=PRIMITIVE, init-value=0, base-type=BT_ZV_Status_eTAG_ist, compu {0=Cx0_Init (CM_ZV_Status_eTAG_ist_Cx0_Init), 1=Cx1_Tueraussengriff_eingefahren_Istzustand (CM_ZV_Status_eTAG_ist_Cx1_Tueraussengriff_eingefahren_Istzustand) (Türaussengriff._eingefahren (Istzustand)), 2=Cx2_Tueraussengriff_ausgefahren_Istzustand (CM_ZV_Status_eTAG_ist_Cx2_Tueraussengriff_ausgefahren_Istzustand) (Türaussengriff._ausgefahren ( (Istzustand))}, range raw 0..2, transfer-property=TRIGGERED-WITHOUT-REPETITION  # Istzustand: Türaussengriff eingefahren oder ausgefahren (Zielzustand)
    signal ZV_Status_eTAG_soll_XIX_CentralLocking_01_XIX_VLAN_Cockpit: start 116, 2 bit, little-endian, data-type-policy=OVERRIDE, i-signal-type=PRIMITIVE, init-value=0, base-type=BT_ZV_Status_eTAG_soll, compu {2=Cx2_Tueraussengriff_ausgefahren_Sollzustand (CM_ZV_Status_eTAG_soll_Cx2_Tueraussengriff_ausgefahren_Sollzustand) (Türaussengriff._ausgefahren (Sollzustand)), 1=Cx1_Tueraussengriff_eingefahren_Sollzustand (CM_ZV_Status_eTAG_soll_Cx1_Tueraussengriff_eingefahren_Sollzustand) (Türaussengriff._eingefahren (Sollzustand)), 0=Cx0_Init (CM_ZV_Status_eTAG_soll_Cx0_Init)}, range raw 0..2, transfer-property=TRIGGERED-WITHOUT-REPETITION  # Sollzustand: Türaussengriff eingefahren oder ausgefahren (Zielzustand)
    signal ZV_verriegelt_extern_ist_02_XIX_CentralLocking_01_XIX_VLAN_Cockpit: start 118, 2 bit, little-endian, data-type-policy=OVERRIDE, i-signal-type=PRIMITIVE, init-value=2, base-type=BT_ZV_verriegelt_extern_ist_02, invalid-value=Invalid_ZV_verriegelt_extern_ist_02_XIX_CentralLocking_01_XIX_VLAN_Cockpit:3, compu {3=Cx3_Fehler (CM_ZV_verriegelt_extern_ist_02_Cx3_Fehler), 1=Cx1_Fahrzeug_extern_verriegelt_Ist (CM_ZV_verriegelt_extern_ist_02_Cx1_Fahrzeug_extern_verriegelt_Ist), 0=Cx0_Fahrzeug_nicht_extern_verriegelt (CM_ZV_verriegelt_extern_ist_02_Cx0_Fahrzeug_nicht_extern_verriegelt), 2=Cx2_Init (CM_ZV_verriegelt_extern_ist_02_Cx2_Init)}, range raw 0..3, transfer-property=TRIGGERED-WITHOUT-REPETITION, to HCP3_IONode(timeout 2 s)  # Istzustand: Verriegelung Fahrzeug aussen
    signal ZV_Anf_HSK_XIX_CentralLocking_01_XIX_VLAN_Cockpit: start 120, 3 bit, little-endian, data-type-policy=OVERRIDE, i-signal-type=PRIMITIVE, init-value=0, base-type=BT_ZV_Anf_HSK, invalid-value=Invalid_ZV_Anf_HSK_XIX_CentralLocking_01_XIX_VLAN_Cockpit:7, compu {7=Cx7_Fehler (CM_ZV_Anf_HSK_Cx7_Fehler), 1=Cx1_keine_Freigabe (CM_ZV_Anf_HSK_Cx1_keine_Freigabe), 2=Cx2_Handschuhkasten_entriegeln (CM_ZV_Anf_HSK_Cx2_Handschuhkasten_entriegeln), 0=Cx0_Init_oder_nicht_verbaut (CM_ZV_Anf_HSK_Cx0_Init_oder_nicht_verbaut), 3=Cx3_Handschuhkasten_verriegeln (CM_ZV_Anf_HSK_Cx3_Handschuhkasten_verriegeln)}, range raw 0..7, transfer-property=TRIGGERED-WITHOUT-REPETITION  # Anforderungssignal zur Ansteuerung des Handschuhkastenmotors
    signal ZV_gesafet_extern_soll_02_XIX_CentralLocking_01_XIX_VLAN_Cockpit: start 123, 2 bit, little-endian, data-type-policy=OVERRIDE, i-signal-type=PRIMITIVE, init-value=2, base-type=BT_ZV_gesafet_extern_soll_02, invalid-value=Invalid_ZV_gesafet_extern_soll_02_XIX_CentralLocking_01_XIX_VLAN_Cockpit:3, compu {3=Cx3_Fehler (CM_ZV_gesafet_extern_soll_02_Cx3_Fehler), 0=Cx0_Fahrzeug_nicht_gesafet (CM_ZV_gesafet_extern_soll_02_Cx0_Fahrzeug_nicht_gesafet), 1=Cx1_Fahrzeug_gesafet_Sollzustand (CM_ZV_gesafet_extern_soll_02_Cx1_Fahrzeug_gesafet_Sollzustand), 2=Cx2_Init (CM_ZV_gesafet_extern_soll_02_Cx2_Init)}, range raw 0..3, transfer-property=TRIGGERED-WITHOUT-REPETITION  # Sollzustand: Fahrzeug gesafet extern
    signal ZV_verriegelt_intern_ist_02_XIX_CentralLocking_01_XIX_VLAN_Cockpit: start 125, 2 bit, little-endian, data-type-policy=OVERRIDE, i-signal-type=PRIMITIVE, init-value=2, base-type=BT_ZV_verriegelt_intern_ist_02, invalid-value=Invalid_ZV_verriegelt_intern_ist_02_XIX_CentralLocking_01_XIX_VLAN_Cockpit:3, compu {3=Cx3_Fehler (CM_ZV_verriegelt_intern_ist_02_Cx3_Fehler), 1=Cx1_Fahrzeug_innen_verriegelt_Istzus (CM_ZV_verriegelt_intern_ist_02_Cx1_Fahrzeug_innen_verriegelt_Istzus), 2=Cx2_Init (CM_ZV_verriegelt_intern_ist_02_Cx2_Init), 0=Cx0_Fahrzeug_nicht_innen_verriegelt (CM_ZV_verriegelt_intern_ist_02_Cx0_Fahrzeug_nicht_innen_verriegelt)}, range raw 0..3, transfer-property=TRIGGERED-WITHOUT-REPETITION  # Istzustand: Verriegelung Fahrzeug innen
    signal ZV_TxT_TE_Warnung_vorne_XIX_CentralLocking_01_XIX_VLAN_Cockpit: start 127, 4 bit, little-endian, data-type-policy=OVERRIDE, i-signal-type=PRIMITIVE, init-value=13, base-type=BT_ZV_TxT_TE_Warnung_vorne, invalid-value=Invalid_ZV_TxT_TE_Warnung_vorne_XIX_CentralLocking_01_XIX_VLAN_Cockpit:15, compu {15=Cxf_Fehler (CM_ZV_TxT_TE_Warnung_vorne_Cxf_Fehler), 2=Cx2_Warn_TE_vorne_Bet_im_Fahrt_erk (CM_ZV_TxT_TE_Warnung_vorne_Cx2_Warn_TE_vorne_Bet_im_Fahrt_erk), 0=Cx0_Warnung_TE_vorne_Aus (CM_ZV_TxT_TE_Warnung_vorne_Cx0_Warnung_TE_vorne_Aus), 3=Cx3_Warn_TE_vorne_Systemfehler (CM_ZV_TxT_TE_Warnung_vorne_Cx3_Warn_TE_vorne_Systemfehler), 1=Cx1_Warn_TE_vorne_Bet_im_Stand_erk (CM_ZV_TxT_TE_Warnung_vorne_Cx1_Warn_TE_vorne_Bet_im_Stand_erk), 14=Cxe_Warn_nicht_vorhanden_verbaut (CM_ZV_TxT_TE_Warnung_vorne_Cxe_Warn_nicht_vorhanden_verbaut), 13=Cxd_Init (CM_ZV_TxT_TE_Warnung_vorne_Cxd_Init)}, range raw 0..15, transfer-property=TRIGGERED-WITHOUT-REPETITION  # Das Signal triggert eine Warnmeldung im Kombi zur Anzeige von diagnostizierten schleichenden Fehlern an den Aktoren oder Sensoren von TrunkEntrapment Frontdeckel Das Signal muss über eine E2E-Absicherung verfügen.
    signal ZV_Frontdeckelzustand_XIX_CentralLocking_01_XIX_VLAN_Cockpit: start 131, 3 bit, little-endian, data-type-policy=OVERRIDE, i-signal-type=PRIMITIVE, init-value=0, base-type=BT_ZV_Frontdeckelzustand, invalid-value=Invalid_ZV_Frontdeckelzustand_XIX_CentralLocking_01_XIX_VLAN_Cockpit:5, compu {5=Cx5_Fehler (CM_ZV_Frontdeckelzustand_Cx5_Fehler), 4=Cx4_Frontdeckel_vollgeoeffnet (CM_ZV_Frontdeckelzustand_Cx4_Frontdeckel_vollgeoeffnet), 0=Cx0_Init_oder_nicht_verbaut (CM_ZV_Frontdeckelzustand_Cx0_Init_oder_nicht_verbaut), 3=Cx3_Frontde_ausgeworden_ungesichert (CM_ZV_Frontdeckelzustand_Cx3_Frontde_ausgeworden_ungesichert), 1=Cx1_Frontdeckel_vollverriegelt_gesichert (CM_ZV_Frontdeckelzustand_Cx1_Frontdeckel_vollverriegelt_gesichert), 2=Cx2_Frontde_ausgeworfen_gesichert (CM_ZV_Frontdeckelzustand_Cx2_Frontde_ausgeworfen_gesichert)}, range raw 0..5, transfer-property=TRIGGERED-WITHOUT-REPETITION  # Der Frontdeckelsystemstatus wird mittels der Endlagenkontakte (Hauptraste, Auflagenerkennung und Fanghaken) ermittelt und in ASIL Guete ausgegeben.
    signal ZV_Heckschlossstatus_XIX_CentralLocking_01_XIX_VLAN_Cockpit: start 134, 2 bit, little-endian, data-type-policy=OVERRIDE, i-signal-type=PRIMITIVE, init-value=2, base-type=BT_ZV_Heckschlossstatus, invalid-value=Invalid_ZV_Heckschlossstatus_XIX_CentralLocking_01_XIX_VLAN_Cockpit:3, compu {3=Cx3_Fehler (CM_ZV_Heckschlossstatus_Cx3_Fehler), 1=Cx1_offen (CM_ZV_Heckschlossstatus_Cx1_offen), 2=Cx2_Init_oder_nicht_verbaut (CM_ZV_Heckschlossstatus_Cx2_Init_oder_nicht_verbaut), 0=Cx0_geschlossen (CM_ZV_Heckschlossstatus_Cx0_geschlossen)}, range raw 0..3, transfer-property=TRIGGERED-WITHOUT-REPETITION  # Rückmeldung Status Heckschloss
    signal ZV_TxT_Frontschloss_Warnung_XIX_CentralLocking_01_XIX_VLAN_Cockpit: start 136, 4 bit, little-endian, data-type-policy=OVERRIDE, i-signal-type=PRIMITIVE, init-value=13, base-type=BT_ZV_TxT_Frontschloss_Warnung, invalid-value=Invalid_ZV_TxT_Frontschloss_Warnung_XIX_CentralLocking_01_XIX_VLAN_Cockpit:15, compu {15=Cxf_Fehler (CM_ZV_TxT_Frontschloss_Warnung_Cxf_Fehler), 2=Cx2_Warn_Frontschloss_offen_bei_Fahrt (CM_ZV_TxT_Frontschloss_Warnung_Cx2_Warn_Frontschloss_offen_bei_Fahrt), 14=Cxe_Warnung_nicht_vorhanden_verbaut (CM_ZV_TxT_Frontschloss_Warnung_Cxe_Warnung_nicht_vorhanden_verbaut), 3=Cx3_Warn_Frontschloss_unplausibel (CM_ZV_TxT_Frontschloss_Warnung_Cx3_Warn_Frontschloss_unplausibel), 0=Cx0_Anzeige_Frontschloss_Warnung_Aus (CM_ZV_TxT_Frontschloss_Warnung_Cx0_Anzeige_Frontschloss_Warnung_Aus), 1=Cx1_Warn_Frontschloss_offen_im_Stand (CM_ZV_TxT_Frontschloss_Warnung_Cx1_Warn_Frontschloss_offen_im_Stand), 13=Cxd_Init (CM_ZV_TxT_Frontschloss_Warnung_Cxd_Init)}, range raw 0..15, transfer-property=TRIGGERED-WITHOUT-REPETITION  # Abhaengig vom Betriebszustand des Fahrzeuges fuehren die Frotdeckelsystemzustaende zu eine Bewarnung an den Kunden, um Gefahrsituationen zu vermeiden.
    signal ZV_TxT_Heckschloss_Warnung_XIX_CentralLocking_01_XIX_VLAN_Cockpit: start 140, 4 bit, little-endian, data-type-policy=OVERRIDE, i-signal-type=PRIMITIVE, init-value=13, base-type=BT_ZV_TxT_Heckschloss_Warnung, invalid-value=Invalid_ZV_TxT_Heckschloss_Warnung_XIX_CentralLocking_01_XIX_VLAN_Cockpit:15, compu {15=Cxf_Fehler (CM_ZV_TxT_Heckschloss_Warnung_Cxf_Fehler), 1=Cx1_Warn_Heck_offen_im_Stand (CM_ZV_TxT_Heckschloss_Warnung_Cx1_Warn_Heck_offen_im_Stand), 0=Cx0_Anzeige_Heckschloss_Warnung_Aus (CM_ZV_TxT_Heckschloss_Warnung_Cx0_Anzeige_Heckschloss_Warnung_Aus), 2=Cx2_Warn_Heckschloss_offen_bei_Fahrt (CM_ZV_TxT_Heckschloss_Warnung_Cx2_Warn_Heckschloss_offen_bei_Fahrt), 13=Cxd_Init (CM_ZV_TxT_Heckschloss_Warnung_Cxd_Init), 3=Cx3_Warn_Heckschloss_unplausibel (CM_ZV_TxT_Heckschloss_Warnung_Cx3_Warn_Heckschloss_unplausibel), 14=Cxe_Warnung_nicht_vorhanden_verbaut (CM_ZV_TxT_Heckschloss_Warnung_Cxe_Warnung_nicht_vorhanden_verbaut)}, range raw 0..15, transfer-property=TRIGGERED-WITHOUT-REPETITION  # Abhaengig vom Betriebszustand des Fahrzeuges fuehren die Heckschlosszustaende zu eine Bewarnung an den Kunden, um Gefahrsituationen zu vermeiden.
    signal ZV_Txt_Waehlhebel_P_Hinweis_XIX_CentralLocking_01_XIX_VLAN_Cockpit: start 144, 1 bit, little-endian, data-type-policy=OVERRIDE, i-signal-type=PRIMITIVE, init-value=0, base-type=BT_ZV_Txt_Waehlhebel_P_Hinweis, compu {0=Cx0_inaktiv (CM_ZV_Txt_Waehlhebel_P_Hinweis_Cx0_inaktiv), 1=Cx1_aktiv (CM_ZV_Txt_Waehlhebel_P_Hinweis_Cx1_aktiv)}, range raw 0..1, transfer-property=TRIGGERED-WITHOUT-REPETITION  # Infotext NAR für die Vorbedingung "Waehlhebel in P" für Öffnen des Frontdeckesl oder des Heckdeckels / der Heckklappe über die Fahrerrauminnentaster.
    signal ZV_Tasten_HMI_Anf_XIX_CentralLocking_01_XIX_VLAN_Cockpit: start 145, 1 bit, little-endian, data-type-policy=OVERRIDE, i-signal-type=PRIMITIVE, init-value=0, base-type=BT_ZV_Tasten_HMI_Anf, compu {0=Cx0_ZV_Tasten_im_HMI_nicht_anzeigen (CM_ZV_Tasten_HMI_Anf_Cx0_ZV_Tasten_im_HMI_nicht_anzeigen), 1=Cx1_ZV_Tasten_im_HMI_anzeigen (CM_ZV_Tasten_HMI_Anf_Cx1_ZV_Tasten_im_HMI_anzeigen)}, range raw 0..1, transfer-property=TRIGGERED-WITHOUT-REPETITION, to HCP3_IONode(timeout 2 s)  # Trigger zum Einschalten des Touchbediendisplays und Anzeigen der ZV Tasten
    signal ZV_Frontschloss_Vorraste_XIX_CentralLocking_01_XIX_VLAN_Cockpit: start 146, 2 bit, little-endian, data-type-policy=OVERRIDE, i-signal-type=PRIMITIVE, init-value=2, base-type=BT_ZV_Frontschloss_Vorraste, invalid-value=Invalid_ZV_Frontschloss_Vorraste_XIX_CentralLocking_01_XIX_VLAN_Cockpit:3, compu {3=Cx3_Fehler (CM_ZV_Frontschloss_Vorraste_Cx3_Fehler), 1=Cx1_offen (CM_ZV_Frontschloss_Vorraste_Cx1_offen), 0=Cx0_geschlossen (CM_ZV_Frontschloss_Vorraste_Cx0_geschlossen), 2=Cx2_Init_oder_nicht_verbaut (CM_ZV_Frontschloss_Vorraste_Cx2_Init_oder_nicht_verbaut)}, range raw 0..3, transfer-property=TRIGGERED-WITHOUT-REPETITION  # Sperrklinke oder Vorraste Frontchloss Das Signal muss über eine E2E-Absicherung verfügen.
    signal ZV_Heckschlosszustand_XIX_CentralLocking_01_XIX_VLAN_Cockpit: start 152, 3 bit, little-endian, data-type-policy=OVERRIDE, i-signal-type=PRIMITIVE, init-value=0, base-type=BT_ZV_Heckschlosszustand, invalid-value=Invalid_ZV_Heckschlosszustand_XIX_CentralLocking_01_XIX_VLAN_Cockpit:5, compu {5=Cx5_Fehler (CM_ZV_Heckschlosszustand_Cx5_Fehler), 0=Cx0_Init_oder_nicht_verbaut (CM_ZV_Heckschlosszustand_Cx0_Init_oder_nicht_verbaut), 2=Cx2_Schloss_ausgeworfen_gesichert (CM_ZV_Heckschlosszustand_Cx2_Schloss_ausgeworfen_gesichert), 1=Cx1_Schloss_vollverriegelt_gesichert (CM_ZV_Heckschlosszustand_Cx1_Schloss_vollverriegelt_gesichert), 3=Cx3_Schloss_ausgeworfen_ungesichert (CM_ZV_Heckschlosszustand_Cx3_Schloss_ausgeworfen_ungesichert), 4=Cx4_Schloss_vollgeoeffnet (CM_ZV_Heckschlosszustand_Cx4_Schloss_vollgeoeffnet)}, range raw 0..5, transfer-property=TRIGGERED-WITHOUT-REPETITION  # Der Heckschlosssystemstatus wird mittels der Endlagenkontakte (Hauptraste und Vorraste) ermittelt und in ASIL Guete ausgegeben.
    signal ZV_Noteinspeisung_erkannt_XIX_CentralLocking_01_XIX_VLAN_Cockpit: start 155, 1 bit, little-endian, data-type-policy=OVERRIDE, i-signal-type=PRIMITIVE, init-value=0, base-type=BT_ZV_Noteinspeisung_erkannt, compu {1=Cx1_Noteinspeisung_erkannt (CM_ZV_Noteinspeisung_erkannt_Cx1_Noteinspeisung_erkannt), 0=Cx0_Noteinspeisung_nicht_erkannt (CM_ZV_Noteinspeisung_erkannt_Cx0_Noteinspeisung_nicht_erkannt)}, range raw 0..1, transfer-property=TRIGGERED-WITHOUT-REPETITION  # Information, dass eine Noteinspeisung im HCP4 erkannt wurde.
    signal ZV_TxT_TE_Warnung_hinten_XIX_CentralLocking_01_XIX_VLAN_Cockpit: start 156, 4 bit, little-endian, data-type-policy=OVERRIDE, i-signal-type=PRIMITIVE, init-value=13, base-type=BT_ZV_TxT_TE_Warnung_hinten, invalid-value=Invalid_ZV_TxT_TE_Warnung_hinten_XIX_CentralLocking_01_XIX_VLAN_Cockpit:15, compu {15=Cxf_Fehler (CM_ZV_TxT_TE_Warnung_hinten_Cxf_Fehler), 1=Cx1_Warn_TE_hinten_Bet_im_Stand_erk (CM_ZV_TxT_TE_Warnung_hinten_Cx1_Warn_TE_hinten_Bet_im_Stand_erk), 0=Cx0_Warn_TE_hinten_Aus (CM_ZV_TxT_TE_Warnung_hinten_Cx0_Warn_TE_hinten_Aus), 14=Cxe_Warnung_nicht_vorhanden_verbaut (CM_ZV_TxT_TE_Warnung_hinten_Cxe_Warnung_nicht_vorhanden_verbaut), 3=Cx3_Warn_TE_hinten_Systemfehler (CM_ZV_TxT_TE_Warnung_hinten_Cx3_Warn_TE_hinten_Systemfehler), 13=Cxd_Init (CM_ZV_TxT_TE_Warnung_hinten_Cxd_Init), 2=Cx2_Warn_TE_hinten_Bet_im_Fahrt_erk (CM_ZV_TxT_TE_Warnung_hinten_Cx2_Warn_TE_hinten_Bet_im_Fahrt_erk)}, range raw 0..15, transfer-property=TRIGGERED-WITHOUT-REPETITION  # Das Signal triggert eine Warnmeldung im Kombi zur Anzeige von diagnostizierten schleichenden Fehlern an den Aktoren oder Sensoren von TrunkEntrapment Heckdeckel/-klappe
  pdu CID_01_XIX_VLAN_Cockpit: length=48, minimum-delay=0.04, transmission-mode-true-timing={cyclic-timing={time-offset=0.0, time-period=1.0}, event-controlled-timing={number-of-repetitions=0, repetition-period=0.0}}, unused-bit-pattern=0
    signal CID_LVDS_Status_XIX_CID_01_XIX_VLAN_Cockpit: start 12, 1 bit, little-endian, data-type-policy=OVERRIDE, i-signal-type=PRIMITIVE, init-value=0, base-type=BT_CID_LVDS_Status, compu {0=Cx0_LVDS_Unlocked (CM_CID_LVDS_Status_Cx0_LVDS_Unlocked), 1=Cx1_LVDS_Lock (CM_CID_LVDS_Status_Cx1_LVDS_Lock)}, range raw 0..1, transfer-property=TRIGGERED-ON-CHANGE-WITHOUT-REPETITION  # Statussignal im CID LVDS_Lock= 1 Ein valides Videosignal zum Anzeigen liegt an LVDS_Unlocked = 0 kein Videosignal liegt an
    signal CID_State_XIX_CID_01_XIX_VLAN_Cockpit: start 13, 3 bit, little-endian, data-type-policy=OVERRIDE, i-signal-type=PRIMITIVE, init-value=0, base-type=BT_CID_State, compu {1=Cx1_Disp_On (CM_CID_State_Cx1_Disp_On), 2=Cx2_LowPow (CM_CID_State_Cx2_LowPow), 0=Cx0_Disp_Off (CM_CID_State_Cx0_Disp_Off)}, range raw 0..2, transfer-property=TRIGGERED-ON-CHANGE-WITHOUT-REPETITION  # Power state des CID
    signal CID_PCB_Temp_Error_XIX_CID_01_XIX_VLAN_Cockpit: start 16, 1 bit, little-endian, data-type-policy=OVERRIDE, i-signal-type=PRIMITIVE, init-value=0, base-type=BT_CID_PCB_Temp_Error, invalid-value=Invalid_CID_PCB_Temp_Error_XIX_CID_01_XIX_VLAN_Cockpit:1, compu {1=Cx1_Fehler (CM_CID_PCB_Temp_Error_Cx1_Fehler), 0=Cx0_normal (CM_CID_PCB_Temp_Error_Cx0_normal)}, range raw 0..1, transfer-property=TRIGGERED-ON-CHANGE-WITHOUT-REPETITION  # Display unit has detected a temperature error of the PCB
    signal CID_Temp_Error_XIX_CID_01_XIX_VLAN_Cockpit: start 17, 1 bit, little-endian, data-type-policy=OVERRIDE, i-signal-type=PRIMITIVE, init-value=0, base-type=BT_CID_Temp_Error, invalid-value=Invalid_CID_Temp_Error_XIX_CID_01_XIX_VLAN_Cockpit:1, compu {1=Cx1_Fehler (CM_CID_Temp_Error_Cx1_Fehler), 0=Cx0_normal (CM_CID_Temp_Error_Cx0_normal)}, range raw 0..1, transfer-property=TRIGGERED-ON-CHANGE-WITHOUT-REPETITION  # Display unit has detected a temperature error of the display panel
    signal CID_HDCP_Status_XIX_CID_01_XIX_VLAN_Cockpit: start 18, 1 bit, little-endian, data-type-policy=OVERRIDE, i-signal-type=PRIMITIVE, init-value=0, base-type=BT_CID_HDCP_Status, invalid-value=Invalid_CID_HDCP_Status_XIX_CID_01_XIX_VLAN_Cockpit:1, compu {1=Cx1_Fehler (CM_CID_HDCP_Status_Cx1_Fehler), 0=Cx0_Kein_Fehler (CM_CID_HDCP_Status_Cx0_Kein_Fehler)}, range raw 0..1, transfer-property=TRIGGERED-ON-CHANGE-WITHOUT-REPETITION  # Current status of HDCP
    signal CID_SystemMode_XIX_CID_01_XIX_VLAN_Cockpit: start 19, 1 bit, little-endian, data-type-policy=OVERRIDE, i-signal-type=PRIMITIVE, init-value=0, base-type=BT_CID_SystemMode, compu {0=Cx0_bootloader (CM_CID_SystemMode_Cx0_bootloader), 1=Cx1_applikation (CM_CID_SystemMode_Cx1_applikation)}, range raw 0..1, transfer-property=TRIGGERED-ON-CHANGE-WITHOUT-REPETITION  # Current system mode
    signal CID_LVDS_Errorstate_XIX_CID_01_XIX_VLAN_Cockpit: start 20, 2 bit, little-endian, data-type-policy=OVERRIDE, i-signal-type=PRIMITIVE, init-value=0, base-type=BT_CID_LVDS_Errorstate, compu {1=Cx1_SW_error (CM_CID_LVDS_Errorstate_Cx1_SW_error), 0=Cx0_no_error (CM_CID_LVDS_Errorstate_Cx0_no_error), 2=Cx2_HW_error (CM_CID_LVDS_Errorstate_Cx2_HW_error)}, range raw 0..2, transfer-property=PENDING  # CID_LVDS_Errorstate = 0 no error detected CID_LVDS_Errorstate = 1 SW error detected CID_LVDS_Errorstate = 2 HW error detected
    signal CID_CL30_Overvolt_Error_XIX_CID_01_XIX_VLAN_Cockpit: start 22, 1 bit, little-endian, data-type-policy=OVERRIDE, i-signal-type=PRIMITIVE, init-value=0, base-type=BT_CID_CL30_Overvolt_Error, invalid-value=Invalid_CID_CL30_Overvolt_Error_XIX_CID_01_XIX_VLAN_Cockpit:1, compu {1=Cx1_Fehler (CM_CID_CL30_Overvolt_Error_Cx1_Fehler), 0=Cx0_normal (CM_CID_CL30_Overvolt_Error_Cx0_normal)}, range raw 0..1, transfer-property=TRIGGERED-ON-CHANGE-WITHOUT-REPETITION  # Display unit detected overvoltage error
    signal CID_CL30_Undervolt_Error_XIX_CID_01_XIX_VLAN_Cockpit: start 23, 1 bit, little-endian, data-type-policy=OVERRIDE, i-signal-type=PRIMITIVE, init-value=0, base-type=BT_CID_CL30_Undervolt_Error, invalid-value=Invalid_CID_CL30_Undervolt_Error_XIX_CID_01_XIX_VLAN_Cockpit:1, compu {1=Cx1_Fehler (CM_CID_CL30_Undervolt_Error_Cx1_Fehler), 0=Cx0_normal (CM_CID_CL30_Undervolt_Error_Cx0_normal)}, range raw 0..1, transfer-property=TRIGGERED-ON-CHANGE-WITHOUT-REPETITION  # Display unit detected undervoltage error
    signal CID_CL_30F_XIX_CID_01_XIX_VLAN_Cockpit: start 24, 8 bit, little-endian, data-type-policy=OVERRIDE, i-signal-type=PRIMITIVE, init-value=254, base-type=BT_CID_CL_30F, invalid-value=Invalid_CID_CL_30F_XIX_CID_01_XIX_VLAN_Cockpit:255, compu {phys=raw*0.1 for raw 0..253, 255=Cxff_Fehler (CM_CID_CL_30F_Cxff_Fehler), 254=Cxfe_Init (CM_CID_CL_30F_Cxfe_Init); unit Unit_Volt}, range phys 0..25.3 Unit_Volt, raw 0..255, unit=Unit_Volt, transfer-property=PENDING  # Measured supply voltage of the display unit in volt
    signal CID_FanSpeed_XIX_CID_01_XIX_VLAN_Cockpit: start 32, 7 bit, little-endian, data-type-policy=OVERRIDE, i-signal-type=PRIMITIVE, init-value=126, base-type=BT_CID_FanSpeed, invalid-value=Invalid_CID_FanSpeed_XIX_CID_01_XIX_VLAN_Cockpit:127, compu {phys=raw for raw 0..100, 127=Cx7f_Fehler (CM_CID_FanSpeed_Cx7f_Fehler), 126=Cx7e_Init (CM_CID_FanSpeed_Cx7e_Init); unit Unit_PerCent}, range phys 0..100 Unit_PerCent, raw 0..127, unit=Unit_PerCent, transfer-property=PENDING  # Speed of fan in display unit
    signal CID_Photosensor_XIX_CID_01_XIX_VLAN_Cockpit: start 39, 9 bit, little-endian, data-type-policy=OVERRIDE, i-signal-type=PRIMITIVE, init-value=510, base-type=BT_CID_Photosensor, invalid-value=Invalid_CID_Photosensor_XIX_CID_01_XIX_VLAN_Cockpit:511, compu {phys=raw*0.25 for raw 1..400, 511=Cx1ff_Fehler (CM_CID_Photosensor_Cx1ff_Fehler), 0=Cx0_Sensor_unbeleuchtet (CM_CID_Photosensor_Cx0_Sensor_unbeleuchtet), 510=Cx1fe_Initialwert (CM_CID_Photosensor_Cx1fe_Initialwert); unit Unit_PerCent}, range phys 0.25..100 Unit_PerCent, raw 0..511, unit=Unit_PerCent, transfer-property=PENDING  # Measured value photosensor of the display unit (PCM or CDR) logarithmically distorted (see description of functions Nightdesign - according to Audi Spec) PCM/CDR_Signal
    signal CID_DispDerating_XIX_CID_01_XIX_VLAN_Cockpit: start 48, 8 bit, little-endian, data-type-policy=OVERRIDE, i-signal-type=PRIMITIVE, init-value=254, base-type=BT_CID_DispDerating, invalid-value=Invalid_CID_DispDerating_XIX_CID_01_XIX_VLAN_Cockpit:255, compu {phys=raw for raw 0..100, 255=Cxff_Fehler (CM_CID_DispDerating_Cxff_Fehler), 254=Cxfe_Init (CM_CID_DispDerating_Cxfe_Init); unit Unit_PerCent}, range phys 0..100 Unit_PerCent, raw 0..255, unit=Unit_PerCent, transfer-property=PENDING  # Limitation of power dissipation depending on the temperature
    signal CID_TempSensor_XIX_CID_01_XIX_VLAN_Cockpit: start 56, 8 bit, little-endian, data-type-policy=OVERRIDE, i-signal-type=PRIMITIVE, init-value=254, base-type=BT_CID_TempSensor, invalid-value=Invalid_CID_TempSensor_XIX_CID_01_XIX_VLAN_Cockpit:255, compu {phys=raw-55 for raw 0..182, 255=Cxff_Fehler (CM_CID_TempSensor_Cxff_Fehler), 254=Cxfe_Init (CM_CID_TempSensor_Cxfe_Init); unit Unit_DegreCelsi}, range phys -55..127 Unit_DegreCelsi, raw 0..255, unit=Unit_DegreCelsi, transfer-property=PENDING  # Display Unit current temperatur of the displaypanel
    signal CID_TempSensorMax_XIX_CID_01_XIX_VLAN_Cockpit: start 64, 8 bit, little-endian, data-type-policy=OVERRIDE, i-signal-type=PRIMITIVE, init-value=254, base-type=BT_CID_TempSensorMax, invalid-value=Invalid_CID_TempSensorMax_XIX_CID_01_XIX_VLAN_Cockpit:255, compu {phys=raw-55 for raw 0..182, 255=Cxff_Fehler (CM_CID_TempSensorMax_Cxff_Fehler), 254=Cxfe_Init (CM_CID_TempSensorMax_Cxfe_Init); unit Unit_DegreCelsi}, range phys -55..127 Unit_DegreCelsi, raw 0..255, unit=Unit_DegreCelsi, transfer-property=PENDING  # Stored maximum sensor temperature of the display panel. Value remains over quiescent current
    signal CID_PCB_TempSensor_XIX_CID_01_XIX_VLAN_Cockpit: start 72, 8 bit, little-endian, data-type-policy=OVERRIDE, i-signal-type=PRIMITIVE, init-value=254, base-type=BT_CID_PCB_TempSensor, invalid-value=Invalid_CID_PCB_TempSensor_XIX_CID_01_XIX_VLAN_Cockpit:255, compu {phys=raw-55 for raw 0..182, 255=Cxff_Fehler (CM_CID_PCB_TempSensor_Cxff_Fehler), 254=Cxfe_Init (CM_CID_PCB_TempSensor_Cxfe_Init); unit Unit_DegreCelsi}, range phys -55..127 Unit_DegreCelsi, raw 0..255, unit=Unit_DegreCelsi, transfer-property=PENDING  # Display Unit current temperatur of the PCB
    signal CID_PCB_TempSensorMax_XIX_CID_01_XIX_VLAN_Cockpit: start 80, 8 bit, little-endian, data-type-policy=OVERRIDE, i-signal-type=PRIMITIVE, init-value=254, base-type=BT_CID_PCB_TempSensorMax, invalid-value=Invalid_CID_PCB_TempSensorMax_XIX_CID_01_XIX_VLAN_Cockpit:255, compu {phys=raw-55 for raw 0..182, 255=Cxff_Fehler (CM_CID_PCB_TempSensorMax_Cxff_Fehler), 254=Cxfe_Init (CM_CID_PCB_TempSensorMax_Cxfe_Init); unit Unit_DegreCelsi}, range phys -55..127 Unit_DegreCelsi, raw 0..255, unit=Unit_DegreCelsi, transfer-property=PENDING  # Stored maximum sensor temperature of the PCB (display unit). Value remains over quiescent current
    signal CID_OperatingTime_min_XIX_CID_01_XIX_VLAN_Cockpit: start 88, 8 bit, little-endian, data-type-policy=OVERRIDE, i-signal-type=PRIMITIVE, init-value=254, base-type=BT_CID_OperatingTime_min, invalid-value=Invalid_CID_OperatingTime_min_XIX_CID_01_XIX_VLAN_Cockpit:255, compu {phys=raw for raw 0..59, 255=Cxff_Fehler (CM_CID_OperatingTime_min_Cxff_Fehler), 254=Cxfe_Init (CM_CID_OperatingTime_min_Cxfe_Init); unit Unit_Minut}, range phys 0..59 Unit_Minut, raw 0..255, unit=Unit_Minut, transfer-property=PENDING  # Display Unit operatingtime minutes share
    signal CID_OperatingTime_hr_XIX_CID_01_XIX_VLAN_Cockpit: start 96, 16 bit, little-endian, data-type-policy=OVERRIDE, i-signal-type=PRIMITIVE, init-value=65534, base-type=BT_CID_OperatingTime_hr, invalid-value=Invalid_CID_OperatingTime_hr_XIX_CID_01_XIX_VLAN_Cockpit:65535, compu {phys=raw for raw 0..65533, 65535=Cxffff_Fehler (CM_CID_OperatingTime_hr_Cxffff_Fehler), 65534=Cxfffe_Init (CM_CID_OperatingTime_hr_Cxfffe_Init); unit Unit_Hours}, range phys 0..65533 Unit_Hours, raw 0..65535, unit=Unit_Hours, transfer-property=PENDING  # Display Unit operatingtime hours share
    signal CID_VW_SL_Spare_Part_Nr_Index_XIX_CID_01_XIX_VLAN_Cockpit: start 112, 16 bit, little-endian, data-type-policy=OVERRIDE, i-signal-type=PRIMITIVE, init-value=45, base-type=BT_CID_VW_SL_Spare_Part_Nr_Index, compu {phys=raw for raw 0..65534, 65535=Cxffff_Error (CM_CID_VW_SL_Spare_Part_Nr_Index_Cxffff_Error); unit Unit_None}, range phys 0..65534 Unit_None, raw 0..65535, unit=Unit_None, transfer-property=PENDING  # Index der VW/Audi-Teilenummern des CID gemäß der VW 80127= Teilenummer gemäß Kennung Teilnummer aus DID F187 VW SparePartNumber
    signal CID_VW_SL_App_SW_Version_Nr_XIX_CID_01_XIX_VLAN_Cockpit: start 128, 32 bit, little-endian, data-type-policy=OVERRIDE, i-signal-type=PRIMITIVE, init-value=45, base-type=BT_CID_VW_SL_App_SW_Version_Nr, compu {phys=raw for raw 0..4294967294, 4294967295=Cxffffffff_Error (CM_CID_VW_SL_App_SW_Version_Nr_Cxffffffff_Error); unit Unit_None}, range phys 0..4294967294 Unit_None, raw 0..4294967295, unit=Unit_None, transfer-property=PENDING  # SW-Version des CID gemäß VW80127= Entspricht Software-Version gemäß der DID F189 VW Software Version Number
    signal CID_VW_SL_HW_Version_Nr_XIX_CID_01_XIX_VLAN_Cockpit: start 160, 24 bit, little-endian, data-type-policy=OVERRIDE, i-signal-type=PRIMITIVE, init-value=45, base-type=BT_CID_VW_SL_HW_Version_Nr, compu {phys=raw for raw 0..16777214, 16777215=Cxffffff_Error (CM_CID_VW_SL_HW_Version_Nr_Cxffffff_Error); unit Unit_None}, range phys 0..16777214 Unit_None, raw 0..16777215, unit=Unit_None, transfer-property=PENDING  # Slave-Hardware des CID gemäß VW80127= Entspricht Kennung Hardware Version gemäß DID F1A3 VW ECU Hardware Version Number
    signal CID_VW_SL_Spare_Part_Nr_EndNr_XIX_CID_01_XIX_VLAN_Cockpit: start 184, 24 bit, little-endian, data-type-policy=OVERRIDE, i-signal-type=PRIMITIVE, init-value=45, base-type=BT_CID_VW_SL_Spare_Part_Nr_EndNr, compu {phys=raw for raw 0..16777214, 16777215=Cxffffff_Error (CM_CID_VW_SL_Spare_Part_Nr_EndNr_Cxffffff_Error); unit Unit_None}, range phys 0..16777214 Unit_None, raw 0..16777215, unit=Unit_None, transfer-property=PENDING  # Endnummer der VW/Audi-Teilenummern des CID gemäß der VW 80127= Teilenummer gemäß Kennung Teilnummer aus DID F187 VW SparePartNumber
    signal CID_VW_SL_Spare_Part_Nr_MittelNr_XIX_CID_01_XIX_VLAN_Cockpit: start 208, 24 bit, little-endian, data-type-policy=OVERRIDE, i-signal-type=PRIMITIVE, init-value=45, base-type=BT_CID_VW_SL_Spare_Part_Nr_MittelNr, compu {phys=raw for raw 0..16777214, 16777215=Cxffffff_Error (CM_CID_VW_SL_Spare_Part_Nr_MittelNr_Cxffffff_Error); unit Unit_None}, range phys 0..16777214 Unit_None, raw 0..16777215, unit=Unit_None, transfer-property=PENDING  # Mittelnummer der VW/Audi-Teilenummern des CID gemäß der VW 80127= Teilenummer gemäß Kennung Teilnummer aus DID F187 VW SparePartNumber
    signal CID_VW_SL_Spare_Part_Nr_TMA_XIX_CID_01_XIX_VLAN_Cockpit: start 232, 24 bit, little-endian, data-type-policy=OVERRIDE, i-signal-type=PRIMITIVE, init-value=45, base-type=BT_CID_VW_SL_Spare_Part_Nr_TMA, compu {phys=raw for raw 0..16777214, 16777215=Cxffffff_Error (CM_CID_VW_SL_Spare_Part_Nr_TMA_Cxffffff_Error); unit Unit_None}, range phys 0..16777214 Unit_None, raw 0..16777215, unit=Unit_None, transfer-property=PENDING  # TMA der VW/Audi-Teilenummern des CID gemäß der VW 80127= Teilenummer gemäß Kennung Teilnummer aus DID F187 VW SparePartNumber
    signal CID_Touch_Errorstate_XIX_CID_01_XIX_VLAN_Cockpit: start 256, 2 bit, little-endian, data-type-policy=OVERRIDE, i-signal-type=PRIMITIVE, init-value=0, base-type=BT_CID_Touch_Errorstate, compu {0=Cx0_no_error (CM_CID_Touch_Errorstate_Cx0_no_error), 1=Cx1_SW_error (CM_CID_Touch_Errorstate_Cx1_SW_error), 2=Cx2_HW_error (CM_CID_Touch_Errorstate_Cx2_HW_error)}, range raw 0..2, transfer-property=PENDING  # CID_Touch_Errorstate = 0 no error detected CID_Touch_Errorstate = 1 SW error detected CID_Touch_Errorstate = 2 HW error detected
    signal CID_Haptik_Errorstate_XIX_CID_01_XIX_VLAN_Cockpit: start 258, 2 bit, little-endian, data-type-policy=OVERRIDE, i-signal-type=PRIMITIVE, init-value=0, base-type=BT_CID_Haptik_Errorstate, compu {2=Cx2_HW_error (CM_CID_Haptik_Errorstate_Cx2_HW_error), 0=Cx0_no_error (CM_CID_Haptik_Errorstate_Cx0_no_error), 1=Cx1_SW_error (CM_CID_Haptik_Errorstate_Cx1_SW_error)}, range raw 0..2, transfer-property=PENDING  # CID_Haptik_Errorstate = 0 no error detected CID_Haptik_Errorstate = 1 SW error detected CID_Haptik_Errorstate = 2 HW error detected
    signal CID_LVDS_Splitter_Errorstate_XIX_CID_01_XIX_VLAN_Cockpit: start 260, 2 bit, little-endian, data-type-policy=OVERRIDE, i-signal-type=PRIMITIVE, init-value=0, base-type=BT_CID_LVDS_Splitter_Errorstate, compu {2=Cx2_HW_error (CM_CID_LVDS_Splitter_Errorstate_Cx2_HW_error), 0=Cx0_no_error (CM_CID_LVDS_Splitter_Errorstate_Cx0_no_error), 1=Cx1_SW_error (CM_CID_LVDS_Splitter_Errorstate_Cx1_SW_error)}, range raw 0..2, transfer-property=PENDING  # CID_LVDS_Splitter_Errorstate = 0 no error detected CID_LVDS_Splitter_Errorstate = 1 SW error detected CID_LVDS_Splitter_Errorstate = 2 HW error detected
    signal CID_ShutterFoil_Errorstate_XIX_CID_01_XIX_VLAN_Cockpit: start 262, 2 bit, little-endian, data-type-policy=OVERRIDE, i-signal-type=PRIMITIVE, init-value=0, base-type=BT_CID_ShutterFoil_Errorstate, compu {2=Cx2_HW_error (CM_CID_ShutterFoil_Errorstate_Cx2_HW_error), 1=Cx1_SW_error (CM_CID_ShutterFoil_Errorstate_Cx1_SW_error), 0=Cx0_no_error (CM_CID_ShutterFoil_Errorstate_Cx0_no_error)}, range raw 0..2, transfer-property=PENDING  # CID_ShutterFoil_Errorstate = 0 no error detected CID_ShutterFoil_Errorstate = 1 SW error detected CID_ShutterFoil_Errorstate = 2 HW error detected
    signal CID_Proximity_Errorstate_XIX_CID_01_XIX_VLAN_Cockpit: start 264, 2 bit, little-endian, data-type-policy=OVERRIDE, i-signal-type=PRIMITIVE, init-value=0, base-type=BT_CID_Proximity_Errorstate, compu {1=Cx1_SW_error (CM_CID_Proximity_Errorstate_Cx1_SW_error), 2=Cx2_HW_error (CM_CID_Proximity_Errorstate_Cx2_HW_error), 0=Cx0_no_error (CM_CID_Proximity_Errorstate_Cx0_no_error)}, range raw 0..2, transfer-property=PENDING  # CID_Proximity_Errorstate = 0 no error detected CID_Proximity_Errorstate = 1 SW error detected CID_Proximity_Errorstate = 2 HW error detected
    signal CID_Slider_Errorstate_XIX_CID_01_XIX_VLAN_Cockpit: start 266, 2 bit, little-endian, data-type-policy=OVERRIDE, i-signal-type=PRIMITIVE, init-value=0, base-type=BT_CID_Slider_Errorstate, compu {1=Cx1_SW_error (CM_CID_Slider_Errorstate_Cx1_SW_error), 0=Cx0_no_error (CM_CID_Slider_Errorstate_Cx0_no_error), 2=Cx2_HW_error (CM_CID_Slider_Errorstate_Cx2_HW_error)}, range raw 0..2, transfer-property=PENDING  # CID_Slider_Errorstate = 0 no error detected CID_Slider_Errorstate = 1 SW error detected CID_Slider_Errorstate = 2 HW error detected
    signal CID_Backlight_ShortCircuit_XIX_CID_01_XIX_VLAN_Cockpit: start 268, 1 bit, little-endian, data-type-policy=OVERRIDE, i-signal-type=PRIMITIVE, init-value=0, base-type=BT_CID_Backlight_ShortCircuit, invalid-value=Invalid_CID_Backlight_ShortCircuit_XIX_CID_01_XIX_VLAN_Cockpit:1, compu {1=Cx1_Fehler (CM_CID_Backlight_ShortCircuit_Cx1_Fehler), 0=Cx0_normal (CM_CID_Backlight_ShortCircuit_Cx0_normal)}, range raw 0..1, transfer-property=TRIGGERED-ON-CHANGE-WITHOUT-REPETITION  # Backlight has a short circuit
    signal CID_Backlight_OpenCircuit_XIX_CID_01_XIX_VLAN_Cockpit: start 269, 1 bit, little-endian, data-type-policy=OVERRIDE, i-signal-type=PRIMITIVE, init-value=0, base-type=BT_CID_Backlight_OpenCircuit, invalid-value=Invalid_CID_Backlight_OpenCircuit_XIX_CID_01_XIX_VLAN_Cockpit:1, compu {1=Cx1_Fehler (CM_CID_Backlight_OpenCircuit_Cx1_Fehler), 0=Cx0_normal (CM_CID_Backlight_OpenCircuit_Cx0_normal)}, range raw 0..1, transfer-property=TRIGGERED-ON-CHANGE-WITHOUT-REPETITION  # With current measurements, at least one LED line is broken
    signal CID_SW_inconsistent_XIX_CID_01_XIX_VLAN_Cockpit: start 270, 1 bit, little-endian, data-type-policy=OVERRIDE, i-signal-type=PRIMITIVE, init-value=0, base-type=BT_CID_SW_inconsistent, invalid-value=Invalid_CID_SW_inconsistent_XIX_CID_01_XIX_VLAN_Cockpit:1, compu {1=Cx1_Fehler (CM_CID_SW_inconsistent_Cx1_Fehler), 0=Cx0_Kein_Fehler (CM_CID_SW_inconsistent_Cx0_Kein_Fehler)}, range raw 0..1, transfer-property=PENDING  # SW_inconsistent = 1 SW Status is inconsistent - error SW_inconsistent = 0 no error - SW is consistent
    signal CID_EEPROM_Error_XIX_CID_01_XIX_VLAN_Cockpit: start 271, 1 bit, little-endian, data-type-policy=OVERRIDE, i-signal-type=PRIMITIVE, init-value=0, base-type=BT_CID_EEPROM_Error, invalid-value=Invalid_CID_EEPROM_Error_XIX_CID_01_XIX_VLAN_Cockpit:1, compu {1=Cx1_Fehler (CM_CID_EEPROM_Error_Cx1_Fehler), 0=Cx0_normal (CM_CID_EEPROM_Error_Cx0_normal)}, range raw 0..1, transfer-property=TRIGGERED-ON-CHANGE-WITHOUT-REPETITION  # EEPROM error detected
    signal CID_Touchstate_XIX_CID_01_XIX_VLAN_Cockpit: start 272, 1 bit, little-endian, data-type-policy=OVERRIDE, i-signal-type=PRIMITIVE, init-value=0, base-type=BT_CID_Touchstate, compu {1=Cx1_touched (CM_CID_Touchstate_Cx1_touched), 0=Cx0_not_touched (CM_CID_Touchstate_Cx0_not_touched)}, range raw 0..1, transfer-property=TRIGGERED-ON-CHANGE-WITHOUT-REPETITION  # This signal provides the current touchstate of the touchscreen (not_touched/touched).
    signal CID_HID_FetchAll_XIX_CID_01_XIX_VLAN_Cockpit: start 273, 1 bit, little-endian, data-type-policy=OVERRIDE, i-signal-type=PRIMITIVE, init-value=0, base-type=BT_CID_HID_FetchAll, compu {0=Cx0_Init (CM_CID_HID_FetchAll_Cx0_Init), 1=Cx1_Done (CM_CID_HID_FetchAll_Cx1_Done)}, range raw 0..1, transfer-property=TRIGGERED-ON-CHANGE-WITHOUT-REPETITION  # HID command FetchAll received and answered
    signal CID_Input_Errorstate_XIX_CID_01_XIX_VLAN_Cockpit: start 274, 1 bit, little-endian, data-type-policy=OVERRIDE, i-signal-type=PRIMITIVE, init-value=0, base-type=BT_CID_Input_Errorstate, invalid-value=Invalid_CID_Input_Errorstate_XIX_CID_01_XIX_VLAN_Cockpit:1, compu {1=Cx1_Fehler (CM_CID_Input_Errorstate_Cx1_Fehler), 0=Cx0_normal (CM_CID_Input_Errorstate_Cx0_normal)}, range raw 0..1, transfer-property=TRIGGERED-ON-CHANGE-WITHOUT-REPETITION  # Display unit has detected an error which could lead to no or incorrect user inputs
    signal CID_Image_Errorstate_XIX_CID_01_XIX_VLAN_Cockpit: start 275, 1 bit, little-endian, data-type-policy=OVERRIDE, i-signal-type=PRIMITIVE, init-value=0, base-type=BT_CID_Image_Errorstate, invalid-value=Invalid_CID_Image_Errorstate_XIX_CID_01_XIX_VLAN_Cockpit:1, compu {1=Cx1_Fehler (CM_CID_Image_Errorstate_Cx1_Fehler), 0=Cx0_normal (CM_CID_Image_Errorstate_Cx0_normal)}, range raw 0..1, transfer-property=TRIGGERED-ON-CHANGE-WITHOUT-REPETITION  # Display unit has detected an error which could lead to no or incorrect image display.
    signal CID_Input_ErrorState_TNCTOC_XIX_CID_01_XIX_VLAN_Cockpit: start 276, 1 bit, little-endian, data-type-policy=OVERRIDE, i-signal-type=PRIMITIVE, init-value=1, base-type=BT_CID_Input_ErrorState_TNCTOC, compu {0=Cx0_completed (CM_CID_Input_ErrorState_TNCTOC_Cx0_completed), 1=Cx1_not_completed (CM_CID_Input_ErrorState_TNCTOC_Cx1_not_completed)}, range raw 0..1, transfer-property=PENDING  # TestNotCompletedThisOperationCycle for signal CID_Input_ErrorState
  pdu ClampControl_01_XIX_VLAN_Cockpit_E2E: length=8, minimum-delay=0.01, transmission-mode-true-timing=event-controlled-timing={number-of-repetitions=0, repetition-period=0.0}, unused-bit-pattern=0  # Fuer die Botschaft ist das Cyclic-Timing 0.1 zu verwenden.
    signal ClampControl_01_CRC_XIX_ClampControl_01_XIX_VLAN_Cockpit: start 0, 8 bit, little-endian, data-type-policy=OVERRIDE, i-signal-type=PRIMITIVE, init-value=0, base-type=BT_ClampControl_01_CRC, compu {phys=raw for raw 0..255}, range phys 0..255, raw 0..255, to HCP3_IONode(timeout 1 s)  # Für MLB: Berechnung siehe Lastenheft "Kommunikationsabsicherung für FlexRay und CAN" Ab MQB und MLBevo: Berechnung siehe Lastenheft "End-to-End Kommunikationsabsicherung" Endwerte siehe Begleitdokument "S-PDU Kennungsfolgen"
    signal ClampControl_01_BZ_XIX_ClampControl_01_XIX_VLAN_Cockpit: start 8, 4 bit, little-endian, data-type-policy=OVERRIDE, i-signal-type=PRIMITIVE, init-value=0, base-type=BT_ClampControl_01_BZ, compu {phys=raw for raw 0..15}, range phys 0..15, raw 0..15, to HCP3_IONode(timeout 1 s)  # 4bit Botschaftszähler, wird mit jeder Sendebotschaft inkrementiert
    signal KST_Warn_P1_ZAT_def_XIX_ClampControl_01_XIX_VLAN_Cockpit: start 12, 1 bit, little-endian, data-type-policy=OVERRIDE, i-signal-type=PRIMITIVE, init-value=0, base-type=BT_KST_Warn_P1_ZAT_def, compu {1=Cx1_defekt (CM_KST_Warn_P1_ZAT_def_Cx1_defekt), 0=Cx0_nicht_defekt (CM_KST_Warn_P1_ZAT_def_Cx0_nicht_defekt)}, range raw 0..1  # Kombi Prio Warnung Klemmensteuerung Zündschloß defekt, Service aufsuchen!
    signal KST_Warn_P2_ZAT_def_XIX_ClampControl_01_XIX_VLAN_Cockpit: start 13, 1 bit, little-endian, data-type-policy=OVERRIDE, i-signal-type=PRIMITIVE, init-value=0, base-type=BT_KST_Warn_P2_ZAT_def, compu {1=Cx1_defekt (CM_KST_Warn_P2_ZAT_def_Cx1_defekt), 0=Cx0_nicht_defekt (CM_KST_Warn_P2_ZAT_def_Cx0_nicht_defekt)}, range raw 0..1  # Kombi Prio Warnung Klemmensteuerung Zündschloß defekt!
    signal KST_Deaktivierungs_Trigger_XIX_ClampControl_01_XIX_VLAN_Cockpit: start 14, 2 bit, little-endian, data-type-policy=OVERRIDE, i-signal-type=PRIMITIVE, init-value=0, base-type=BT_KST_Deaktivierungs_Trigger, compu {0=Cx0_KEINE_DEAKTIVIERUNG_ERFOLGT_0 (CM_KST_Deaktivierungs_Trigger_Cx0_KEINE_DEAKTIVIERUNG_ERFOLGT_0), 1=Cx1_DEAKTIVIERUNG_UEBER_ZAT_1 (CM_KST_Deaktivierungs_Trigger_Cx1_DEAKTIVIERUNG_UEBER_ZAT_1), 2=Cx2_DEAKTIVIERUNG_VEREINFACHT_VLK_2 (CM_KST_Deaktivierungs_Trigger_Cx2_DEAKTIVIERUNG_VEREINFACHT_VLK_2)}, range raw 0..2  # Ausgabe des Deaktivierungstriggers für Funktionen mit Goodbye-Szenario zur Unterscheidung zwischen manueller und automatischer Deaktivierung bei Fzg.-Verlassen
    signal KST_Kl_S_XIX_ClampControl_01_XIX_VLAN_Cockpit: start 16, 1 bit, little-endian, data-type-policy=OVERRIDE, i-signal-type=PRIMITIVE, init-value=0, base-type=BT_KST_Kl_S, compu {0=Cx0_aus (CM_KST_Kl_S_Cx0_aus), 1=Cx1_S_Kontakt_ein (CM_KST_Kl_S_Cx1_S_Kontakt_ein)}, range raw 0..1, to HCP3_IONode(timeout 1 s)  # Klemme S: S-Kontakt (Schluessel steckt)
    signal KST_KL_15_XIX_ClampControl_01_XIX_VLAN_Cockpit: start 17, 1 bit, little-endian, data-type-policy=OVERRIDE, i-signal-type=PRIMITIVE, init-value=0, base-type=BT_KST_KL_15, compu {0=Cx0_aus (CM_KST_KL_15_Cx0_aus), 1=Cx1_ein (CM_KST_KL_15_Cx1_ein)}, range raw 0..1, to HCP3_IONode(timeout 1 s)  # Klemme 15: Zuendung (SW-Kl.15)
    signal KST_Kl_50_Startanforderung_XIX_ClampControl_01_XIX_VLAN_Cockpit: start 18, 1 bit, little-endian, data-type-policy=OVERRIDE, i-signal-type=PRIMITIVE, init-value=0, base-type=BT_KST_Kl_50_Startanforderung, compu {1=Cx1_KL50_ein_Startwunsch_Fahrer (CM_KST_Kl_50_Startanforderung_Cx1_KL50_ein_Startwunsch_Fahrer), 0=Cx0_aus (CM_KST_Kl_50_Startanforderung_Cx0_aus)}, range raw 0..1, to HCP3_IONode(timeout 1 s)  # Klemme 50: Startwunsch Fahrer
    signal KST_Sonderzustand_Status_XIX_ClampControl_01_XIX_VLAN_Cockpit: start 19, 2 bit, little-endian, data-type-policy=OVERRIDE, i-signal-type=PRIMITIVE, init-value=0, base-type=BT_KST_Sonderzustand_Status, invalid-value=Invalid_KST_Sonderzustand_Status_XIX_ClampControl_01_XIX_VLAN_Cockpit:3, compu {3=Cx3_Fehler (CM_KST_Sonderzustand_Status_Cx3_Fehler), 0=Cx0_Init (CM_KST_Sonderzustand_Status_Cx0_Init), 1=Cx1_Uebergang_neue_Anforderung (CM_KST_Sonderzustand_Status_Cx1_Uebergang_neue_Anforderung), 2=Cx2_Aktiv (CM_KST_Sonderzustand_Status_Cx2_Aktiv)}, range raw 0..3  # Hiermit wird signalisiert, dass eine Sonderfunktion aktiv ist und die Klemme 15 durch diese angefordert wurde bzw. ein Übergang von Sonderfunktionen stattfindet
    signal KST_Ausstiegswunsch_Status_XIX_ClampControl_01_XIX_VLAN_Cockpit: start 21, 1 bit, little-endian, data-type-policy=OVERRIDE, i-signal-type=PRIMITIVE, init-value=0, base-type=BT_KST_Ausstiegswunsch_Status, compu {1=Cx1_AUSSTIEGSWUNSCH_AKTIV_1 (CM_KST_Ausstiegswunsch_Status_Cx1_AUSSTIEGSWUNSCH_AKTIV_1), 0=Cx0_KEIN_AUSSTIEGSWUNSCH_AKTIV_0 (CM_KST_Ausstiegswunsch_Status_Cx0_KEIN_AUSSTIEGSWUNSCH_AKTIV_0)}, range raw 0..1, to HCP3_IONode(timeout 1 s)  # Ausstiegswunsch über den Funktionen mit Goodbye-Szenario zentral getriggert werden können.
    signal ISignalVoid_ClampControl_01_XIX_VLAN_Cockpit_0: start 22, 1 bit, little-endian, system signal SignalVoid_ClampControl_01_0, data-type-policy=OVERRIDE, i-signal-type=PRIMITIVE, base-type=BT_SignalVoid
    signal KST_BulbCheckReq_XIX_ClampControl_01_XIX_VLAN_Cockpit: start 23, 1 bit, little-endian, data-type-policy=OVERRIDE, i-signal-type=PRIMITIVE, init-value=0, base-type=BT_KST_BulbCheckReq, compu {0=Cx0_Keine_Anfrage (CM_KST_BulbCheckReq_Cx0_Keine_Anfrage), 1=Cx1_Anfrage (CM_KST_BulbCheckReq_Cx1_Anfrage)}, range raw 0..1  # Signal fordert eine Lampenaufprüfung (Bulb Check) an.
    signal KST_Kl_X_XIX_ClampControl_01_XIX_VLAN_Cockpit: start 24, 1 bit, little-endian, data-type-policy=OVERRIDE, i-signal-type=PRIMITIVE, init-value=0, base-type=BT_KST_Kl_X, compu {0=Cx0_aus (CM_KST_Kl_X_Cx0_aus), 1=Cx1_ein (CM_KST_Kl_X_Cx1_ein)}, range raw 0..1  # Ausgabe der Klemme 75 aus Kompatibilitätsgründen für COP-Übernahmen aus MEB.
    signal KST_Ausparken_Betrieb_XIX_ClampControl_01_XIX_VLAN_Cockpit: start 25, 1 bit, little-endian, data-type-policy=OVERRIDE, i-signal-type=PRIMITIVE, init-value=0, base-type=BT_KST_Ausparken_Betrieb, compu {0=Cx0_kein_Betrieb (CM_KST_Ausparken_Betrieb_Cx0_kein_Betrieb), 1=Cx1_Ausparkvorgang_aktiv (CM_KST_Ausparken_Betrieb_Cx1_Ausparkvorgang_aktiv)}, range raw 0..1  # Anforderung zur erneuten Lampenaufprüfung und Anzeige von Warnhinweisen nach einem pilotierten Ausparkvorgang (Trigger: fallende Flanke)
    signal KST_Fahrerhinweis_1_XIX_ClampControl_01_XIX_VLAN_Cockpit: start 26, 1 bit, little-endian, data-type-policy=OVERRIDE, i-signal-type=PRIMITIVE, init-value=0, base-type=BT_KST_Fahrerhinweis_1, compu {0=Cx0_inaktiv (CM_KST_Fahrerhinweis_1_Cx0_inaktiv), 1=Cx1_aktiv (CM_KST_Fahrerhinweis_1_Cx1_aktiv)}, range raw 0..1  # Signalisierung Fahrerhinweis 1 der Klemmensteuerung an das Kombi
    signal KST_Fahrerhinweis_2_XIX_ClampControl_01_XIX_VLAN_Cockpit: start 27, 1 bit, little-endian, data-type-policy=OVERRIDE, i-signal-type=PRIMITIVE, init-value=0, base-type=BT_KST_Fahrerhinweis_2, compu {0=Cx0_inaktiv (CM_KST_Fahrerhinweis_2_Cx0_inaktiv), 1=Cx1_aktiv (CM_KST_Fahrerhinweis_2_Cx1_aktiv)}, range raw 0..1  # Signalisierung Fahrerhinweis 2 der Klemmensteuerung an das Kombi
    signal KST_Fahrerhinweis_3_XIX_ClampControl_01_XIX_VLAN_Cockpit: start 28, 1 bit, little-endian, data-type-policy=OVERRIDE, i-signal-type=PRIMITIVE, init-value=0, base-type=BT_KST_Fahrerhinweis_3, compu {0=Cx0_inaktiv (CM_KST_Fahrerhinweis_3_Cx0_inaktiv), 1=Cx1_aktiv (CM_KST_Fahrerhinweis_3_Cx1_aktiv)}, range raw 0..1  # Signalisierung Fahrerhinweis 3 der Klemmensteuerung an das Kombi
    signal KST_Fahrerhinweis_4_XIX_ClampControl_01_XIX_VLAN_Cockpit: start 29, 1 bit, little-endian, data-type-policy=OVERRIDE, i-signal-type=PRIMITIVE, init-value=0, base-type=BT_KST_Fahrerhinweis_4, compu {0=Cx0_inaktiv (CM_KST_Fahrerhinweis_4_Cx0_inaktiv), 1=Cx1_aktiv (CM_KST_Fahrerhinweis_4_Cx1_aktiv)}, range raw 0..1  # Signalisierung Fahrerhinweis 4 der Klemmensteuerung an das Kombi
    signal KST_Fahrerhinweis_5_XIX_ClampControl_01_XIX_VLAN_Cockpit: start 30, 1 bit, little-endian, data-type-policy=OVERRIDE, i-signal-type=PRIMITIVE, init-value=0, base-type=BT_KST_Fahrerhinweis_5, compu {0=Cx0_inaktiv (CM_KST_Fahrerhinweis_5_Cx0_inaktiv), 1=Cx1_aktiv (CM_KST_Fahrerhinweis_5_Cx1_aktiv)}, range raw 0..1  # Anzeigesignal für RemoteStart
    signal KST_Fahrerhinweis_6_XIX_ClampControl_01_XIX_VLAN_Cockpit: start 31, 1 bit, little-endian, data-type-policy=OVERRIDE, i-signal-type=PRIMITIVE, init-value=0, base-type=BT_KST_Fahrerhinweis_6, compu {0=Cx0_inaktiv (CM_KST_Fahrerhinweis_6_Cx0_inaktiv), 1=Cx1_aktiv (CM_KST_Fahrerhinweis_6_Cx1_aktiv)}, range raw 0..1  # Signal aktiviert die Kombi-Anzeigeinstrumente (Drehzahl, Tankinhalt, Kühlmitteltemperatur) während aktiviertem RemoteStart-Betrieb
    signal ISignalVoid_ClampControl_01_XIX_VLAN_Cockpit_1: start 32, 2 bit, little-endian, system signal SignalVoid_ClampControl_01_1, data-type-policy=OVERRIDE, i-signal-type=PRIMITIVE, base-type=BT_SignalVoid
    signal KST_Txt_Panikabschaltung_XIX_ClampControl_01_XIX_VLAN_Cockpit: start 34, 1 bit, little-endian, data-type-policy=OVERRIDE, i-signal-type=PRIMITIVE, init-value=0, base-type=BT_KST_Txt_Panikabschaltung, compu {0=Cx0_Aus (CM_KST_Txt_Panikabschaltung_Cx0_Aus), 1=Cx1_Ein (CM_KST_Txt_Panikabschaltung_Cx1_Ein)}, range raw 0..1  # Text: 'Notabschaltung''
    signal ISignalVoid_ClampControl_01_XIX_VLAN_Cockpit_2: start 35, 5 bit, little-endian, system signal SignalVoid_ClampControl_01_2, data-type-policy=OVERRIDE, i-signal-type=PRIMITIVE, base-type=BT_SignalVoid
    signal ISignalVoid_ClampControl_01_XIX_VLAN_Cockpit_3: start 40, 1 bit, little-endian, system signal SignalVoid_ClampControl_01_3, data-type-policy=OVERRIDE, i-signal-type=PRIMITIVE, base-type=BT_SignalVoid
    signal KST_Anf_Klemmenfreigabe_ELV_XIX_ClampControl_01_XIX_VLAN_Cockpit: start 41, 1 bit, little-endian, data-type-policy=OVERRIDE, i-signal-type=PRIMITIVE, init-value=0, base-type=BT_KST_Anf_Klemmenfreigabe_ELV, compu {0=Cx0_nicht_angefordert (CM_KST_Anf_Klemmenfreigabe_ELV_Cx0_nicht_angefordert), 1=Cx1_angefordert (CM_KST_Anf_Klemmenfreigabe_ELV_Cx1_angefordert)}, range raw 0..1  # Klemmensteuerung fordert Klemmen-Freigabe durch die ELV an.
    signal KST_aut_Abschaltung_Zuendung_XIX_ClampControl_01_XIX_VLAN_Cockpit: start 42, 1 bit, little-endian, data-type-policy=OVERRIDE, i-signal-type=PRIMITIVE, init-value=0, base-type=BT_KST_aut_Abschaltung_Zuendung, compu {1=Cx1_Zuendung_wird_bei_Verl_deaktiviert (CM_KST_aut_Abschaltung_Zuendung_Cx1_Zuendung_wird_bei_Verl_deaktiviert), 0=Cx0_Zuendung_wird_bei_Verl_nicht_deaktiviert (CM_KST_aut_Abschaltung_Zuendung_Cx0_Zuendung_wird_bei_Verl_nicht_deaktiviert)}, range raw 0..1  # Falls bei eingeschalteter Zündung das Abblendlicht aktiv war, muss nach der automatischen Abschaltung der Kl_15 & Kl_S, dass Standlicht aktiv bleiben. Das Signal sendet die Information, dass eine automatische Abschaltung der Kl_15 und Kl_S erfogt.
    signal KST_StPtAcvReq_XIX_ClampControl_01_XIX_VLAN_Cockpit: start 43, 2 bit, little-endian, data-type-policy=OVERRIDE, i-signal-type=PRIMITIVE, init-value=0, base-type=BT_KST_StPtAcvReq, compu {0=Cx0_NoActivationRequest (CM_KST_StPtAcvReq_Cx0_NoActivationRequest), 2=Cx2_CurrentActivationRequest (CM_KST_StPtAcvReq_Cx2_CurrentActivationRequest), 1=Cx1_StoredActivationRequest (CM_KST_StPtAcvReq_Cx1_StoredActivationRequest)}, range raw 0..2  # ZAT-activation-demand
    signal KST_StPtDeacReq_XIX_ClampControl_01_XIX_VLAN_Cockpit: start 45, 1 bit, little-endian, data-type-policy=OVERRIDE, i-signal-type=PRIMITIVE, init-value=0, base-type=BT_KST_StPtDeacReq, compu {0=Cx0_NoRequest (CM_KST_StPtDeacReq_Cx0_NoRequest), 1=Cx1_RequestDeactivatePowertrain (CM_KST_StPtDeacReq_Cx1_RequestDeactivatePowertrain)}, range raw 0..1  # Anforderung Deaktivierung des Antriebsstrangs durch Klemmensteuerung
    signal KST_ZAT_betaetigt_XIX_ClampControl_01_XIX_VLAN_Cockpit: start 46, 1 bit, little-endian, data-type-policy=OVERRIDE, i-signal-type=PRIMITIVE, init-value=0, base-type=BT_KST_ZAT_betaetigt, compu {0=Cx0_Aus (CM_KST_ZAT_betaetigt_Cx0_Aus), 1=Cx1_Ein (CM_KST_ZAT_betaetigt_Cx1_Ein)}, range raw 0..1  # Zündanlass-Taster (ZAT) betätigt
    signal KST_ComfortReadyStatus_XIX_ClampControl_01_XIX_VLAN_Cockpit: start 47, 1 bit, little-endian, data-type-policy=OVERRIDE, i-signal-type=PRIMITIVE, init-value=0, base-type=BT_KST_ComfortReadyStatus, compu {1=Cx1_ComfortReadyStatus_ein (CM_KST_ComfortReadyStatus_Cx1_ComfortReadyStatus_ein), 0=Cx0_aus (CM_KST_ComfortReadyStatus_Cx0_aus)}, range raw 0..1, to HCP3_IONode(timeout 1 s)  # Zustand des ComfortReadyStatus über den Komfortfunktionen aktiviert werden können.
    signal KST_Sonderzustand_Anforderung_XIX_ClampControl_01_XIX_VLAN_Cockpit: start 48, 5 bit, little-endian, data-type-policy=OVERRIDE, i-signal-type=PRIMITIVE, init-value=0, base-type=BT_KST_Sonderzustand_Anforderung, invalid-value=Invalid_KST_Sonderzustand_Anforderung_XIX_ClampControl_01_XIX_VLAN_Cockpit:31, compu {31=Cx1f_Fehler (CM_KST_Sonderzustand_Anforderung_Cx1f_Fehler), 11=Cxb_MotorWeiterlaufSchaltung (CM_KST_Sonderzustand_Anforderung_Cxb_MotorWeiterlaufSchaltung), 7=Cx7_Klemme15ViaDiagnose (CM_KST_Sonderzustand_Anforderung_Cx7_Klemme15ViaDiagnose), 10=Cxa_AnhaengerAnkuppelAssistent (CM_KST_Sonderzustand_Anforderung_Cxa_AnhaengerAnkuppelAssistent), 3=Cx3_IntelligentParkAssist (CM_KST_Sonderzustand_Anforderung_Cx3_IntelligentParkAssist), 6=Cx6_Einfrierschutz (CM_KST_Sonderzustand_Anforderung_Cx6_Einfrierschutz), 1=Cx1_RemoteStart (CM_KST_Sonderzustand_Anforderung_Cx1_RemoteStart), 4=Cx4_TrainiertesParken (CM_KST_Sonderzustand_Anforderung_Cx4_TrainiertesParken), 9=Cx9_ParkHausPilot (CM_KST_Sonderzustand_Anforderung_Cx9_ParkHausPilot), 8=Cx8_RueckwandklappenSicherungPDC (CM_KST_Sonderzustand_Anforderung_Cx8_RueckwandklappenSicherungPDC), 5=Cx5_OnlineRemoteUpdate (CM_KST_Sonderzustand_Anforderung_Cx5_OnlineRemoteUpdate), 2=Cx2_RemoteParkAssist (CM_KST_Sonderzustand_Anforderung_Cx2_RemoteParkAssist), 0=Cx0_Init (CM_KST_Sonderzustand_Anforderung_Cx0_Init)}, range raw 0..31  # Hiermit wird die aktive bzw. aktuell angeforderte (s. KST_Sonderzustand_Status) Sonderfunktion identifiziert
    signal KST_WFS_Fahrfreigabe_Anforderung_XIX_ClampControl_01_XIX_VLAN_Cockpit: start 53, 2 bit, little-endian, data-type-policy=OVERRIDE, i-signal-type=PRIMITIVE, init-value=0, base-type=BT_KST_WFS_Fahrfreigabe_Anforderung, compu {2=Cx2_Eingeschraenkt (CM_KST_WFS_Fahrfreigabe_Anforderung_Cx2_Eingeschraenkt), 1=Cx1_Uneingeschraenkt (CM_KST_WFS_Fahrfreigabe_Anforderung_Cx1_Uneingeschraenkt), 0=Cx0_Keine (CM_KST_WFS_Fahrfreigabe_Anforderung_Cx0_Keine)}, range raw 0..2  # Hiermit wird den Wegfahrsperren-Teilnehmern signalisiert welche Art der Fahrfreigabe von der anfordernden Sonderfunktion benötigt wird
    signal ISignalVoid_ClampControl_01_XIX_VLAN_Cockpit_4: start 55, 1 bit, little-endian, system signal SignalVoid_ClampControl_01_4, data-type-policy=OVERRIDE, i-signal-type=PRIMITIVE, base-type=BT_SignalVoid
    signal ISignalVoid_ClampControl_01_XIX_VLAN_Cockpit_5: start 56, 8 bit, little-endian, system signal SignalVoid_ClampControl_01_5, data-type-policy=OVERRIDE, i-signal-type=PRIMITIVE, base-type=BT_SignalVoid
    mapping SG_ClampControl_01_XIX_VLAN_Cockpit: i-signal-group=SG_ClampControl_01_XIX_VLAN_Cockpit, transfer-property=TRIGGERED-WITHOUT-REPETITION
  pdu ClimateControl_01_XIX_VLAN_Cockpit: length=48, minimum-delay=0.025, transmission-mode-true-timing={cyclic-timing={time-offset=0.0, time-period=0.2}, event-controlled-timing={number-of-repetitions=5, repetition-period=0.1}}, unused-bit-pattern=0
    signal ClimateControl_01_CRC_XIX_ClimateControl_01_XIX_VLAN_Cockpit: start 0, 8 bit, little-endian, data-type-policy=OVERRIDE, i-signal-type=PRIMITIVE, init-value=0, base-type=BT_ClimateControl_01_CRC, compu {phys=raw for raw 0..255}, range phys 0..255, raw 0..255, transfer-property=TRIGGERED-WITHOUT-REPETITION
    signal ClimateControl_01_BZ_XIX_ClimateControl_01_XIX_VLAN_Cockpit: start 8, 4 bit, little-endian, data-type-policy=OVERRIDE, i-signal-type=PRIMITIVE, init-value=0, base-type=BT_ClimateControl_01_BZ, compu {phys=raw for raw 0..15}, range phys 0..15, raw 0..15, transfer-property=TRIGGERED-WITHOUT-REPETITION
    signal HSH_Taster_XIX_ClimateControl_01_XIX_VLAN_Cockpit: start 12, 2 bit, little-endian, data-type-policy=OVERRIDE, i-signal-type=PRIMITIVE, init-value=0, base-type=BT_HSH_Taster, compu {1=Cx1_short_push (CM_HSH_Taster_Cx1_short_push), 0=Cx0_nicht_betaetigt (CM_HSH_Taster_Cx0_nicht_betaetigt), 2=Cx2_long_push (CM_HSH_Taster_Cx2_long_push), 3=Cx3_tbd (CM_HSH_Taster_Cx3_tbd)}, range raw 0..3, transfer-property=TRIGGERED-WITHOUT-REPETITION  # An-/Abforderung Heckscheibenheizung über spezielles Tastersignal
    signal KL_Anf_AussenspiegelHzg_XIX_ClimateControl_01_XIX_VLAN_Cockpit: start 14, 1 bit, little-endian, data-type-policy=OVERRIDE, i-signal-type=PRIMITIVE, init-value=0, base-type=BT_KL_Anf_AussenspiegelHzg, compu {0=Cx0_nicht_angefordert (CM_KL_Anf_AussenspiegelHzg_Cx0_nicht_angefordert), 1=Cx1_angefordert (CM_KL_Anf_AussenspiegelHzg_Cx1_angefordert)}, range raw 0..1, transfer-property=TRIGGERED-WITHOUT-REPETITION  # Anforderung Außenspiegelheizung seitens Klimafunktion (z.B. bei Erweiterter VoKo)
    signal KL_ErwVK_Anf_XIX_ClimateControl_01_XIX_VLAN_Cockpit: start 15, 1 bit, little-endian, data-type-policy=OVERRIDE, i-signal-type=PRIMITIVE, init-value=0, base-type=BT_KL_ErwVK_Anf, compu {1=Cx1_angefordert (CM_KL_ErwVK_Anf_Cx1_angefordert), 0=Cx0_nicht_angefordert (CM_KL_ErwVK_Anf_Cx0_nicht_angefordert)}, range raw 0..1, transfer-property=TRIGGERED-WITHOUT-REPETITION  # Erweiterte Voko angefordertert / aktiv
    signal KL_Geblaese_Fond_Status_XIX_ClimateControl_01_XIX_VLAN_Cockpit: start 16, 4 bit, little-endian, data-type-policy=OVERRIDE, i-signal-type=PRIMITIVE, init-value=14, base-type=BT_KL_Geblaese_Fond_Status, invalid-value=Invalid_KL_Geblaese_Fond_Status_XIX_ClimateControl_01_XIX_VLAN_Cockpit:15, compu {15=Cxf_Fehler (CM_KL_Geblaese_Fond_Status_Cxf_Fehler), 10=Cxa_Geblaesestufe_100 (CM_KL_Geblaese_Fond_Status_Cxa_Geblaesestufe_100), 0=Cx0_Geblaese_aus (CM_KL_Geblaese_Fond_Status_Cx0_Geblaese_aus), 5=Cx5_Geblaesestufe_50 (CM_KL_Geblaese_Fond_Status_Cx5_Geblaesestufe_50), 6=Cx6_Geblaesestufe_60 (CM_KL_Geblaese_Fond_Status_Cx6_Geblaesestufe_60), 9=Cx9_Geblaesestufe_90 (CM_KL_Geblaese_Fond_Status_Cx9_Geblaesestufe_90), 2=Cx2_Geblaesestufe_20 (CM_KL_Geblaese_Fond_Status_Cx2_Geblaesestufe_20), 14=Cxe_Init (CM_KL_Geblaese_Fond_Status_Cxe_Init), 8=Cx8_Geblaesestufe_80 (CM_KL_Geblaese_Fond_Status_Cx8_Geblaesestufe_80), 7=Cx7_Geblaesestufe_70 (CM_KL_Geblaese_Fond_Status_Cx7_Geblaesestufe_70), 3=Cx3_Geblaesestufe_30 (CM_KL_Geblaese_Fond_Status_Cx3_Geblaesestufe_30), 1=Cx1_Geblaesestufe_10 (CM_KL_Geblaese_Fond_Status_Cx1_Geblaesestufe_10), 4=Cx4_Geblaesestufe_40 (CM_KL_Geblaese_Fond_Status_Cx4_Geblaesestufe_40)}, range raw 0..15, transfer-property=TRIGGERED-WITHOUT-REPETITION  # Status Geblaese
    signal KL_Geblaese_Status_XIX_ClimateControl_01_XIX_VLAN_Cockpit: start 20, 4 bit, little-endian, data-type-policy=OVERRIDE, i-signal-type=PRIMITIVE, init-value=14, base-type=BT_KL_Geblaese_Status, invalid-value=Invalid_KL_Geblaese_Status_XIX_ClimateControl_01_XIX_VLAN_Cockpit:15, compu {15=Cxf_Fehler (CM_KL_Geblaese_Status_Cxf_Fehler), 14=Cxe_Init (CM_KL_Geblaese_Status_Cxe_Init), 0=Cx0_Geblaese_aus (CM_KL_Geblaese_Status_Cx0_Geblaese_aus), 1=Cx1_Geblaesestufe_10 (CM_KL_Geblaese_Status_Cx1_Geblaesestufe_10), 2=Cx2_Geblaesestufe_20 (CM_KL_Geblaese_Status_Cx2_Geblaesestufe_20), 3=Cx3_Geblaesestufe_30 (CM_KL_Geblaese_Status_Cx3_Geblaesestufe_30), 4=Cx4_Geblaesestufe_40 (CM_KL_Geblaese_Status_Cx4_Geblaesestufe_40), 5=Cx5_Geblaesestufe_50 (CM_KL_Geblaese_Status_Cx5_Geblaesestufe_50), 6=Cx6_Geblaesestufe_60 (CM_KL_Geblaese_Status_Cx6_Geblaesestufe_60), 7=Cx7_Geblaesestufe_70 (CM_KL_Geblaese_Status_Cx7_Geblaesestufe_70), 8=Cx8_Geblaesestufe_80 (CM_KL_Geblaese_Status_Cx8_Geblaesestufe_80), 9=Cx9_Geblaesestufe_90 (CM_KL_Geblaese_Status_Cx9_Geblaesestufe_90), 10=Cxa_Geblaesestufe_100 (CM_KL_Geblaese_Status_Cxa_Geblaesestufe_100)}, range raw 0..15, transfer-property=TRIGGERED-WITHOUT-REPETITION, to HCP3_IONode(timeout 2 s)  # Status Geblaese
    signal KL_Innen_Temp_XIX_ClimateControl_01_XIX_VLAN_Cockpit: start 24, 8 bit, little-endian, data-type-policy=OVERRIDE, i-signal-type=PRIMITIVE, init-value=254, base-type=BT_KL_Innen_Temp, invalid-value=Invalid_KL_Innen_Temp_XIX_ClimateControl_01_XIX_VLAN_Cockpit:255, compu {phys=raw*0.5-50 for raw 0..252, 255=Cxff_Fehler (CM_KL_Innen_Temp_Cxff_Fehler), 254=Cxfe_nicht_verfuegbar (CM_KL_Innen_Temp_Cxfe_nicht_verfuegbar), 253=Cxfd_nicht_verbaut (CM_KL_Innen_Temp_Cxfd_nicht_verbaut); unit Unit_DegreCelsi}, range phys -50..76 Unit_DegreCelsi, raw 0..255, unit=Unit_DegreCelsi, transfer-property=TRIGGERED-WITHOUT-REPETITION  # Innentemperatur
    signal KL_Restwaerme_aktiv_XIX_ClimateControl_01_XIX_VLAN_Cockpit: start 35, 1 bit, little-endian, data-type-policy=OVERRIDE, i-signal-type=PRIMITIVE, init-value=0, base-type=BT_KL_Restwaerme_aktiv, compu {0=Cx0_inaktiv (CM_KL_Restwaerme_aktiv_Cx0_inaktiv), 1=Cx1_aktiv (CM_KL_Restwaerme_aktiv_Cx1_aktiv)}, range raw 0..1, transfer-property=TRIGGERED-WITHOUT-REPETITION  # Signal zur Aktivierung/Deaktivierung der Wasserpumpe bei Restwärme; reduzierte IRÜ Empfindlichkeit
    signal KL_Solarluefter_aktiv_XIX_ClimateControl_01_XIX_VLAN_Cockpit: start 36, 1 bit, little-endian, data-type-policy=OVERRIDE, i-signal-type=PRIMITIVE, init-value=0, base-type=BT_KL_Solarluefter_aktiv, compu {0=Cx0_Solarluefter_nicht_aktiv (CM_KL_Solarluefter_aktiv_Cx0_Solarluefter_nicht_aktiv), 1=Cx1_Solarluefter_aktiv_auto (CM_KL_Solarluefter_aktiv_Cx1_Solarluefter_aktiv_auto) (Solarluefter_aktiv__auto)}, range raw 0..1, transfer-property=TRIGGERED-WITHOUT-REPETITION  # Betriebsstatus Solarluefter
    signal KL_STH_aktiv_XIX_ClimateControl_01_XIX_VLAN_Cockpit: start 37, 1 bit, little-endian, data-type-policy=OVERRIDE, i-signal-type=PRIMITIVE, init-value=0, base-type=BT_KL_STH_aktiv, compu {0=Cx0_Standheizung_nicht_aktiv (CM_KL_STH_aktiv_Cx0_Standheizung_nicht_aktiv), 1=Cx1_Standheizung_aktiv (CM_KL_STH_aktiv_Cx1_Standheizung_aktiv)}, range raw 0..1, transfer-property=TRIGGERED-WITHOUT-REPETITION  # Betriebsstatus Standheizung
    signal KL_STL_aktiv_XIX_ClimateControl_01_XIX_VLAN_Cockpit: start 46, 1 bit, little-endian, data-type-policy=OVERRIDE, i-signal-type=PRIMITIVE, init-value=0, base-type=BT_KL_STL_aktiv, compu {0=Cx0_Standlueftung_nicht_aktiv (CM_KL_STL_aktiv_Cx0_Standlueftung_nicht_aktiv), 1=Cx1_Standlueftung_aktiv (CM_KL_STL_aktiv_Cx1_Standlueftung_aktiv)}, range raw 0..1, transfer-property=TRIGGERED-WITHOUT-REPETITION  # Betriebsstatus Standlueftung
    signal KL_Thermomanagement_XIX_ClimateControl_01_XIX_VLAN_Cockpit: start 47, 2 bit, little-endian, data-type-policy=OVERRIDE, i-signal-type=PRIMITIVE, init-value=0, base-type=BT_KL_Thermomanagement, compu {3=Cx3_volle_Freigabe_TMM_kein_Heizbedarf (CM_KL_Thermomanagement_Cx3_volle_Freigabe_TMM_kein_Heizbedarf) (volle_Freigabe_TMM__kein_Heizbedarf), 1=Cx1_kleine_Freigabe_TMM (CM_KL_Thermomanagement_Cx1_kleine_Freigabe_TMM), 0=Cx0_keine_Freigabe_TMM_max_Heizbedarf (CM_KL_Thermomanagement_Cx0_keine_Freigabe_TMM_max_Heizbedarf) (keine_Freigabe_TMM__max_Heizbedarf), 2=Cx2_mittlere_Freigabe_TMM (CM_KL_Thermomanagement_Cx2_mittlere_Freigabe_TMM)}, range raw 0..3, transfer-property=TRIGGERED-WITHOUT-REPETITION  # Stufen des Thermomanagements; Bei Klemme 15 AUS und erkannten Timeout zum Klimabedienteil (z.B. Klimabedienteil während des Motorsteuergeräte-Kommunikations-Nachlaufs bereits im NM-Zustand ¿Bus Sleep¿) erfolgt keine Ansteuerung der Wasserpumpe durch die ITM Funktion. In dem konkreten Fall wird der definierte Initwert von der ITM-Funktion nicht als Ersatzwert verwendet. Parallel ist eine Ansteuerung zur Restwärmenutzung außerhalb der ITM-Funktion möglich.
    signal KL_Zuheizer_Freigabe_XIX_ClimateControl_01_XIX_VLAN_Cockpit: start 49, 1 bit, little-endian, data-type-policy=OVERRIDE, i-signal-type=PRIMITIVE, init-value=0, base-type=BT_KL_Zuheizer_Freigabe, compu {1=Cx1_Zuheizerfreigabe (CM_KL_Zuheizer_Freigabe_Cx1_Zuheizerfreigabe), 0=Cx0_keine_Freigabe_Zuheizer (CM_KL_Zuheizer_Freigabe_Cx0_keine_Freigabe_Zuheizer)}, range raw 0..1, transfer-property=TRIGGERED-WITHOUT-REPETITION  # Freigabe Zuheizer
    signal KL_Vorkond_Strategie_XIX_ClimateControl_01_XIX_VLAN_Cockpit: start 50, 4 bit, little-endian, data-type-policy=OVERRIDE, i-signal-type=PRIMITIVE, init-value=15, base-type=BT_KL_Vorkond_Strategie, compu {14=Cxe_Konditionierung_nicht_moeglich (CM_KL_Vorkond_Strategie_Cxe_Konditionierung_nicht_moeglich), 7=Cx7_Heizen_elektrisch (CM_KL_Vorkond_Strategie_Cx7_Heizen_elektrisch), 5=Cx5_Heizen (CM_KL_Vorkond_Strategie_Cx5_Heizen), 4=Cx4_Aktive_Kuehlung (CM_KL_Vorkond_Strategie_Cx4_Aktive_Kuehlung) (Aktive Kühlung), 1=Cx1_Spuelen (CM_KL_Vorkond_Strategie_Cx1_Spuelen) (Spülen), 3=Cx3_Kuehlwasserzirkulation (CM_KL_Vorkond_Strategie_Cx3_Kuehlwasserzirkulation) (Kühlwasserzirkulation), 13=Cxd_Strategie_nicht_berechnet (CM_KL_Vorkond_Strategie_Cxd_Strategie_nicht_berechnet), 0=Cx0_Aus (CM_KL_Vorkond_Strategie_Cx0_Aus), 6=Cx6_Reheat (CM_KL_Vorkond_Strategie_Cx6_Reheat), 2=Cx2_Kanalkuehlung (CM_KL_Vorkond_Strategie_Cx2_Kanalkuehlung) (Kanalkühlung), 8=Cx8_Heizen_verbrennungstechnisch (CM_KL_Vorkond_Strategie_Cx8_Heizen_verbrennungstechnisch), 15=Cxf_Init (CM_KL_Vorkond_Strategie_Cxf_Init)}, range raw 0..15, transfer-property=TRIGGERED-WITHOUT-REPETITION  # Strategie der Vorkonditionierung des Innenraums
    signal KRH_Soll_li_XIX_ClimateControl_01_XIX_VLAN_Cockpit: start 54, 2 bit, little-endian, data-type-policy=OVERRIDE, i-signal-type=PRIMITIVE, init-value=0, base-type=BT_KRH_Soll_li, compu {0=Cx0_aus (CM_KRH_Soll_li_Cx0_aus), 1=Cx1_Stufe_1 (CM_KRH_Soll_li_Cx1_Stufe_1), 2=Cx2_Stufe_2 (CM_KRH_Soll_li_Cx2_Stufe_2), 3=Cx3_Stufe_3 (CM_KRH_Soll_li_Cx3_Stufe_3)}, range raw 0..3, transfer-property=TRIGGERED-WITHOUT-REPETITION  # Ausgabe des Sollwertes für die Kopfraumheizung links.
    signal KRH_Soll_re_XIX_ClimateControl_01_XIX_VLAN_Cockpit: start 56, 2 bit, little-endian, data-type-policy=OVERRIDE, i-signal-type=PRIMITIVE, init-value=0, base-type=BT_KRH_Soll_re, compu {2=Cx2_Stufe_2 (CM_KRH_Soll_re_Cx2_Stufe_2), 1=Cx1_Stufe_1 (CM_KRH_Soll_re_Cx1_Stufe_1), 3=Cx3_Stufe_3 (CM_KRH_Soll_re_Cx3_Stufe_3), 0=Cx0_aus (CM_KRH_Soll_re_Cx0_aus)}, range raw 0..3, transfer-property=TRIGGERED-WITHOUT-REPETITION  # Ausgabe des Sollwertes für die Kopfraumheizung rechts.
    signal KL_SIL_Soll_re_XIX_ClimateControl_01_XIX_VLAN_Cockpit: start 58, 3 bit, little-endian, data-type-policy=OVERRIDE, i-signal-type=PRIMITIVE, init-value=0, base-type=BT_KL_SIL_Soll_re, compu {phys=raw for raw 0..6}, range phys 0..6, raw 0..6, transfer-property=TRIGGERED-WITHOUT-REPETITION  # Einstellung Sitzlüftung Beifahrer (0...6)
    signal KL_SIL_Soll_li_XIX_ClimateControl_01_XIX_VLAN_Cockpit: start 61, 3 bit, little-endian, data-type-policy=OVERRIDE, i-signal-type=PRIMITIVE, init-value=0, base-type=BT_KL_SIL_Soll_li, compu {phys=raw for raw 0..6}, range phys 0..6, raw 0..6, transfer-property=TRIGGERED-WITHOUT-REPETITION  # Einstellung Sitzlüftung Fahrer (0...6)
    signal KL_SIH_Soll_li_XIX_ClimateControl_01_XIX_VLAN_Cockpit: start 64, 3 bit, little-endian, data-type-policy=OVERRIDE, i-signal-type=PRIMITIVE, init-value=0, base-type=BT_KL_SIH_Soll_li, compu {phys=raw for raw 0..6}, range phys 0..6, raw 0..6, transfer-property=TRIGGERED-WITHOUT-REPETITION  # Einstellung Sitzheizung Fahrer (0...6)
    signal KL_SIH_Soll_re_XIX_ClimateControl_01_XIX_VLAN_Cockpit: start 67, 3 bit, little-endian, data-type-policy=OVERRIDE, i-signal-type=PRIMITIVE, init-value=0, base-type=BT_KL_SIH_Soll_re, compu {phys=raw for raw 0..6}, range phys 0..6, raw 0..6, transfer-property=TRIGGERED-WITHOUT-REPETITION  # Einstellung Sitzheizung Beifahrer (0...6)
    signal KL_VK_Anf_XIX_ClimateControl_01_XIX_VLAN_Cockpit: start 72, 3 bit, little-endian, data-type-policy=OVERRIDE, i-signal-type=PRIMITIVE, init-value=6, base-type=BT_KL_VK_Anf, invalid-value=Invalid_KL_VK_Anf_XIX_ClimateControl_01_XIX_VLAN_Cockpit:7, compu {7=Cx7_Fehler (CM_KL_VK_Anf_Cx7_Fehler), 1=Cx1_Startanf_via_FFB (CM_KL_VK_Anf_Cx1_Startanf_via_FFB), 3=Cx3_VK_Strategie_STH (CM_KL_VK_Anf_Cx3_VK_Strategie_STH), 2=Cx2_Startanf_via_Sofortheiztaste (CM_KL_VK_Anf_Cx2_Startanf_via_Sofortheiztaste), 0=Cx0_keine_Startanf_von_Climatronic (CM_KL_VK_Anf_Cx0_keine_Startanf_von_Climatronic), 4=Cx4_Startanf_via_ZV_FFB (CM_KL_VK_Anf_Cx4_Startanf_via_ZV_FFB), 5=Cx5_VK_Abbruch (CM_KL_VK_Anf_Cx5_VK_Abbruch), 6=Cx6_Init (CM_KL_VK_Anf_Cx6_Init)}, range raw 0..7, transfer-property=TRIGGERED-WITHOUT-REPETITION  # Starten einer Standklimatisierung ausgehend von der Climatronic Richtung Lademanagment.
    signal KL_Umluftklappe_Status_XIX_ClimateControl_01_XIX_VLAN_Cockpit: start 75, 4 bit, little-endian, data-type-policy=OVERRIDE, i-signal-type=PRIMITIVE, init-value=14, base-type=BT_KL_Umluftklappe_Status, invalid-value=Invalid_KL_Umluftklappe_Status_XIX_ClimateControl_01_XIX_VLAN_Cockpit:15, compu {15=Cxf_Fehler (CM_KL_Umluftklappe_Status_Cxf_Fehler), 8=Cx8_Teilumluft_80 (CM_KL_Umluftklappe_Status_Cx8_Teilumluft_80), 1=Cx1_Teilumluft_10 (CM_KL_Umluftklappe_Status_Cx1_Teilumluft_10), 0=Cx0_Frischluft (CM_KL_Umluftklappe_Status_Cx0_Frischluft), 9=Cx9_Teilumluft_90 (CM_KL_Umluftklappe_Status_Cx9_Teilumluft_90), 6=Cx6_Teilumluft_60 (CM_KL_Umluftklappe_Status_Cx6_Teilumluft_60), 14=Cxe_Init (CM_KL_Umluftklappe_Status_Cxe_Init), 10=Cxa_Umluft (CM_KL_Umluftklappe_Status_Cxa_Umluft), 4=Cx4_Teilumluft_40 (CM_KL_Umluftklappe_Status_Cx4_Teilumluft_40), 2=Cx2_Teilumluft_20 (CM_KL_Umluftklappe_Status_Cx2_Teilumluft_20), 7=Cx7_Teilumluft_70 (CM_KL_Umluftklappe_Status_Cx7_Teilumluft_70), 5=Cx5_Teilumluft_50 (CM_KL_Umluftklappe_Status_Cx5_Teilumluft_50), 3=Cx3_Teilumluft_30 (CM_KL_Umluftklappe_Status_Cx3_Teilumluft_30)}, range raw 0..15, transfer-property=TRIGGERED-WITHOUT-REPETITION  # Status Umluftklappe
    signal KL_FSH_Anf_XIX_ClimateControl_01_XIX_VLAN_Cockpit: start 79, 1 bit, little-endian, data-type-policy=OVERRIDE, i-signal-type=PRIMITIVE, init-value=0, base-type=BT_KL_FSH_Anf, compu {0=Cx0_nicht_angefordert (CM_KL_FSH_Anf_Cx0_nicht_angefordert), 1=Cx1_angefordert (CM_KL_FSH_Anf_Cx1_angefordert)}, range raw 0..1, transfer-property=TRIGGERED-WITHOUT-REPETITION  # Frontscheibenheizungsbedarf im Rahmen der Standklimatisierung
    signal KL_Luftfeuchte_vVerd_Front_XIX_ClimateControl_01_XIX_VLAN_Cockpit: start 80, 8 bit, little-endian, data-type-policy=OVERRIDE, i-signal-type=PRIMITIVE, init-value=254, base-type=BT_KL_Luftfeuchte_vVerd_Front, invalid-value=Invalid_KL_Luftfeuchte_vVerd_Front_XIX_ClimateControl_01_XIX_VLAN_Cockpit:255, compu {phys=raw*0.5 for raw 0..252, 255=Cxff_Fehler (CM_KL_Luftfeuchte_vVerd_Front_Cxff_Fehler), 254=Cxfe_Init (CM_KL_Luftfeuchte_vVerd_Front_Cxfe_Init), 253=Cxfd_nicht_verfuegbar (CM_KL_Luftfeuchte_vVerd_Front_Cxfd_nicht_verfuegbar); unit Unit_PerCent}, range phys 0..126 Unit_PerCent, raw 0..255, unit=Unit_PerCent, transfer-property=TRIGGERED-WITHOUT-REPETITION  # relative Luftfeuchtigkeit vor Frontverdampfer
    signal KL_ECO_Aktiv_XIX_ClimateControl_01_XIX_VLAN_Cockpit: start 88, 1 bit, little-endian, data-type-policy=OVERRIDE, i-signal-type=PRIMITIVE, init-value=0, base-type=BT_KL_ECO_Aktiv, compu {0=Cx0_inaktiv (CM_KL_ECO_Aktiv_Cx0_inaktiv), 1=Cx1_aktiv (CM_KL_ECO_Aktiv_Cx1_aktiv)}, range raw 0..1, transfer-property=TRIGGERED-WITHOUT-REPETITION  # Funktion Eco durch Kundeneingriff aktiviert
    signal KL_FSH_ansteuern_XIX_ClimateControl_01_XIX_VLAN_Cockpit: start 89, 1 bit, little-endian, data-type-policy=OVERRIDE, i-signal-type=PRIMITIVE, init-value=0, base-type=BT_KL_FSH_ansteuern, compu {1=Cx1_nicht_angefordert (CM_KL_FSH_ansteuern_Cx1_nicht_angefordert), 0=Cx0_angefordert (CM_KL_FSH_ansteuern_Cx0_angefordert)}, range raw 0..1, transfer-property=TRIGGERED-WITHOUT-REPETITION  # Anforderung zum Ansteuern der Frontscheibenheizung
    signal KL_FSH_Soll_P_XIX_ClimateControl_01_XIX_VLAN_Cockpit: start 90, 6 bit, little-endian, data-type-policy=OVERRIDE, i-signal-type=PRIMITIVE, init-value=0, base-type=BT_KL_FSH_Soll_P, invalid-value=Invalid_KL_FSH_Soll_P_XIX_ClimateControl_01_XIX_VLAN_Cockpit:63, compu {phys=raw*20 for raw 1..62, 63=Cx3f_Fehler (CM_KL_FSH_Soll_P_Cx3f_Fehler), 0=Cx0_Aus (CM_KL_FSH_Soll_P_Cx0_Aus); unit Unit_Watt}, range phys 20..1240 Unit_Watt, raw 0..63, unit=Unit_Watt, transfer-property=TRIGGERED-WITHOUT-REPETITION  # Sollwertvorgabe für Frontscheibenheizung
    signal KL_I_Geblaese_XIX_ClimateControl_01_XIX_VLAN_Cockpit: start 96, 8 bit, little-endian, data-type-policy=OVERRIDE, i-signal-type=PRIMITIVE, init-value=0, base-type=BT_KL_I_Geblaese, invalid-value=Invalid_KL_I_Geblaese_XIX_ClimateControl_01_XIX_VLAN_Cockpit:255, compu {phys=raw*0.25 for raw 0..254, 255=Cxff_Fehler (CM_KL_I_Geblaese_Cxff_Fehler); unit Unit_Amper}, range phys 0..63.5 Unit_Amper, raw 0..255, unit=Unit_Amper, transfer-property=TRIGGERED-WITHOUT-REPETITION  # Stromaufnahme Gebläse
    signal KL_Beschlagsgefahr_XIX_ClimateControl_01_XIX_VLAN_Cockpit: start 105, 1 bit, little-endian, data-type-policy=OVERRIDE, i-signal-type=PRIMITIVE, init-value=0, base-type=BT_KL_Beschlagsgefahr, compu {0=Cx0_keine_Beschlagsgefahr (CM_KL_Beschlagsgefahr_Cx0_keine_Beschlagsgefahr), 1=Cx1_Beschlagsgefahr (CM_KL_Beschlagsgefahr_Cx1_Beschlagsgefahr)}, range raw 0..1, transfer-property=TRIGGERED-WITHOUT-REPETITION  # Beschlagsgefahr auf der Frontscheibe im Bereich des Spiegelfusses. Dient zur präventiven Ansteuerung der Kamera-Scheibenheizung, um Kamera-Blindheit zu vermeiden PHEV: volle Leistungsfreigabe HV Heizer und HV EKK bei Scheibenbeschlag
    signal KL_ZR_Anforderung_XIX_ClimateControl_01_XIX_VLAN_Cockpit: start 106, 2 bit, little-endian, data-type-policy=OVERRIDE, i-signal-type=PRIMITIVE, init-value=0, base-type=BT_KL_ZR_Anforderung, compu {1=Cx1_inaktiv (CM_KL_ZR_Anforderung_Cx1_inaktiv), 2=Cx2_aktiv (CM_KL_ZR_Anforderung_Cx2_aktiv), 3=Cx3_reserviert (CM_KL_ZR_Anforderung_Cx3_reserviert), 0=Cx0_init (CM_KL_ZR_Anforderung_Cx0_init)}, range raw 0..3, transfer-property=TRIGGERED-WITHOUT-REPETITION  # Anforderung an MIB die Displays zu aktivieren
    signal KL_Kundeneingriff_Geblaese_Z1_XIX_ClimateControl_01_XIX_VLAN_Cockpit: start 108, 1 bit, little-endian, data-type-policy=OVERRIDE, i-signal-type=PRIMITIVE, init-value=0, base-type=BT_KL_Kundeneingriff_Geblaese_Z1, compu {0=Cx0_Kein_Kundeneingriff_Geblaese (CM_KL_Kundeneingriff_Geblaese_Z1_Cx0_Kein_Kundeneingriff_Geblaese), 1=Cx1_Kundeneingriff_Geblaese_aktiv (CM_KL_Kundeneingriff_Geblaese_Z1_Cx1_Kundeneingriff_Geblaese_aktiv)}, range raw 0..1, transfer-property=TRIGGERED-WITHOUT-REPETITION  # Manueller Kundeneingriff in die Geblaeseregelung
    signal KL_Kundeneingriff_Geblaese_Z2_XIX_ClimateControl_01_XIX_VLAN_Cockpit: start 109, 1 bit, little-endian, data-type-policy=OVERRIDE, i-signal-type=PRIMITIVE, init-value=0, base-type=BT_KL_Kundeneingriff_Geblaese_Z2, compu {1=Cx1_Kundeneingriff_Geblaese_aktiv (CM_KL_Kundeneingriff_Geblaese_Z2_Cx1_Kundeneingriff_Geblaese_aktiv), 0=Cx0_Kein_Kundeneingriff_Geblaese (CM_KL_Kundeneingriff_Geblaese_Z2_Cx0_Kein_Kundeneingriff_Geblaese)}, range raw 0..1, transfer-property=TRIGGERED-WITHOUT-REPETITION  # Manueller Kundeneingriff in die Geblaeseregelung
    signal KL_ECO_PRO_Aktiv_XIX_ClimateControl_01_XIX_VLAN_Cockpit: start 110, 1 bit, little-endian, data-type-policy=OVERRIDE, i-signal-type=PRIMITIVE, init-value=0, base-type=BT_KL_ECO_PRO_Aktiv, compu {0=Cx0_inaktiv (CM_KL_ECO_PRO_Aktiv_Cx0_inaktiv), 1=Cx1_aktiv (CM_KL_ECO_PRO_Aktiv_Cx1_aktiv)}, range raw 0..1, transfer-property=TRIGGERED-WITHOUT-REPETITION  # Funktion ECO-PRO durch Kundeneingriff aktiviert
    signal KL_HSH_Soll_XIX_ClimateControl_01_XIX_VLAN_Cockpit: start 111, 1 bit, little-endian, data-type-policy=OVERRIDE, i-signal-type=PRIMITIVE, init-value=0, base-type=BT_KL_HSH_Soll, compu {0=Cx0_nicht_angefordert (CM_KL_HSH_Soll_Cx0_nicht_angefordert), 1=Cx1_angefordert (CM_KL_HSH_Soll_Cx1_angefordert)}, range raw 0..1, transfer-property=TRIGGERED-WITHOUT-REPETITION  # Sollstatus Heckscheibenheizung
    signal KL_Sonnenintensitaet_XIX_ClimateControl_01_XIX_VLAN_Cockpit: start 112, 8 bit, little-endian, data-type-policy=OVERRIDE, i-signal-type=PRIMITIVE, init-value=254, base-type=BT_KL_Sonnenintensitaet, invalid-value=Invalid_KL_Sonnenintensitaet_XIX_ClimateControl_01_XIX_VLAN_Cockpit:255, compu {phys=raw*10 for raw 0..100, 255=Cxff_Fehler (CM_KL_Sonnenintensitaet_Cxff_Fehler), 254=Cxfe_Init (CM_KL_Sonnenintensitaet_Cxfe_Init); unit Unit_WattPerMeterSquar}, range phys 0..1000 Unit_WattPerMeterSquar, raw 0..255, unit=Unit_WattPerMeterSquar, transfer-property=TRIGGERED-WITHOUT-REPETITION  # gemittelte eingestrahlte Leistung in W/m2
    signal KL_Eps_Innen_XIX_ClimateControl_01_XIX_VLAN_Cockpit: start 120, 8 bit, little-endian, data-type-policy=OVERRIDE, i-signal-type=PRIMITIVE, init-value=254, base-type=BT_KL_Eps_Innen, invalid-value=Invalid_KL_Eps_Innen_XIX_ClimateControl_01_XIX_VLAN_Cockpit:255, compu {phys=raw*0.5-50 for raw 0..200, 255=Cxff_Fehler (CM_KL_Eps_Innen_Cxff_Fehler), 254=Cxfe_Init (CM_KL_Eps_Innen_Cxfe_Init); unit Unit_DegreCelsi}, range phys -50..50 Unit_DegreCelsi, raw 0..255, unit=Unit_DegreCelsi, transfer-property=TRIGGERED-WITHOUT-REPETITION  # mittlerer Wert der Klima Regelabweichung
    signal KL_Heizbedarf_XIX_ClimateControl_01_XIX_VLAN_Cockpit: start 128, 10 bit, little-endian, data-type-policy=OVERRIDE, i-signal-type=PRIMITIVE, init-value=1022, base-type=BT_KL_Heizbedarf, invalid-value=Invalid_KL_Heizbedarf_XIX_ClimateControl_01_XIX_VLAN_Cockpit:1023, compu {phys=raw*0.1 for raw 1..900, 1023=Cx3ff_Fehler (CM_KL_Heizbedarf_Cx3ff_Fehler), 1022=Cx3fe_Init (CM_KL_Heizbedarf_Cx3fe_Init), 0=Cx0_Kein_Heizbedarf (CM_KL_Heizbedarf_Cx0_Kein_Heizbedarf); unit Unit_DegreCelsi}, range phys 0.1..90 Unit_DegreCelsi, raw 0..1023, unit=Unit_DegreCelsi, transfer-property=TRIGGERED-WITHOUT-REPETITION  # Bedarf an Heizmenge für Innenraumklimatisierung
    signal KL_Kundeneingriff_Geblaese_XIX_ClimateControl_01_XIX_VLAN_Cockpit: start 138, 1 bit, little-endian, data-type-policy=OVERRIDE, i-signal-type=PRIMITIVE, init-value=0, base-type=BT_KL_Kundeneingriff_Geblaese, compu {1=Cx1_Kundeneingriff_Geblaese_aktiv (CM_KL_Kundeneingriff_Geblaese_Cx1_Kundeneingriff_Geblaese_aktiv), 0=Cx0_Kein_Kundeneingriff_Geblaese (CM_KL_Kundeneingriff_Geblaese_Cx0_Kein_Kundeneingriff_Geblaese)}, range raw 0..1, transfer-property=TRIGGERED-WITHOUT-REPETITION  # Manueller Kundeneingriff in die Geblaeseregelung
    signal KL_QBit_Sonnenintensitaet_XIX_ClimateControl_01_XIX_VLAN_Cockpit: start 139, 1 bit, little-endian, data-type-policy=OVERRIDE, i-signal-type=PRIMITIVE, init-value=1, base-type=BT_KL_QBit_Sonnenintensitaet, compu {1=Cx1_Ersatz_Init_oder_Fehlerwert (CM_KL_QBit_Sonnenintensitaet_Cx1_Ersatz_Init_oder_Fehlerwert), 0=Cx0_gueltiger_Wert (CM_KL_QBit_Sonnenintensitaet_Cx0_gueltiger_Wert)}, range raw 0..1, transfer-property=TRIGGERED-WITHOUT-REPETITION  # Gültigkeitsbit für Signal KL_Sonenintensität Gesetzt bei Ersatzwert, Init oder Fehler.
    signal KL_Status_Klimastil_XIX_ClimateControl_01_XIX_VLAN_Cockpit: start 140, 2 bit, little-endian, data-type-policy=OVERRIDE, i-signal-type=PRIMITIVE, init-value=0, base-type=BT_KL_Status_Klimastil, compu {0=Cx0_Modus_1 (CM_KL_Status_Klimastil_Cx0_Modus_1), 2=Cx2_Modus_3 (CM_KL_Status_Klimastil_Cx2_Modus_3), 3=Cx3_Modus_4 (CM_KL_Status_Klimastil_Cx3_Modus_4), 1=Cx1_Modus_2 (CM_KL_Status_Klimastil_Cx1_Modus_2)}, range raw 0..3, transfer-property=TRIGGERED-WITHOUT-REPETITION  # Signal für aktuelles Programm des KBT
    signal KL_Thermischer_Bedarf_XIX_ClimateControl_01_XIX_VLAN_Cockpit: start 142, 3 bit, little-endian, data-type-policy=OVERRIDE, i-signal-type=PRIMITIVE, init-value=6, base-type=BT_KL_Thermischer_Bedarf, invalid-value=Invalid_KL_Thermischer_Bedarf_XIX_ClimateControl_01_XIX_VLAN_Cockpit:7, compu {7=Cx7_Fehler (CM_KL_Thermischer_Bedarf_Cx7_Fehler), 2=Cx2_Nachlauf_Heizen (CM_KL_Thermischer_Bedarf_Cx2_Nachlauf_Heizen), 6=Cx6_Init (CM_KL_Thermischer_Bedarf_Cx6_Init), 3=Cx3_Lueften (CM_KL_Thermischer_Bedarf_Cx3_Lueften), 4=Cx4_Kuehlen (CM_KL_Thermischer_Bedarf_Cx4_Kuehlen), 1=Cx1_Heizen (CM_KL_Thermischer_Bedarf_Cx1_Heizen), 0=Cx0_Aus (CM_KL_Thermischer_Bedarf_Cx0_Aus)}, range raw 0..7, transfer-property=TRIGGERED-WITHOUT-REPETITION  # Temperierungsbedarf zur Innenraumklimatisierung
    signal KL_Temp_vor_Verdampfer_XIX_ClimateControl_01_XIX_VLAN_Cockpit: start 145, 7 bit, little-endian, data-type-policy=OVERRIDE, i-signal-type=PRIMITIVE, init-value=126, base-type=BT_KL_Temp_vor_Verdampfer, invalid-value=Invalid_KL_Temp_vor_Verdampfer_XIX_ClimateControl_01_XIX_VLAN_Cockpit:127, compu {phys=raw-20 for raw 0..90, 127=Cx7f_Fehler (CM_KL_Temp_vor_Verdampfer_Cx7f_Fehler), 126=Cx7e_Init (CM_KL_Temp_vor_Verdampfer_Cx7e_Init); unit Unit_DegreCelsi}, range phys -20..70 Unit_DegreCelsi, raw 0..127, unit=Unit_DegreCelsi, transfer-property=TRIGGERED-WITHOUT-REPETITION  # Ist Lufttemperatur vor Verdampfer
    signal KL_NV_Energie_Anf_XIX_ClimateControl_01_XIX_VLAN_Cockpit: start 152, 8 bit, little-endian, data-type-policy=OVERRIDE, i-signal-type=PRIMITIVE, init-value=254, base-type=BT_KL_NV_Energie_Anf, invalid-value=Invalid_KL_NV_Energie_Anf_XIX_ClimateControl_01_XIX_VLAN_Cockpit:255, compu {phys=raw*10 for raw 0..253, 255=Cxff_Fehler (CM_KL_NV_Energie_Anf_Cxff_Fehler), 254=Cxfe_Init (CM_KL_NV_Energie_Anf_Cxfe_Init); unit Unit_WattHour}, range phys 0..2530 Unit_WattHour, raw 0..255, unit=Unit_WattHour, transfer-property=TRIGGERED-WITHOUT-REPETITION  # Benötigte Energie (12V) für die Erweiterte Vorkonditionierung
    signal KL_Kuehllstg_Delta_Eingriff_XIX_ClimateControl_01_XIX_VLAN_Cockpit: start 160, 8 bit, little-endian, data-type-policy=OVERRIDE, i-signal-type=PRIMITIVE, init-value=254, base-type=BT_KL_Kuehllstg_Delta_Eingriff, invalid-value=Invalid_KL_Kuehllstg_Delta_Eingriff_XIX_ClimateControl_01_XIX_VLAN_Cockpit:255, compu {phys=raw*50-6300 for raw 0..253, 255=Cxff_Fehler (CM_KL_Kuehllstg_Delta_Eingriff_Cxff_Fehler), 254=Cxfe_Init (CM_KL_Kuehllstg_Delta_Eingriff_Cxfe_Init); unit Unit_Watt}, range phys -6300..6350 Unit_Watt, raw 0..255, unit=Unit_Watt, transfer-property=TRIGGERED-WITHOUT-REPETITION  # Durch Kundeneingriff erwartete Veränderung der Kühlleistung bei aktuellen klimatischen Bedingungen
    signal KL_Heizlstg_Delta_Eingriff_XIX_ClimateControl_01_XIX_VLAN_Cockpit: start 168, 8 bit, little-endian, data-type-policy=OVERRIDE, i-signal-type=PRIMITIVE, init-value=254, base-type=BT_KL_Heizlstg_Delta_Eingriff, invalid-value=Invalid_KL_Heizlstg_Delta_Eingriff_XIX_ClimateControl_01_XIX_VLAN_Cockpit:255, compu {phys=raw*50-6300 for raw 0..253, 255=Cxff_Fehler (CM_KL_Heizlstg_Delta_Eingriff_Cxff_Fehler), 254=Cxfe_Init (CM_KL_Heizlstg_Delta_Eingriff_Cxfe_Init); unit Unit_Watt}, range phys -6300..6350 Unit_Watt, raw 0..255, unit=Unit_Watt, transfer-property=TRIGGERED-WITHOUT-REPETITION  # Durch Kundeneingriff erwartete Veränderung der Heizleistung bei aktuellen klimatischen Bedingungen
    signal KL_Tempklappe_Fond_XIX_ClimateControl_01_XIX_VLAN_Cockpit: start 176, 8 bit, little-endian, data-type-policy=OVERRIDE, i-signal-type=PRIMITIVE, init-value=254, base-type=BT_KL_Tempklappe_Fond, invalid-value=Invalid_KL_Tempklappe_Fond_XIX_ClimateControl_01_XIX_VLAN_Cockpit:255, compu {phys=raw*0.5 for raw 0..200, 255=Cxff_Fehler (CM_KL_Tempklappe_Fond_Cxff_Fehler), 254=Cxfe_Init (CM_KL_Tempklappe_Fond_Cxfe_Init); unit Unit_PerCent}, range phys 0..100 Unit_PerCent, raw 0..255, unit=Unit_PerCent, transfer-property=TRIGGERED-WITHOUT-REPETITION  # Sollwert der Temperaturklappe Fond
    signal KL_Tempklappe_li_XIX_ClimateControl_01_XIX_VLAN_Cockpit: start 184, 8 bit, little-endian, data-type-policy=OVERRIDE, i-signal-type=PRIMITIVE, init-value=254, base-type=BT_KL_Tempklappe_li, invalid-value=Invalid_KL_Tempklappe_li_XIX_ClimateControl_01_XIX_VLAN_Cockpit:255, compu {phys=raw*0.5 for raw 0..200, 255=Cxff_Fehler (CM_KL_Tempklappe_li_Cxff_Fehler), 254=Cxfe_Init (CM_KL_Tempklappe_li_Cxfe_Init); unit Unit_PerCent}, range phys 0..100 Unit_PerCent, raw 0..255, unit=Unit_PerCent, transfer-property=TRIGGERED-WITHOUT-REPETITION  # Sollwert der Temperaturklappe links (2 zonig) Sollwert der Temperaturklappe (1-zonig)
    signal KL_Tempklappe_re_XIX_ClimateControl_01_XIX_VLAN_Cockpit: start 192, 8 bit, little-endian, data-type-policy=OVERRIDE, i-signal-type=PRIMITIVE, init-value=254, base-type=BT_KL_Tempklappe_re, invalid-value=Invalid_KL_Tempklappe_re_XIX_ClimateControl_01_XIX_VLAN_Cockpit:255, compu {phys=raw*0.5 for raw 0..200, 255=Cxff_Fehler (CM_KL_Tempklappe_re_Cxff_Fehler), 254=Cxfe_Init (CM_KL_Tempklappe_re_Cxfe_Init); unit Unit_PerCent}, range phys 0..100 Unit_PerCent, raw 0..255, unit=Unit_PerCent, transfer-property=TRIGGERED-WITHOUT-REPETITION  # Sollwert der Temperaturklappe rechts
    signal KL_Kuehlbedarf_XIX_ClimateControl_01_XIX_VLAN_Cockpit: start 200, 8 bit, little-endian, data-type-policy=OVERRIDE, i-signal-type=PRIMITIVE, init-value=254, base-type=BT_KL_Kuehlbedarf, invalid-value=Invalid_KL_Kuehlbedarf_XIX_ClimateControl_01_XIX_VLAN_Cockpit:255, compu {phys=raw*0.1 for raw 0..250, 255=Cxff_Fehler (CM_KL_Kuehlbedarf_Cxff_Fehler), 254=Cxfe_Init (CM_KL_Kuehlbedarf_Cxfe_Init), 253=Cxfd_Kein_Kuehlbedarf (CM_KL_Kuehlbedarf_Cxfd_Kein_Kuehlbedarf); unit Unit_DegreCelsi}, range phys 0..25 Unit_DegreCelsi, raw 0..255, unit=Unit_DegreCelsi, transfer-property=TRIGGERED-WITHOUT-REPETITION  # Bedarf an Kühlmenge für Innenraumklimatisierung
    signal KL_AC_Schalter_XIX_ClimateControl_01_XIX_VLAN_Cockpit: start 208, 1 bit, little-endian, data-type-policy=OVERRIDE, i-signal-type=PRIMITIVE, init-value=0, base-type=BT_KL_AC_Schalter, compu {1=Cx1_ein (CM_KL_AC_Schalter_Cx1_ein), 0=Cx0_aus (CM_KL_AC_Schalter_Cx0_aus)}, range raw 0..1, transfer-property=TRIGGERED-WITHOUT-REPETITION  # AC Schalter
    signal KL_Leistungspriorisierung_XIX_ClimateControl_01_XIX_VLAN_Cockpit: start 209, 2 bit, little-endian, data-type-policy=OVERRIDE, i-signal-type=PRIMITIVE, init-value=0, base-type=BT_KL_Leistungspriorisierung, compu {0=Cx0_keine_Priorisierung (CM_KL_Leistungspriorisierung_Cx0_keine_Priorisierung), 1=Cx1_PullDown (CM_KL_Leistungspriorisierung_Cx1_PullDown), 2=Cx2_Beschlagsgefahr (CM_KL_Leistungspriorisierung_Cx2_Beschlagsgefahr), 3=Cx3_Defrost_aktiv (CM_KL_Leistungspriorisierung_Cx3_Defrost_aktiv)}, range raw 0..3, transfer-property=TRIGGERED-WITHOUT-REPETITION  # Priorisierungsvorgaben
    signal KL_Zustand_XIX_ClimateControl_01_XIX_VLAN_Cockpit: start 211, 1 bit, little-endian, data-type-policy=OVERRIDE, i-signal-type=PRIMITIVE, init-value=0, base-type=BT_KL_Zustand, compu {0=Cx0_Aus (CM_KL_Zustand_Cx0_Aus), 1=Cx1_Ein (CM_KL_Zustand_Cx1_Ein)}, range raw 0..1, transfer-property=TRIGGERED-WITHOUT-REPETITION  # Beschreibt den Zustand des Klima-/Heizungsbedienteils. (OFF-Mode Bedienteil) PAG (MLB): Beschreibt den Zustand des Kompressors
    signal KL_Heizbedarf_Z1_XIX_ClimateControl_01_XIX_VLAN_Cockpit: start 212, 10 bit, little-endian, data-type-policy=OVERRIDE, i-signal-type=PRIMITIVE, init-value=1022, base-type=BT_KL_Heizbedarf_Z1, invalid-value=Invalid_KL_Heizbedarf_Z1_XIX_ClimateControl_01_XIX_VLAN_Cockpit:1023, compu {phys=raw*0.1 for raw 1..900, 1023=Cx3ff_Fehler (CM_KL_Heizbedarf_Z1_Cx3ff_Fehler), 0=Cx0_kein_Heizbedarf (CM_KL_Heizbedarf_Z1_Cx0_kein_Heizbedarf), 1022=Cx3fe_Init (CM_KL_Heizbedarf_Z1_Cx3fe_Init); unit Unit_DegreCelsi}, range phys 0.1..90 Unit_DegreCelsi, raw 0..1023, unit=Unit_DegreCelsi, transfer-property=TRIGGERED-WITHOUT-REPETITION  # Bedarf an Heizmenge für Innenraumklimatisierung Zone 1
    signal KL_Heizbedarf_Z2_XIX_ClimateControl_01_XIX_VLAN_Cockpit: start 222, 10 bit, little-endian, data-type-policy=OVERRIDE, i-signal-type=PRIMITIVE, init-value=1022, base-type=BT_KL_Heizbedarf_Z2, invalid-value=Invalid_KL_Heizbedarf_Z2_XIX_ClimateControl_01_XIX_VLAN_Cockpit:1023, compu {phys=raw*0.1 for raw 1..900, 1023=Cx3ff_Fehler (CM_KL_Heizbedarf_Z2_Cx3ff_Fehler), 0=Cx0_kein_Heizbedarf (CM_KL_Heizbedarf_Z2_Cx0_kein_Heizbedarf), 1022=Cx3fe_Init (CM_KL_Heizbedarf_Z2_Cx3fe_Init); unit Unit_DegreCelsi}, range phys 0.1..90 Unit_DegreCelsi, raw 0..1023, unit=Unit_DegreCelsi, transfer-property=TRIGGERED-WITHOUT-REPETITION  # Bedarf an Heizmenge für Innenraumklimatisierung Zone 2
    signal KL_Heizbedarf_Z3_XIX_ClimateControl_01_XIX_VLAN_Cockpit: start 232, 10 bit, little-endian, data-type-policy=OVERRIDE, i-signal-type=PRIMITIVE, init-value=1022, base-type=BT_KL_Heizbedarf_Z3, invalid-value=Invalid_KL_Heizbedarf_Z3_XIX_ClimateControl_01_XIX_VLAN_Cockpit:1023, compu {phys=raw*0.1 for raw 1..900, 1023=Cx3ff_Fehler (CM_KL_Heizbedarf_Z3_Cx3ff_Fehler), 0=Cx0_kein_Heizbedarf (CM_KL_Heizbedarf_Z3_Cx0_kein_Heizbedarf), 1022=Cx3fe_Init (CM_KL_Heizbedarf_Z3_Cx3fe_Init); unit Unit_DegreCelsi}, range phys 0.1..90 Unit_DegreCelsi, raw 0..1023, unit=Unit_DegreCelsi, transfer-property=TRIGGERED-WITHOUT-REPETITION  # Bedarf an Heizmenge für Innenraumklimatisierung Zone 3
    signal KL_Heizbedarf_Z4_XIX_ClimateControl_01_XIX_VLAN_Cockpit: start 242, 10 bit, little-endian, data-type-policy=OVERRIDE, i-signal-type=PRIMITIVE, init-value=1022, base-type=BT_KL_Heizbedarf_Z4, invalid-value=Invalid_KL_Heizbedarf_Z4_XIX_ClimateControl_01_XIX_VLAN_Cockpit:1023, compu {phys=raw*0.1 for raw 1..900, 1023=Cx3ff_Fehler (CM_KL_Heizbedarf_Z4_Cx3ff_Fehler), 1022=Cx3fe_Init (CM_KL_Heizbedarf_Z4_Cx3fe_Init), 0=Cx0_kein_Heizbedarf (CM_KL_Heizbedarf_Z4_Cx0_kein_Heizbedarf); unit Unit_DegreCelsi}, range phys 0.1..90 Unit_DegreCelsi, raw 0..1023, unit=Unit_DegreCelsi, transfer-property=TRIGGERED-WITHOUT-REPETITION  # Bedarf an Heizmenge für Innenraumklimatisierung Zone 4
    signal KL_AC_Aktiv_XIX_ClimateControl_01_XIX_VLAN_Cockpit: start 252, 1 bit, little-endian, data-type-policy=OVERRIDE, i-signal-type=PRIMITIVE, init-value=0, base-type=BT_KL_AC_Aktiv, compu {1=Cx1_aktiv (CM_KL_AC_Aktiv_Cx1_aktiv), 0=Cx0_inaktiv (CM_KL_AC_Aktiv_Cx0_inaktiv)}, range raw 0..1, transfer-property=TRIGGERED-WITHOUT-REPETITION  # Kundenwunsch AC
    signal KL_Luftmasse_Gesamt_Z1_XIX_ClimateControl_01_XIX_VLAN_Cockpit: start 253, 16 bit, little-endian, data-type-policy=OVERRIDE, i-signal-type=PRIMITIVE, init-value=65534, base-type=BT_KL_Luftmasse_Gesamt_Z1, invalid-value=Invalid_KL_Luftmasse_Gesamt_Z1_XIX_ClimateControl_01_XIX_VLAN_Cockpit:65535, compu {phys=raw*0.125 for raw 0..6400, 65535=Cxffff_Fehler (CM_KL_Luftmasse_Gesamt_Z1_Cxffff_Fehler), 65534=Cxfffe_Init (CM_KL_Luftmasse_Gesamt_Z1_Cxfffe_Init)}, range phys 0..800, raw 0..65535, transfer-property=TRIGGERED-WITHOUT-REPETITION  # Ist Luftmassenstrom Gesamt Klimatisierung Zone 1 (kg/h)
    signal KL_Luftmasse_Gesamt_Z2_XIX_ClimateControl_01_XIX_VLAN_Cockpit: start 269, 16 bit, little-endian, data-type-policy=OVERRIDE, i-signal-type=PRIMITIVE, init-value=65534, base-type=BT_KL_Luftmasse_Gesamt_Z2, invalid-value=Invalid_KL_Luftmasse_Gesamt_Z2_XIX_ClimateControl_01_XIX_VLAN_Cockpit:65535, compu {phys=raw*0.125 for raw 0..6400, 65535=Cxffff_Fehler (CM_KL_Luftmasse_Gesamt_Z2_Cxffff_Fehler), 65534=Cxfffe_Init (CM_KL_Luftmasse_Gesamt_Z2_Cxfffe_Init)}, range phys 0..800, raw 0..65535, transfer-property=TRIGGERED-WITHOUT-REPETITION  # Ist Luftmassenstrom Gesamt Klimatisierung Zone 2 (kg/h)
    signal KL_Luftmasse_Gesamt_Z3_XIX_ClimateControl_01_XIX_VLAN_Cockpit: start 285, 16 bit, little-endian, data-type-policy=OVERRIDE, i-signal-type=PRIMITIVE, init-value=65534, base-type=BT_KL_Luftmasse_Gesamt_Z3, invalid-value=Invalid_KL_Luftmasse_Gesamt_Z3_XIX_ClimateControl_01_XIX_VLAN_Cockpit:65535, compu {phys=raw*0.125 for raw 0..6400, 65535=Cxffff_Fehler (CM_KL_Luftmasse_Gesamt_Z3_Cxffff_Fehler), 65534=Cxfffe_Init (CM_KL_Luftmasse_Gesamt_Z3_Cxfffe_Init)}, range phys 0..800, raw 0..65535, transfer-property=TRIGGERED-WITHOUT-REPETITION  # Ist Luftmassenstrom Gesamt Klimatisierung Zone 3 (kg/h)
    signal KL_Luftmasse_Gesamt_Z4_XIX_ClimateControl_01_XIX_VLAN_Cockpit: start 301, 16 bit, little-endian, data-type-policy=OVERRIDE, i-signal-type=PRIMITIVE, init-value=65534, base-type=BT_KL_Luftmasse_Gesamt_Z4, invalid-value=Invalid_KL_Luftmasse_Gesamt_Z4_XIX_ClimateControl_01_XIX_VLAN_Cockpit:65535, compu {phys=raw*0.125 for raw 0..6400, 65535=Cxffff_Fehler (CM_KL_Luftmasse_Gesamt_Z4_Cxffff_Fehler), 65534=Cxfffe_Init (CM_KL_Luftmasse_Gesamt_Z4_Cxfffe_Init)}, range phys 0..800, raw 0..65535, transfer-property=TRIGGERED-WITHOUT-REPETITION  # Ist Luftmassenstrom Gesamt Klimatisierung Zone 4 (kg/h)
    signal KL_FSA_Taupunkt_XIX_ClimateControl_01_XIX_VLAN_Cockpit: start 317, 10 bit, little-endian, data-type-policy=OVERRIDE, i-signal-type=PRIMITIVE, init-value=1022, base-type=BT_KL_FSA_Taupunkt, invalid-value=Invalid_KL_FSA_Taupunkt_XIX_ClimateControl_01_XIX_VLAN_Cockpit:1023, compu {phys=raw*0.1-40 for raw 0..1000, 1023=Cx3ff_Fehler (CM_KL_FSA_Taupunkt_Cx3ff_Fehler), 1022=Cx3fe_Init (CM_KL_FSA_Taupunkt_Cx3fe_Init), 1021=Cx3fd_nicht_verbaut (CM_KL_FSA_Taupunkt_Cx3fd_nicht_verbaut); unit Unit_DegreCelsi}, range phys -40..60 Unit_DegreCelsi, raw 0..1023, unit=Unit_DegreCelsi, transfer-property=TRIGGERED-WITHOUT-REPETITION  # FSA_Taupunkt (geroutet)
    signal KL_FSA_Luftfeuchte_rel_XIX_ClimateControl_01_XIX_VLAN_Cockpit: start 327, 8 bit, little-endian, data-type-policy=OVERRIDE, i-signal-type=PRIMITIVE, init-value=254, base-type=BT_KL_FSA_Luftfeuchte_rel, invalid-value=Invalid_KL_FSA_Luftfeuchte_rel_XIX_ClimateControl_01_XIX_VLAN_Cockpit:255, compu {phys=raw*0.5 for raw 0..252, 255=Cxff_Fehler (CM_KL_FSA_Luftfeuchte_rel_Cxff_Fehler), 254=Cxfe_Init (CM_KL_FSA_Luftfeuchte_rel_Cxfe_Init), 253=Cxfd_nicht_verbaut (CM_KL_FSA_Luftfeuchte_rel_Cxfd_nicht_verbaut); unit Unit_PerCent}, range phys 0..126 Unit_PerCent, raw 0..255, unit=Unit_PerCent, transfer-property=TRIGGERED-WITHOUT-REPETITION  # FSA_Luftfeuchte (geroutet)
    signal KL_Kundeneingriff_Geblaese_Z3_XIX_ClimateControl_01_XIX_VLAN_Cockpit: start 335, 1 bit, little-endian, data-type-policy=OVERRIDE, i-signal-type=PRIMITIVE, init-value=0, base-type=BT_KL_Kundeneingriff_Geblaese_Z3, compu {0=Cx0_Kein_Kundeneingriff_Geblaese (CM_KL_Kundeneingriff_Geblaese_Z3_Cx0_Kein_Kundeneingriff_Geblaese), 1=Cx1_Kundeneingriff_Geblaese_aktiv (CM_KL_Kundeneingriff_Geblaese_Z3_Cx1_Kundeneingriff_Geblaese_aktiv)}, range raw 0..1, transfer-property=TRIGGERED-WITHOUT-REPETITION  # Manueller Kundeneingriff in die Geblaeseregelung
    signal KL_Kundeneingriff_Geblaese_Z4_XIX_ClimateControl_01_XIX_VLAN_Cockpit: start 336, 1 bit, little-endian, data-type-policy=OVERRIDE, i-signal-type=PRIMITIVE, init-value=0, base-type=BT_KL_Kundeneingriff_Geblaese_Z4, compu {1=Cx1_Kundeneingriff_Geblaese_aktiv (CM_KL_Kundeneingriff_Geblaese_Z4_Cx1_Kundeneingriff_Geblaese_aktiv), 0=Cx0_Kein_Kundeneingriff_Geblaese (CM_KL_Kundeneingriff_Geblaese_Z4_Cx0_Kein_Kundeneingriff_Geblaese)}, range raw 0..1, transfer-property=TRIGGERED-WITHOUT-REPETITION  # Manueller Kundeneingriff in die Geblaeseregelung
  pdu Diagnose_01_XIX_VLAN_Cockpit: length=8, transmission-mode-true-timing=cyclic-timing={time-offset=0.0, time-period=1.0}, unused-bit-pattern=0
    signal DGN_Verlernzaehler_XIX_Diagnose_01_XIX_VLAN_Cockpit: start 0, 8 bit, little-endian, data-type-policy=OVERRIDE, i-signal-type=PRIMITIVE, init-value=0, base-type=BT_DGN_Verlernzaehler, compu {phys=raw for raw 0..254, 255=Cxff_ungueltiger_Zaehlerstand_oder_kein_gueltiger_Fahrzyklus (CM_DGN_Verlernzaehler_Cxff_ungueltiger_Zaehlerstand_oder_kein_gueltiger_Fahrzyklus) (ungültiger Zählerstand oder kein gültiger Fahrzyklus)}, range phys 0..254, raw 0..255, transfer-property=PENDING  # wrap around 254 --> 0
    signal DW_Kilometerstand_XIX_Diagnose_01_XIX_VLAN_Cockpit: start 8, 20 bit, little-endian, data-type-policy=OVERRIDE, i-signal-type=PRIMITIVE, init-value=1048574, base-type=BT_DW_Kilometerstand, invalid-value=Invalid_DW_Kilometerstand_XIX_Diagnose_01_XIX_VLAN_Cockpit:1048575, compu {phys=raw for raw 0..1048573, 1048575=Cxfffff_Fehler (CM_DW_Kilometerstand_Cxfffff_Fehler), 1048574=Cxffffe_Init (CM_DW_Kilometerstand_Cxffffe_Init); unit Unit_KiloMeter}, range phys 0..1048573 Unit_KiloMeter, raw 0..1048575, unit=Unit_KiloMeter, transfer-property=PENDING, to HCP3_IONode(timeout 5 s)  # Fehler wird ausgegeben, falls Kilometerstand nicht restaurierbar
    signal UH_Jahr_XIX_Diagnose_01_XIX_VLAN_Cockpit: start 28, 7 bit, little-endian, data-type-policy=OVERRIDE, i-signal-type=PRIMITIVE, init-value=0, base-type=BT_UH_Jahr, compu {phys=raw+2000 for raw 0..127; unit Unit_Year}, range phys 2000..2127 Unit_Year, raw 0..127, unit=Unit_Year, transfer-property=PENDING, to HCP3_IONode(timeout 5 s)
    signal UH_Monat_XIX_Diagnose_01_XIX_VLAN_Cockpit: start 35, 4 bit, little-endian, data-type-policy=OVERRIDE, i-signal-type=PRIMITIVE, init-value=0, base-type=BT_UH_Monat, invalid-value=Invalid_UH_Monat_XIX_Diagnose_01_XIX_VLAN_Cockpit:15, compu {phys=raw for raw 1..12, 15=Cxf_Fehler (CM_UH_Monat_Cxf_Fehler), 14=Cxe_Relatives_Datum (CM_UH_Monat_Cxe_Relatives_Datum), 0=Cx0_Init (CM_UH_Monat_Cx0_Init); unit Unit_Month}, range phys 1..12 Unit_Month, raw 0..15, unit=Unit_Month, transfer-property=PENDING, to HCP3_IONode(timeout 5 s)  # 0x0D, 0xF = Werte ungültig 0x0E = Relatives Datum (nur VW)
    signal UH_Tag_XIX_Diagnose_01_XIX_VLAN_Cockpit: start 39, 5 bit, little-endian, data-type-policy=OVERRIDE, i-signal-type=PRIMITIVE, init-value=0, base-type=BT_UH_Tag, compu {phys=raw for raw 1..31, 0=Cx0_Init (CM_UH_Tag_Cx0_Init); unit Unit_Day}, range phys 1..31 Unit_Day, raw 0..31, unit=Unit_Day, transfer-property=PENDING, to HCP3_IONode(timeout 5 s)  # 0x0: reserviert bei VW
    signal UH_Stunde_XIX_Diagnose_01_XIX_VLAN_Cockpit: start 44, 5 bit, little-endian, data-type-policy=OVERRIDE, i-signal-type=PRIMITIVE, init-value=0, base-type=BT_UH_Stunde, compu {phys=raw for raw 0..23; unit Unit_Hours}, range phys 0..23 Unit_Hours, raw 0..23, unit=Unit_Hours, transfer-property=PENDING, to HCP3_IONode(timeout 5 s)  # 0x18 - 0x1F = Werte ungültig
    signal UH_Minute_XIX_Diagnose_01_XIX_VLAN_Cockpit: start 49, 6 bit, little-endian, data-type-policy=OVERRIDE, i-signal-type=PRIMITIVE, init-value=0, base-type=BT_UH_Minute, compu {phys=raw for raw 0..59; unit Unit_Minut}, range phys 0..59 Unit_Minut, raw 0..59, unit=Unit_Minut, transfer-property=PENDING, to HCP3_IONode(timeout 5 s)  # 0x3C- 0x3f = Werte ungültig
    signal UH_Sekunde_XIX_Diagnose_01_XIX_VLAN_Cockpit: start 55, 6 bit, little-endian, data-type-policy=OVERRIDE, i-signal-type=PRIMITIVE, init-value=0, base-type=BT_UH_Sekunde, compu {phys=raw for raw 0..59; unit Unit_Secon}, range phys 0..59 Unit_Secon, raw 0..59, unit=Unit_Secon, transfer-property=PENDING, to HCP3_IONode(timeout 5 s)  # 0x3C- 0x3f = Werte ungültig
  pdu Dimmung_01_XIX_VLAN_Cockpit: length=8, minimum-delay=0.05, transmission-mode-true-timing={cyclic-timing={time-offset=0.0, time-period=0.2}, event-controlled-timing={number-of-repetitions=0, repetition-period=0.0}}, unused-bit-pattern=0
    signal DI_KL_58xd_XIX_Dimmung_01_XIX_VLAN_Cockpit: start 0, 8 bit, little-endian, data-type-policy=OVERRIDE, i-signal-type=PRIMITIVE, init-value=254, base-type=BT_DI_KL_58xd, invalid-value=Invalid_DI_KL_58xd_XIX_Dimmung_01_XIX_VLAN_Cockpit:255, compu {phys=raw for raw 0..253, 255=Cxff_Fehler (CM_DI_KL_58xd_Cxff_Fehler), 254=Cxfe_Init (CM_DI_KL_58xd_Cxfe_Init)}, range phys 0..253, raw 0..255, transfer-property=TRIGGERED-ON-CHANGE-WITHOUT-REPETITION  # Klemme 58xd Display- und Funktionsbeleuchtung Mit der Klemme 58xd wird die Helligkeit der Display- und der Funktionsbeleuchtungen der Schalter gesteuert. Im Detail beschrieben im 'Funktionslastenheft Dimmung MQB'.
    signal DI_KL_58xs_XIX_Dimmung_01_XIX_VLAN_Cockpit: start 8, 7 bit, little-endian, data-type-policy=OVERRIDE, i-signal-type=PRIMITIVE, init-value=126, base-type=BT_DI_KL_58xs, invalid-value=Invalid_DI_KL_58xs_XIX_Dimmung_01_XIX_VLAN_Cockpit:127, compu {phys=raw for raw 0..100, 127=Cx7f_Fehler (CM_DI_KL_58xs_Cx7f_Fehler), 126=Cx7e_Init (CM_DI_KL_58xs_Cx7e_Init); unit Unit_PerCent}, range phys 0..100 Unit_PerCent, raw 0..127, unit=Unit_PerCent, transfer-property=TRIGGERED-ON-CHANGE-WITHOUT-REPETITION  # Suchbeleuchtung Schalter EIN-AUS-Schaltalgorithmus der allgemeinen Schaltersuchbeleuchtung. Im Detail beschrieben im 'Funktionslastenheft Dimmung MQB'.
    signal DI_Display_Nachtdesign_XIX_Dimmung_01_XIX_VLAN_Cockpit: start 15, 1 bit, little-endian, data-type-policy=OVERRIDE, i-signal-type=PRIMITIVE, init-value=0, base-type=BT_DI_Display_Nachtdesign, transfer-property=TRIGGERED-ON-CHANGE-WITHOUT-REPETITION  # Für Displays sind oft automatische Umschaltungen von Tag-/Nachtdesign vorgesehen. Es gibt jedoch Zustände, an denen auch tagsüber das Abblendlicht eingeschaltet ist. z.B. Dauerfahrlicht, Geschwindigkeitsabhängiges "Licht-An-Bei-Autobahn", "Regenlicht", etc. Die Aufgabe des Signals s_Display_Nachtdesign ist es, Fehlumschaltungen zu vermeiden. Es ist im Dimm-Master zu implementieren. Im Detail beschrieben im 'Funktionslastenheft Dimmung MQB'.
    signal DI_KL_58xt_XIX_Dimmung_01_XIX_VLAN_Cockpit: start 16, 7 bit, little-endian, data-type-policy=OVERRIDE, i-signal-type=PRIMITIVE, init-value=126, base-type=BT_DI_KL_58xt, invalid-value=Invalid_DI_KL_58xt_XIX_Dimmung_01_XIX_VLAN_Cockpit:127, compu {phys=raw for raw 0..100, 127=Cx7f_Fehler (CM_DI_KL_58xt_Cx7f_Fehler), 126=Cx7e_Init (CM_DI_KL_58xt_Cx7e_Init); unit Unit_PerCent}, range phys 0..100 Unit_PerCent, raw 0..127, unit=Unit_PerCent, transfer-property=TRIGGERED-ON-CHANGE-WITHOUT-REPETITION  # Timergesteuerte Suchbeleuchtung Der EIN-AUS-Schaltalgorithmus für die vor- und nachlaufende Schaltersuchbeleuchtungen beim Ein- & Aussteigen; z.B.: Start/Stop-Taster. Im Detail beschrieben im 'Funktionslastenheft Dimmung MQB'.
    signal DI_Fotosensor_XIX_Dimmung_01_XIX_VLAN_Cockpit: start 24, 16 bit, little-endian, data-type-policy=OVERRIDE, i-signal-type=PRIMITIVE, init-value=0, base-type=BT_DI_Fotosensor, compu {phys=raw for raw 0..65535}, range phys 0..65535, raw 0..65535, transfer-property=TRIGGERED-ON-CHANGE-WITHOUT-REPETITION  # Helligkeitswert Fotosensor Für die Dimmung relevanter Wert zur Sensierung der Umgebungshelligkeit Im Detail beschrieben im 'Funktionslastenheft Dimmung MQB'.
    signal BCM1_Stellgroesse_Kl_58s_XIX_Dimmung_01_XIX_VLAN_Cockpit: start 40, 7 bit, little-endian, data-type-policy=OVERRIDE, i-signal-type=PRIMITIVE, init-value=126, base-type=BT_BCM1_Stellgroesse_Kl_58s, invalid-value=Invalid_BCM1_Stellgroesse_Kl_58s_XIX_Dimmung_01_XIX_VLAN_Cockpit:127, compu {phys=raw for raw 0..100, 127=Cx7f_Fehler (CM_BCM1_Stellgroesse_Kl_58s_Cx7f_Fehler), 125=Cx7d_Nicht_verbaut (CM_BCM1_Stellgroesse_Kl_58s_Cx7d_Nicht_verbaut), 126=Cx7e_Init (CM_BCM1_Stellgroesse_Kl_58s_Cx7e_Init)}, range phys 0..100, raw 0..127, transfer-property=TRIGGERED-ON-CHANGE-WITHOUT-REPETITION  # Rohwert Dimmpoti
