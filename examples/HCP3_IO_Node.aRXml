[part 6 of 15: packages /Cluster to /PDU]
AUTOSAR XML (schema 4-3-0)
package /Cluster  (continued)
  ethernet cluster ETH_Cluster_E3_1_2: protocol-name=Ethernet, protocol-version=802.3
    ethernet physical channel VLAN_Cockpit: comm-connectors=CN_VLAN_Cockpit
      pdu triggering PT_ServiceDiscoveryRxUnicast_XIX_HCP3_IONode: pdu=ServiceDiscoveryRxUnicast_XIX_HCP3_IONode, to HCP3_IONode
      pdu triggering PT_ServiceDiscoveryTx_XIX_HCP3_IONode: pdu=ServiceDiscoveryTx_XIX_HCP3_IONode, from HCP3_IONode
      pdu triggering PT_ServiceDiscoveryRxMulticast_XIX_HCP3_IONode: pdu=ServiceDiscoveryRxMulticast_XIX_HCP3_IONode, to HCP3_IONode
      pdu triggering PT_VLAN_Cockpit_XIX_TPCHType_DoIP_Cockpit_XIX_0xE80_XIX_Functional: pdu=DCM_VLAN_Cockpit_XIX_TPCHType_DoIP_Cockpit_XIX_0xE80_XIX_Functional, to HCP3_IONode
      pdu triggering PT_VLAN_Cockpit_XIX_TPCHType_DoIP_Cockpit_XIX_0xE80_XIX_0x3124_XIX_Physical: pdu=DCM_VLAN_Cockpit_XIX_TPCHType_DoIP_Cockpit_XIX_0xE80_XIX_0x3124_XIX_Physical, to HCP3_IONode
      pdu triggering PT_VLAN_Cockpit_XIX_TPCHType_DoIP_Cockpit_XIX_0x3124_XIX_0xE80_XIX_Physical: pdu=DCM_VLAN_Cockpit_XIX_TPCHType_DoIP_Cockpit_XIX_0x3124_XIX_0xE80_XIX_Physical, from HCP3_IONode
      pdu triggering PT_VLAN_Cockpit_XIX_TPCHType_DoIP_Cockpit_XIX_0xE80_XIX_0x3122_XIX_Physical: pdu=DCM_VLAN_Cockpit_XIX_TPCHType_DoIP_Cockpit_XIX_0xE80_XIX_0x3122_XIX_Physical, to HCP3_IONode
      pdu triggering PT_VLAN_Cockpit_XIX_TPCHType_DoIP_Cockpit_XIX_0x3122_XIX_0xE80_XIX_Physical: pdu=DCM_VLAN_Cockpit_XIX_TPCHType_DoIP_Cockpit_XIX_0x3122_XIX_0xE80_XIX_Physical, from HCP3_IONode
      pdu triggering PT_VLAN_Cockpit_XIX_TPCHType_DoIP_Cockpit_XIX_0xE80_XIX_0x1073_XIX_Physical: pdu=DCM_VLAN_Cockpit_XIX_TPCHType_DoIP_Cockpit_XIX_0xE80_XIX_0x1073_XIX_Physical, to HCP3_IONode
      pdu triggering PT_VLAN_Cockpit_XIX_TPCHType_DoIP_Cockpit_XIX_0x1073_XIX_0xE80_XIX_Physical: pdu=DCM_VLAN_Cockpit_XIX_TPCHType_DoIP_Cockpit_XIX_0x1073_XIX_0xE80_XIX_Physical, from HCP3_IONode
      pdu triggering PT_VLAN_Cockpit_XIX_TPCHType_DoIP_Cockpit_XIX_0xE80_XIX_0x101B_XIX_Physical: pdu=DCM_VLAN_Cockpit_XIX_TPCHType_DoIP_Cockpit_XIX_0xE80_XIX_0x101B_XIX_Physical, to HCP3_IONode
      pdu triggering PT_VLAN_Cockpit_XIX_TPCHType_DoIP_Cockpit_XIX_0x101B_XIX_0xE80_XIX_Physical: pdu=DCM_VLAN_Cockpit_XIX_TPCHType_DoIP_Cockpit_XIX_0x101B_XIX_0xE80_XIX_Physical, from HCP3_IONode
      pdu triggering PT_VLAN_Cockpit_XIX_TPCHType_DoIP_Cockpit_XIX_0xE80_XIX_0x3493_XIX_Physical: pdu=DCM_VLAN_Cockpit_XIX_TPCHType_DoIP_Cockpit_XIX_0xE80_XIX_0x3493_XIX_Physical, to HCP3_IONode
      pdu triggering PT_VLAN_Cockpit_XIX_TPCHType_DoIP_Cockpit_XIX_0x3493_XIX_0xE80_XIX_Physical: pdu=DCM_VLAN_Cockpit_XIX_TPCHType_DoIP_Cockpit_XIX_0x3493_XIX_0xE80_XIX_Physical, from HCP3_IONode
      pdu triggering PT_VLAN_Cockpit_XIX_TPCHType_DoIP_Cockpit_XIX_0xE80_XIX_0x3123_XIX_Physical: pdu=DCM_VLAN_Cockpit_XIX_TPCHType_DoIP_Cockpit_XIX_0xE80_XIX_0x3123_XIX_Physical, to HCP3_IONode
      pdu triggering PT_VLAN_Cockpit_XIX_TPCHType_DoIP_Cockpit_XIX_0x3123_XIX_0xE80_XIX_Physical: pdu=DCM_VLAN_Cockpit_XIX_TPCHType_DoIP_Cockpit_XIX_0x3123_XIX_0xE80_XIX_Physical, from HCP3_IONode
      pdu triggering PT_VLAN_Cockpit_XIX_TPCHType_DoIP_Cockpit_XIX_0xE80_XIX_0x30A5_XIX_Physical: pdu=DCM_VLAN_Cockpit_XIX_TPCHType_DoIP_Cockpit_XIX_0xE80_XIX_0x30A5_XIX_Physical, to HCP3_IONode
      pdu triggering PT_VLAN_Cockpit_XIX_TPCHType_DoIP_Cockpit_XIX_0x30A5_XIX_0xE80_XIX_Physical: pdu=DCM_VLAN_Cockpit_XIX_TPCHType_DoIP_Cockpit_XIX_0x30A5_XIX_0xE80_XIX_Physical, from HCP3_IONode
      pdu triggering PT_VLAN_Cockpit_XIX_TPCHType_DoIP_Cockpit_XIX_0xE80_XIX_0x30A6_XIX_Physical: pdu=DCM_VLAN_Cockpit_XIX_TPCHType_DoIP_Cockpit_XIX_0xE80_XIX_0x30A6_XIX_Physical, to HCP3_IONode
      pdu triggering PT_VLAN_Cockpit_XIX_TPCHType_DoIP_Cockpit_XIX_0x30A6_XIX_0xE80_XIX_Physical: pdu=DCM_VLAN_Cockpit_XIX_TPCHType_DoIP_Cockpit_XIX_0x30A6_XIX_0xE80_XIX_Physical, from HCP3_IONode
      pdu triggering PT_VLAN_Cockpit_XIX_TPCHType_DoIP_Cockpit_OBDC_XIX_0xF02_XIX_Functional: pdu=DCM_VLAN_Cockpit_XIX_TPCHType_DoIP_Cockpit_OBDC_XIX_0xF02_XIX_Functional, to HCP3_IONode
      pdu triggering PT_VLAN_Cockpit_XIX_TPCHType_DoIP_Cockpit_OBDC_XIX_0xF02_XIX_0x3124_XIX_Physical: pdu=DCM_VLAN_Cockpit_XIX_TPCHType_DoIP_Cockpit_OBDC_XIX_0xF02_XIX_0x3124_XIX_Physical, to HCP3_IONode
      pdu triggering PT_VLAN_Cockpit_XIX_TPCHType_DoIP_Cockpit_OBDC_XIX_0x3124_XIX_0xF02_XIX_Physical: pdu=DCM_VLAN_Cockpit_XIX_TPCHType_DoIP_Cockpit_OBDC_XIX_0x3124_XIX_0xF02_XIX_Physical, from HCP3_IONode
      pdu triggering PT_VLAN_Cockpit_XIX_TPCHType_DoIP_Cockpit_OBDC_XIX_0xF02_XIX_0x3122_XIX_Physical: pdu=DCM_VLAN_Cockpit_XIX_TPCHType_DoIP_Cockpit_OBDC_XIX_0xF02_XIX_0x3122_XIX_Physical, to HCP3_IONode
      pdu triggering PT_VLAN_Cockpit_XIX_TPCHType_DoIP_Cockpit_OBDC_XIX_0x3122_XIX_0xF02_XIX_Physical: pdu=DCM_VLAN_Cockpit_XIX_TPCHType_DoIP_Cockpit_OBDC_XIX_0x3122_XIX_0xF02_XIX_Physical, from HCP3_IONode
      pdu triggering PT_VLAN_Cockpit_XIX_TPCHType_DoIP_Cockpit_OBDC_XIX_0xF02_XIX_0x101B_XIX_Physical: pdu=DCM_VLAN_Cockpit_XIX_TPCHType_DoIP_Cockpit_OBDC_XIX_0xF02_XIX_0x101B_XIX_Physical, to HCP3_IONode
      pdu triggering PT_VLAN_Cockpit_XIX_TPCHType_DoIP_Cockpit_OBDC_XIX_0x101B_XIX_0xF02_XIX_Physical: pdu=DCM_VLAN_Cockpit_XIX_TPCHType_DoIP_Cockpit_OBDC_XIX_0x101B_XIX_0xF02_XIX_Physical, from HCP3_IONode
      pdu triggering PT_VLAN_Cockpit_XIX_TPCHType_DoIP_Cockpit_OBDC_XIX_0xF02_XIX_0x3493_XIX_Physical: pdu=DCM_VLAN_Cockpit_XIX_TPCHType_DoIP_Cockpit_OBDC_XIX_0xF02_XIX_0x3493_XIX_Physical, to HCP3_IONode
      pdu triggering PT_VLAN_Cockpit_XIX_TPCHType_DoIP_Cockpit_OBDC_XIX_0x3493_XIX_0xF02_XIX_Physical: pdu=DCM_VLAN_Cockpit_XIX_TPCHType_DoIP_Cockpit_OBDC_XIX_0x3493_XIX_0xF02_XIX_Physical, from HCP3_IONode
      pdu triggering PT_VLAN_Cockpit_XIX_TPCHType_DoIP_Cockpit_OBDC_XIX_0xF02_XIX_0x3123_XIX_Physical: pdu=DCM_VLAN_Cockpit_XIX_TPCHType_DoIP_Cockpit_OBDC_XIX_0xF02_XIX_0x3123_XIX_Physical, to HCP3_IONode
      pdu triggering PT_VLAN_Cockpit_XIX_TPCHType_DoIP_Cockpit_OBDC_XIX_0x3123_XIX_0xF02_XIX_Physical: pdu=DCM_VLAN_Cockpit_XIX_TPCHType_DoIP_Cockpit_OBDC_XIX_0x3123_XIX_0xF02_XIX_Physical, from HCP3_IONode
      pdu triggering PT_VLAN_Cockpit_XIX_TPCHType_DoIP_Cockpit_OBDC_XIX_0xF02_XIX_0x1073_XIX_Physical: pdu=DCM_VLAN_Cockpit_XIX_TPCHType_DoIP_Cockpit_OBDC_XIX_0xF02_XIX_0x1073_XIX_Physical, to HCP3_IONode
      pdu triggering PT_VLAN_Cockpit_XIX_TPCHType_DoIP_Cockpit_OBDC_XIX_0x1073_XIX_0xF02_XIX_Physical: pdu=DCM_VLAN_Cockpit_XIX_TPCHType_DoIP_Cockpit_OBDC_XIX_0x1073_XIX_0xF02_XIX_Physical, from HCP3_IONode
      pdu triggering PT_VLAN_Cockpit_XIX_TPCHType_DoIP_Cockpit_OBDC_XIX_0xF02_XIX_0x30A5_XIX_Physical: pdu=DCM_VLAN_Cockpit_XIX_TPCHType_DoIP_Cockpit_OBDC_XIX_0xF02_XIX_0x30A5_XIX_Physical, to HCP3_IONode
      pdu triggering PT_VLAN_Cockpit_XIX_TPCHType_DoIP_Cockpit_OBDC_XIX_0x30A5_XIX_0xF02_XIX_Physical: pdu=DCM_VLAN_Cockpit_XIX_TPCHType_DoIP_Cockpit_OBDC_XIX_0x30A5_XIX_0xF02_XIX_Physical, from HCP3_IONode
      pdu triggering PT_VLAN_Cockpit_XIX_TPCHType_DoIP_Cockpit_OBDC_XIX_0xF02_XIX_0x30A6_XIX_Physical: pdu=DCM_VLAN_Cockpit_XIX_TPCHType_DoIP_Cockpit_OBDC_XIX_0xF02_XIX_0x30A6_XIX_Physical, to HCP3_IONode
      pdu triggering PT_VLAN_Cockpit_XIX_TPCHType_DoIP_Cockpit_OBDC_XIX_0x30A6_XIX_0xF02_XIX_Physical: pdu=DCM_VLAN_Cockpit_XIX_TPCHType_DoIP_Cockpit_OBDC_XIX_0x30A6_XIX_0xF02_XIX_Physical, from HCP3_IONode
      pdu triggering PT_VKM_04: pdu=VKM_04_XIX_VLAN_Cockpit, to HCP3_IONode
      pdu triggering PT_DoIP_Gateway_Info_El_UC: pdu=DoIP_Gateway_Info_El_UC_XIX_VLAN_Cockpit, to HCP3_IONode
      pdu triggering PT_TCPClient_DoIP_GW_Info_El: pdu=TCPClient_DoIP_GW_Info_El_XIX_VLAN_Cockpit, to HCP3_IONode
      pdu triggering PT_DoIP_Info_El_Gateway_UC: pdu=DoIP_Info_El_Gateway_UC_XIX_VLAN_Cockpit, from HCP3_IONode
      pdu triggering PT_TCPServer_DoIP_Info_El_GW: pdu=TCPServer_DoIP_Info_El_GW_XIX_VLAN_Cockpit, from HCP3_IONode
      pdu triggering PT_DoIP_Info_El_MC: pdu=DoIP_Info_El_MC_XIX_VLAN_Cockpit, from HCP3_IONode
      pdu triggering PT_KN_Info_El: pdu=KN_Info_El_XIX_VLAN_Cockpit, from HCP3_IONode
      pdu triggering PT_WakeupclusterConfiguration_Methods_subscribeConfigurationsByKey_XIX_SomeIP_ServiceProvider_01_Gateway_Info_El_01_UC_Request: pdu=WakeupclusterConfiguration_Methods_subscribeConfigurationsByKey_Request_XIX_SomeIP_ServiceProvi_7E6CBA6D90EFBC1C0C8259184F31093C, from HCP3_IONode
      pdu triggering PT_WakeupclusterConfiguration_Methods_subscribeConfigurationsByKey_XIX_SomeIP_ServiceProvider_01_Gateway_Info_El_01_UC_Response: pdu=WakeupclusterConfiguration_Methods_subscribeConfigurationsByKey_Response_XIX_SomeIP_ServiceProv_DAB357DD5E2932C31761DB84F3B5D9E6, to HCP3_IONode
      pdu triggering PT_WakeupclusterConfiguration_Methods_setConfigurationsElement_XIX_SomeIP_ServiceProvider_01_Gateway_Info_El_01_UC_Request: pdu=WakeupclusterConfiguration_Methods_setConfigurationsElement_Request_XIX_SomeIP_ServiceProvider_D8F002AA1F2AB500774DEA13942C0264, from HCP3_IONode
      pdu triggering PT_WakeupclusterConfiguration_Methods_setConfigurationsElement_XIX_SomeIP_ServiceProvider_01_Gateway_Info_El_01_UC_Response: pdu=WakeupclusterConfiguration_Methods_setConfigurationsElement_Response_XIX_SomeIP_ServiceProvider_B3CA95585AEFD5969CCFE8B81AEAD959, to HCP3_IONode
      pdu triggering PT_WakeupclusterConfiguration_Methods_getConfigurationsElementByKey_XIX_SomeIP_ServiceProvider_01_Gateway_Info_El_01_UC_Request: pdu=WakeupclusterConfiguration_Methods_getConfigurationsElementByKey_Request_XIX_SomeIP_ServiceProv_915C94CE0BB3781DF02EF7972CEC1C52, from HCP3_IONode
      pdu triggering PT_WakeupclusterConfiguration_Methods_getConfigurationsElementByKey_XIX_SomeIP_ServiceProvider_01_Gateway_Info_El_01_UC_Response: pdu=WakeupclusterConfiguration_Methods_getConfigurationsElementByKey_Response_XIX_SomeIP_ServicePro_5F40FB5A1866E25D2F44ACF3DA9DBB90, to HCP3_IONode
      pdu triggering PT_WakeupclusterConfiguration_Methods_subscribeConfigurations_XIX_SomeIP_ServiceProvider_01_Gateway_Info_El_01_UC_Request: pdu=WakeupclusterConfiguration_Methods_subscribeConfigurations_Request_XIX_SomeIP_ServiceProvider_0_DBABD344C00D07A361B29B6A5CB24FD3, from HCP3_IONode
      pdu triggering PT_WakeupclusterConfiguration_Methods_subscribeConfigurations_XIX_SomeIP_ServiceProvider_01_Gateway_Info_El_01_UC_Response: pdu=WakeupclusterConfiguration_Methods_subscribeConfigurations_Response_XIX_SomeIP_ServiceProvider_F85D5CE3466F3F22466CF9911D2EA7E8, to HCP3_IONode
      pdu triggering PT_WakeupclusterConfiguration_Methods_getConfigurationsElements_XIX_SomeIP_ServiceProvider_01_Gateway_Info_El_01_UC_Request: pdu=WakeupclusterConfiguration_Methods_getConfigurationsElements_Request_XIX_SomeIP_ServiceProvider_83EA04CC8AD03D4FFDA545878D6C3966, from HCP3_IONode
      pdu triggering PT_WakeupclusterConfiguration_Methods_getConfigurationsElements_XIX_SomeIP_ServiceProvider_01_Gateway_Info_El_01_UC_Response: pdu=WakeupclusterConfiguration_Methods_getConfigurationsElements_Response_XIX_SomeIP_ServiceProvide_2E5FD60B99F81F557A6910B338C49833, to HCP3_IONode
      pdu triggering PT_WakeupclusterConfiguration_Methods_unsubscribeConfigurations_XIX_SomeIP_ServiceProvider_01_Gateway_Info_El_01_UC_Request: pdu=WakeupclusterConfiguration_Methods_unsubscribeConfigurations_Request_XIX_SomeIP_ServiceProvider_A92E979D506F6973EF947DF57A11513F, from HCP3_IONode
      pdu triggering PT_WakeupclusterConfiguration_Methods_unsubscribeConfigurations_XIX_SomeIP_ServiceProvider_01_Gateway_Info_El_01_UC_Response: pdu=WakeupclusterConfiguration_Methods_unsubscribeConfigurations_Response_XIX_SomeIP_ServiceProvide_A5BA5F80A437E042A3A50D941887F96B, to HCP3_IONode
      pdu triggering PT_WakeupclusterConfiguration_Methods_createConfigurationsElement_XIX_SomeIP_ServiceProvider_01_Gateway_Info_El_01_UC_Request: pdu=WakeupclusterConfiguration_Methods_createConfigurationsElement_Request_XIX_SomeIP_ServiceProvid_7737BB873B01B3A00B3C2023AB27203D, from HCP3_IONode
      pdu triggering PT_WakeupclusterConfiguration_Methods_createConfigurationsElement_XIX_SomeIP_ServiceProvider_01_Gateway_Info_El_01_UC_Response: pdu=WakeupclusterConfiguration_Methods_createConfigurationsElement_Response_XIX_SomeIP_ServiceProvi_231B67EBCBF09FBC4FA70DC1F8EBF924, to HCP3_IONode
      pdu triggering PT_WakeupclusterConfiguration_Events_configurationsEvent_XIX_SomeIP_ServiceProvider_01_Gateway_Info_UC: pdu=WakeupclusterConfiguration_Events_configurationsEvent, to HCP3_IONode
      pdu triggering PT_KN_AMP: pdu=KN_AMP_XIX_VLAN_Cockpit, to HCP3_IONode
      pdu triggering PT_SOMEIPTestabilityClient_Methods_echoFloat32_XIX_SomeIP_ServiceProvider_Testability_TestSysIP_Info_El_Request: pdu=SOMEIPTestabilityClient_Methods_echoFloat32_Request_XIX_SomeIP_ServiceProvider_Testability_TestSysIP_Info_El_XIX_VLAN_Cockpit, from HCP3_IONode
      pdu triggering PT_SOMEIPTestabilityClient_Methods_echoFloat32_XIX_SomeIP_ServiceProvider_Testability_TestSysIP_Info_El_Response: pdu=SOMEIPTestabilityClient_Methods_echoFloat32_Response_XIX_SomeIP_ServiceProvider_Testability_TestSysIP_Info_El_XIX_VLAN_Cockpit, to HCP3_IONode
      pdu triggering PT_SOMEIPTestabilityClient_Methods_echoUInt8UInt16UInt32_XIX_SomeIP_ServiceProvider_Testability_TestSysIP_Info_El_Request: pdu=SOMEIPTestabilityClient_Methods_echoUInt8UInt16UInt32_Request_XIX_SomeIP_ServiceProvider_Testab_65F6305093B81CAD3D38CF0A1637314A, from HCP3_IONode
      pdu triggering PT_SOMEIPTestabilityClient_Methods_echoUInt8UInt16UInt32_XIX_SomeIP_ServiceProvider_Testability_TestSysIP_Info_El_Response: pdu=SOMEIPTestabilityClient_Methods_echoUInt8UInt16UInt32_Response_XIX_SomeIP_ServiceProvider_Testa_F130EBE8645A8C8B63C32950E8FD95F1, to HCP3_IONode
      pdu triggering PT_SOMEIPTestabilityClient_Methods_echoComplexStruct_XIX_SomeIP_ServiceProvider_Testability_TestSysIP_Info_El_Request: pdu=SOMEIPTestabilityClient_Methods_echoComplexStruct_Request_XIX_SomeIP_ServiceProvider_Testabilit_3C83CBA50BCB4C48B5D9E17802CF63AB, from HCP3_IONode
      pdu triggering PT_SOMEIPTestabilityClient_Methods_echoComplexStruct_XIX_SomeIP_ServiceProvider_Testability_TestSysIP_Info_El_Response: pdu=SOMEIPTestabilityClient_Methods_echoComplexStruct_Response_XIX_SomeIP_ServiceProvider_Testabili_FF4764BE3783B4EC0607B4ECD4F98E29, to HCP3_IONode
      pdu triggering PT_SOMEIPTestabilityClient_Methods_echoUInt8_XIX_SomeIP_ServiceProvider_Testability_TestSysIP_Info_El_Request: pdu=SOMEIPTestabilityClient_Methods_echoUInt8_Request_XIX_SomeIP_ServiceProvider_Testability_TestSysIP_Info_El_XIX_VLAN_Cockpit, from HCP3_IONode
      pdu triggering PT_SOMEIPTestabilityClient_Methods_echoUInt8_XIX_SomeIP_ServiceProvider_Testability_TestSysIP_Info_El_Response: pdu=SOMEIPTestabilityClient_Methods_echoUInt8_Response_XIX_SomeIP_ServiceProvider_Testability_TestSysIP_Info_El_XIX_VLAN_Cockpit, to HCP3_IONode
      pdu triggering PT_SOMEIPTestabilityClient_Methods_echoComplexDynamicArray_XIX_SomeIP_ServiceProvider_Testability_TestSysIP_Info_El_Request: pdu=SOMEIPTestabilityClient_Methods_echoComplexDynamicArray_Request_XIX_SomeIP_ServiceProvider_Test_5975F69CF86108D92A7FF5DE502EED3C, from HCP3_IONode
      pdu triggering PT_SOMEIPTestabilityClient_Methods_echoComplexDynamicArray_XIX_SomeIP_ServiceProvider_Testability_TestSysIP_Info_El_Response: pdu=SOMEIPTestabilityClient_Methods_echoComplexDynamicArray_Response_XIX_SomeIP_ServiceProvider_Tes_A3E901FC688CD8C3B0D5838E355C4D78, to HCP3_IONode
      pdu triggering PT_SOMEIPTestabilityClient_RnRMethods_rnrEchoComplexDynamicArray_XIX_SomeIP_ServiceProvider_Testability_TestSysIP_Info_El: pdu=SOMEIPTestabilityClient_RnRMethods_rnrEchoComplexDynamicArray_XIX_SomeIP_ServiceProvider_Testab_19E4CC73C2D5EF5F86A76E798A9DFB06, from HCP3_IONode
      pdu triggering PT_SOMEIPTestabilityClient_RnRMethods_rnrEchoFloat32_XIX_SomeIP_ServiceProvider_Testability_TestSysIP_Info_El: pdu=SOMEIPTestabilityClient_RnRMethods_rnrEchoFloat32_XIX_SomeIP_ServiceProvider_Testability_TestSysIP_Info_El_XIX_VLAN_Cockpit, from HCP3_IONode
      pdu triggering PT_SOMEIPTestabilityClient_RnRMethods_rnrEchoUInt8UInt16UInt32_XIX_SomeIP_ServiceProvider_Testability_TestSysIP_Info_El: pdu=SOMEIPTestabilityClient_RnRMethods_rnrEchoUInt8UInt16UInt32_XIX_SomeIP_ServiceProvider_Testabil_227449E5AB814CE5EDD5836CB7A76091, from HCP3_IONode
      pdu triggering PT_SOMEIPTestabilityClient_RnRMethods_rnrEchoComplexStruct_XIX_SomeIP_ServiceProvider_Testability_TestSysIP_Info_El: pdu=SOMEIPTestabilityClient_RnRMethods_rnrEchoComplexStruct_XIX_SomeIP_ServiceProvider_Testability_B845B48FBA5A8201DBD37C907E043B16, from HCP3_IONode
      pdu triggering PT_SOMEIPTestabilityClient_RnRMethods_noResponseUInt8_XIX_SomeIP_ServiceProvider_Testability_TestSysIP_Info_El: pdu=SOMEIPTestabilityClient_RnRMethods_noResponseUInt8_XIX_SomeIP_ServiceProvider_Testability_TestSysIP_Info_El_XIX_VLAN_Cockpit, from HCP3_IONode
      pdu triggering PT_SOMEIPTestabilityClient_MethodsGet_TestFieldUInt8_XIX_SomeIP_ServiceProvider_Testability_TestSysIP_Info_El_Request: pdu=SOMEIPTestabilityClient_MethodsGet_TestFieldUInt8_Request_XIX_SomeIP_ServiceProvider_Testabilit_774024A6124BD6528741A00398ABA277, from HCP3_IONode
      pdu triggering PT_SOMEIPTestabilityClient_MethodsGet_TestFieldUInt8_XIX_SomeIP_ServiceProvider_Testability_TestSysIP_Info_El_Response: pdu=SOMEIPTestabilityClient_MethodsGet_TestFieldUInt8_Response_XIX_SomeIP_ServiceProvider_Testabili_6F3892C45E71BA79D69AA01185614DF6, to HCP3_IONode
      pdu triggering PT_SOMEIPTestabilityClient_MethodsSet_TestFieldUInt8_XIX_SomeIP_ServiceProvider_Testability_TestSysIP_Info_El_Request: pdu=SOMEIPTestabilityClient_MethodsSet_TestFieldUInt8_Request_XIX_SomeIP_ServiceProvider_Testabilit_F141CC37CD94C1CB5D7BF6F6989D75BD, from HCP3_IONode
      pdu triggering PT_SOMEIPTestabilityClient_MethodsSet_TestFieldUInt8_XIX_SomeIP_ServiceProvider_Testability_TestSysIP_Info_El_Response: pdu=SOMEIPTestabilityClient_MethodsSet_TestFieldUInt8_Response_XIX_SomeIP_ServiceProvider_Testabili_3796B9B168685FBB71A6262D54431B54, to HCP3_IONode
      pdu triggering PT_SOMEIPTestabilityClient_Events_TestFieldUInt8_XIX_SomeIP_ServiceProvider_Testability_TestSysIP_Info_UC: pdu=SOMEIPTestabilityClient_Events_TestFieldUInt8, to HCP3_IONode
      pdu triggering PT_SOMEIPTestabilityClient_Events_testEventUInt8_XIX_SomeIP_ServiceProvider_Testability_TestSysIP_Info_UC: pdu=SOMEIPTestabilityClient_Events_testEventUInt8, to HCP3_IONode
      pdu triggering PT_KN_ICAS3Sys01: pdu=KN_ICAS3Sys01_XIX_VLAN_Cockpit, to HCP3_IONode
      pdu triggering PT_SOMEIPTestabilityReliable_Methods_echoUInt8UInt16UInt32_XIX_TCPServer_SomeIP_Testability_Info_El_TestSysIP_Request: pdu=SOMEIPTestabilityReliable_Methods_echoUInt8UInt16UInt32_Request_XIX_TCPServer_SomeIP_Testabilit_69C56E707EDB2DE5B6A25F8F8A314E62, to HCP3_IONode
      pdu triggering PT_SOMEIPTestabilityReliable_Methods_echoUInt8UInt16UInt32_XIX_TCPServer_SomeIP_Testability_Info_El_TestSysIP_Response: pdu=SOMEIPTestabilityReliable_Methods_echoUInt8UInt16UInt32_Response_XIX_TCPServer_SomeIP_Testabili_080176D85C95E78B40C5018645211CD9, from HCP3_IONode
      pdu triggering PT_SOMEIPTestabilityReliable_Methods_echoUInt8_XIX_TCPServer_SomeIP_Testability_Info_El_TestSysIP_Request: pdu=SOMEIPTestabilityReliable_Methods_echoUInt8_Request_XIX_TCPServer_SomeIP_Testability_Info_El_TestSysIP_XIX_VLAN_Cockpit, to HCP3_IONode
      pdu triggering PT_SOMEIPTestabilityReliable_Methods_echoUInt8_XIX_TCPServer_SomeIP_Testability_Info_El_TestSysIP_Response: pdu=SOMEIPTestabilityReliable_Methods_echoUInt8_Response_XIX_TCPServer_SomeIP_Testability_Info_El_TestSysIP_XIX_VLAN_Cockpit, from HCP3_IONode
      pdu triggering PT_SOMEIPTestabilityReliable_Methods_echoBool_XIX_TCPServer_SomeIP_Testability_Info_El_TestSysIP_Request: pdu=SOMEIPTestabilityReliable_Methods_echoBool_Request_XIX_TCPServer_SomeIP_Testability_Info_El_TestSysIP_XIX_VLAN_Cockpit, to HCP3_IONode
      pdu triggering PT_SOMEIPTestabilityReliable_Methods_echoBool_XIX_TCPServer_SomeIP_Testability_Info_El_TestSysIP_Response: pdu=SOMEIPTestabilityReliable_Methods_echoBool_Response_XIX_TCPServer_SomeIP_Testability_Info_El_TestSysIP_XIX_VLAN_Cockpit, from HCP3_IONode
      pdu triggering PT_SOMEIPTestabilityReliable_Methods_getLastValueFieldMulticast_XIX_TCPServer_SomeIP_Testability_Info_El_TestSysIP_Request: pdu=SOMEIPTestabilityReliable_Methods_getLastValueFieldMulticast_Request_XIX_TCPServer_SomeIP_Testa_BD9AA0588327A8EEAF8039E934CA774B, to HCP3_IONode
      pdu triggering PT_SOMEIPTestabilityReliable_Methods_getLastValueFieldMulticast_XIX_TCPServer_SomeIP_Testability_Info_El_TestSysIP_Response: pdu=SOMEIPTestabilityReliable_Methods_getLastValueFieldMulticast_Response_XIX_TCPServer_SomeIP_Test_96EE0D57336F6629D301D80B1DF9BA66, from HCP3_IONode
      pdu triggering PT_SOMEIPTestabilityReliable_Methods_echoInverseDynamicArray_XIX_TCPServer_SomeIP_Testability_Info_El_TestSysIP_Request: pdu=SOMEIPTestabilityReliable_Methods_echoInverseDynamicArray_Request_XIX_TCPServer_SomeIP_Testabil_2251AB4E56559A475C48178E53B5E5EB, to HCP3_IONode
      pdu triggering PT_SOMEIPTestabilityReliable_Methods_echoInverseDynamicArray_XIX_TCPServer_SomeIP_Testability_Info_El_TestSysIP_Response: pdu=SOMEIPTestabilityReliable_Methods_echoInverseDynamicArray_Response_XIX_TCPServer_SomeIP_Testabi_D70AD9E9EA8C9EC9D33463A790B744DA, from HCP3_IONode
      pdu triggering PT_SOMEIPTestabilityReliable_Methods_getLastValueEventUInt8_XIX_TCPServer_SomeIP_Testability_Info_El_TestSysIP_Request: pdu=SOMEIPTestabilityReliable_Methods_getLastValueEventUInt8_Request_XIX_TCPServer_SomeIP_Testabili_871CD559971D9D0FC9EB1A3CDE066A3E, to HCP3_IONode
      pdu triggering PT_SOMEIPTestabilityReliable_Methods_getLastValueEventUInt8_XIX_TCPServer_SomeIP_Testability_Info_El_TestSysIP_Response: pdu=SOMEIPTestabilityReliable_Methods_getLastValueEventUInt8_Response_XIX_TCPServer_SomeIP_Testabil_34B0B086E60CC6D10CEF44811CCBF0BA, from HCP3_IONode
      pdu triggering PT_SOMEIPTestabilityReliable_Methods_echoUInt64_XIX_TCPServer_SomeIP_Testability_Info_El_TestSysIP_Request: pdu=SOMEIPTestabilityReliable_Methods_echoUInt64_Request_XIX_TCPServer_SomeIP_Testability_Info_El_TestSysIP_XIX_VLAN_Cockpit, to HCP3_IONode
      pdu triggering PT_SOMEIPTestabilityReliable_Methods_echoUInt64_XIX_TCPServer_SomeIP_Testability_Info_El_TestSysIP_Response: pdu=SOMEIPTestabilityReliable_Methods_echoUInt64_Response_XIX_TCPServer_SomeIP_Testability_Info_El_TestSysIP_XIX_VLAN_Cockpit, from HCP3_IONode
      pdu triggering PT_SOMEIPTestabilityReliable_Methods_echoUInt32_XIX_TCPServer_SomeIP_Testability_Info_El_TestSysIP_Request: pdu=SOMEIPTestabilityReliable_Methods_echoUInt32_Request_XIX_TCPServer_SomeIP_Testability_Info_El_TestSysIP_XIX_VLAN_Cockpit, to HCP3_IONode
      pdu triggering PT_SOMEIPTestabilityReliable_Methods_echoUInt32_XIX_TCPServer_SomeIP_Testability_Info_El_TestSysIP_Response: pdu=SOMEIPTestabilityReliable_Methods_echoUInt32_Response_XIX_TCPServer_SomeIP_Testability_Info_El_TestSysIP_XIX_VLAN_Cockpit, from HCP3_IONode
      pdu triggering PT_SOMEIPTestabilityReliable_Methods_echoComplexStruct_XIX_TCPServer_SomeIP_Testability_Info_El_TestSysIP_Request: pdu=SOMEIPTestabilityReliable_Methods_echoComplexStruct_Request_XIX_TCPServer_SomeIP_Testability_Info_El_TestSysIP_XIX_VLAN_Cockpit, to HCP3_IONode
      pdu triggering PT_SOMEIPTestabilityReliable_Methods_echoComplexStruct_XIX_TCPServer_SomeIP_Testability_Info_El_TestSysIP_Response: pdu=SOMEIPTestabilityReliable_Methods_echoComplexStruct_Response_XIX_TCPServer_SomeIP_Testability_Info_El_TestSysIP_XIX_VLAN_Cockpit, from HCP3_IONode
      pdu triggering PT_SOMEIPTestabilityReliable_Methods_checkByteOrder_XIX_TCPServer_SomeIP_Testability_Info_El_TestSysIP_Request: pdu=SOMEIPTestabilityReliable_Methods_checkByteOrder_Request_XIX_TCPServer_SomeIP_Testability_Info_El_TestSysIP_XIX_VLAN_Cockpit, to HCP3_IONode
      pdu triggering PT_SOMEIPTestabilityReliable_Methods_checkByteOrder_XIX_TCPServer_SomeIP_Testability_Info_El_TestSysIP_Response: pdu=SOMEIPTestabilityReliable_Methods_checkByteOrder_Response_XIX_TCPServer_SomeIP_Testability_Info_El_TestSysIP_XIX_VLAN_Cockpit, from HCP3_IONode
      pdu triggering PT_SOMEIPTestabilityReliable_Methods_getSupportedFunctions_XIX_TCPServer_SomeIP_Testability_Info_El_TestSysIP_Request: pdu=SOMEIPTestabilityReliable_Methods_getSupportedFunctions_Request_XIX_TCPServer_SomeIP_Testabilit_AF9B756A63B7DD83A0F5FC37C48635BF, to HCP3_IONode
      pdu triggering PT_SOMEIPTestabilityReliable_Methods_getSupportedFunctions_XIX_TCPServer_SomeIP_Testability_Info_El_TestSysIP_Response: pdu=SOMEIPTestabilityReliable_Methods_getSupportedFunctions_Response_XIX_TCPServer_SomeIP_Testabili_B0116466194258F67CE8BCCEA84907B0, from HCP3_IONode
      pdu triggering PT_SOMEIPTestabilityReliable_Methods_echoInverseDynamicMultidimensionalArray_XIX_TCPServer_Some_F145DA4A564DECEA438E4C73A67AD229: pdu=SOMEIPTestabilityReliable_Methods_echoInverseDynamicMultidimensionalArray_Request_XIX_TCPServer_9D1508085278F533916397EA2D85A645, to HCP3_IONode
      pdu triggering PT_SOMEIPTestabilityReliable_Methods_echoInverseDynamicMultidimensionalArray_XIX_TCPServer_Some_8912479F3DFDD2E1D50DE97A28F7FF6C: pdu=SOMEIPTestabilityReliable_Methods_echoInverseDynamicMultidimensionalArray_Response_XIX_TCPServe_F17F02095D8D19E65FFCFAE2CFA6F4BF, from HCP3_IONode
      pdu triggering PT_SOMEIPTestabilityReliable_Methods_echoFloat32_XIX_TCPServer_SomeIP_Testability_Info_El_TestSysIP_Request: pdu=SOMEIPTestabilityReliable_Methods_echoFloat32_Request_XIX_TCPServer_SomeIP_Testability_Info_El_TestSysIP_XIX_VLAN_Cockpit, to HCP3_IONode
      pdu triggering PT_SOMEIPTestabilityReliable_Methods_echoFloat32_XIX_TCPServer_SomeIP_Testability_Info_El_TestSysIP_Response: pdu=SOMEIPTestabilityReliable_Methods_echoFloat32_Response_XIX_TCPServer_SomeIP_Testability_Info_El_TestSysIP_XIX_VLAN_Cockpit, from HCP3_IONode
      pdu triggering PT_SOMEIPTestabilityReliable_Methods_echoComplexDynamicArray_XIX_TCPServer_SomeIP_Testability_Info_El_TestSysIP_Request: pdu=SOMEIPTestabilityReliable_Methods_echoComplexDynamicArray_Request_XIX_TCPServer_SomeIP_Testabil_5C81E8A88956CADC3224246876A9A0C1, to HCP3_IONode
      pdu triggering PT_SOMEIPTestabilityReliable_Methods_echoComplexDynamicArray_XIX_TCPServer_SomeIP_Testability_Info_El_TestSysIP_Response: pdu=SOMEIPTestabilityReliable_Methods_echoComplexDynamicArray_Response_XIX_TCPServer_SomeIP_Testabi_D2162A0B62BA000ECE607E0E1322ED57, from HCP3_IONode
      pdu triggering PT_SOMEIPTestabilityReliable_Methods_activateTsClient_XIX_TCPServer_SomeIP_Testability_Info_El_TestSysIP_Request: pdu=SOMEIPTestabilityReliable_Methods_activateTsClient_Request_XIX_TCPServer_SomeIP_Testability_Info_El_TestSysIP_XIX_VLAN_Cockpit, to HCP3_IONode
      pdu triggering PT_SOMEIPTestabilityReliable_Methods_activateTsClient_XIX_TCPServer_SomeIP_Testability_Info_El_TestSysIP_Response: pdu=SOMEIPTestabilityReliable_Methods_activateTsClient_Response_XIX_TCPServer_SomeIP_Testability_Info_El_TestSysIP_XIX_VLAN_Cockpit, from HCP3_IONode
      pdu triggering PT_SOMEIPTestabilityReliable_Methods_enableSubscription_XIX_TCPServer_SomeIP_Testability_Info_El_TestSysIP_Request: pdu=SOMEIPTestabilityReliable_Methods_enableSubscription_Request_XIX_TCPServer_SomeIP_Testability_Info_El_TestSysIP_XIX_VLAN_Cockpit, to HCP3_IONode
      pdu triggering PT_SOMEIPTestabilityReliable_Methods_enableSubscription_XIX_TCPServer_SomeIP_Testability_Info_El_TestSysIP_Response: pdu=SOMEIPTestabilityReliable_Methods_enableSubscription_Response_XIX_TCPServer_SomeIP_Testability_574FC24CB182E41708BE342C1436842C, from HCP3_IONode
      pdu triggering PT_SOMEIPTestabilityReliable_Methods_echoStructInStruct_XIX_TCPServer_SomeIP_Testability_Info_El_TestSysIP_Request: pdu=SOMEIPTestabilityReliable_Methods_echoStructInStruct_Request_XIX_TCPServer_SomeIP_Testability_Info_El_TestSysIP_XIX_VLAN_Cockpit, to HCP3_IONode
      pdu triggering PT_SOMEIPTestabilityReliable_Methods_echoStructInStruct_XIX_TCPServer_SomeIP_Testability_Info_El_TestSysIP_Response: pdu=SOMEIPTestabilityReliable_Methods_echoStructInStruct_Response_XIX_TCPServer_SomeIP_Testability_C119ADB5B460ADBD6A690F61A4D3EB22, from HCP3_IONode
      pdu triggering PT_SOMEIPTestabilityReliable_Methods_echoFloat64_XIX_TCPServer_SomeIP_Testability_Info_El_TestSysIP_Request: pdu=SOMEIPTestabilityReliable_Methods_echoFloat64_Request_XIX_TCPServer_SomeIP_Testability_Info_El_TestSysIP_XIX_VLAN_Cockpit, to HCP3_IONode
      pdu triggering PT_SOMEIPTestabilityReliable_Methods_echoFloat64_XIX_TCPServer_SomeIP_Testability_Info_El_TestSysIP_Response: pdu=SOMEIPTestabilityReliable_Methods_echoFloat64_Response_XIX_TCPServer_SomeIP_Testability_Info_El_TestSysIP_XIX_VLAN_Cockpit, from HCP3_IONode
      pdu triggering PT_SOMEIPTestabilityReliable_Methods_resetInterface_XIX_TCPServer_SomeIP_Testability_Info_El_TestSysIP_Request: pdu=SOMEIPTestabilityReliable_Methods_resetInterface_Request_XIX_TCPServer_SomeIP_Testability_Info_El_TestSysIP_XIX_VLAN_Cockpit, to HCP3_IONode
      pdu triggering PT_SOMEIPTestabilityReliable_Methods_resetInterface_XIX_TCPServer_SomeIP_Testability_Info_El_TestSysIP_Response: pdu=SOMEIPTestabilityReliable_Methods_resetInterface_Response_XIX_TCPServer_SomeIP_Testability_Info_El_TestSysIP_XIX_VLAN_Cockpit, from HCP3_IONode
      pdu triggering PT_SOMEIPTestabilityReliable_Methods_echoInverseBitField_XIX_TCPServer_SomeIP_Testability_Info_El_TestSysIP_Request: pdu=SOMEIPTestabilityReliable_Methods_echoInverseBitField_Request_XIX_TCPServer_SomeIP_Testability_9810139930AA6602913F8587B779818E, to HCP3_IONode
      pdu triggering PT_SOMEIPTestabilityReliable_Methods_echoInverseBitField_XIX_TCPServer_SomeIP_Testability_Info_El_TestSysIP_Response: pdu=SOMEIPTestabilityReliable_Methods_echoInverseBitField_Response_XIX_TCPServer_SomeIP_Testability_47ADD3912D3BA99B8C4BA1F58AB1BA9B, from HCP3_IONode
      pdu triggering PT_SOMEIPTestabilityReliable_Methods_echoUInt16_XIX_TCPServer_SomeIP_Testability_Info_El_TestSysIP_Request: pdu=SOMEIPTestabilityReliable_Methods_echoUInt16_Request_XIX_TCPServer_SomeIP_Testability_Info_El_TestSysIP_XIX_VLAN_Cockpit, to HCP3_IONode
      pdu triggering PT_SOMEIPTestabilityReliable_Methods_echoUInt16_XIX_TCPServer_SomeIP_Testability_Info_El_TestSysIP_Response: pdu=SOMEIPTestabilityReliable_Methods_echoUInt16_Response_XIX_TCPServer_SomeIP_Testability_Info_El_TestSysIP_XIX_VLAN_Cockpit, from HCP3_IONode
      pdu triggering PT_SOMEIPTestabilityReliable_Methods_echoSInt32_XIX_TCPServer_SomeIP_Testability_Info_El_TestSysIP_Request: pdu=SOMEIPTestabilityReliable_Methods_echoSInt32_Request_XIX_TCPServer_SomeIP_Testability_Info_El_TestSysIP_XIX_VLAN_Cockpit, to HCP3_IONode
      pdu triggering PT_SOMEIPTestabilityReliable_Methods_echoSInt32_XIX_TCPServer_SomeIP_Testability_Info_El_TestSysIP_Response: pdu=SOMEIPTestabilityReliable_Methods_echoSInt32_Response_XIX_TCPServer_SomeIP_Testability_Info_El_TestSysIP_XIX_VLAN_Cockpit, from HCP3_IONode
      pdu triggering PT_SOMEIPTestabilityReliable_Methods_echoInverseStruct_XIX_TCPServer_SomeIP_Testability_Info_El_TestSysIP_Request: pdu=SOMEIPTestabilityReliable_Methods_echoInverseStruct_Request_XIX_TCPServer_SomeIP_Testability_Info_El_TestSysIP_XIX_VLAN_Cockpit, to HCP3_IONode
      pdu triggering PT_SOMEIPTestabilityReliable_Methods_echoInverseStruct_XIX_TCPServer_SomeIP_Testability_Info_El_TestSysIP_Response: pdu=SOMEIPTestabilityReliable_Methods_echoInverseStruct_Response_XIX_TCPServer_SomeIP_Testability_Info_El_TestSysIP_XIX_VLAN_Cockpit, from HCP3_IONode
      pdu triggering PT_SOMEIPTestabilityReliable_Methods_echoSInt64_XIX_TCPServer_SomeIP_Testability_Info_El_TestSysIP_Request: pdu=SOMEIPTestabilityReliable_Methods_echoSInt64_Request_XIX_TCPServer_SomeIP_Testability_Info_El_TestSysIP_XIX_VLAN_Cockpit, to HCP3_IONode
      pdu triggering PT_SOMEIPTestabilityReliable_Methods_echoSInt64_XIX_TCPServer_SomeIP_Testability_Info_El_TestSysIP_Response: pdu=SOMEIPTestabilityReliable_Methods_echoSInt64_Response_XIX_TCPServer_SomeIP_Testability_Info_El_TestSysIP_XIX_VLAN_Cockpit, from HCP3_IONode
      pdu triggering PT_SOMEIPTestabilityReliable_Methods_echoSInt16_XIX_TCPServer_SomeIP_Testability_Info_El_TestSysIP_Request: pdu=SOMEIPTestabilityReliable_Methods_echoSInt16_Request_XIX_TCPServer_SomeIP_Testability_Info_El_TestSysIP_XIX_VLAN_Cockpit, to HCP3_IONode
      pdu triggering PT_SOMEIPTestabilityReliable_Methods_echoSInt16_XIX_TCPServer_SomeIP_Testability_Info_El_TestSysIP_Response: pdu=SOMEIPTestabilityReliable_Methods_echoSInt16_Response_XIX_TCPServer_SomeIP_Testability_Info_El_TestSysIP_XIX_VLAN_Cockpit, from HCP3_IONode
      pdu triggering PT_SOMEIPTestabilityReliable_Methods_echoUTF8String_XIX_TCPServer_SomeIP_Testability_Info_El_TestSysIP_Request: pdu=SOMEIPTestabilityReliable_Methods_echoUTF8String_Request_XIX_TCPServer_SomeIP_Testability_Info_El_TestSysIP_XIX_VLAN_Cockpit, to HCP3_IONode
      pdu triggering PT_SOMEIPTestabilityReliable_Methods_echoUTF8String_XIX_TCPServer_SomeIP_Testability_Info_El_TestSysIP_Response: pdu=SOMEIPTestabilityReliable_Methods_echoUTF8String_Response_XIX_TCPServer_SomeIP_Testability_Info_El_TestSysIP_XIX_VLAN_Cockpit, from HCP3_IONode
      pdu triggering PT_SOMEIPTestabilityReliable_Methods_deactivateTsClient_XIX_TCPServer_SomeIP_Testability_Info_El_TestSysIP_Request: pdu=SOMEIPTestabilityReliable_Methods_deactivateTsClient_Request_XIX_TCPServer_SomeIP_Testability_Info_El_TestSysIP_XIX_VLAN_Cockpit, to HCP3_IONode
      pdu triggering PT_SOMEIPTestabilityReliable_Methods_deactivateTsClient_XIX_TCPServer_SomeIP_Testability_Info_El_TestSysIP_Response: pdu=SOMEIPTestabilityReliable_Methods_deactivateTsClient_Response_XIX_TCPServer_SomeIP_Testability_B089AA1EA4E40519D5795365FA65B779, from HCP3_IONode
      pdu triggering PT_SOMEIPTestabilityReliable_Methods_echoSInt8_XIX_TCPServer_SomeIP_Testability_Info_El_TestSysIP_Request: pdu=SOMEIPTestabilityReliable_Methods_echoSInt8_Request_XIX_TCPServer_SomeIP_Testability_Info_El_TestSysIP_XIX_VLAN_Cockpit, to HCP3_IONode
      pdu triggering PT_SOMEIPTestabilityReliable_Methods_echoSInt8_XIX_TCPServer_SomeIP_Testability_Info_El_TestSysIP_Response: pdu=SOMEIPTestabilityReliable_Methods_echoSInt8_Response_XIX_TCPServer_SomeIP_Testability_Info_El_TestSysIP_XIX_VLAN_Cockpit, from HCP3_IONode
      pdu triggering PT_SOMEIPTestabilityReliable_RnRMethods_triggerEchoFloat32_XIX_TCPServer_SomeIP_Testability_Info_El_TestSysIP: pdu=SOMEIPTestabilityReliable_RnRMethods_triggerEchoFloat32_XIX_TCPServer_SomeIP_Testability_Info_El_TestSysIP_XIX_VLAN_Cockpit, to HCP3_IONode
      pdu triggering PT_SOMEIPTestabilityReliable_RnRMethods_triggerGetterUInt8_XIX_TCPServer_SomeIP_Testability_Info_El_TestSysIP: pdu=SOMEIPTestabilityReliable_RnRMethods_triggerGetterUInt8_XIX_TCPServer_SomeIP_Testability_Info_El_TestSysIP_XIX_VLAN_Cockpit, to HCP3_IONode
      pdu triggering PT_SOMEIPTestabilityReliable_RnRMethods_triggerSetterUInt8_XIX_TCPServer_SomeIP_Testability_Info_El_TestSysIP: pdu=SOMEIPTestabilityReliable_RnRMethods_triggerSetterUInt8_XIX_TCPServer_SomeIP_Testability_Info_El_TestSysIP_XIX_VLAN_Cockpit, to HCP3_IONode
      pdu triggering PT_SOMEIPTestabilityReliable_RnRMethods_triggerEchoComplexStruct_XIX_TCPServer_SomeIP_Testability_Info_El_TestSysIP: pdu=SOMEIPTestabilityReliable_RnRMethods_triggerEchoComplexStruct_XIX_TCPServer_SomeIP_Testability_66441691A56525584C1C972BF61F7737, to HCP3_IONode
      pdu triggering PT_SOMEIPTestabilityReliable_RnRMethods_triggerFireForgetUInt8_XIX_TCPServer_SomeIP_Testability_Info_El_TestSysIP: pdu=SOMEIPTestabilityReliable_RnRMethods_triggerFireForgetUInt8_XIX_TCPServer_SomeIP_Testability_Info_El_TestSysIP_XIX_VLAN_Cockpit, to HCP3_IONode
      pdu triggering PT_SOMEIPTestabilityReliable_RnRMethods_triggerEchoLargeDataArray_XIX_TCPServer_SomeIP_Testability_Info_El_TestSysIP: pdu=SOMEIPTestabilityReliable_RnRMethods_triggerEchoLargeDataArray_XIX_TCPServer_SomeIP_Testability_EAA76D6BE112DC3CEB9E9F874869F052, to HCP3_IONode
      pdu triggering PT_SOMEIPTestabilityReliable_RnRMethods_triggerFieldMulticast_XIX_TCPServer_SomeIP_Testability_Info_El_TestSysIP: pdu=SOMEIPTestabilityReliable_RnRMethods_triggerFieldMulticast_XIX_TCPServer_SomeIP_Testability_Info_El_TestSysIP_XIX_VLAN_Cockpit, to HCP3_IONode
      pdu triggering PT_SOMEIPTestabilityReliable_RnRMethods_triggerEchoUInt8UInt16UInt32_XIX_TCPServer_SomeIP_Testability_Info_El_TestSysIP: pdu=SOMEIPTestabilityReliable_RnRMethods_triggerEchoUInt8UInt16UInt32_XIX_TCPServer_SomeIP_Testabil_94225595C9A15EA1DA0DA88498470107, to HCP3_IONode
      pdu triggering PT_SOMEIPTestabilityReliable_RnRMethods_triggerEchoUInt8_XIX_TCPServer_SomeIP_Testability_Info_El_TestSysIP: pdu=SOMEIPTestabilityReliable_RnRMethods_triggerEchoUInt8_XIX_TCPServer_SomeIP_Testability_Info_El_TestSysIP_XIX_VLAN_Cockpit, to HCP3_IONode
      pdu triggering PT_SOMEIPTestabilityReliable_RnRMethods_noResponseUInt8_XIX_TCPServer_SomeIP_Testability_Info_El_TestSysIP: pdu=SOMEIPTestabilityReliable_RnRMethods_noResponseUInt8_XIX_TCPServer_SomeIP_Testability_Info_El_TestSysIP_XIX_VLAN_Cockpit, to HCP3_IONode
      pdu triggering PT_SOMEIPTestabilityReliable_RnRMethods_triggerEventUInt8_XIX_TCPServer_SomeIP_Testability_Info_El_TestSysIP: pdu=SOMEIPTestabilityReliable_RnRMethods_triggerEventUInt8_XIX_TCPServer_SomeIP_Testability_Info_El_TestSysIP_XIX_VLAN_Cockpit, to HCP3_IONode
      pdu triggering PT_SOMEIPTestabilityReliable_RnRMethods_triggerEchoComplexDynamicArray_XIX_TCPServer_SomeIP_Testability_Info_El_TestSysIP: pdu=SOMEIPTestabilityReliable_RnRMethods_triggerEchoComplexDynamicArray_XIX_TCPServer_SomeIP_Testab_E8FBD0BF52742CD4B95686D3C9201F76, to HCP3_IONode
      pdu triggering PT_SOMEIPTestabilityReliable_MethodsGet_TestFieldComplexStruct_XIX_TCPServer_SomeIP_Testability_Info_El_TestSysIP_Request: pdu=SOMEIPTestabilityReliable_MethodsGet_TestFieldComplexStruct_Request_XIX_TCPServer_SomeIP_Testab_2145344557D3AC120245B93E17DBF805, to HCP3_IONode
      pdu triggering PT_SOMEIPTestabilityReliable_MethodsGet_TestFieldComplexStruct_XIX_TCPServer_SomeIP_Testability_Info_El_TestSysIP_Response: pdu=SOMEIPTestabilityReliable_MethodsGet_TestFieldComplexStruct_Response_XIX_TCPServer_SomeIP_Testa_2C2CF55E67EFDC04A641F3B716BC1318, from HCP3_IONode
      pdu triggering PT_SOMEIPTestabilityReliable_MethodsSet_TestFieldComplexStruct_XIX_TCPServer_SomeIP_Testability_Info_El_TestSysIP_Request: pdu=SOMEIPTestabilityReliable_MethodsSet_TestFieldComplexStruct_Request_XIX_TCPServer_SomeIP_Testab_549DD3A42476EEB162C512D39F7492C4, to HCP3_IONode
      pdu triggering PT_SOMEIPTestabilityReliable_MethodsSet_TestFieldComplexStruct_XIX_TCPServer_SomeIP_Testability_Info_El_TestSysIP_Response: pdu=SOMEIPTestabilityReliable_MethodsSet_TestFieldComplexStruct_Response_XIX_TCPServer_SomeIP_Testa_83CD490315339B1D24B1C4726608531D, from HCP3_IONode
      pdu triggering PT_SOMEIPTestabilityReliable_Events_TestFieldComplexStruct_XIX_TCPServer_SomeIP_Testability_Info_El_UC: pdu=SOMEIPTestabilityReliable_Events_TestFieldComplexStruct, from HCP3_IONode
      pdu triggering PT_SOMEIPTestabilityReliable_MethodsGet_TestFieldUInt64_XIX_TCPServer_SomeIP_Testability_Info_El_TestSysIP_Request: pdu=SOMEIPTestabilityReliable_MethodsGet_TestFieldUInt64_Request_XIX_TCPServer_SomeIP_Testability_Info_El_TestSysIP_XIX_VLAN_Cockpit, to HCP3_IONode
      pdu triggering PT_SOMEIPTestabilityReliable_MethodsGet_TestFieldUInt64_XIX_TCPServer_SomeIP_Testability_Info_El_TestSysIP_Response: pdu=SOMEIPTestabilityReliable_MethodsGet_TestFieldUInt64_Response_XIX_TCPServer_SomeIP_Testability_8D4D4D29F496710EEE40DBDA8E8211EC, from HCP3_IONode
      pdu triggering PT_SOMEIPTestabilityReliable_Events_TestFieldUInt64_XIX_TCPServer_SomeIP_Testability_Info_El_UC: pdu=SOMEIPTestabilityReliable_Events_TestFieldUInt64, from HCP3_IONode
      pdu triggering PT_SOMEIPTestabilityReliable_MethodsGet_TestFieldUInt8_XIX_TCPServer_SomeIP_Testability_Info_El_TestSysIP_Request: pdu=SOMEIPTestabilityReliable_MethodsGet_TestFieldUInt8_Request_XIX_TCPServer_SomeIP_Testability_Info_El_TestSysIP_XIX_VLAN_Cockpit, to HCP3_IONode
      pdu triggering PT_SOMEIPTestabilityReliable_MethodsGet_TestFieldUInt8_XIX_TCPServer_SomeIP_Testability_Info_El_TestSysIP_Response: pdu=SOMEIPTestabilityReliable_MethodsGet_TestFieldUInt8_Response_XIX_TCPServer_SomeIP_Testability_Info_El_TestSysIP_XIX_VLAN_Cockpit, from HCP3_IONode
      pdu triggering PT_SOMEIPTestabilityReliable_MethodsSet_TestFieldUInt8_XIX_TCPServer_SomeIP_Testability_Info_El_TestSysIP_Request: pdu=SOMEIPTestabilityReliable_MethodsSet_TestFieldUInt8_Request_XIX_TCPServer_SomeIP_Testability_Info_El_TestSysIP_XIX_VLAN_Cockpit, to HCP3_IONode
      pdu triggering PT_SOMEIPTestabilityReliable_MethodsSet_TestFieldUInt8_XIX_TCPServer_SomeIP_Testability_Info_El_TestSysIP_Response: pdu=SOMEIPTestabilityReliable_MethodsSet_TestFieldUInt8_Response_XIX_TCPServer_SomeIP_Testability_Info_El_TestSysIP_XIX_VLAN_Cockpit, from HCP3_IONode
      pdu triggering PT_SOMEIPTestabilityReliable_Events_TestFieldUInt8_XIX_TCPServer_SomeIP_Testability_Info_El_UC: pdu=SOMEIPTestabilityReliable_Events_TestFieldUInt8, from HCP3_IONode
      pdu triggering PT_SOMEIPTestabilityReliable_Events_testEventUInt8_XIX_TCPServer_SomeIP_Testability_Info_El_UC: pdu=SOMEIPTestabilityReliable_Events_testEventUInt8, from HCP3_IONode
      pdu triggering PT_HCP1_07: pdu=HCP1_07_XIX_VLAN_Cockpit, to HCP3_IONode
      pdu triggering PT_OBD_03: pdu=OBD_03_XIX_VLAN_Cockpit, to HCP3_IONode
      pdu triggering PT_OBD_04: pdu=OBD_04_XIX_VLAN_Cockpit, to HCP3_IONode
      pdu triggering PT_ClimateControl_01: pdu=ClimateControl_01_XIX_VLAN_Cockpit, to HCP3_IONode
      pdu triggering PT_DS_HUD: pdu=DS_HUD_XIX_VLAN_Cockpit, from HCP3_IONode
      pdu triggering PT_DS_CID: pdu=DS_CID_XIX_VLAN_Cockpit, from HCP3_IONode
      pdu triggering PT_DS_WLC2: pdu=DS_WLC2_XIX_VLAN_Cockpit, from HCP3_IONode
      pdu triggering PT_DS_WLC1: pdu=DS_WLC1_XIX_VLAN_Cockpit, from HCP3_IONode
      pdu triggering PT_DS_PID: pdu=DS_PID_XIX_VLAN_Cockpit, from HCP3_IONode
      pdu triggering PT_DS_Info_El: pdu=DS_Info_El_XIX_VLAN_Cockpit, from HCP3_IONode
      pdu triggering PT_DS_CCF: pdu=DS_CCF_XIX_VLAN_Cockpit, from HCP3_IONode
      pdu triggering PT_Info_FID_01: pdu=Info_FID_01_XIX_VLAN_Cockpit, from HCP3_IONode
      pdu triggering PT_RadioFunc_01: pdu=RadioFunc_01_XIX_VLAN_Cockpit, from HCP3_IONode
      pdu triggering PT_Tank_01: pdu=Tank_01_XIX_VLAN_Cockpit, from HCP3_IONode
      pdu triggering PT_ZR_VA_Communication_Init_FID: pdu=ZR_VA_Communication_Init_FID_XIX_VLAN_Cockpit, from HCP3_IONode
      pdu triggering PT_ZR_VA_Challenge_FID: pdu=ZR_VA_Challenge_FID_XIX_VLAN_Cockpit, from HCP3_IONode
      pdu triggering PT_NFC_MiKo_01: pdu=NFC_MiKo_01_XIX_VLAN_Cockpit, from HCP3_IONode
      pdu triggering PT_ZR_VA_Communication_Init_Ack_FID: pdu=ZR_VA_Communication_Init_Ack_FID_XIX_VLAN_Cockpit, from HCP3_IONode
      pdu triggering PT_CID_01: pdu=CID_01_XIX_VLAN_Cockpit, from HCP3_IONode
      pdu triggering PT_ORU_Control_A_01_E2E: pdu=ORU_Control_A_01_XIX_VLAN_Cockpit_E2E, to HCP3_IONode
      pdu triggering PT_TCPServer_DoIP_Info_El_OBDC: pdu=TCPServer_DoIP_Info_El_OBDC_XIX_VLAN_Cockpit, from HCP3_IONode
      pdu triggering PT_FBS_MKGO_03: pdu=FBS_MKGO_03_XIX_VLAN_Cockpit, to HCP3_IONode
      pdu triggering PT_FBS_MKGO_01: pdu=FBS_MKGO_01_XIX_VLAN_Cockpit, to HCP3_IONode
      pdu triggering PT_FBS_MKGO_05: pdu=FBS_MKGO_05_XIX_VLAN_Cockpit, to HCP3_IONode
      pdu triggering PT_FBS_MKGO_04: pdu=FBS_MKGO_04_XIX_VLAN_Cockpit, to HCP3_IONode
      pdu triggering PT_FBS_MKGO_02: pdu=FBS_MKGO_02_XIX_VLAN_Cockpit, to HCP3_IONode
      pdu triggering PT_MKGO_FBS_04: pdu=MKGO_FBS_04_XIX_VLAN_Cockpit, from HCP3_IONode
      pdu triggering PT_MKGO_FBS_01: pdu=MKGO_FBS_01_XIX_VLAN_Cockpit, from HCP3_IONode
      pdu triggering PT_MKGO_FBS_03: pdu=MKGO_FBS_03_XIX_VLAN_Cockpit, from HCP3_IONode
      pdu triggering PT_MKGO_FBS_02: pdu=MKGO_FBS_02_XIX_VLAN_Cockpit, from HCP3_IONode
      pdu triggering PT_MKGO_FBS_05: pdu=MKGO_FBS_05_XIX_VLAN_Cockpit, from HCP3_IONode
      pdu triggering PT_DoorFunctions_FS_01: pdu=DoorFunctions_FS_01_XIX_VLAN_Cockpit, to HCP3_IONode
      pdu triggering PT_STH_01: pdu=STH_01_XIX_VLAN_Cockpit, to HCP3_IONode
      pdu triggering PT_DoorFunctions_HBFS_01: pdu=DoorFunctions_HBFS_01_XIX_VLAN_Cockpit, to HCP3_IONode
      pdu triggering PT_DoorFunctions_HFS_01: pdu=DoorFunctions_HFS_01_XIX_VLAN_Cockpit, to HCP3_IONode
      pdu triggering PT_CentralLocking_01: pdu=CentralLocking_01_XIX_VLAN_Cockpit, to HCP3_IONode
      pdu triggering PT_RLS_01: pdu=RLS_01_XIX_VLAN_Cockpit, to HCP3_IONode
      pdu triggering PT_ClampControl_01_E2E: pdu=ClampControl_01_XIX_VLAN_Cockpit_E2E, to HCP3_IONode
      pdu triggering PT_Dimmung_01: pdu=Dimmung_01_XIX_VLAN_Cockpit, to HCP3_IONode
      pdu triggering PT_DoorFunctions_BFS_01: pdu=DoorFunctions_BFS_01_XIX_VLAN_Cockpit, to HCP3_IONode
      pdu triggering PT_KeylessAccess_01: pdu=KeylessAccess_01_XIX_VLAN_Cockpit, to HCP3_IONode
      pdu triggering PT_MDK_02: pdu=MDK_02_XIX_VLAN_Cockpit, to HCP3_IONode
      pdu triggering PT_FID_01: pdu=FID_01_XIX_VLAN_Cockpit, to HCP3_IONode
      pdu triggering PT_ORU_Control_D_01_E2E: pdu=ORU_Control_D_01_XIX_VLAN_Cockpit_E2E, to HCP3_IONode
      pdu triggering PT_OTAMC_D_01_E2E: pdu=OTAMC_D_01_XIX_VLAN_Cockpit_E2E, to HCP3_IONode
      pdu triggering PT_WFS_02_SOK: pdu=WFS_02_SOK_XIX_VLAN_Cockpit, to HCP3_IONode
      pdu triggering PT_WFS_02: pdu=WFS_02_XIX_VLAN_Cockpit, to HCP3_IONode
      pdu triggering PT_ACA_02: pdu=ACA_02_XIX_VLAN_Cockpit, to HCP3_IONode
      pdu triggering PT_HWP_01_E2E: pdu=HWP_01_XIX_VLAN_Cockpit_E2E, to HCP3_IONode
      pdu triggering PT_IP_TS_Info_El_CTO_01: pdu=IP_TS_Info_El_CTO_01_XIX_VLAN_Cockpit, to HCP3_IONode
      pdu triggering PT_IP_TS_Info_El_DTO_{01..04}: pdu=IP_TS_Info_El_DTO_{01..04}_XIX_VLAN_Cockpit, to HCP3_IONode
      pdu triggering PT_FID_VA_Response: pdu=FID_VA_Response_XIX_VLAN_Cockpit, to HCP3_IONode
      pdu triggering PT_FID_VA_Communication_Init_Ack: pdu=FID_VA_Communication_Init_Ack_XIX_VLAN_Cockpit, to HCP3_IONode
      pdu triggering PT_Tankgeber_02: pdu=Tankgeber_02_XIX_VLAN_Cockpit, to HCP3_IONode
      pdu triggering PT_FID_VA_Communication_Init: pdu=FID_VA_Communication_Init_XIX_VLAN_Cockpit, to HCP3_IONode
      pdu triggering PT_RLSs_01: pdu=RLSs_01_XIX_VLAN_Cockpit, to HCP3_IONode
      pdu triggering PT_HWP_02: pdu=HWP_02_XIX_VLAN_Cockpit, to HCP3_IONode
      pdu triggering PT_TCPClient_DoIP_GW01_Info_El: pdu=TCPClient_DoIP_GW01_Info_El_XIX_VLAN_Cockpit, to HCP3_IONode
      pdu triggering PT_TCPServer_DoIP_Info_El_GW01: pdu=TCPServer_DoIP_Info_El_GW01_XIX_VLAN_Cockpit, from HCP3_IONode
      pdu triggering PT_TCPClient_DoIP_OBDC_Info_El: pdu=TCPClient_DoIP_OBDC_Info_El_XIX_VLAN_Cockpit, to HCP3_IONode
      pdu triggering PT_FoD_Info_El_Req_SOK: pdu=FoD_Info_El_Req_SOK_XIX_VLAN_Cockpit, to HCP3_IONode
      pdu triggering PT_FoD_Info_El_Req: pdu=FoD_Info_El_Req_XIX_VLAN_Cockpit, to HCP3_IONode
      pdu triggering PT_SOK_FoD_Info_El_Req_Challenge: pdu=SOK_FoD_Info_El_Req_Challenge_XIX_VLAN_Cockpit, to HCP3_IONode
      pdu triggering PT_FoD_Info_El_Resp_SOK: pdu=FoD_Info_El_Resp_SOK_XIX_VLAN_Cockpit, from HCP3_IONode
      pdu triggering PT_FoD_Info_El_Resp: pdu=FoD_Info_El_Resp_XIX_VLAN_Cockpit, from HCP3_IONode
      pdu triggering PT_SOK_FoD_Info_El_Resp_Challenge: pdu=SOK_FoD_Info_El_Resp_Challenge_XIX_VLAN_Cockpit, from HCP3_IONode
      pdu triggering PT_NVEM_12: pdu=NVEM_12_XIX_VLAN_Cockpit, to HCP3_IONode
      pdu triggering PT_Diagnose_01: pdu=Diagnose_01_XIX_VLAN_Cockpit, to HCP3_IONode
      pdu triggering PT_MFL_01: pdu=MFL_01_XIX_VLAN_Cockpit, to HCP3_IONode
      pdu triggering PT_MFL_Tasten_Konzern: pdu=MFL_Tasten_Konzern_XIX_VLAN_Cockpit, to HCP3_IONode
      pdu triggering PT_SOK_Zeit_Info_E_Chal_01: pdu=SOK_Zeit_Info_E_Chal_01_XIX_VLAN_Cockpit, from HCP3_IONode
      pdu triggering PT_SOK_Zeit_Info_El_Resp_01_SOK: pdu=SOK_Zeit_Info_El_Resp_01_SOK_XIX_VLAN_Cockpit, to HCP3_IONode
      pdu triggering PT_SOK_Zeit_Info_El_Resp_01: pdu=SOK_Zeit_Info_El_Resp_01_XIX_VLAN_Cockpit, to HCP3_IONode
      pdu triggering PT_SOK_NoAuthenticTime_01: pdu=SOK_NoAuthenticTime_01_XIX_VLAN_Cockpit, to HCP3_IONode
      pdu triggering PT_ORU_01: pdu=ORU_01_XIX_VLAN_Cockpit, to HCP3_IONode
      pdu triggering PT_VDSO_05_E2E: pdu=VDSO_05_XIX_VLAN_Cockpit_E2E, to HCP3_IONode
      pdu triggering PT_HCP1_02: pdu=HCP1_02_XIX_VLAN_Cockpit, to HCP3_IONode
      pdu triggering PT_VDSO_09: pdu=VDSO_09_XIX_VLAN_Cockpit, to HCP3_IONode
      pdu triggering PT_DTSO_01: pdu=DTSO_01_XIX_VLAN_Cockpit, to HCP3_IONode
      pdu triggering PT_WakeUpMonitorData_Methods_startCycle_XIX_TCPServer_SomeIP_01_Info_El_SGW03_Request: pdu=WakeUpMonitorData_Methods_startCycle_Request_XIX_TCPServer_SomeIP_01_Info_El_SGW03_XIX_VLAN_Cockpit, to HCP3_IONode
      pdu triggering PT_WakeUpMonitorData_Methods_startCycle_XIX_TCPServer_SomeIP_01_Info_El_SGW03_Response: pdu=WakeUpMonitorData_Methods_startCycle_Response_XIX_TCPServer_SomeIP_01_Info_El_SGW03_XIX_VLAN_Cockpit, from HCP3_IONode
      pdu triggering PT_WakeUpMonitorData_Methods_getTable_XIX_TCPServer_SomeIP_01_Info_El_SGW03_Request: pdu=WakeUpMonitorData_Methods_getTable_Request_XIX_TCPServer_SomeIP_01_Info_El_SGW03_XIX_VLAN_Cockpit, to HCP3_IONode
      pdu triggering PT_WakeUpMonitorData_Methods_getTable_XIX_TCPServer_SomeIP_01_Info_El_SGW03_Response: pdu=WakeUpMonitorData_Methods_getTable_Response_XIX_TCPServer_SomeIP_01_Info_El_SGW03_XIX_VLAN_Cockpit, from HCP3_IONode
      pdu triggering PT_WakeUpMonitorData_RnRMethods_configuration_XIX_TCPServer_SomeIP_01_Info_El_SGW03: pdu=WakeUpMonitorData_RnRMethods_configuration_XIX_TCPServer_SomeIP_01_Info_El_SGW03_XIX_VLAN_Cockpit, to HCP3_IONode
      pdu triggering PT_IdsCanSensor_Methods_undefineCanSensorFeaturesElement0_XIX_TCPServer_SomeIP_01_Info_El_SGW03_Request: pdu=IdsCanSensor_Methods_undefineCanSensorFeaturesElement0_Request_XIX_TCPServer_SomeIP_01_Info_El_SGW03_XIX_VLAN_Cockpit, to HCP3_IONode
      pdu triggering PT_IdsCanSensor_Methods_undefineCanSensorFeaturesElement0_XIX_TCPServer_SomeIP_01_Info_El_SGW03_Response: pdu=IdsCanSensor_Methods_undefineCanSensorFeaturesElement0_Response_XIX_TCPServer_SomeIP_01_Info_El_SGW03_XIX_VLAN_Cockpit, from HCP3_IONode
      pdu triggering PT_IdsCanSensor_Methods_setCanSensorFeaturesElement0_XIX_TCPServer_SomeIP_01_Info_El_SGW03_Request: pdu=IdsCanSensor_Methods_setCanSensorFeaturesElement0_Request_XIX_TCPServer_SomeIP_01_Info_El_SGW03_XIX_VLAN_Cockpit, to HCP3_IONode
      pdu triggering PT_IdsCanSensor_Methods_setCanSensorFeaturesElement0_XIX_TCPServer_SomeIP_01_Info_El_SGW03_Response: pdu=IdsCanSensor_Methods_setCanSensorFeaturesElement0_Response_XIX_TCPServer_SomeIP_01_Info_El_SGW03_XIX_VLAN_Cockpit, from HCP3_IONode
      pdu triggering PT_IdsCanSensor_MethodsGet_canSensorFeaturesElement0_XIX_TCPServer_SomeIP_01_Info_El_SGW03_Request: pdu=IdsCanSensor_MethodsGet_canSensorFeaturesElement0_Request_XIX_TCPServer_SomeIP_01_Info_El_SGW03_XIX_VLAN_Cockpit, to HCP3_IONode
      pdu triggering PT_IdsCanSensor_MethodsGet_canSensorFeaturesElement0_XIX_TCPServer_SomeIP_01_Info_El_SGW03_Response: pdu=IdsCanSensor_MethodsGet_canSensorFeaturesElement0_Response_XIX_TCPServer_SomeIP_01_Info_El_SGW03_XIX_VLAN_Cockpit, from HCP3_IONode
      pdu triggering PT_IdsCanSensor_Events_canSensorFeaturesElement0_XIX_TCPServer_SomeIP_01_Info_El_UC: pdu=IdsCanSensor_Events_canSensorFeaturesElement0, from HCP3_IONode
      pdu triggering PT_IdsCanSensor_MethodsGet_periodicSignalElement0_XIX_TCPServer_SomeIP_01_Info_El_SGW03_Request: pdu=IdsCanSensor_MethodsGet_periodicSignalElement0_Request_XIX_TCPServer_SomeIP_01_Info_El_SGW03_XIX_VLAN_Cockpit, to HCP3_IONode
      pdu triggering PT_IdsCanSensor_MethodsGet_periodicSignalElement0_XIX_TCPServer_SomeIP_01_Info_El_SGW03_Response: pdu=IdsCanSensor_MethodsGet_periodicSignalElement0_Response_XIX_TCPServer_SomeIP_01_Info_El_SGW03_XIX_VLAN_Cockpit, from HCP3_IONode
      pdu triggering PT_IdsCanSensor_Events_periodicSignalElement0_XIX_TCPServer_SomeIP_01_Info_El_UC: pdu=IdsCanSensor_Events_periodicSignalElement0, from HCP3_IONode
      pdu triggering PT_KN_HCP3Sys03: pdu=KN_HCP3Sys03_XIX_VLAN_Cockpit, to HCP3_IONode
      pdu triggering PT_TCPServer_IP_TS_Info_El_DTO_01: pdu=TCPServer_IP_TS_Info_El_DTO_01_XIX_VLAN_Cockpit, from HCP3_IONode
      pdu triggering PT_TCPServer_IP_TS_Info_El_DTO_04: pdu=TCPServer_IP_TS_Info_El_DTO_04_XIX_VLAN_Cockpit, from HCP3_IONode
      pdu triggering PT_TCPServer_IP_TS_Info_El_DTO_03: pdu=TCPServer_IP_TS_Info_El_DTO_03_XIX_VLAN_Cockpit, from HCP3_IONode
      pdu triggering PT_TCPServer_IP_TS_Info_El_DTO_02: pdu=TCPServer_IP_TS_Info_El_DTO_02_XIX_VLAN_Cockpit, from HCP3_IONode
      pdu triggering PT_IDSSecurityEventSmall_Events_securityEvent_XIX_SomeIP_ServiceProvider_01_Info_El_UC: pdu=IDSSecurityEventSmall_Events_securityEvent, from HCP3_IONode
      pdu triggering PT_TCPServer_SSOA_Info_El_Gateway: pdu=TCPServer_SSOA_Info_El_Gateway, from HCP3_IONode
      pdu triggering PT_TCPClient_SSOA_Gateway_Info_El: pdu=TCPClient_SSOA_Gateway_Info_El, to HCP3_IONode
      pdu triggering PT_TCPServer_SSOA_Info_El_SGW03: pdu=TCPServer_SSOA_Info_El_SGW03, from HCP3_IONode
      pdu triggering PT_TCPClient_SSOA_SGW03_Info_El: pdu=TCPClient_SSOA_SGW03_Info_El, to HCP3_IONode
      pdu triggering PT_SSOA_Info_El_Multicast: pdu=SSOA_Info_El_Multicast, from HCP3_IONode
      pdu triggering PT_DoIP_Gateway_MC: pdu=DoIP_Gateway_MC_XIX_VLAN_Cockpit, to HCP3_IONode
      41 x network endpoint:
        NE_fd53_7cb8_0383_0002_0000_0000_0000_010f: network-endpoint-addresses=ipv-6-configuration={default-router=fd53:7cb8:0383:000e:0000:0000:0000:fc10, ip-address-prefix-length=64, ipv-6-address=fd53:7cb8:0383:0002:0000:0000:0000:010f, ipv-6-address-source=FIXED}
        NE_ff14_0000_0000_0000_0000_0000_0000_0061: network-endpoint-addresses=ipv-6-configuration={ipv-6-address=ff14:0000:0000:0000:0000:0000:0000:0061, ipv-6-address-source=FIXED}
        NE_fd53_7cb8_0383_0004_0000_0000_0001_01e5: network-endpoint-addresses=ipv-6-configuration={default-router=fd53:7cb8:0383:000e:0000:0000:0000:fc10, ip-address-prefix-length=64, ipv-6-address=fd53:7cb8:0383:0004:0000:0000:0001:01e5, ipv-6-address-source=FIXED}
        NE_fd53_7cb8_0383_000e_0000_0000_0000_0108: network-endpoint-addresses=ipv-6-configuration={default-router=fd53:7cb8:0383:000e:0000:0000:0000:fc10, ip-address-prefix-length=64, ipv-6-address=fd53:7cb8:0383:000e:0000:0000:0000:0108, ipv-6-address-source=FIXED}
        NE_fd53_7cb8_0383_0004_0000_0000_0000_0107: network-endpoint-addresses=ipv-6-configuration={default-router=fd53:7cb8:0383:000e:0000:0000:0000:fc10, ip-address-prefix-length=64, ipv-6-address=fd53:7cb8:0383:0004:0000:0000:0000:0107, ipv-6-address-source=FIXED}
        NE_fd53_7cb8_0383_000e_0000_0000_0000_0073: infrastructure-services=do-ip-entity=do-ip-entity-role=GATEWAY, network-endpoint-addresses=ipv-6-configuration={default-router=fd53:7cb8:0383:000e:0000:0000:0000:fc10, ip-address-prefix-length=64, ipv-6-address=fd53:7cb8:0383:000e:0000:0000:0000:0073, ipv-6-address-source=FIXED}
        NE_ff02_0000_0000_0000_0000_0000_0000_0001: network-endpoint-addresses=ipv-6-configuration={ipv-6-address=ff02:0000:0000:0000:0000:0000:0000:0001, ipv-6-address-source=FIXED}
        NE_ff14_0000_0000_0000_0000_0000_0000_0005: network-endpoint-addresses=ipv-6-configuration={ipv-6-address=ff14:0000:0000:0000:0000:0000:0000:0005, ipv-6-address-source=FIXED}
        NE_fd53_7cb8_0383_0005_0000_0000_0000_000e: network-endpoint-addresses=ipv-6-configuration={default-router=fd53:7cb8:0383:000e:0000:0000:0000:fc10, ip-address-prefix-length=64, ipv-6-address=fd53:7cb8:0383:0005:0000:0000:0000:000e, ipv-6-address-source=FIXED}
        NE_fd53_7cb8_0383_000e_0000_0000_0000_006f: network-endpoint-addresses=ipv-6-configuration={default-router=fd53:7cb8:0383:000e:0000:0000:0000:fc10, ip-address-prefix-length=64, ipv-6-address=fd53:7cb8:0383:000e:0000:0000:0000:006f, ipv-6-address-source=FIXED}
        NE_fd53_7cb8_0383_0005_0000_0000_0000_0010: network-endpoint-addresses=ipv-6-configuration={default-router=fd53:7cb8:0383:000e:0000:0000:0000:fc10, ip-address-prefix-length=64, ipv-6-address=fd53:7cb8:0383:0005:0000:0000:0000:0010, ipv-6-address-source=FIXED}
        NE_fd53_7cb8_0383_0005_0000_0000_0001_01e6: network-endpoint-addresses=ipv-6-configuration={default-router=fd53:7cb8:0383:000e:0000:0000:0000:fc10, ip-address-prefix-length=64, ipv-6-address=fd53:7cb8:0383:0005:0000:0000:0001:01e6, ipv-6-address-source=FIXED}
        NE_fd53_7cb8_0383_000e_0000_0000_0000_03aa: network-endpoint-addresses=ipv-6-configuration={default-router=fd53:7cb8:0383:000e:0000:0000:0000:fc10, ip-address-prefix-length=64, ipv-6-address=fd53:7cb8:0383:000e:0000:0000:0000:03aa, ipv-6-address-source=FIXED}
        NE_ff14_0000_0000_0000_0000_0000_0000_0062: network-endpoint-addresses=ipv-6-configuration={ipv-6-address=ff14:0000:0000:0000:0000:0000:0000:0062, ipv-6-address-source=FIXED}
        NE_fd53_7cb8_0383_0005_0000_0000_0000_0114: network-endpoint-addresses=ipv-6-configuration={default-router=fd53:7cb8:0383:000e:0000:0000:0000:fc10, ip-address-prefix-length=64, ipv-6-address=fd53:7cb8:0383:0005:0000:0000:0000:0114, ipv-6-address-source=FIXED}
        NE_ff14_0000_0000_0000_0000_0000_0000_003f: network-endpoint-addresses=ipv-6-configuration={ipv-6-address=ff14:0000:0000:0000:0000:0000:0000:003f, ipv-6-address-source=FIXED}
        NE_ff14_0000_0000_0000_0000_0000_0000_0067: network-endpoint-addresses=ipv-6-configuration={ipv-6-address=ff14:0000:0000:0000:0000:0000:0000:0067, ipv-6-address-source=FIXED}
        NE_ff14_0000_0000_0000_0000_0000_0000_0001: network-endpoint-addresses=ipv-6-configuration={ipv-6-address=ff14:0000:0000:0000:0000:0000:0000:0001, ipv-6-address-source=FIXED}
        NE_ff14_0000_0000_0000_0000_0000_0000_004b: network-endpoint-addresses=ipv-6-configuration={ipv-6-address=ff14:0000:0000:0000:0000:0000:0000:004b, ipv-6-address-source=FIXED}
        NE_ff14_0000_0000_0000_0000_0000_0000_0051: network-endpoint-addresses=ipv-6-configuration={ipv-6-address=ff14:0000:0000:0000:0000:0000:0000:0051, ipv-6-address-source=FIXED}
        NE_ff14_0000_0000_0000_0000_0000_0000_0052: network-endpoint-addresses=ipv-6-configuration={ipv-6-address=ff14:0000:0000:0000:0000:0000:0000:0052, ipv-6-address-source=FIXED}
        NE_ff14_0000_0000_0000_0000_0000_0000_003a: network-endpoint-addresses=ipv-6-configuration={ipv-6-address=ff14:0000:0000:0000:0000:0000:0000:003a, ipv-6-address-source=FIXED}
        NE_ff14_0000_0000_0000_0000_0000_0000_0063: network-endpoint-addresses=ipv-6-configuration={ipv-6-address=ff14:0000:0000:0000:0000:0000:0000:0063, ipv-6-address-source=FIXED}
        NE_fd53_7cb8_0383_0002_0000_0000_0001_0117: network-endpoint-addresses=ipv-6-configuration={default-router=fd53:7cb8:0383:000e:0000:0000:0000:fc10, ip-address-prefix-length=64, ipv-6-address=fd53:7cb8:0383:0002:0000:0000:0001:0117, ipv-6-address-source=FIXED}
        NE_ff14_0000_0000_0000_0000_0000_0000_002c: network-endpoint-addresses=ipv-6-configuration={ipv-6-address=ff14:0000:0000:0000:0000:0000:0000:002c, ipv-6-address-source=FIXED}
        NE_ff14_0000_0000_0000_0000_0000_0000_0064: network-endpoint-addresses=ipv-6-configuration={ipv-6-address=ff14:0000:0000:0000:0000:0000:0000:0064, ipv-6-address-source=FIXED}
        NE_fd53_7cb8_0383_0002_0000_0000_0000_00b3: network-endpoint-addresses=ipv-6-configuration={default-router=fd53:7cb8:0383:000e:0000:0000:0000:fc10, ip-address-prefix-length=64, ipv-6-address=fd53:7cb8:0383:0002:0000:0000:0000:00b3, ipv-6-address-source=FIXED}
        NE_ff14_0000_0000_0000_0000_0000_0000_0065: network-endpoint-addresses=ipv-6-configuration={ipv-6-address=ff14:0000:0000:0000:0000:0000:0000:0065, ipv-6-address-source=FIXED}
        NE_ff14_0000_0000_0000_0000_0000_0000_0069: network-endpoint-addresses=ipv-6-configuration={ipv-6-address=ff14:0000:0000:0000:0000:0000:0000:0069, ipv-6-address-source=FIXED}
        NE_fd53_7cb8_0383_0002_0000_0000_0001_01e4: network-endpoint-addresses=ipv-6-configuration={default-router=fd53:7cb8:0383:000e:0000:0000:0000:fc10, ip-address-prefix-length=64, ipv-6-address=fd53:7cb8:0383:0002:0000:0000:0001:01e4, ipv-6-address-source=FIXED}
        NE_ff14_0000_0000_0000_0000_0000_0000_006f: network-endpoint-addresses=ipv-6-configuration={ipv-6-address=ff14:0000:0000:0000:0000:0000:0000:006f, ipv-6-address-source=FIXED}
        NE_ff14_0000_0000_0000_0000_0000_0000_004a: network-endpoint-addresses=ipv-6-configuration={ipv-6-address=ff14:0000:0000:0000:0000:0000:0000:004a, ipv-6-address-source=FIXED}
        NE_ff14_0000_0000_0000_0000_0000_0000_004c: network-endpoint-addresses=ipv-6-configuration={ipv-6-address=ff14:0000:0000:0000:0000:0000:0000:004c, ipv-6-address-source=FIXED}
        NE_ff14_0000_0000_0000_0000_0000_0000_003b: network-endpoint-addresses=ipv-6-configuration={ipv-6-address=ff14:0000:0000:0000:0000:0000:0000:003b, ipv-6-address-source=FIXED}
        NE_ff14_0000_0000_0000_0000_0000_0000_0071: network-endpoint-addresses=ipv-6-configuration={ipv-6-address=ff14:0000:0000:0000:0000:0000:0000:0071, ipv-6-address-source=FIXED}
        NE_ff14_0000_0000_0000_0000_0000_0000_0055: network-endpoint-addresses=ipv-6-configuration={ipv-6-address=ff14:0000:0000:0000:0000:0000:0000:0055, ipv-6-address-source=FIXED}
        NE_ff14_0000_0000_0000_0000_0000_0000_007f: network-endpoint-addresses=ipv-6-configuration={ipv-6-address=ff14:0000:0000:0000:0000:0000:0000:007f, ipv-6-address-source=FIXED}
        NE_fd53_7cb8_0383_0003_0000_0000_0000_0130: network-endpoint-addresses=ipv-6-configuration={default-router=fd53:7cb8:0383:000e:0000:0000:0000:fc10, ip-address-prefix-length=64, ipv-6-address=fd53:7cb8:0383:0003:0000:0000:0000:0130, ipv-6-address-source=FIXED}
        NE_SDANY: network-endpoint-addresses=ipv-6-configuration={ip-address-prefix-length=64, ipv-6-address=ANY}
        NE_SDMulticast: network-endpoint-addresses=ipv-6-configuration={ipv-6-address=ff14:0000:0000:0000:0000:0000:0004:0000, ipv-6-address-source=FIXED}
        NE_SSOAMulticast: network-endpoint-addresses=ipv-6-configuration={ipv-6-address=ff14:0000:0000:0000:0000:0000:0005:0000, ipv-6-address-source=FIXED}
      so-ad-config:
        30 x socket connection bundle:
          SCB_SA_Tx_fd53_7cb8_0383_0002_0000_0000_0000_010f_42994_UDP_4: server-port=SA_Tx_fd53_7cb8_0383_0002_0000_0000_0000_010f_42994_UDP_4
            bundled-connections:
              {client-ip-addr-from-connection-request=false, client-port-from-connection-request=false, client-port=SA_Rx_ff14_0000_0000_0000_0000_0000_0000_0061_42557_UDP_4, pdus=socket-connection-ipdu-identifier={header-id=1029, pdu-collection-semantics=QUEUED, pdu-collection-trigger=NEVER, pdu-triggering=PT_VKM_04}, pdu-collection-timeout=0.005, runtime-ip-address-configuration=NONE, runtime-port-configuration=NONE, short-label=SC_SK_HCP1_01}
              {client-ip-addr-from-connection-request=false, client-port-from-connection-request=false, client-port=SA_Rx_ff14_0000_0000_0000_0000_0000_0000_0062_42557_UDP_4, pdus=[{header-id=813, pdu-collection-semantics=QUEUED, pdu-collection-trigger=NEVER, pdu-triggering=PT_HCP1_07}, {header-id=914, pdu-collection-semantics=QUEUED, pdu-collection-trigger=NEVER, pdu-triggering=VLAN_Cockpit/PT_OBD_03}, {header-id=1102, pdu-collection-semantics=QUEUED, pdu-collection-trigger=NEVER, pdu-triggering=VLAN_Cockpit/PT_OBD_04}], pdu-collection-timeout=0.005, runtime-ip-address-configuration=NONE, runtime-port-configuration=NONE, short-label=SC_SK_HCP1_02}
              {client-ip-addr-from-connection-request=false, client-port-from-connection-request=false, client-port=SA_Rx_ff14_0000_0000_0000_0000_0000_0000_0063_42557_UDP_4, pdus=[{header-id=1469, pdu-collection-semantics=QUEUED, pdu-collection-trigger=NEVER, pdu-triggering=PT_ORU_Control_D_01_E2E}, {header-id=1471, pdu-collection-semantics=QUEUED, pdu-collection-trigger=NEVER, pdu-triggering=PT_OTAMC_D_01_E2E}], pdu-collection-timeout=0.005, runtime-ip-address-configuration=NONE, runtime-port-configuration=NONE, short-label=SC_SK_HCP1_03}
              {client-ip-addr-from-connection-request=false, client-port-from-connection-request=false, client-port=SA_Rx_ff14_0000_0000_0000_0000_0000_0000_007f_42557_UDP_4, pdus=[{header-id=1558, pdu-collection-semantics=QUEUED, pdu-collection-trigger=NEVER, pdu-triggering=PT_DTSO_01}, {header-id=566, pdu-collection-semantics=QUEUED, pdu-collection-trigger=NEVER, pdu-triggering=PT_HCP1_02}, {header-id=1046, pdu-collection-semantics=QUEUED, pdu-collection-trigger=NEVER, pdu-triggering=PT_VDSO_05_E2E}, {header-id=1456, pdu-collection-semantics=QUEUED, pdu-collection-trigger=NEVER, pdu-triggering=VLAN_Cockpit/PT_VDSO_09}], pdu-collection-timeout=0.003, runtime-ip-address-configuration=NONE, runtime-port-configuration=NONE, short-label=SC_SK_HCP1_04}
          SCB_SA_Tx_fd53_7cb8_0383_000e_0000_0000_0000_006f_42994_UDP_4: socket-connection{client-ip-addr-from-connection-request=false, client-port-from-connection-request=false, client-port=SA_Rx_ff14_0000_0000_0000_0000_0000_0000_0005_42557_UDP_4, pdus=socket-connection-ipdu-identifier={header-id=1349454848, pdu-collection-semantics=QUEUED, pdu-collection-trigger=ALWAYS, pdu-triggering=VLAN_Cockpit/PT_KN_AMP}, runtime-ip-address-configuration=NONE, runtime-port-configuration=NONE, short-label=SC_Architekturinfos_AMP_01}, server-port=SA_Tx_fd53_7cb8_0383_000e_0000_0000_0000_006f_42994_UDP_4
          SCB_SA_Rx_fd53_7cb8_0383_000e_0000_0000_0000_0073_13400_UDP_0: server-port=SA_Rx_fd53_7cb8_0383_000e_0000_0000_0000_0073_13400_UDP_0
            bundled-connections:
              {client-ip-addr-from-connection-request=false, client-port-from-connection-request=true, client-port=SA_Tx_fd53_7cb8_0383_0004_0000_0000_0000_0107_dynamic_UDP_0, pdus=[{pdu-collection-semantics=QUEUED, pdu-collection-trigger=ALWAYS, pdu-triggering=PT_DoIP_Info_El_Gateway_UC}, {pdu-collection-semantics=QUEUED, pdu-collection-trigger=ALWAYS, pdu-triggering=PT_DoIP_Gateway_Info_El_UC}], runtime-ip-address-configuration=NONE, runtime-port-configuration=NONE, short-label=SC_DoIP_Info_El_Gateway_UC_HCP5_P6_MOD}
              {client-ip-addr-from-connection-request=false, client-port-from-connection-request=false, client-port=SA_Tx_ff02_0000_0000_0000_0000_0000_0000_0001_13400_UDP_0, pdus=socket-connection-ipdu-identifier={pdu-collection-semantics=QUEUED, pdu-collection-trigger=ALWAYS, pdu-triggering=PT_DoIP_Info_El_MC}, runtime-ip-address-configuration=NONE, runtime-port-configuration=NONE, short-label=SC_DoIP_Info_El_MC}
          SCB_SA_Tx_fd53_7cb8_0383_000e_0000_0000_0000_0073_13400_TCP_0: server-port=SA_Tx_fd53_7cb8_0383_000e_0000_0000_0000_0073_13400_TCP_0
            bundled-connections:
              {client-ip-addr-from-connection-request=false, client-port-from-connection-request=true, client-port=SA_Rx_fd53_7cb8_0383_0004_0000_0000_0000_0107_dynamic_TCP_0, pdus=[{pdu-collection-semantics=QUEUED, pdu-collection-trigger=ALWAYS, pdu-triggering=PT_TCPServer_DoIP_Info_El_GW}, {pdu-collection-semantics=QUEUED, pdu-collection-trigger=ALWAYS, pdu-triggering=PT_TCPClient_DoIP_GW_Info_El}], runtime-ip-address-configuration=NONE, runtime-port-configuration=NONE, short-label=SC_TCPServer_DoIP_Info_El_GW_HCP5_P6_MOD}
              {client-ip-addr-from-connection-request=false, client-port-from-connection-request=true, client-port=SA_Rx_fd53_7cb8_0383_0004_0000_0000_0000_0107_dynamic_TCP_0, pdus=[{pdu-collection-semantics=QUEUED, pdu-collection-trigger=ALWAYS, pdu-triggering=PT_TCPServer_DoIP_Info_El_OBDC}, {pdu-collection-semantics=QUEUED, pdu-collection-trigger=NEVER, pdu-triggering=PT_TCPClient_DoIP_OBDC_Info_El}], runtime-ip-address-configuration=NONE, runtime-port-configuration=NONE, short-label=SC_TCPServer_DoIP_Info_El_OBDC_HCP5_P6_MOD}
              {client-ip-addr-from-connection-request=false, client-port-from-connection-request=true, client-port=SA_Rx_fd53_7cb8_0383_0004_0000_0000_0000_0107_dynamic_TCP_0, pdus=[{pdu-collection-semantics=QUEUED, pdu-collection-trigger=ALWAYS, pdu-triggering=PT_TCPServer_DoIP_Info_El_GW01}, {pdu-collection-semantics=QUEUED, pdu-collection-trigger=ALWAYS, pdu-triggering=PT_TCPClient_DoIP_GW01_Info_El}], runtime-ip-address-configuration=NONE, runtime-port-configuration=NONE, short-label=SC_TCPServer_DoIP_Info_El_GW01_HCP5_P6_MOD}
          SCB_SA_Tx_fd53_7cb8_0383_000e_0000_0000_0000_0073_42994_UDP_4: server-port=SA_Tx_fd53_7cb8_0383_000e_0000_0000_0000_0073_42994_UDP_4
            bundled-connections:
              {client-ip-addr-from-connection-request=false, client-port-from-connection-request=false, client-port=SA_Rx_ff14_0000_0000_0000_0000_0000_0000_0005_42557_UDP_4_XIX_SCB_SA_Tx_fd53_7cb8_0383_000e_0000_0000_0000_0073_42994_UDP_4, pdus=socket-connection-ipdu-identifier={header-id=1349716992, pdu-collection-semantics=QUEUED, pdu-collection-trigger=ALWAYS, pdu-triggering=VLAN_Cockpit/PT_KN_Info_El}, pdu-collection-max-buffer-size=1452, runtime-ip-address-configuration=NONE, runtime-port-configuration=NONE, short-label=SC_Architekturinfos_Info_El_01}
              {client-ip-addr-from-connection-request=false, client-port-from-connection-request=false, client-port=SA_Rx_ff14_0000_0000_0000_0000_0000_0000_0067_42557_UDP_4, pdus=[{header-id=2435055616, pdu-collection-semantics=QUEUED, pdu-collection-trigger=NEVER, pdu-triggering=VLAN_Cockpit/PT_DS_CCF}, {header-id=2434924544, pdu-collection-semantics=QUEUED, pdu-collection-trigger=NEVER, pdu-triggering=VLAN_Cockpit/PT_DS_CID}, {header-id=2417688576, pdu-collection-semantics=QUEUED, pdu-collection-trigger=NEVER, pdu-triggering=VLAN_Cockpit/PT_DS_HUD}, {header-id=2423455744, pdu-collection-semantics=QUEUED, pdu-collection-trigger=NEVER, pdu-triggering=PT_DS_Info_El}, {header-id=2434990080, pdu-collection-semantics=QUEUED, pdu-collection-trigger=NEVER, pdu-triggering=VLAN_Cockpit/PT_DS_PID}, {header-id=2426732544, pdu-collection-semantics=QUEUED, pdu-collection-trigger=NEVER, pdu-triggering=VLAN_Cockpit/PT_DS_WLC1}, {header-id=2426798080, pdu-collection-semantics=QUEUED, pdu-collection-trigger=NEVER, pdu-triggering=VLAN_Cockpit/PT_DS_WLC2}], pdu-collection-max-buffer-size=1452, pdu-collection-timeout=0.06, runtime-ip-address-configuration=NONE, runtime-port-configuration=NONE, short-label=SC_SK_DS_Info_El}
              {client-ip-addr-from-connection-request=false, client-port-from-connection-request=false, client-port=SA_Rx_ff14_0000_0000_0000_0000_0000_0000_0001_42557_UDP_4, pdus=[{header-id=947, pdu-collection-semantics=QUEUED, pdu-collection-trigger=NEVER, pdu-triggering=PT_Tank_01}, {header-id=1501, pdu-collection-semantics=QUEUED, pdu-collection-trigger=NEVER, pdu-triggering=VLAN_Cockpit/PT_CID_01}, {header-id=913, pdu-collection-semantics=QUEUED, pdu-collection-trigger=NEVER, pdu-triggering=PT_Info_FID_01}, {header-id=928, pdu-collection-semantics=QUEUED, pdu-collection-trigger=NEVER, pdu-triggering=VLAN_Cockpit/PT_NFC_MiKo_01}, {header-id=921, pdu-collection-semantics=QUEUED, pdu-collection-trigger=NEVER, pdu-triggering=VLAN_Cockpit/PT_RadioFunc_01}, {header-id=1244, pdu-collection-semantics=QUEUED, pdu-collection-trigger=NEVER, pdu-triggering=PT_ZR_VA_Challenge_FID}, {header-id=1416, pdu-collection-semantics=QUEUED, pdu-collection-trigger=NEVER, pdu-triggering=PT_ZR_VA_Communication_Init_Ack_FID}, {header-id=1245, pdu-collection-semantics=QUEUED, pdu-collection-trigger=NEVER, pdu-triggering=PT_ZR_VA_Communication_Init_FID}], pdu-collection-max-buffer-size=1452, pdu-collection-timeout=0.005, runtime-ip-address-configuration=NONE, runtime-port-configuration=NONE, short-label=SC_SK_Info_El_01}
              {client-ip-addr-from-connection-request=false, client-port-from-connection-request=false, client-port=SA_Rx_ff14_0000_0000_0000_0000_0000_0000_0052_42557_UDP_4, pdus=[{header-id=995, pdu-collection-semantics=QUEUED, pdu-collection-trigger=ALWAYS, pdu-triggering=VLAN_Cockpit/PT_MKGO_FBS_01}, {header-id=996, pdu-collection-semantics=QUEUED, pdu-collection-trigger=ALWAYS, pdu-triggering=VLAN_Cockpit/PT_MKGO_FBS_02}, {header-id=997, pdu-collection-semantics=QUEUED, pdu-collection-trigger=ALWAYS, pdu-triggering=VLAN_Cockpit/PT_MKGO_FBS_03}, {header-id=998, pdu-collection-semantics=QUEUED, pdu-collection-trigger=ALWAYS, pdu-triggering=VLAN_Cockpit/PT_MKGO_FBS_04}, {header-id=999, pdu-collection-semantics=QUEUED, pdu-collection-trigger=ALWAYS, pdu-triggering=VLAN_Cockpit/PT_MKGO_FBS_05}], pdu-collection-max-buffer-size=1452, runtime-ip-address-configuration=NONE, runtime-port-configuration=NONE, short-label=SC_SK_MKGO_FBS}
              {client-ip-addr-from-connection-request=false, client-port-from-connection-request=false, client-port=SA_Rx_fd53_7cb8_0383_0005_0000_0000_0000_0010_42557_UDP_4, pdus=[{header-id=1142, pdu-collection-semantics=QUEUED, pdu-collection-trigger=ALWAYS, pdu-triggering=PT_FoD_Info_El_Resp_SOK}, {header-id=1144, pdu-collection-semantics=QUEUED, pdu-collection-trigger=ALWAYS, pdu-triggering=PT_SOK_FoD_Info_El_Resp_Challenge}], pdu-collection-max-buffer-size=1452, runtime-ip-address-configuration=NONE, runtime-port-configuration=NONE, short-label=SC_SK_FoD_Info_El_Gateway_HCP5_P10_ETHRouter}
              {client-ip-addr-from-connection-request=false, client-port-from-connection-request=false, client-port=SA_Rx_fd53_7cb8_0383_0005_0000_0000_0000_0010_42559_UDP_4, pdus=socket-connection-ipdu-identifier={header-id=1879048307, pdu-collection-semantics=QUEUED, pdu-collection-trigger=ALWAYS, pdu-triggering=PT_SOK_Zeit_Info_E_Chal_01}, pdu-collection-max-buffer-size=1452, runtime-ip-address-configuration=NONE, runtime-port-configuration=NONE, short-label=SC_SK_SOK_Info_El_Gateway_HCP5_P10_ETHRouter}
          SCB_SA_Tx_fd53_7cb8_0383_0005_0000_0000_0000_0010_42810_UDP_3: socket-connection{client-ip-addr-from-connection-request=false, client-port-from-connection-request=false, client-port=SA_Rx_fd53_7cb8_0383_000e_0000_0000_0000_0073_42991_UDP_3, pdus=[{header-id=1643659275, pdu-collection-semantics=QUEUED, pdu-collection-trigger=ALWAYS, pdu-triggering=PT_WakeupclusterConfiguration_Methods_setConfigurationsElement_XIX_SomeIP_ServiceProvider_01_Gateway_Info_El_01_UC_Request, routing-group=SoAdRG_WakeupclusterConfiguration_Instance1_Methods}, {header-id=1643659275, pdu-collection-semantics=QUEUED, pdu-collection-trigger=ALWAYS, pdu-triggering=PT_WakeupclusterConfiguration_Methods_setConfigurationsElement_XIX_SomeIP_ServiceProvider_01_Gateway_Info_El_01_UC_Response, routing-group=SoAdRG_WakeupclusterConfiguration_Instance1_Methods}, {header-id=1643659274, pdu-collection-semantics=QUEUED, pdu-collection-trigger=ALWAYS, pdu-triggering=PT_WakeupclusterConfiguration_Methods_createConfigurationsElement_XIX_SomeIP_ServiceProvider_01_Gateway_Info_El_01_UC_Request, routing-group=SoAdRG_WakeupclusterConfiguration_Instance1_Methods}, {header-id=1643659271, pdu-collection-semantics=QUEUED, pdu-collection-trigger=ALWAYS, pdu-triggering=PT_WakeupclusterConfiguration_Methods_getConfigurationsElements_XIX_SomeIP_ServiceProvider_01_Gateway_Info_El_01_UC_Response, routing-group=SoAdRG_WakeupclusterConfiguration_Instance1_Methods}, {header-id=1643659265, pdu-collection-semantics=QUEUED, pdu-collection-trigger=ALWAYS, pdu-triggering=PT_WakeupclusterConfiguration_Methods_getConfigurationsElementByKey_XIX_SomeIP_ServiceProvider_01_Gateway_Info_El_01_UC_Response, routing-group=SoAdRG_WakeupclusterConfiguration_Instance1_Methods}, {header-id=1643659274, pdu-collection-semantics=QUEUED, pdu-collection-trigger=ALWAYS, pdu-triggering=PT_WakeupclusterConfiguration_Methods_createConfigurationsElement_XIX_SomeIP_ServiceProvider_01_Gateway_Info_El_01_UC_Response, routing-group=SoAdRG_WakeupclusterConfiguration_Instance1_Methods}, {header-id=1643659279, pdu-collection-semantics=QUEUED, pdu-collection-trigger=ALWAYS, pdu-triggering=PT_WakeupclusterConfiguration_Methods_subscribeConfigurationsByKey_XIX_SomeIP_ServiceProvider_01_Gateway_Info_El_01_UC_Response, routing-group=SoAdRG_WakeupclusterConfiguration_Instance1_Methods}, {header-id=1643692160, pdu-collection-semantics=QUEUED, pdu-collection-trigger=ALWAYS, pdu-triggering=PT_WakeupclusterConfiguration_Events_configurationsEvent_XIX_SomeIP_ServiceProvider_01_Gateway_Info_UC, routing-group=SoAdRG_WakeupclusterConfiguration_Instance1_configurationsEvent}, {header-id=1643659280, pdu-collection-semantics=QUEUED, pdu-collection-trigger=ALWAYS, pdu-triggering=PT_WakeupclusterConfiguration_Methods_subscribeConfigurations_XIX_SomeIP_ServiceProvider_01_Gateway_Info_El_01_UC_Request, routing-group=SoAdRG_WakeupclusterConfiguration_Instance1_Methods}, {header-id=1643659282, pdu-collection-semantics=QUEUED, pdu-collection-trigger=ALWAYS, pdu-triggering=PT_WakeupclusterConfiguration_Methods_unsubscribeConfigurations_XIX_SomeIP_ServiceProvider_01_Gateway_Info_El_01_UC_Request, routing-group=SoAdRG_WakeupclusterConfiguration_Instance1_Methods}, {header-id=1643659282, pdu-collection-semantics=QUEUED, pdu-collection-trigger=ALWAYS, pdu-triggering=PT_WakeupclusterConfiguration_Methods_unsubscribeConfigurations_XIX_SomeIP_ServiceProvider_01_Gateway_Info_El_01_UC_Response, routing-group=SoAdRG_WakeupclusterConfiguration_Instance1_Methods}, {header-id=1643659279, pdu-collection-semantics=QUEUED, pdu-collection-trigger=ALWAYS, pdu-triggering=PT_WakeupclusterConfiguration_Methods_subscribeConfigurationsByKey_XIX_SomeIP_ServiceProvider_01_Gateway_Info_El_01_UC_Request, routing-group=SoAdRG_WakeupclusterConfiguration_Instance1_Methods}, {header-id=1643659265, pdu-collection-semantics=QUEUED, pdu-collection-trigger=ALWAYS, pdu-triggering=PT_WakeupclusterConfiguration_Methods_getConfigurationsElementByKey_XIX_SomeIP_ServiceProvider_01_Gateway_Info_El_01_UC_Request, routing-group=SoAdRG_WakeupclusterConfiguration_Instance1_Methods}, {header-id=1643659280, pdu-collection-semantics=QUEUED, pdu-collection-trigger=ALWAYS, pdu-triggering=PT_WakeupclusterConfiguration_Methods_subscribeConfigurations_XIX_SomeIP_ServiceProvider_01_Gateway_Info_El_01_UC_Response, routing-group=SoAdRG_WakeupclusterConfiguration_Instance1_Methods}, {header-id=1643659271, pdu-collection-semantics=QUEUED, pdu-collection-trigger=ALWAYS, pdu-triggering=PT_WakeupclusterConfiguration_Methods_getConfigurationsElements_XIX_SomeIP_ServiceProvider_01_Gateway_Info_El_01_UC_Request, routing-group=SoAdRG_WakeupclusterConfiguration_Instance1_Methods}], pdu-collection-max-buffer-size=1452, runtime-ip-address-configuration=NONE, runtime-port-configuration=NONE, short-label=SC_SomeIP_ServiceProvider_01_Gateway_Info_El_01_UC_HCP3_IONode}, server-port=SA_Tx_fd53_7cb8_0383_0005_0000_0000_0000_0010_42810_UDP_3
          SCB_SA_Tx_fd53_7cb8_0383_000e_0000_0000_0000_03aa_30500_UDP_3: socket-connection{client-ip-addr-from-connection-request=false, client-port-from-connection-request=false, client-port=SA_Rx_fd53_7cb8_0383_000e_0000_0000_0000_0073_42991_UDP_3, pdus=[{header-id=4279246852, pdu-collection-semantics=QUEUED, pdu-collection-trigger=ALWAYS, pdu-triggering=PT_SOMEIPTestabilityClient_MethodsGet_TestFieldUInt8_XIX_SomeIP_ServiceProvider_Testability_TestSysIP_Info_El_Response, routing-group=SoAdRG_SOMEIPTestabilityClient_Instance65534_Methods}, {header-id=4279238667, pdu-collection-semantics=QUEUED, pdu-collection-trigger=ALWAYS, pdu-triggering=PT_SOMEIPTestabilityClient_RnRMethods_rnrEchoFloat32_XIX_SomeIP_ServiceProvider_Testability_TestSysIP_Info_El, routing-group=SoAdRG_SOMEIPTestabilityClient_Instance65534_Methods}, {header-id=4279238660, pdu-collection-semantics=QUEUED, pdu-collection-trigger=ALWAYS, pdu-triggering=PT_SOMEIPTestabilityClient_Methods_echoFloat32_XIX_SomeIP_ServiceProvider_Testability_TestSysIP_Info_El_Response, routing-group=SoAdRG_SOMEIPTestabilityClient_Instance65534_Methods}, {header-id=4279279622, pdu-collection-semantics=QUEUED, pdu-collection-trigger=ALWAYS, pdu-triggering=PT_SOMEIPTestabilityClient_Events_TestFieldUInt8_XIX_SomeIP_ServiceProvider_Testability_TestSysIP_Info_UC, routing-group=SoAdRG_SOMEIPTestabilityClient_Instance65534_TestFieldUInt8}, {header-id=4279271438, pdu-collection-semantics=QUEUED, pdu-collection-trigger=ALWAYS, pdu-triggering=PT_SOMEIPTestabilityClient_Events_testEventUInt8_XIX_SomeIP_ServiceProvider_Testability_TestSysIP_Info_UC, routing-group=SoAdRG_SOMEIPTestabilityClient_Instance65534_testEventUInt8}, {header-id=4279238658, pdu-collection-semantics=QUEUED, pdu-collection-trigger=ALWAYS, pdu-triggering=PT_SOMEIPTestabilityClient_Methods_echoComplexDynamicArray_XIX_SomeIP_ServiceProvider_Testability_TestSysIP_Info_El_Request, routing-group=SoAdRG_SOMEIPTestabilityClient_Instance65534_Methods}, {header-id=4279238666, pdu-collection-semantics=QUEUED, pdu-collection-trigger=ALWAYS, pdu-triggering=PT_SOMEIPTestabilityClient_RnRMethods_rnrEchoUInt8UInt16UInt32_XIX_SomeIP_ServiceProvider_Testability_TestSysIP_Info_El, routing-group=SoAdRG_SOMEIPTestabilityClient_Instance65534_Methods}, {header-id=4279238659, pdu-collection-semantics=QUEUED, pdu-collection-trigger=ALWAYS, pdu-triggering=PT_SOMEIPTestabilityClient_Methods_echoComplexStruct_XIX_SomeIP_ServiceProvider_Testability_TestSysIP_Info_El_Request, routing-group=SoAdRG_SOMEIPTestabilityClient_Instance65534_Methods}, {header-id=4279238658, pdu-collection-semantics=QUEUED, pdu-collection-trigger=ALWAYS, pdu-triggering=PT_SOMEIPTestabilityClient_Methods_echoComplexDynamicArray_XIX_SomeIP_ServiceProvider_Testability_TestSysIP_Info_El_Response, routing-group=SoAdRG_SOMEIPTestabilityClient_Instance65534_Methods}, {header-id=4279238663, pdu-collection-semantics=QUEUED, pdu-collection-trigger=ALWAYS, pdu-triggering=PT_SOMEIPTestabilityClient_RnRMethods_rnrEchoComplexDynamicArray_XIX_SomeIP_ServiceProvider_Testability_TestSysIP_Info_El, routing-group=SoAdRG_SOMEIPTestabilityClient_Instance65534_Methods}, {header-id=4279238669, pdu-collection-semantics=QUEUED, pdu-collection-trigger=ALWAYS, pdu-triggering=PT_SOMEIPTestabilityClient_RnRMethods_noResponseUInt8_XIX_SomeIP_ServiceProvider_Testability_TestSysIP_Info_El, routing-group=SoAdRG_SOMEIPTestabilityClient_Instance65534_Methods}, {header-id=4279238661, pdu-collection-semantics=QUEUED, pdu-collection-trigger=ALWAYS, pdu-triggering=PT_SOMEIPTestabilityClient_Methods_echoUInt8_XIX_SomeIP_ServiceProvider_Testability_TestSysIP_Info_El_Request, routing-group=SoAdRG_SOMEIPTestabilityClient_Instance65534_Methods}, {header-id=4279246852, pdu-collection-semantics=QUEUED, pdu-collection-trigger=ALWAYS, pdu-triggering=PT_SOMEIPTestabilityClient_MethodsGet_TestFieldUInt8_XIX_SomeIP_ServiceProvider_Testability_TestSysIP_Info_El_Request, routing-group=SoAdRG_SOMEIPTestabilityClient_Instance65534_Methods}, {header-id=4279246853, pdu-collection-semantics=QUEUED, pdu-collection-trigger=ALWAYS, pdu-triggering=PT_SOMEIPTestabilityClient_MethodsSet_TestFieldUInt8_XIX_SomeIP_ServiceProvider_Testability_TestSysIP_Info_El_Response, routing-group=SoAdRG_SOMEIPTestabilityClient_Instance65534_Methods}, {header-id=4279238664, pdu-collection-semantics=QUEUED, pdu-collection-trigger=ALWAYS, pdu-triggering=PT_SOMEIPTestabilityClient_RnRMethods_rnrEchoComplexStruct_XIX_SomeIP_ServiceProvider_Testability_TestSysIP_Info_El, routing-group=SoAdRG_SOMEIPTestabilityClient_Instance65534_Methods}, {header-id=4279246853, pdu-collection-semantics=QUEUED, pdu-collection-trigger=ALWAYS, pdu-triggering=PT_SOMEIPTestabilityClient_MethodsSet_TestFieldUInt8_XIX_SomeIP_ServiceProvider_Testability_TestSysIP_Info_El_Request, routing-group=SoAdRG_SOMEIPTestabilityClient_Instance65534_Methods}, {header-id=4279238660, pdu-collection-semantics=QUEUED, pdu-collection-trigger=ALWAYS, pdu-triggering=PT_SOMEIPTestabilityClient_Methods_echoFloat32_XIX_SomeIP_ServiceProvider_Testability_TestSysIP_Info_El_Request, routing-group=SoAdRG_SOMEIPTestabilityClient_Instance65534_Methods}, {header-id=4279238662, pdu-collection-semantics=QUEUED, pdu-collection-trigger=ALWAYS, pdu-triggering=PT_SOMEIPTestabilityClient_Methods_echoUInt8UInt16UInt32_XIX_SomeIP_ServiceProvider_Testability_TestSysIP_Info_El_Request, routing-group=SoAdRG_SOMEIPTestabilityClient_Instance65534_Methods}, {header-id=4279238662, pdu-collection-semantics=QUEUED, pdu-collection-trigger=ALWAYS, pdu-triggering=PT_SOMEIPTestabilityClient_Methods_echoUInt8UInt16UInt32_XIX_SomeIP_ServiceProvider_Testability_TestSysIP_Info_El_Response, routing-group=SoAdRG_SOMEIPTestabilityClient_Instance65534_Methods}, {header-id=4279238661, pdu-collection-semantics=QUEUED, pdu-collection-trigger=ALWAYS, pdu-triggering=PT_SOMEIPTestabilityClient_Methods_echoUInt8_XIX_SomeIP_ServiceProvider_Testability_TestSysIP_Info_El_Response, routing-group=SoAdRG_SOMEIPTestabilityClient_Instance65534_Methods}, {header-id=4279238659, pdu-collection-semantics=QUEUED, pdu-collection-trigger=ALWAYS, pdu-triggering=PT_SOMEIPTestabilityClient_Methods_echoComplexStruct_XIX_SomeIP_ServiceProvider_Testability_TestSysIP_Info_El_Response, routing-group=SoAdRG_SOMEIPTestabilityClient_Instance65534_Methods}], pdu-collection-max-buffer-size=1452, runtime-ip-address-configuration=NONE, runtime-port-configuration=NONE, short-label=SC_SomeIP_ServiceProvider_Testability_TestSysIP_Info_El_HCP3_IONode}, server-port=SA_Tx_fd53_7cb8_0383_000e_0000_0000_0000_03aa_30500_UDP_3
          SCB_SA_Tx_fd53_7cb8_0383_000e_0000_0000_0000_0108_42994_UDP_4: socket-connection{client-ip-addr-from-connection-request=false, client-port-from-connection-request=false, client-port=SA_Rx_ff14_0000_0000_0000_0000_0000_0000_0005_42557_UDP_4_XIX_SCB_SA_Tx_fd53_7cb8_0383_000e_0000_0000_0000_0108_42994_UDP_4, pdus=socket-connection-ipdu-identifier={header-id=1359481856, pdu-collection-semantics=QUEUED, pdu-collection-trigger=ALWAYS, pdu-triggering=PT_KN_ICAS3Sys01}, runtime-ip-address-configuration=NONE, runtime-port-configuration=NONE, short-label=SC_Architekturinfos_ICAS3Sys01_01}, server-port=SA_Tx_fd53_7cb8_0383_000e_0000_0000_0000_0108_42994_UDP_4
          SCB_SA_Tx_fd53_7cb8_0383_000e_0000_0000_0000_0073_30601_TCP_0: socket-connection{client-ip-addr-from-connection-request=false, client-port-from-connection-request=true, client-port=SA_Rx_fd53_7cb8_0383_000e_0000_0000_0000_03aa_dynamic_TCP_0, pdus=[{header-id=4278386756, pdu-collection-semantics=QUEUED, pdu-collection-trigger=ALWAYS, pdu-triggering=PT_SOMEIPTestabilityReliable_Methods_getSupportedFunctions_XIX_TCPServer_SomeIP_Testability_Info_El_TestSysIP_Request, routing-group=SoAdRG_SOMEIPTestabilityReliable_Instance1_Methods}, {header-id=4278394880, pdu-collection-semantics=QUEUED, pdu-collection-trigger=ALWAYS, pdu-triggering=PT_SOMEIPTestabilityReliable_MethodsGet_TestFieldUInt8_XIX_TCPServer_SomeIP_Testability_Info_El_TestSysIP_Response, routing-group=SoAdRG_SOMEIPTestabilityReliable_Instance1_Methods}, {header-id=4278386727, pdu-collection-semantics=QUEUED, pdu-collection-trigger=ALWAYS, pdu-triggering=PT_SOMEIPTestabilityReliable_Methods_deactivateTsClient_XIX_TCPServer_SomeIP_Testability_Info_El_TestSysIP_Response, routing-group=SoAdRG_SOMEIPTestabilityReliable_Instance1_Methods}, {header-id=4278386724, pdu-collection-semantics=QUEUED, pdu-collection-trigger=ALWAYS, pdu-triggering=PT_SOMEIPTestabilityReliable_RnRMethods_triggerGetterUInt8_XIX_TCPServer_SomeIP_Testability_Info_El_TestSysIP, routing-group=SoAdRG_SOMEIPTestabilityReliable_Instance1_Methods}, {header-id=4278386718, pdu-collection-semantics=QUEUED, pdu-collection-trigger=ALWAYS, pdu-triggering=PT_SOMEIPTestabilityReliable_RnRMethods_noResponseUInt8_XIX_TCPServer_SomeIP_Testability_Info_El_TestSysIP, routing-group=SoAdRG_SOMEIPTestabilityReliable_Instance1_Methods}, {header-id=4278386692, pdu-collection-semantics=QUEUED, pdu-collection-trigger=ALWAYS, pdu-triggering=PT_SOMEIPTestabilityReliable_Methods_echoUInt16_XIX_TCPServer_SomeIP_Testability_Info_El_TestSysIP_Request, routing-group=SoAdRG_SOMEIPTestabilityReliable_Instance1_Methods}, {header-id=4278394884, pdu-collection-semantics=QUEUED, pdu-collection-trigger=ALWAYS, pdu-triggering=PT_SOMEIPTestabilityReliable_MethodsGet_TestFieldUInt64_XIX_TCPServer_SomeIP_Testability_Info_El_TestSysIP_Request, routing-group=SoAdRG_SOMEIPTestabilityReliable_Instance1_Methods}, {header-id=4278386711, pdu-collection-semantics=QUEUED, pdu-collection-trigger=ALWAYS, pdu-triggering=PT_SOMEIPTestabilityReliable_Methods_echoComplexStruct_XIX_TCPServer_SomeIP_Testability_Info_El_TestSysIP_Response, routing-group=SoAdRG_SOMEIPTestabilityReliable_Instance1_Methods}, {header-id=4278394884, pdu-collection-semantics=QUEUED, pdu-collection-trigger=ALWAYS, pdu-triggering=PT_SOMEIPTestabilityReliable_MethodsGet_TestFieldUInt64_XIX_TCPServer_SomeIP_Testability_Info_El_TestSysIP_Response, routing-group=SoAdRG_SOMEIPTestabilityReliable_Instance1_Methods}, {header-id=4278427650, pdu-collection-semantics=QUEUED, pdu-collection-trigger=ALWAYS, pdu-triggering=PT_SOMEIPTestabilityReliable_Events_TestFieldUInt8_XIX_TCPServer_SomeIP_Testability_Info_El_UC, routing-group=SoAdRG_SOMEIPTestabilityReliable_Instance1_TestFieldUInt8}, {header-id=4278386695, pdu-collection-semantics=QUEUED, pdu-collection-trigger=ALWAYS, pdu-triggering=PT_SOMEIPTestabilityReliable_Methods_echoSInt8_XIX_TCPServer_SomeIP_Testability_Info_El_TestSysIP_Response, routing-group=SoAdRG_SOMEIPTestabilityReliable_Instance1_Methods}, {header-id=4278427658, pdu-collection-semantics=QUEUED, pdu-collection-trigger=ALWAYS, pdu-triggering=PT_SOMEIPTestabilityReliable_Events_TestFieldComplexStruct_XIX_TCPServer_SomeIP_Testability_Info_El_UC, routing-group=SoAdRG_SOMEIPTestabilityReliable_Instance1_TestFieldComplexStruct}, {header-id=4278386728, pdu-collection-semantics=QUEUED, pdu-collection-trigger=ALWAYS, pdu-triggering=PT_SOMEIPTestabilityReliable_Methods_enableSubscription_XIX_TCPServer_SomeIP_Testability_Info_El_TestSysIP_Response, routing-group=SoAdRG_SOMEIPTestabilityReliable_Instance1_Methods}, {header-id=4278386698, pdu-collection-semantics=QUEUED, pdu-collection-trigger=ALWAYS, pdu-triggering=PT_SOMEIPTestabilityReliable_Methods_echoSInt64_XIX_TCPServer_SomeIP_Testability_Info_El_TestSysIP_Request, routing-group=SoAdRG_SOMEIPTestabilityReliable_Instance1_Methods}, {header-id=4278386756, pdu-collection-semantics=QUEUED, pdu-collection-trigger=ALWAYS, pdu-triggering=PT_SOMEIPTestabilityReliable_Methods_getSupportedFunctions_XIX_TCPServer_SomeIP_Testability_Info_El_TestSysIP_Response, routing-group=SoAdRG_SOMEIPTestabilityReliable_Instance1_Methods}, {header-id=4278386728, pdu-collection-semantics=QUEUED, pdu-collection-trigger=ALWAYS, pdu-triggering=PT_SOMEIPTestabilityReliable_Methods_enableSubscription_XIX_TCPServer_SomeIP_Testability_Info_El_TestSysIP_Request, routing-group=SoAdRG_SOMEIPTestabilityReliable_Instance1_Methods}, {header-id=4278386705, pdu-collection-semantics=QUEUED, pdu-collection-trigger=ALWAYS, pdu-triggering=PT_SOMEIPTestabilityReliable_Methods_echoInverseDynamicMultidimensionalArray_XIX_TCPServer_Some_F145DA4A564DECEA438E4C73A67AD229, routing-group=SoAdRG_SOMEIPTestabilityReliable_Instance1_Methods}, {header-id=4278386774, pdu-collection-semantics=QUEUED, pdu-collection-trigger=ALWAYS, pdu-triggering=PT_SOMEIPTestabilityReliable_Methods_resetInterface_XIX_TCPServer_SomeIP_Testability_Info_El_TestSysIP_Response, routing-group=SoAdRG_SOMEIPTestabilityReliable_Instance1_Methods}, {header-id=4278386779, pdu-collection-semantics=QUEUED, pdu-collection-trigger=ALWAYS, pdu-triggering=PT_SOMEIPTestabilityReliable_RnRMethods_triggerEchoFloat32_XIX_TCPServer_SomeIP_Testability_Info_El_TestSysIP, routing-group=SoAdRG_SOMEIPTestabilityReliable_Instance1_Methods}, {header-id=4278386689, pdu-collection-semantics=QUEUED, pdu-collection-trigger=ALWAYS, pdu-triggering=PT_SOMEIPTestabilityReliable_Methods_checkByteOrder_XIX_TCPServer_SomeIP_Testability_Info_El_TestSysIP_Request, routing-group=SoAdRG_SOMEIPTestabilityReliable_Instance1_Methods}, {header-id=4278386700, pdu-collection-semantics=QUEUED, pdu-collection-trigger=ALWAYS, pdu-triggering=PT_SOMEIPTestabilityReliable_Methods_echoFloat64_XIX_TCPServer_SomeIP_Testability_Info_El_TestSysIP_Request, routing-group=SoAdRG_SOMEIPTestabilityReliable_Instance1_Methods}, {header-id=4278386774, pdu-collection-semantics=QUEUED, pdu-collection-trigger=ALWAYS, pdu-triggering=PT_SOMEIPTestabilityReliable_Methods_resetInterface_XIX_TCPServer_SomeIP_Testability_Info_El_TestSysIP_Request, routing-group=SoAdRG_SOMEIPTestabilityReliable_Instance1_Methods}, {header-id=4278386782, pdu-collection-semantics=QUEUED, pdu-collection-trigger=ALWAYS, pdu-triggering=PT_SOMEIPTestabilityReliable_RnRMethods_triggerFieldMulticast_XIX_TCPServer_SomeIP_Testability_Info_El_TestSysIP, routing-group=SoAdRG_SOMEIPTestabilityReliable_Instance1_Methods}, {header-id=4278394888, pdu-collection-semantics=QUEUED, pdu-collection-trigger=ALWAYS, pdu-triggering=PT_SOMEIPTestabilityReliable_MethodsGet_TestFieldComplexStruct_XIX_TCPServer_SomeIP_Testability_Info_El_TestSysIP_Response, routing-group=SoAdRG_SOMEIPTestabilityReliable_Instance1_Methods}, {header-id=4278386697, pdu-collection-semantics=QUEUED, pdu-collection-trigger=ALWAYS, pdu-triggering=PT_SOMEIPTestabilityReliable_Methods_echoSInt32_XIX_TCPServer_SomeIP_Testability_Info_El_TestSysIP_Request, routing-group=SoAdRG_SOMEIPTestabilityReliable_Instance1_Methods}, {header-id=4278386726, pdu-collection-semantics=QUEUED, pdu-collection-trigger=ALWAYS, pdu-triggering=PT_SOMEIPTestabilityReliable_Methods_activateTsClient_XIX_TCPServer_SomeIP_Testability_Info_El_TestSysIP_Response, routing-group=SoAdRG_SOMEIPTestabilityReliable_Instance1_Methods}, {header-id=4278386705, pdu-collection-semantics=QUEUED, pdu-collection-trigger=ALWAYS, pdu-triggering=PT_SOMEIPTestabilityReliable_Methods_echoInverseDynamicMultidimensionalArray_XIX_TCPServer_Some_8912479F3DFDD2E1D50DE97A28F7FF6C, routing-group=SoAdRG_SOMEIPTestabilityReliable_Instance1_Methods}, {header-id=4278419456, pdu-collection-semantics=QUEUED, pdu-collection-trigger=ALWAYS, pdu-triggering=PT_SOMEIPTestabilityReliable_Events_testEventUInt8_XIX_TCPServer_SomeIP_Testability_Info_El_UC, routing-group=SoAdRG_SOMEIPTestabilityReliable_Instance1_testEventUInt8}, {header-id=4278386776, pdu-collection-semantics=QUEUED, pdu-collection-trigger=ALWAYS, pdu-triggering=PT_SOMEIPTestabilityReliable_Methods_getLastValueEventUInt8_XIX_TCPServer_SomeIP_Testability_Info_El_TestSysIP_Response, routing-group=SoAdRG_SOMEIPTestabilityReliable_Instance1_Methods}, {header-id=4278386726, pdu-collection-semantics=QUEUED, pdu-collection-trigger=ALWAYS, pdu-triggering=PT_SOMEIPTestabilityReliable_Methods_activateTsClient_XIX_TCPServer_SomeIP_Testability_Info_El_TestSysIP_Request, routing-group=SoAdRG_SOMEIPTestabilityReliable_Instance1_Methods}, {header-id=4278386696, pdu-collection-semantics=QUEUED, pdu-collection-trigger=ALWAYS, pdu-triggering=PT_SOMEIPTestabilityReliable_Methods_echoSInt16_XIX_TCPServer_SomeIP_Testability_Info_El_TestSysIP_Response, routing-group=SoAdRG_SOMEIPTestabilityReliable_Instance1_Methods}, {header-id=4278386716, pdu-collection-semantics=QUEUED, pdu-collection-trigger=ALWAYS, pdu-triggering=PT_SOMEIPTestabilityReliable_Methods_echoUInt8UInt16UInt32_XIX_TCPServer_SomeIP_Testability_Info_El_TestSysIP_Request, routing-group=SoAdRG_SOMEIPTestabilityReliable_Instance1_Methods}, {header-id=4278394880, pdu-collection-semantics=QUEUED, pdu-collection-trigger=ALWAYS, pdu-triggering=PT_SOMEIPTestabilityReliable_MethodsGet_TestFieldUInt8_XIX_TCPServer_SomeIP_Testability_Info_El_TestSysIP_Request, routing-group=SoAdRG_SOMEIPTestabilityReliable_Instance1_Methods}, {header-id=4278386777, pdu-collection-semantics=QUEUED, pdu-collection-trigger=ALWAYS, pdu-triggering=PT_SOMEIPTestabilityReliable_RnRMethods_triggerEchoComplexDynamicArray_XIX_TCPServer_SomeIP_Testability_Info_El_TestSysIP, routing-group=SoAdRG_SOMEIPTestabilityReliable_Instance1_Methods}, {header-id=4278386691, pdu-collection-semantics=QUEUED, pdu-collection-trigger=ALWAYS, pdu-triggering=PT_SOMEIPTestabilityReliable_Methods_echoUInt8_XIX_TCPServer_SomeIP_Testability_Info_El_TestSysIP_Request, routing-group=SoAdRG_SOMEIPTestabilityReliable_Instance1_Methods}, {header-id=4278386708, pdu-collection-semantics=QUEUED, pdu-collection-trigger=ALWAYS, pdu-triggering=PT_SOMEIPTestabilityReliable_Methods_echoUTF8String_XIX_TCPServer_SomeIP_Testability_Info_El_TestSysIP_Request, routing-group=SoAdRG_SOMEIPTestabilityReliable_Instance1_Methods}, {header-id=4278386695, pdu-collection-semantics=QUEUED, pdu-collection-trigger=ALWAYS, pdu-triggering=PT_SOMEIPTestabilityReliable_Methods_echoSInt8_XIX_TCPServer_SomeIP_Testability_Info_El_TestSysIP_Request, routing-group=SoAdRG_SOMEIPTestabilityReliable_Instance1_Methods}, {header-id=4278386697, pdu-collection-semantics=QUEUED, pdu-collection-trigger=ALWAYS, pdu-triggering=PT_SOMEIPTestabilityReliable_Methods_echoSInt32_XIX_TCPServer_SomeIP_Testability_Info_El_TestSysIP_Response, routing-group=SoAdRG_SOMEIPTestabilityReliable_Instance1_Methods}, {header-id=4278386721, pdu-collection-semantics=QUEUED, pdu-collection-trigger=ALWAYS, pdu-triggering=PT_SOMEIPTestabilityReliable_RnRMethods_triggerEchoUInt8UInt16UInt32_XIX_TCPServer_SomeIP_Testability_Info_El_TestSysIP, routing-group=SoAdRG_SOMEIPTestabilityReliable_Instance1_Methods}, {header-id=4278394889, pdu-collection-semantics=QUEUED, pdu-collection-trigger=ALWAYS, pdu-triggering=PT_SOMEIPTestabilityReliable_MethodsSet_TestFieldComplexStruct_XIX_TCPServer_SomeIP_Testability_Info_El_TestSysIP_Request, routing-group=SoAdRG_SOMEIPTestabilityReliable_Instance1_Methods}, {header-id=4278386709, pdu-collection-semantics=QUEUED, pdu-collection-trigger=ALWAYS, pdu-triggering=PT_SOMEIPTestabilityReliable_Methods_echoInverseBitField_XIX_TCPServer_SomeIP_Testability_Info_El_TestSysIP_Response, routing-group=SoAdRG_SOMEIPTestabilityReliable_Instance1_Methods}, {header-id=4278386693, pdu-collection-semantics=QUEUED, pdu-collection-trigger=ALWAYS, pdu-triggering=PT_SOMEIPTestabilityReliable_Methods_echoUInt32_XIX_TCPServer_SomeIP_Testability_Info_El_TestSysIP_Request, routing-group=SoAdRG_SOMEIPTestabilityReliable_Instance1_Methods}, {header-id=4278386719, pdu-collection-semantics=QUEUED, pdu-collection-trigger=ALWAYS, pdu-triggering=PT_SOMEIPTestabilityReliable_RnRMethods_triggerEventUInt8_XIX_TCPServer_SomeIP_Testability_Info_El_TestSysIP, routing-group=SoAdRG_SOMEIPTestabilityReliable_Instance1_Methods}, {header-id=4278386700, pdu-collection-semantics=QUEUED, pdu-collection-trigger=ALWAYS, pdu-triggering=PT_SOMEIPTestabilityReliable_Methods_echoFloat64_XIX_TCPServer_SomeIP_Testability_Info_El_TestSysIP_Response, routing-group=SoAdRG_SOMEIPTestabilityReliable_Instance1_Methods}, {header-id=4278386709, pdu-collection-semantics=QUEUED, pdu-collection-trigger=ALWAYS, pdu-triggering=PT_SOMEIPTestabilityReliable_Methods_echoInverseBitField_XIX_TCPServer_SomeIP_Testability_Info_El_TestSysIP_Request, routing-group=SoAdRG_SOMEIPTestabilityReliable_Instance1_Methods}, {header-id=4278394889, pdu-collection-semantics=QUEUED, pdu-collection-trigger=ALWAYS, pdu-triggering=PT_SOMEIPTestabilityReliable_MethodsSet_TestFieldComplexStruct_XIX_TCPServer_SomeIP_Testability_Info_El_TestSysIP_Response, routing-group=SoAdRG_SOMEIPTestabilityReliable_Instance1_Methods}, {header-id=4278386694, pdu-collection-semantics=QUEUED, pdu-collection-trigger=ALWAYS, pdu-triggering=PT_SOMEIPTestabilityReliable_Methods_echoUInt64_XIX_TCPServer_SomeIP_Testability_Info_El_TestSysIP_Response, routing-group=SoAdRG_SOMEIPTestabilityReliable_Instance1_Methods}, {header-id=4278386716, pdu-collection-semantics=QUEUED, pdu-collection-trigger=ALWAYS, pdu-triggering=PT_SOMEIPTestabilityReliable_Methods_echoUInt8UInt16UInt32_XIX_TCPServer_SomeIP_Testability_Info_El_TestSysIP_Response, routing-group=SoAdRG_SOMEIPTestabilityReliable_Instance1_Methods}, {header-id=4278386707, pdu-collection-semantics=QUEUED, pdu-collection-trigger=ALWAYS, pdu-triggering=PT_SOMEIPTestabilityReliable_Methods_echoComplexDynamicArray_XIX_TCPServer_SomeIP_Testability_Info_El_TestSysIP_Request, routing-group=SoAdRG_SOMEIPTestabilityReliable_Instance1_Methods}, {header-id=4278386699, pdu-collection-semantics=QUEUED, pdu-collection-trigger=ALWAYS, pdu-triggering=PT_SOMEIPTestabilityReliable_Methods_echoFloat32_XIX_TCPServer_SomeIP_Testability_Info_El_TestSysIP_Response, routing-group=SoAdRG_SOMEIPTestabilityReliable_Instance1_Methods}, {header-id=4278386692, pdu-collection-semantics=QUEUED, pdu-collection-trigger=ALWAYS, pdu-triggering=PT_SOMEIPTestabilityReliable_Methods_echoUInt16_XIX_TCPServer_SomeIP_Testability_Info_El_TestSysIP_Response, routing-group=SoAdRG_SOMEIPTestabilityReliable_Instance1_Methods}, {header-id=4278394888, pdu-collection-semantics=QUEUED, pdu-collection-trigger=ALWAYS, pdu-triggering=PT_SOMEIPTestabilityReliable_MethodsGet_TestFieldComplexStruct_XIX_TCPServer_SomeIP_Testability_Info_El_TestSysIP_Request, routing-group=SoAdRG_SOMEIPTestabilityReliable_Instance1_Methods}, {header-id=4278386711, pdu-collection-semantics=QUEUED, pdu-collection-trigger=ALWAYS, pdu-triggering=PT_SOMEIPTestabilityReliable_Methods_echoComplexStruct_XIX_TCPServer_SomeIP_Testability_Info_El_TestSysIP_Request, routing-group=SoAdRG_SOMEIPTestabilityReliable_Instance1_Methods}, {header-id=4278386701, pdu-collection-semantics=QUEUED, pdu-collection-trigger=ALWAYS, pdu-triggering=PT_SOMEIPTestabilityReliable_Methods_echoInverseStruct_XIX_TCPServer_SomeIP_Testability_Info_El_TestSysIP_Response, routing-group=SoAdRG_SOMEIPTestabilityReliable_Instance1_Methods}, {header-id=4278386690, pdu-collection-semantics=QUEUED, pdu-collection-trigger=ALWAYS, pdu-triggering=PT_SOMEIPTestabilityReliable_Methods_echoBool_XIX_TCPServer_SomeIP_Testability_Info_El_TestSysIP_Response, routing-group=SoAdRG_SOMEIPTestabilityReliable_Instance1_Methods}, {header-id=4278386693, pdu-collection-semantics=QUEUED, pdu-collection-trigger=ALWAYS, pdu-triggering=PT_SOMEIPTestabilityReliable_Methods_echoUInt32_XIX_TCPServer_SomeIP_Testability_Info_El_TestSysIP_Response, routing-group=SoAdRG_SOMEIPTestabilityReliable_Instance1_Methods}, {header-id=4278386727, pdu-collection-semantics=QUEUED, pdu-collection-trigger=ALWAYS, pdu-triggering=PT_SOMEIPTestabilityReliable_Methods_deactivateTsClient_XIX_TCPServer_SomeIP_Testability_Info_El_TestSysIP_Request, routing-group=SoAdRG_SOMEIPTestabilityReliable_Instance1_Methods}, {header-id=4278386722, pdu-collection-semantics=QUEUED, pdu-collection-trigger=ALWAYS, pdu-triggering=PT_SOMEIPTestabilityReliable_RnRMethods_triggerFireForgetUInt8_XIX_TCPServer_SomeIP_Testability_Info_El_TestSysIP, routing-group=SoAdRG_SOMEIPTestabilityReliable_Instance1_Methods}, {header-id=4278386781, pdu-collection-semantics=QUEUED, pdu-collection-trigger=ALWAYS, pdu-triggering=PT_SOMEIPTestabilityReliable_RnRMethods_triggerEchoLargeDataArray_XIX_TCPServer_SomeIP_Testability_Info_El_TestSysIP, routing-group=SoAdRG_SOMEIPTestabilityReliable_Instance1_Methods}, {header-id=4278386714, pdu-collection-semantics=QUEUED, pdu-collection-trigger=ALWAYS, pdu-triggering=PT_SOMEIPTestabilityReliable_Methods_echoStructInStruct_XIX_TCPServer_SomeIP_Testability_Info_El_TestSysIP_Response, routing-group=SoAdRG_SOMEIPTestabilityReliable_Instance1_Methods}, {header-id=4278386696, pdu-collection-semantics=QUEUED, pdu-collection-trigger=ALWAYS, pdu-triggering=PT_SOMEIPTestabilityReliable_Methods_echoSInt16_XIX_TCPServer_SomeIP_Testability_Info_El_TestSysIP_Request, routing-group=SoAdRG_SOMEIPTestabilityReliable_Instance1_Methods}, {header-id=4278386690, pdu-collection-semantics=QUEUED, pdu-collection-trigger=ALWAYS, pdu-triggering=PT_SOMEIPTestabilityReliable_Methods_echoBool_XIX_TCPServer_SomeIP_Testability_Info_El_TestSysIP_Request, routing-group=SoAdRG_SOMEIPTestabilityReliable_Instance1_Methods}, {header-id=4278386780, pdu-collection-semantics=QUEUED, pdu-collection-trigger=ALWAYS, pdu-triggering=PT_SOMEIPTestabilityReliable_Methods_getLastValueFieldMulticast_XIX_TCPServer_SomeIP_Testability_Info_El_TestSysIP_Request, routing-group=SoAdRG_SOMEIPTestabilityReliable_Instance1_Methods}, {header-id=4278386780, pdu-collection-semantics=QUEUED, pdu-collection-trigger=ALWAYS, pdu-triggering=PT_SOMEIPTestabilityReliable_Methods_getLastValueFieldMulticast_XIX_TCPServer_SomeIP_Testability_Info_El_TestSysIP_Response, routing-group=SoAdRG_SOMEIPTestabilityReliable_Instance1_Methods}, {header-id=4278386723, pdu-collection-semantics=QUEUED, pdu-collection-trigger=ALWAYS, pdu-triggering=PT_SOMEIPTestabilityReliable_RnRMethods_triggerSetterUInt8_XIX_TCPServer_SomeIP_Testability_Info_El_TestSysIP, routing-group=SoAdRG_SOMEIPTestabilityReliable_Instance1_Methods}, {header-id=4278386778, pdu-collection-semantics=QUEUED, pdu-collection-trigger=ALWAYS, pdu-triggering=PT_SOMEIPTestabilityReliable_RnRMethods_triggerEchoComplexStruct_XIX_TCPServer_SomeIP_Testability_Info_El_TestSysIP, routing-group=SoAdRG_SOMEIPTestabilityReliable_Instance1_Methods}, {header-id=4278386701, pdu-collection-semantics=QUEUED, pdu-collection-trigger=ALWAYS, pdu-triggering=PT_SOMEIPTestabilityReliable_Methods_echoInverseStruct_XIX_TCPServer_SomeIP_Testability_Info_El_TestSysIP_Request, routing-group=SoAdRG_SOMEIPTestabilityReliable_Instance1_Methods}, {header-id=4278386691, pdu-collection-semantics=QUEUED, pdu-collection-trigger=ALWAYS, pdu-triggering=PT_SOMEIPTestabilityReliable_Methods_echoUInt8_XIX_TCPServer_SomeIP_Testability_Info_El_TestSysIP_Response, routing-group=SoAdRG_SOMEIPTestabilityReliable_Instance1_Methods}, {header-id=4278386776, pdu-collection-semantics=QUEUED, pdu-collection-trigger=ALWAYS, pdu-triggering=PT_SOMEIPTestabilityReliable_Methods_getLastValueEventUInt8_XIX_TCPServer_SomeIP_Testability_Info_El_TestSysIP_Request, routing-group=SoAdRG_SOMEIPTestabilityReliable_Instance1_Methods}, {header-id=4278386708, pdu-collection-semantics=QUEUED, pdu-collection-trigger=ALWAYS, pdu-triggering=PT_SOMEIPTestabilityReliable_Methods_echoUTF8String_XIX_TCPServer_SomeIP_Testability_Info_El_TestSysIP_Response, routing-group=SoAdRG_SOMEIPTestabilityReliable_Instance1_Methods}, {header-id=4278427654, pdu-collection-semantics=QUEUED, pdu-collection-trigger=ALWAYS, pdu-triggering=PT_SOMEIPTestabilityReliable_Events_TestFieldUInt64_XIX_TCPServer_SomeIP_Testability_Info_El_UC, routing-group=SoAdRG_SOMEIPTestabilityReliable_Instance1_TestFieldUInt64}, {header-id=4278386714, pdu-collection-semantics=QUEUED, pdu-collection-trigger=ALWAYS, pdu-triggering=PT_SOMEIPTestabilityReliable_Methods_echoStructInStruct_XIX_TCPServer_SomeIP_Testability_Info_El_TestSysIP_Request, routing-group=SoAdRG_SOMEIPTestabilityReliable_Instance1_Methods}, {header-id=4278386704, pdu-collection-semantics=QUEUED, pdu-collection-trigger=ALWAYS, pdu-triggering=PT_SOMEIPTestabilityReliable_Methods_echoInverseDynamicArray_XIX_TCPServer_SomeIP_Testability_Info_El_TestSysIP_Response, routing-group=SoAdRG_SOMEIPTestabilityReliable_Instance1_Methods}, {header-id=4278386707, pdu-collection-semantics=QUEUED, pdu-collection-trigger=ALWAYS, pdu-triggering=PT_SOMEIPTestabilityReliable_Methods_echoComplexDynamicArray_XIX_TCPServer_SomeIP_Testability_Info_El_TestSysIP_Response, routing-group=SoAdRG_SOMEIPTestabilityReliable_Instance1_Methods}, {header-id=4278386698, pdu-collection-semantics=QUEUED, pdu-collection-trigger=ALWAYS, pdu-triggering=PT_SOMEIPTestabilityReliable_Methods_echoSInt64_XIX_TCPServer_SomeIP_Testability_Info_El_TestSysIP_Response, routing-group=SoAdRG_SOMEIPTestabilityReliable_Instance1_Methods}, {header-id=4278394881, pdu-collection-semantics=QUEUED, pdu-collection-trigger=ALWAYS, pdu-triggering=PT_SOMEIPTestabilityReliable_MethodsSet_TestFieldUInt8_XIX_TCPServer_SomeIP_Testability_Info_El_TestSysIP_Request, routing-group=SoAdRG_SOMEIPTestabilityReliable_Instance1_Methods}, {header-id=4278386689, pdu-collection-semantics=QUEUED, pdu-collection-trigger=ALWAYS, pdu-triggering=PT_SOMEIPTestabilityReliable_Methods_checkByteOrder_XIX_TCPServer_SomeIP_Testability_Info_El_TestSysIP_Response, routing-group=SoAdRG_SOMEIPTestabilityReliable_Instance1_Methods}, {header-id=4278386699, pdu-collection-semantics=QUEUED, pdu-collection-trigger=ALWAYS, pdu-triggering=PT_SOMEIPTestabilityReliable_Methods_echoFloat32_XIX_TCPServer_SomeIP_Testability_Info_El_TestSysIP_Request, routing-group=SoAdRG_SOMEIPTestabilityReliable_Instance1_Methods}, {header-id=4278386694, pdu-collection-semantics=QUEUED, pdu-collection-trigger=ALWAYS, pdu-triggering=PT_SOMEIPTestabilityReliable_Methods_echoUInt64_XIX_TCPServer_SomeIP_Testability_Info_El_TestSysIP_Request, routing-group=SoAdRG_SOMEIPTestabilityReliable_Instance1_Methods}, {header-id=4278386720, pdu-collection-semantics=QUEUED, pdu-collection-trigger=ALWAYS, pdu-triggering=PT_SOMEIPTestabilityReliable_RnRMethods_triggerEchoUInt8_XIX_TCPServer_SomeIP_Testability_Info_El_TestSysIP, routing-group=SoAdRG_SOMEIPTestabilityReliable_Instance1_Methods}, {header-id=4278394881, pdu-collection-semantics=QUEUED, pdu-collection-trigger=ALWAYS, pdu-triggering=PT_SOMEIPTestabilityReliable_MethodsSet_TestFieldUInt8_XIX_TCPServer_SomeIP_Testability_Info_El_TestSysIP_Response, routing-group=SoAdRG_SOMEIPTestabilityReliable_Instance1_Methods}, {header-id=4278386704, pdu-collection-semantics=QUEUED, pdu-collection-trigger=ALWAYS, pdu-triggering=PT_SOMEIPTestabilityReliable_Methods_echoInverseDynamicArray_XIX_TCPServer_SomeIP_Testability_Info_El_TestSysIP_Request, routing-group=SoAdRG_SOMEIPTestabilityReliable_Instance1_Methods}], runtime-ip-address-configuration=NONE, runtime-port-configuration=NONE, short-label=SC_TCPServer_SomeIP_Testability_Info_El_TestSysIP_TestSysIP}, server-port=SA_Tx_fd53_7cb8_0383_000e_0000_0000_0000_0073_30601_TCP_0
          SCB_SA_Tx_fd53_7cb8_0383_0005_0000_0000_0000_0114_42994_UDP_4: socket-connection{client-ip-addr-from-connection-request=false, client-port-from-connection-request=false, client-port=SA_Rx_ff14_0000_0000_0000_0000_0000_0000_003f_42557_UDP_4, pdus=socket-connection-ipdu-identifier={header-id=493, pdu-collection-semantics=QUEUED, pdu-collection-trigger=NEVER, pdu-triggering=VLAN_Cockpit/PT_ClimateControl_01}, pdu-collection-timeout=0.005, runtime-ip-address-configuration=NONE, runtime-port-configuration=NONE, short-label=SC_SK_HCP4Sys01_02}, server-port=SA_Tx_fd53_7cb8_0383_0005_0000_0000_0000_0114_42994_UDP_4
          SCB_SA_Tx_fd53_7cb8_0383_0005_0000_0000_0001_01e6_42994_UDP_4: server-port=SA_Tx_fd53_7cb8_0383_0005_0000_0000_0001_01e6_42994_UDP_4
            bundled-connections:
              {client-ip-addr-from-connection-request=false, client-port-from-connection-request=false, client-port=SA_Rx_ff14_0000_0000_0000_0000_0000_0000_004b_42557_UDP_4, pdus=socket-connection-ipdu-identifier={header-id=1408, pdu-collection-semantics=QUEUED, pdu-collection-trigger=NEVER, pdu-triggering=PT_ORU_Control_A_01_E2E}, pdu-collection-timeout=0.005, runtime-ip-address-configuration=NONE, runtime-port-configuration=NONE, short-label=SC_SK_SGW04_03}
              {client-ip-addr-from-connection-request=false, client-port-from-connection-request=false, client-port=SA_Rx_ff14_0000_0000_0000_0000_0000_0000_004a_42557_UDP_4, pdus=socket-connection-ipdu-identifier={header-id=501, pdu-collection-semantics=QUEUED, pdu-collection-trigger=NEVER, pdu-triggering=VLAN_Cockpit/PT_NVEM_12}, pdu-collection-timeout=0.005, runtime-ip-address-configuration=NONE, runtime-port-configuration=NONE, short-label=SC_SK_SGW04_02}
          SCB_SA_Tx_fd53_7cb8_0383_0005_0000_0000_0000_000e_42994_UDP_4: server-port=SA_Tx_fd53_7cb8_0383_0005_0000_0000_0000_000e_42994_UDP_4
            bundled-connections:
              {client-ip-addr-from-connection-request=false, client-port-from-connection-request=false, client-port=SA_Rx_ff14_0000_0000_0000_0000_0000_0000_0051_42557_UDP_4, pdus=[{header-id=1000, pdu-collection-semantics=QUEUED, pdu-collection-trigger=ALWAYS, pdu-triggering=VLAN_Cockpit/PT_FBS_MKGO_01}, {header-id=1001, pdu-collection-semantics=QUEUED, pdu-collection-trigger=ALWAYS, pdu-triggering=VLAN_Cockpit/PT_FBS_MKGO_02}, {header-id=1002, pdu-collection-semantics=QUEUED, pdu-collection-trigger=ALWAYS, pdu-triggering=VLAN_Cockpit/PT_FBS_MKGO_03}, {header-id=1003, pdu-collection-semantics=QUEUED, pdu-collection-trigger=ALWAYS, pdu-triggering=VLAN_Cockpit/PT_FBS_MKGO_04}, {header-id=1004, pdu-collection-semantics=QUEUED, pdu-collection-trigger=ALWAYS, pdu-triggering=VLAN_Cockpit/PT_FBS_MKGO_05}], runtime-ip-address-configuration=NONE, runtime-port-configuration=NONE, short-label=SC_SK_FBS_MKGO}
              {client-ip-addr-from-connection-request=false, client-port-from-connection-request=false, client-port=SA_Rx_ff14_0000_0000_0000_0000_0000_0000_003a_42557_UDP_4, pdus=[{header-id=520, pdu-collection-semantics=QUEUED, pdu-collection-trigger=NEVER, pdu-triggering=PT_CentralLocking_01}, {header-id=506, pdu-collection-semantics=QUEUED, pdu-collection-trigger=NEVER, pdu-triggering=PT_ClampControl_01_E2E}, {header-id=492, pdu-collection-semantics=QUEUED, pdu-collection-trigger=NEVER, pdu-triggering=VLAN_Cockpit/PT_Dimmung_01}, {header-id=515, pdu-collection-semantics=QUEUED, pdu-collection-trigger=NEVER, pdu-triggering=PT_DoorFunctions_BFS_01}, {header-id=516, pdu-collection-semantics=QUEUED, pdu-collection-trigger=NEVER, pdu-triggering=PT_DoorFunctions_FS_01}, {header-id=514, pdu-collection-semantics=QUEUED, pdu-collection-trigger=NEVER, pdu-triggering=PT_DoorFunctions_HBFS_01}, {header-id=517, pdu-collection-semantics=QUEUED, pdu-collection-trigger=NEVER, pdu-triggering=PT_DoorFunctions_HFS_01}, {header-id=912, pdu-collection-semantics=QUEUED, pdu-collection-trigger=NEVER, pdu-triggering=PT_FID_01}, {header-id=500, pdu-collection-semantics=QUEUED, pdu-collection-trigger=NEVER, pdu-triggering=VLAN_Cockpit/PT_KeylessAccess_01}, {header-id=1333, pdu-collection-semantics=QUEUED, pdu-collection-trigger=NEVER, pdu-triggering=VLAN_Cockpit/PT_MDK_02}, {header-id=24, pdu-collection-semantics=QUEUED, pdu-collection-trigger=NEVER, pdu-triggering=VLAN_Cockpit/PT_RLS_01}, {header-id=630, pdu-collection-semantics=QUEUED, pdu-collection-trigger=NEVER, pdu-triggering=PT_STH_01}], pdu-collection-timeout=0.01, runtime-ip-address-configuration=NONE, runtime-port-configuration=NONE, short-label=SC_SK_BCM1_01}
              {client-ip-addr-from-connection-request=false, client-port-from-connection-request=false, client-port=SA_Rx_ff14_0000_0000_0000_0000_0000_0000_002c_42557_UDP_4, pdus=socket-connection-ipdu-identifier={header-id=489, pdu-collection-semantics=QUEUED, pdu-collection-trigger=ALWAYS, pdu-triggering=VLAN_Cockpit/PT_WFS_02_SOK}, runtime-ip-address-configuration=NONE, runtime-port-configuration=NONE, short-label=SC_SK_IMMO_Master}
              {client-ip-addr-from-connection-request=false, client-port-from-connection-request=false, client-port=SA_Rx_ff14_0000_0000_0000_0000_0000_0000_0069_42557_UDP_4, pdus=[{header-id=1411, pdu-collection-semantics=QUEUED, pdu-collection-trigger=NEVER, pdu-triggering=PT_FID_VA_Communication_Init}, {header-id=1242, pdu-collection-semantics=QUEUED, pdu-collection-trigger=NEVER, pdu-triggering=PT_FID_VA_Communication_Init_Ack}, {header-id=1243, pdu-collection-semantics=QUEUED, pdu-collection-trigger=NEVER, pdu-triggering=PT_FID_VA_Response}, {header-id=805, pdu-collection-semantics=QUEUED, pdu-collection-trigger=NEVER, pdu-triggering=VLAN_Cockpit/PT_RLSs_01}, {header-id=874, pdu-collection-semantics=QUEUED, pdu-collection-trigger=NEVER, pdu-triggering=PT_Tankgeber_02}], pdu-collection-timeout=0.01, runtime-ip-address-configuration=NONE, runtime-port-configuration=NONE, short-label=SC_SK_BCM1_03}
          SCB_SA_Tx_fd53_7cb8_0383_0002_0000_0000_0001_0117_42994_UDP_4: socket-connection{client-ip-addr-from-connection-request=false, client-port-from-connection-request=false, client-port=SA_Rx_ff14_0000_0000_0000_0000_0000_0000_0064_42557_UDP_4, pdus=socket-connection-ipdu-identifier={header-id=872, pdu-collection-semantics=QUEUED, pdu-collection-trigger=NEVER, pdu-triggering=PT_ACA_02}, pdu-collection-timeout=0.005, runtime-ip-address-configuration=NONE, runtime-port-configuration=NONE, short-label=SC_SK_SubFas_01}, server-port=SA_Tx_fd53_7cb8_0383_0002_0000_0000_0001_0117_42994_UDP_4
          SCB_SA_Tx_fd53_7cb8_0383_0005_0000_0000_0000_0010_42994_UDP_4: server-port=SA_Tx_fd53_7cb8_0383_0005_0000_0000_0000_0010_42994_UDP_4
            bundled-connections:
              {client-ip-addr-from-connection-request=false, client-port-from-connection-request=false, client-port=SA_Rx_fd53_7cb8_0383_000e_0000_0000_0000_0073_42557_UDP_4, pdus=[{header-id=1141, pdu-collection-semantics=QUEUED, pdu-collection-trigger=ALWAYS, pdu-triggering=PT_FoD_Info_El_Req_SOK}, {header-id=1143, pdu-collection-semantics=QUEUED, pdu-collection-trigger=ALWAYS, pdu-triggering=PT_SOK_FoD_Info_El_Req_Challenge}], runtime-ip-address-configuration=NONE, runtime-port-configuration=NONE, short-label=SC_SK_FoD_Gateway_Info_El_HCP3_IONode}
              {client-ip-addr-from-connection-request=false, client-port-from-connection-request=false, client-port=SA_Rx_ff14_0000_0000_0000_0000_0000_0000_004c_42557_UDP_4, pdus=socket-connection-ipdu-identifier={header-id=3, pdu-collection-semantics=QUEUED, pdu-collection-trigger=NEVER, pdu-triggering=VLAN_Cockpit/PT_Diagnose_01}, pdu-collection-timeout=0.005, runtime-ip-address-configuration=NONE, runtime-port-configuration=NONE, short-label=SC_SK_Gateway_05}
              {client-ip-addr-from-connection-request=false, client-port-from-connection-request=false, client-port=SA_Rx_ff14_0000_0000_0000_0000_0000_0000_003b_42557_UDP_4, pdus=[{header-id=633, pdu-collection-semantics=QUEUED, pdu-collection-trigger=NEVER, pdu-triggering=PT_MFL_01}, {header-id=17, pdu-collection-semantics=QUEUED, pdu-collection-trigger=ALWAYS, pdu-triggering=PT_MFL_Tasten_Konzern}], pdu-collection-timeout=0.003, runtime-ip-address-configuration=NONE, runtime-port-configuration=NONE, short-label=SC_SK_Gateway_01}
              {client-ip-addr-from-connection-request=false, client-port-from-connection-request=false, client-port=SA_Rx_fd53_7cb8_0383_000e_0000_0000_0000_0073_42559_UDP_4, pdus=socket-connection-ipdu-identifier={header-id=1879179379, pdu-collection-semantics=QUEUED, pdu-collection-trigger=ALWAYS, pdu-triggering=PT_SOK_Zeit_Info_El_Resp_01_SOK}, runtime-ip-address-configuration=NONE, runtime-port-configuration=NONE, short-label=SC_SK_SOK_Gateway_Info_El_HCP3_IONode}
              {client-ip-addr-from-connection-request=false, client-port-from-connection-request=false, client-port=SA_Rx_ff14_0000_0000_0000_0000_0000_0000_0071_42559_UDP_4, pdus=socket-connection-ipdu-identifier={header-id=847, pdu-collection-semantics=QUEUED, pdu-collection-trigger=ALWAYS, pdu-triggering=PT_SOK_NoAuthenticTime_01}, runtime-ip-address-configuration=NONE, runtime-port-configuration=NONE, short-label=SC_SK_SOK_Gateway}
          SCB_SA_Tx_fd53_7cb8_0383_0002_0000_0000_0000_00b3_42994_UDP_4: socket-connection{client-ip-addr-from-connection-request=false, client-port-from-connection-request=false, client-port=SA_Rx_ff14_0000_0000_0000_0000_0000_0000_0065_42557_UDP_4, pdus=socket-connection-ipdu-identifier={header-id=1271, pdu-collection-semantics=QUEUED, pdu-collection-trigger=NEVER, pdu-triggering=PT_HWP_01_E2E}, pdu-collection-timeout=0.003, runtime-ip-address-configuration=NONE, runtime-port-configuration=NONE, short-label=SC_SK_mFAS_01}, server-port=SA_Tx_fd53_7cb8_0383_0002_0000_0000_0000_00b3_42994_UDP_4
          SCB_SA_Tx_fd53_7cb8_0383_000e_0000_0000_0000_03aa_42990_UDP_0: server-port=SA_Tx_fd53_7cb8_0383_000e_0000_0000_0000_03aa_42990_UDP_0
            bundled-connections:
              {client-ip-addr-from-connection-request=false, client-port-from-connection-request=false, client-port=SA_Rx_fd53_7cb8_0383_000e_0000_0000_0000_0073_50444_UDP_0, pdus=socket-connection-ipdu-identifier={pdu-collection-semantics=QUEUED, pdu-collection-trigger=NEVER, pdu-triggering=PT_IP_TS_Info_El_CTO_01}, runtime-ip-address-configuration=NONE, runtime-port-configuration=NONE, short-label=SC_IP_TS_Info_El_CTO_01_HCP3_IONode}
              {client-ip-addr-from-connection-request=false, client-port-from-connection-request=false, client-port=SA_Rx_fd53_7cb8_0383_000e_0000_0000_0000_0073_50445_UDP_0, pdus=socket-connection-ipdu-identifier={pdu-collection-semantics=QUEUED, pdu-collection-trigger=NEVER, pdu-triggering=PT_IP_TS_Info_El_DTO_01}, runtime-ip-address-configuration=NONE, runtime-port-configuration=NONE, short-label=SC_IP_TS_Info_El_DTO_01_HCP3_IONode}
              {client-ip-addr-from-connection-request=false, client-port-from-connection-request=false, client-port=SA_Rx_fd53_7cb8_0383_000e_0000_0000_0000_0073_50446_UDP_0, pdus=socket-connection-ipdu-identifier={pdu-collection-semantics=QUEUED, pdu-collection-trigger=NEVER, pdu-triggering=PT_IP_TS_Info_El_DTO_02}, runtime-ip-address-configuration=NONE, runtime-port-configuration=NONE, short-label=SC_IP_TS_Info_El_DTO_02_HCP3_IONode}
              {client-ip-addr-from-connection-request=false, client-port-from-connection-request=false, client-port=SA_Rx_fd53_7cb8_0383_000e_0000_0000_0000_0073_50447_UDP_0, pdus=socket-connection-ipdu-identifier={pdu-collection-semantics=QUEUED, pdu-collection-trigger=NEVER, pdu-triggering=PT_IP_TS_Info_El_DTO_03}, runtime-ip-address-configuration=NONE, runtime-port-configuration=NONE, short-label=SC_IP_TS_Info_El_DTO_03_HCP3_IONode}
              {client-ip-addr-from-connection-request=false, client-port-from-connection-request=false, client-port=SA_Rx_fd53_7cb8_0383_000e_0000_0000_0000_0073_50448_UDP_0, pdus=socket-connection-ipdu-identifier={pdu-collection-semantics=QUEUED, pdu-collection-trigger=NEVER, pdu-triggering=PT_IP_TS_Info_El_DTO_04}, runtime-ip-address-configuration=NONE, runtime-port-configuration=NONE, short-label=SC_IP_TS_Info_El_DTO_04_HCP3_IONode}
          SCB_SA_Tx_fd53_7cb8_0383_0002_0000_0000_0001_01e4_42994_UDP_4: socket-connection{client-ip-addr-from-connection-request=false, client-port-from-connection-request=false, client-port=SA_Rx_ff14_0000_0000_0000_0000_0000_0000_006f_42557_UDP_4, pdus=socket-connection-ipdu-identifier={header-id=1303, pdu-collection-semantics=QUEUED, pdu-collection-trigger=NEVER, pdu-triggering=PT_HWP_02}, pdu-collection-timeout=0.003, runtime-ip-address-configuration=NONE, runtime-port-configuration=NONE, short-label=SC_SK_mFAS_01b}, server-port=SA_Tx_fd53_7cb8_0383_0002_0000_0000_0001_01e4_42994_UDP_4
          SCB_SA_Tx_fd53_7cb8_0383_0004_0000_0000_0001_01e5_42994_UDP_4: socket-connection{client-ip-addr-from-connection-request=false, client-port-from-connection-request=false, client-port=SA_Rx_ff14_0000_0000_0000_0000_0000_0000_0055_42557_UDP_4, pdus=socket-connection-ipdu-identifier={header-id=22, pdu-collection-semantics=QUEUED, pdu-collection-trigger=NEVER, pdu-triggering=VLAN_Cockpit/PT_ORU_01}, pdu-collection-timeout=0.005, runtime-ip-address-configuration=NONE, runtime-port-configuration=NONE, short-label=SC_SK_SGW03_03}, server-port=SA_Tx_fd53_7cb8_0383_0004_0000_0000_0001_01e5_42994_UDP_4
          SCB_SA_Tx_fd53_7cb8_0383_000e_0000_0000_0000_0073_29180_TCP_0: socket-connection{client-ip-addr-from-connection-request=false, client-port-from-connection-request=true, client-port=SA_Rx_fd53_7cb8_0383_0004_0000_0000_0001_01e5_dynamic_TCP_0, pdus=[{header-id=1632977152, pdu-collection-semantics=QUEUED, pdu-collection-trigger=ALWAYS, pdu-triggering=PT_IdsCanSensor_MethodsGet_canSensorFeaturesElement0_XIX_TCPServer_SomeIP_01_Info_El_SGW03_Request, routing-group=SoAdRG_IdsCanSensor_Instance3_Methods}, {header-id=1622540291, pdu-collection-semantics=QUEUED, pdu-collection-trigger=ALWAYS, pdu-triggering=PT_WakeUpMonitorData_Methods_startCycle_XIX_TCPServer_SomeIP_01_Info_El_SGW03_Response, routing-group=SoAdRG_WakeUpMonitorData_Instance3_Methods}, {header-id=1632977152, pdu-collection-semantics=QUEUED, pdu-collection-trigger=ALWAYS, pdu-triggering=PT_IdsCanSensor_MethodsGet_canSensorFeaturesElement0_XIX_TCPServer_SomeIP_01_Info_El_SGW03_Response, routing-group=SoAdRG_IdsCanSensor_Instance3_Methods}, {header-id=1622540291, pdu-collection-semantics=QUEUED, pdu-collection-trigger=ALWAYS, pdu-triggering=PT_WakeUpMonitorData_Methods_startCycle_XIX_TCPServer_SomeIP_01_Info_El_SGW03_Request, routing-group=SoAdRG_WakeUpMonitorData_Instance3_Methods}, {header-id=1622540290, pdu-collection-semantics=QUEUED, pdu-collection-trigger=ALWAYS, pdu-triggering=PT_WakeUpMonitorData_Methods_getTable_XIX_TCPServer_SomeIP_01_Info_El_SGW03_Request, routing-group=SoAdRG_WakeUpMonitorData_Instance3_Methods}, {header-id=1632977155, pdu-collection-semantics=QUEUED, pdu-collection-trigger=ALWAYS, pdu-triggering=PT_IdsCanSensor_Methods_undefineCanSensorFeaturesElement0_XIX_TCPServer_SomeIP_01_Info_El_SGW03_Response, routing-group=SoAdRG_IdsCanSensor_Instance3_Methods}, {header-id=1632977154, pdu-collection-semantics=QUEUED, pdu-collection-trigger=ALWAYS, pdu-triggering=PT_IdsCanSensor_Methods_setCanSensorFeaturesElement0_XIX_TCPServer_SomeIP_01_Info_El_SGW03_Response, routing-group=SoAdRG_IdsCanSensor_Instance3_Methods}, {header-id=1632976896, pdu-collection-semantics=QUEUED, pdu-collection-trigger=ALWAYS, pdu-triggering=PT_IdsCanSensor_MethodsGet_periodicSignalElement0_XIX_TCPServer_SomeIP_01_Info_El_SGW03_Response, routing-group=SoAdRG_IdsCanSensor_Instance3_Methods}, {header-id=1632977154, pdu-collection-semantics=QUEUED, pdu-collection-trigger=ALWAYS, pdu-triggering=PT_IdsCanSensor_Methods_setCanSensorFeaturesElement0_XIX_TCPServer_SomeIP_01_Info_El_SGW03_Request, routing-group=SoAdRG_IdsCanSensor_Instance3_Methods}, {header-id=1633009665, pdu-collection-semantics=QUEUED, pdu-collection-trigger=ALWAYS, pdu-triggering=PT_IdsCanSensor_Events_periodicSignalElement0_XIX_TCPServer_SomeIP_01_Info_El_UC, routing-group=SoAdRG_IdsCanSensor_Instance3_periodicSignalElement0}, {header-id=1632976896, pdu-collection-semantics=QUEUED, pdu-collection-trigger=ALWAYS, pdu-triggering=PT_IdsCanSensor_MethodsGet_periodicSignalElement0_XIX_TCPServer_SomeIP_01_Info_El_SGW03_Request, routing-group=SoAdRG_IdsCanSensor_Instance3_Methods}, {header-id=1622540289, pdu-collection-semantics=QUEUED, pdu-collection-trigger=ALWAYS, pdu-triggering=PT_WakeUpMonitorData_RnRMethods_configuration_XIX_TCPServer_SomeIP_01_Info_El_SGW03, routing-group=SoAdRG_WakeUpMonitorData_Instance3_Methods}, {header-id=1622540290, pdu-collection-semantics=QUEUED, pdu-collection-trigger=ALWAYS, pdu-triggering=PT_WakeUpMonitorData_Methods_getTable_XIX_TCPServer_SomeIP_01_Info_El_SGW03_Response, routing-group=SoAdRG_WakeUpMonitorData_Instance3_Methods}, {header-id=1632977155, pdu-collection-semantics=QUEUED, pdu-collection-trigger=ALWAYS, pdu-triggering=PT_IdsCanSensor_Methods_undefineCanSensorFeaturesElement0_XIX_TCPServer_SomeIP_01_Info_El_SGW03_Request, routing-group=SoAdRG_IdsCanSensor_Instance3_Methods}, {header-id=1633009921, pdu-collection-semantics=QUEUED, pdu-collection-trigger=ALWAYS, pdu-triggering=PT_IdsCanSensor_Events_canSensorFeaturesElement0_XIX_TCPServer_SomeIP_01_Info_El_UC, routing-group=SoAdRG_IdsCanSensor_Instance3_canSensorFeaturesElement0}], runtime-ip-address-configuration=NONE, runtime-port-configuration=NONE, short-label=SC_TCPServer_SomeIP_01_Info_El_SGW03_HCP5_P10_ETHRouter}, server-port=SA_Tx_fd53_7cb8_0383_000e_0000_0000_0000_0073_29180_TCP_0
          SCB_SA_Tx_fd53_7cb8_0383_0003_0000_0000_0000_0130_42994_UDP_4: socket-connection{client-ip-addr-from-connection-request=false, client-port-from-connection-request=false, client-port=SA_Rx_ff14_0000_0000_0000_0000_0000_0000_0005_42557_UDP_4_XIX_SCB_SA_Tx_fd53_7cb8_0383_0003_0000_0000_0000_0130_42994_UDP_4, pdus=socket-connection-ipdu-identifier={header-id=1362103296, pdu-collection-semantics=QUEUED, pdu-collection-trigger=NEVER, pdu-triggering=PT_KN_HCP3Sys03}, runtime-ip-address-configuration=NONE, runtime-port-configuration=NONE, short-label=SC_Architekturinfos_HCP3Sys03_01}, server-port=SA_Tx_fd53_7cb8_0383_0003_0000_0000_0000_0130_42994_UDP_4
          SCB_SA_Tx_fd53_7cb8_0383_000e_0000_0000_0000_0073_50445_TCP_0: socket-connection{client-ip-addr-from-connection-request=false, client-port-from-connection-request=true, client-port=SA_Rx_fd53_7cb8_0383_000e_0000_0000_0000_03aa_dynamic_TCP_0, pdus=socket-connection-ipdu-identifier={pdu-collection-semantics=QUEUED, pdu-collection-trigger=NEVER, pdu-triggering=PT_TCPServer_IP_TS_Info_El_DTO_01}, runtime-ip-address-configuration=NONE, runtime-port-configuration=NONE, short-label=SC_TCPServer_IP_TS_Info_El_DTO_01_TestSysIP}, server-port=SA_Tx_fd53_7cb8_0383_000e_0000_0000_0000_0073_50445_TCP_0
          SCB_SA_Tx_fd53_7cb8_0383_000e_0000_0000_0000_0073_50448_TCP_0: socket-connection{client-ip-addr-from-connection-request=false, client-port-from-connection-request=true, client-port=SA_Rx_fd53_7cb8_0383_000e_0000_0000_0000_03aa_dynamic_TCP_0, pdus=socket-connection-ipdu-identifier={pdu-collection-semantics=QUEUED, pdu-collection-trigger=NEVER, pdu-triggering=PT_TCPServer_IP_TS_Info_El_DTO_04}, runtime-ip-address-configuration=NONE, runtime-port-configuration=NONE, short-label=SC_TCPServer_IP_TS_Info_El_DTO_04_TestSysIP}, server-port=SA_Tx_fd53_7cb8_0383_000e_0000_0000_0000_0073_50448_TCP_0
          SCB_SA_Tx_fd53_7cb8_0383_000e_0000_0000_0000_0073_50447_TCP_0: socket-connection{client-ip-addr-from-connection-request=false, client-port-from-connection-request=true, client-port=SA_Rx_fd53_7cb8_0383_000e_0000_0000_0000_03aa_dynamic_TCP_0, pdus=socket-connection-ipdu-identifier={pdu-collection-semantics=QUEUED, pdu-collection-trigger=NEVER, pdu-triggering=PT_TCPServer_IP_TS_Info_El_DTO_03}, runtime-ip-address-configuration=NONE, runtime-port-configuration=NONE, short-label=SC_TCPServer_IP_TS_Info_El_DTO_03_TestSysIP}, server-port=SA_Tx_fd53_7cb8_0383_000e_0000_0000_0000_0073_50447_TCP_0
          SCB_SA_Tx_fd53_7cb8_0383_000e_0000_0000_0000_0073_50446_TCP_0: socket-connection{client-ip-addr-from-connection-request=false, client-port-from-connection-request=true, client-port=SA_Rx_fd53_7cb8_0383_000e_0000_0000_0000_03aa_dynamic_TCP_0, pdus=socket-connection-ipdu-identifier={pdu-collection-semantics=QUEUED, pdu-collection-trigger=NEVER, pdu-triggering=PT_TCPServer_IP_TS_Info_El_DTO_02}, runtime-ip-address-configuration=NONE, runtime-port-configuration=NONE, short-label=SC_TCPServer_IP_TS_Info_El_DTO_02_TestSysIP}, server-port=SA_Tx_fd53_7cb8_0383_000e_0000_0000_0000_0073_50446_TCP_0
          SCB_SA_Tx_fd53_7cb8_0383_000e_0000_0000_0000_0073_42810_UDP_3: socket-connection{client-ip-addr-from-connection-request=false, client-port-from-connection-request=false, client-port=SA_Rx_fd53_7cb8_0383_0004_0000_0000_0001_01e5_42991_UDP_3, pdus=socket-connection-ipdu-identifier={header-id=1645445121, pdu-collection-semantics=QUEUED, pdu-collection-trigger=ALWAYS, pdu-triggering=PT_IDSSecurityEventSmall_Events_securityEvent_XIX_SomeIP_ServiceProvider_01_Info_El_UC, routing-group=SoAdRG_IDSSecurityEventSmall_Instance3_securityEvent}, pdu-collection-max-buffer-size=1452, runtime-ip-address-configuration=NONE, runtime-port-configuration=NONE, short-label=SC_SomeIP_ServiceProvider_01_Info_El_SGW03_UC_HCP5_P10_ETHRouter}, server-port=SA_Tx_fd53_7cb8_0383_000e_0000_0000_0000_0073_42810_UDP_3
          SCB_SDUnicast_HCP3_IONode: socket-connection{client-ip-addr-from-connection-request=true, client-port-from-connection-request=true, client-port=SA_SDANY, pdus=[{header-id=4294934784, pdu-collection-semantics=QUEUED, pdu-collection-trigger=ALWAYS, pdu-triggering=PT_ServiceDiscoveryRxUnicast_XIX_HCP3_IONode}, {header-id=4294934784, pdu-collection-semantics=QUEUED, pdu-collection-trigger=ALWAYS, pdu-triggering=PT_ServiceDiscoveryTx_XIX_HCP3_IONode}]}, server-port=SA_SDUnicast_HCP3_IONode
          SCB_SDMulticast_HCP3_IONode: socket-connection{client-ip-addr-from-connection-request=true, client-port-from-connection-request=true, client-port=SA_SDANY, pdus=socket-connection-ipdu-identifier={header-id=4294934784, pdu-collection-semantics=QUEUED, pdu-collection-trigger=ALWAYS, pdu-triggering=PT_ServiceDiscoveryRxMulticast_XIX_HCP3_IONode}}, server-port=SA_SDMulticast
          SCB_SSOAMulticast_Info_El: socket-connection{client-ip-addr-from-connection-request=false, client-port-from-connection-request=false, client-port=SA_SSOAMulticast_SCB_SSOA_Info_El, pdus=socket-connection-ipdu-identifier={pdu-collection-semantics=QUEUED, pdu-collection-trigger=ALWAYS, pdu-triggering=PT_SSOA_Info_El_Multicast}, short-label=SC_SSOA_Info_El_Multicast}, server-port=SA_SSOAMulticast_Info_El
          SCB_SSOAUnicast_Info_El: server-port=SA_SSOAUnicast_Info_El
            bundled-connections:
              {client-ip-addr-from-connection-request=false, client-port-from-connection-request=false, client-port=SA_SSOAUnicast_Gateway_dynamic, pdus=[{pdu-collection-semantics=QUEUED, pdu-collection-trigger=ALWAYS, pdu-triggering=PT_TCPServer_SSOA_Info_El_Gateway}, {pdu-collection-semantics=QUEUED, pdu-collection-trigger=ALWAYS, pdu-triggering=PT_TCPClient_SSOA_Gateway_Info_El}], short-label=SC_SSOA_Info_El_Gateway}
              {client-ip-addr-from-connection-request=false, client-port-from-connection-request=false, client-port=SA_SSOAUnicast_SGW03_dynamic, pdus=[{pdu-collection-semantics=QUEUED, pdu-collection-trigger=ALWAYS, pdu-triggering=PT_TCPServer_SSOA_Info_El_SGW03}, {pdu-collection-semantics=QUEUED, pdu-collection-trigger=ALWAYS, pdu-triggering=PT_TCPClient_SSOA_SGW03_Info_El}], short-label=SC_SSOA_Info_El_SGW03}
          SCB_SA_Tx_fd53_7cb8_0383_0004_0000_0000_0000_0107_13400_UDP_0: socket-connection{client-ip-addr-from-connection-request=false, client-port-from-connection-request=false, client-port=SA_Rx_ff02_0000_0000_0000_0000_0000_0000_0001_13400_UDP_0, pdus=socket-connection-ipdu-identifier={pdu-collection-semantics=QUEUED, pdu-collection-trigger=NEVER, pdu-triggering=PT_DoIP_Gateway_MC}, runtime-ip-address-configuration=NONE, runtime-port-configuration=NONE, short-label=SC_DoIP_Gateway_MC}, server-port=SA_Tx_fd53_7cb8_0383_0004_0000_0000_0000_0107_13400_UDP_0
        76 x socket address:
          SA_Tx_fd53_7cb8_0383_0002_0000_0000_0000_010f_42994_UDP_4
            application endpoint AE_42994_UDP: network-endpoint=NE_fd53_7cb8_0383_0002_0000_0000_0000_010f, priority=4, tp-configuration=udp-tp=udp-tp-port={dynamically-assigned=false, port-number=42994}
          SA_Rx_ff14_0000_0000_0000_0000_0000_0000_0061_42557_UDP_4: multicast-connector=CN_VLAN_Cockpit
            application endpoint AE_42557_UDP: network-endpoint=NE_ff14_0000_0000_0000_0000_0000_0000_0061, priority=4, tp-configuration=udp-tp=udp-tp-port={dynamically-assigned=false, port-number=42557}
          SA_Rx_fd53_7cb8_0383_000e_0000_0000_0000_0073_13400_UDP_0: connector=CN_VLAN_Cockpit
            application endpoint AE_13400_UDP: network-endpoint=NE_fd53_7cb8_0383_000e_0000_0000_0000_0073, priority=0, tp-configuration=udp-tp=udp-tp-port={dynamically-assigned=false, port-number=13400}
          SA_Tx_fd53_7cb8_0383_0004_0000_0000_0000_0107_dynamic_UDP_0
            application endpoint AE_dynamic_UDP: network-endpoint=NE_fd53_7cb8_0383_0004_0000_0000_0000_0107, priority=0, tp-configuration=udp-tp=udp-tp-port=dynamically-assigned=true
          SA_Tx_fd53_7cb8_0383_000e_0000_0000_0000_0073_13400_TCP_0: connector=CN_VLAN_Cockpit
            application endpoint AE_13400_TCP: network-endpoint=NE_fd53_7cb8_0383_000e_0000_0000_0000_0073, priority=0, tp-configuration=tcp-tp={keep-alives=false, nagles-algorithm=false, tcp-tp-port={dynamically-assigned=false, port-number=13400}}
          SA_Rx_fd53_7cb8_0383_0004_0000_0000_0000_0107_dynamic_TCP_0
            application endpoint AE_dynamic_TCP: network-endpoint=NE_fd53_7cb8_0383_0004_0000_0000_0000_0107, priority=0, tp-configuration=tcp-tp={keep-alives=false, nagles-algorithm=false, tcp-tp-port=dynamically-assigned=true}
          SA_Tx_ff02_0000_0000_0000_0000_0000_0000_0001_13400_UDP_0
            application endpoint AE_13400_UDP: network-endpoint=NE_ff02_0000_0000_0000_0000_0000_0000_0001, priority=0, tp-configuration=udp-tp=udp-tp-port={dynamically-assigned=false, port-number=13400}
          SA_Tx_fd53_7cb8_0383_000e_0000_0000_0000_0073_42994_UDP_4: connector=CN_VLAN_Cockpit
            application endpoint AE_42994_UDP: network-endpoint=NE_fd53_7cb8_0383_000e_0000_0000_0000_0073, priority=4, tp-configuration=udp-tp=udp-tp-port={dynamically-assigned=false, port-number=42994}
          SA_Rx_ff14_0000_0000_0000_0000_0000_0000_0005_42557_UDP_4: multicast-connector=CN_VLAN_Cockpit
            application endpoint AE_42557_UDP: network-endpoint=NE_ff14_0000_0000_0000_0000_0000_0000_0005, priority=4, tp-configuration=udp-tp=udp-tp-port={dynamically-assigned=false, port-number=42557}
          SA_Tx_fd53_7cb8_0383_0005_0000_0000_0000_0010_42810_UDP_3
            application endpoint AE_42810_UDP: network-endpoint=NE_fd53_7cb8_0383_0005_0000_0000_0000_0010, priority=3, tp-configuration=udp-tp=udp-tp-port={dynamically-assigned=false, port-number=42810}
              provided service instance ProvSI_WakeupclusterConfiguration_Instance1_XIX_HCP5_P1_Gateway:
                routing-group=SoAdRG_WakeupclusterConfiguration_Instance1_Methods
                instance-identifier=1
                sd-server-config={initial-offer-behavior={initial-delay-max-value=0.0, initial-delay-min-value=0.0, initial-repetitions-base-delay=0.1, initial-repetitions-max=3}, offer-cyclic-delay=1.0, request-response-delay={max-value=0.0, min-value=0.0}, server-service-major-version=3, server-service-minor-version=0, ttl=3}
                service-identifier=25080
                event handler configurationsEvent: application-endpoint=SA_Tx_fd53_7cb8_0383_0005_0000_0000_0000_0010_42810_UDP_3/AE_42810_UDP, consumed-event-group=configurationsEvent, multicast-threshold=0, routing-group=SoAdRG_WakeupclusterConfiguration_Instance1_configurationsEvent, sd-server-config={request-response-delay={max-value=0.0, min-value=0.0}, ttl=3}
          SA_Rx_fd53_7cb8_0383_000e_0000_0000_0000_0073_42991_UDP_3: connector=CN_VLAN_Cockpit
            application endpoint AE_42991_UDP: network-endpoint=NE_fd53_7cb8_0383_000e_0000_0000_0000_0073, priority=3, tp-configuration=udp-tp=udp-tp-port={dynamically-assigned=false, port-number=42991}
              consumed service instance ConsSI_SOMEIPTestabilityClient_XIX_HCP3_IONode: routing-group=SoAdRG_SOMEIPTestabilityClient_Instance65534_Methods, provided-service-instance=ProvSI_SOMEIPTestabilityClient_Instance65534_XIX_TestSysIP, sd-client-config={client-service-major-version=1, client-service-minor-version=0xFFFFFFFF, initial-find-behavior={initial-delay-max-value=0.0, initial-delay-min-value=0.0, initial-repetitions-base-delay=0.1, initial-repetitions-max=3}, ttl=0xFFFFFF}
                consumed event group TestFieldUInt8: application-endpoint=SA_Rx_fd53_7cb8_0383_000e_0000_0000_0000_0073_42991_UDP_3/AE_42991_UDP, event-group-identifier=40966, routing-group=SoAdRG_SOMEIPTestabilityClient_Instance65534_TestFieldUInt8, sd-client-config={request-response-delay={max-value=0.0, min-value=0.0}, ttl=3}
                consumed event group testEventUInt8: application-endpoint=SA_Rx_fd53_7cb8_0383_000e_0000_0000_0000_0073_42991_UDP_3/AE_42991_UDP, event-group-identifier=32782, routing-group=SoAdRG_SOMEIPTestabilityClient_Instance65534_testEventUInt8, sd-client-config={request-response-delay={max-value=0.0, min-value=0.0}, ttl=3}
              consumed service instance ConsSI_WakeupclusterConfiguration_XIX_HCP3_IONode:
                routing-group=SoAdRG_WakeupclusterConfiguration_Instance1_Methods
                provided-service-instance=ProvSI_WakeupclusterConfiguration_Instance1_XIX_HCP5_P1_Gateway
                sd-client-config={client-service-major-version=3, client-service-minor-version=0xFFFFFFFF, initial-find-behavior={initial-delay-max-value=0.0, initial-delay-min-value=0.0, initial-repetitions-base-delay=0.1, initial-repetitions-max=3}, ttl=0xFFFFFF}
                consumed event group configurationsEvent: application-endpoint=SA_Rx_fd53_7cb8_0383_000e_0000_0000_0000_0073_42991_UDP_3/AE_42991_UDP, event-group-identifier=49280, routing-group=SoAdRG_WakeupclusterConfiguration_Instance1_configurationsEvent, sd-client-config={request-response-delay={max-value=0.0, min-value=0.0}, ttl=3}
          SA_Tx_fd53_7cb8_0383_000e_0000_0000_0000_006f_42994_UDP_4
            application endpoint AE_42994_UDP: network-endpoint=NE_fd53_7cb8_0383_000e_0000_0000_0000_006f, priority=4, tp-configuration=udp-tp=udp-tp-port={dynamically-assigned=false, port-number=42994}
          SA_Tx_fd53_7cb8_0383_000e_0000_0000_0000_03aa_30500_UDP_3
            application endpoint AE_30500_UDP: network-endpoint=NE_fd53_7cb8_0383_000e_0000_0000_0000_03aa, priority=3, tp-configuration=udp-tp=udp-tp-port={dynamically-assigned=false, port-number=30500}
              provided service instance ProvSI_SOMEIPTestabilityClient_Instance65534_XIX_TestSysIP:
                routing-group=SoAdRG_SOMEIPTestabilityClient_Instance65534_Methods
                instance-identifier=65534
                sd-server-config={initial-offer-behavior={initial-delay-max-value=0.0, initial-delay-min-value=0.0, initial-repetitions-base-delay=0.1, initial-repetitions-max=3}, offer-cyclic-delay=1.0, request-response-delay={max-value=0.0, min-value=0.0}, server-service-major-version=1, server-service-minor-version=6, ttl=3}
                service-identifier=65296
                event handler TestFieldUInt8: application-endpoint=AE_30500_UDP, consumed-event-group=ConsSI_SOMEIPTestabilityClient_XIX_HCP3_IONode/TestFieldUInt8, multicast-threshold=0, routing-group=SoAdRG_SOMEIPTestabilityClient_Instance65534_TestFieldUInt8, sd-server-config={request-response-delay={max-value=0.0, min-value=0.0}, ttl=3}
                event handler testEventUInt8: application-endpoint=AE_30500_UDP, consumed-event-group=ConsSI_SOMEIPTestabilityClient_XIX_HCP3_IONode/testEventUInt8, multicast-threshold=0, routing-group=SoAdRG_SOMEIPTestabilityClient_Instance65534_testEventUInt8, sd-server-config={request-response-delay={max-value=0.0, min-value=0.0}, ttl=3}
          SA_Tx_fd53_7cb8_0383_000e_0000_0000_0000_0108_42994_UDP_4
            application endpoint AE_42994_UDP: network-endpoint=NE_fd53_7cb8_0383_000e_0000_0000_0000_0108, priority=4, tp-configuration=udp-tp=udp-tp-port={dynamically-assigned=false, port-number=42994}
          SA_Tx_fd53_7cb8_0383_000e_0000_0000_0000_0073_30601_TCP_0: connector=CN_VLAN_Cockpit
            application endpoint AE_30601_TCP: network-endpoint=NE_fd53_7cb8_0383_000e_0000_0000_0000_0073, priority=0, tp-configuration=tcp-tp={keep-alives=false, nagles-algorithm=false, tcp-tp-port={dynamically-assigned=false, port-number=30601}}
              provided service instance ProvSI_SOMEIPTestabilityReliable_Instance1_XIX_HCP3_IONode:
                routing-group=SoAdRG_SOMEIPTestabilityReliable_Instance1_Methods
                instance-identifier=1
                sd-server-config={initial-offer-behavior={initial-delay-max-value=0.0, initial-delay-min-value=0.0, initial-repetitions-base-delay=0.1, initial-repetitions-max=3}, offer-cyclic-delay=1.0, request-response-delay={max-value=0.0, min-value=0.0}, server-service-major-version=1, server-service-minor-version=6, ttl=3}
                service-identifier=65283
                4 x event handler, all with application-endpoint=AE_30601_TCP, multicast-threshold=0, sd-server-config={request-response-delay={max-value=0.0, min-value=0.0}, ttl=3}:
                  TestFieldUInt64: consumed-event-group=TestFieldUInt64, routing-group=SoAdRG_SOMEIPTestabilityReliable_Instance1_TestFieldUInt64
                  testEventUInt8: consumed-event-group=ConsSI_SOMEIPTestabilityReliable_Instance1_XIX_TestSysIP/testEventUInt8, routing-group=SoAdRG_SOMEIPTestabilityReliable_Instance1_testEventUInt8
                  TestFieldComplexStruct: consumed-event-group=TestFieldComplexStruct, routing-group=SoAdRG_SOMEIPTestabilityReliable_Instance1_TestFieldComplexStruct
                  TestFieldUInt8: consumed-event-group=ConsSI_SOMEIPTestabilityReliable_Instance1_XIX_TestSysIP/TestFieldUInt8, routing-group=SoAdRG_SOMEIPTestabilityReliable_Instance1_TestFieldUInt8
          SA_Rx_fd53_7cb8_0383_000e_0000_0000_0000_03aa_dynamic_TCP_0
            application endpoint AE_dynamic_TCP: network-endpoint=NE_fd53_7cb8_0383_000e_0000_0000_0000_03aa, priority=0, tp-configuration=tcp-tp={keep-alives=false, nagles-algorithm=false, tcp-tp-port=dynamically-assigned=true}
              consumed service instance ConsSI_SOMEIPTestabilityReliable_Instance1_XIX_TestSysIP: routing-group=SoAdRG_SOMEIPTestabilityReliable_Instance1_Methods, provided-service-instance=ProvSI_SOMEIPTestabilityReliable_Instance1_XIX_HCP3_IONode, sd-client-config={client-service-major-version=1, client-service-minor-version=0xFFFFFFFF, initial-find-behavior={initial-delay-max-value=0.0, initial-delay-min-value=0.0, initial-repetitions-base-delay=0.1, initial-repetitions-max=3}, ttl=0xFFFFFF}
                4 x consumed event group, all with application-endpoint=SA_Rx_fd53_7cb8_0383_000e_0000_0000_0000_03aa_dynamic_TCP_0/AE_dynamic_TCP, sd-client-config={request-response-delay={max-value=0.0, min-value=0.0}, ttl=3}:
                  TestFieldUInt64: event-group-identifier=40966, routing-group=SoAdRG_SOMEIPTestabilityReliable_Instance1_TestFieldUInt64
                  testEventUInt8: event-group-identifier=32768, routing-group=SoAdRG_SOMEIPTestabilityReliable_Instance1_testEventUInt8
                  TestFieldComplexStruct: event-group-identifier=40970, routing-group=SoAdRG_SOMEIPTestabilityReliable_Instance1_TestFieldComplexStruct
                  TestFieldUInt8: event-group-identifier=40962, routing-group=SoAdRG_SOMEIPTestabilityReliable_Instance1_TestFieldUInt8
          SA_Rx_ff14_0000_0000_0000_0000_0000_0000_0062_42557_UDP_4: multicast-connector=CN_VLAN_Cockpit
            application endpoint AE_42557_UDP: network-endpoint=NE_ff14_0000_0000_0000_0000_0000_0000_0062, priority=4, tp-configuration=udp-tp=udp-tp-port={dynamically-assigned=false, port-number=42557}
          SA_Tx_fd53_7cb8_0383_0005_0000_0000_0000_0114_42994_UDP_4
            application endpoint AE_42994_UDP: network-endpoint=NE_fd53_7cb8_0383_0005_0000_0000_0000_0114, priority=4, tp-configuration=udp-tp=udp-tp-port={dynamically-assigned=false, port-number=42994}
          SA_Rx_ff14_0000_0000_0000_0000_0000_0000_003f_42557_UDP_4: multicast-connector=CN_VLAN_Cockpit
            application endpoint AE_42557_UDP: network-endpoint=NE_ff14_0000_0000_0000_0000_0000_0000_003f, priority=4, tp-configuration=udp-tp=udp-tp-port={dynamically-assigned=false, port-number=42557}
          SA_Rx_ff14_0000_0000_0000_0000_0000_0000_0067_42557_UDP_4
            application endpoint AE_42557_UDP: network-endpoint=NE_ff14_0000_0000_0000_0000_0000_0000_0067, priority=4, tp-configuration=udp-tp=udp-tp-port={dynamically-assigned=false, port-number=42557}
          SA_Rx_ff14_0000_0000_0000_0000_0000_0000_0001_42557_UDP_4
            application endpoint AE_42557_UDP: network-endpoint=NE_ff14_0000_0000_0000_0000_0000_0000_0001, priority=4, tp-configuration=udp-tp=udp-tp-port={dynamically-assigned=false, port-number=42557}
          SA_Tx_fd53_7cb8_0383_0005_0000_0000_0001_01e6_42994_UDP_4
            application endpoint AE_42994_UDP: network-endpoint=NE_fd53_7cb8_0383_0005_0000_0000_0001_01e6, priority=4, tp-configuration=udp-tp=udp-tp-port={dynamically-assigned=false, port-number=42994}
          SA_Rx_ff14_0000_0000_0000_0000_0000_0000_004b_42557_UDP_4: multicast-connector=CN_VLAN_Cockpit
            application endpoint AE_42557_UDP: network-endpoint=NE_ff14_0000_0000_0000_0000_0000_0000_004b, priority=4, tp-configuration=udp-tp=udp-tp-port={dynamically-assigned=false, port-number=42557}
          SA_Tx_fd53_7cb8_0383_0005_0000_0000_0000_000e_42994_UDP_4
            application endpoint AE_42994_UDP: network-endpoint=NE_fd53_7cb8_0383_0005_0000_0000_0000_000e, priority=4, tp-configuration=udp-tp=udp-tp-port={dynamically-assigned=false, port-number=42994}
          SA_Rx_ff14_0000_0000_0000_0000_0000_0000_0051_42557_UDP_4: multicast-connector=CN_VLAN_Cockpit
            application endpoint AE_42557_UDP: network-endpoint=NE_ff14_0000_0000_0000_0000_0000_0000_0051, priority=4, tp-configuration=udp-tp=udp-tp-port={dynamically-assigned=false, port-number=42557}
          SA_Rx_ff14_0000_0000_0000_0000_0000_0000_0052_42557_UDP_4
            application endpoint AE_42557_UDP: network-endpoint=NE_ff14_0000_0000_0000_0000_0000_0000_0052, priority=4, tp-configuration=udp-tp=udp-tp-port={dynamically-assigned=false, port-number=42557}
          SA_Rx_ff14_0000_0000_0000_0000_0000_0000_003a_42557_UDP_4: multicast-connector=CN_VLAN_Cockpit
            application endpoint AE_42557_UDP: network-endpoint=NE_ff14_0000_0000_0000_0000_0000_0000_003a, priority=4, tp-configuration=udp-tp=udp-tp-port={dynamically-assigned=false, port-number=42557}
          SA_Rx_ff14_0000_0000_0000_0000_0000_0000_0063_42557_UDP_4: multicast-connector=CN_VLAN_Cockpit
            application endpoint AE_42557_UDP: network-endpoint=NE_ff14_0000_0000_0000_0000_0000_0000_0063, priority=4, tp-configuration=udp-tp=udp-tp-port={dynamically-assigned=false, port-number=42557}
          SA_Rx_ff14_0000_0000_0000_0000_0000_0000_002c_42557_UDP_4: multicast-connector=CN_VLAN_Cockpit
            application endpoint AE_42557_UDP: network-endpoint=NE_ff14_0000_0000_0000_0000_0000_0000_002c, priority=4, tp-configuration=udp-tp=udp-tp-port={dynamically-assigned=false, port-number=42557}
          SA_Tx_fd53_7cb8_0383_0002_0000_0000_0001_0117_42994_UDP_4
            application endpoint AE_42994_UDP: network-endpoint=NE_fd53_7cb8_0383_0002_0000_0000_0001_0117, priority=4, tp-configuration=udp-tp=udp-tp-port={dynamically-assigned=false, port-number=42994}
          SA_Rx_ff14_0000_0000_0000_0000_0000_0000_0064_42557_UDP_4: multicast-connector=CN_VLAN_Cockpit
            application endpoint AE_42557_UDP: network-endpoint=NE_ff14_0000_0000_0000_0000_0000_0000_0064, priority=4, tp-configuration=udp-tp=udp-tp-port={dynamically-assigned=false, port-number=42557}
          SA_Rx_fd53_7cb8_0383_0004_0000_0000_0001_01e5_dynamic_TCP_0
            application endpoint AE_dynamic_TCP: network-endpoint=NE_fd53_7cb8_0383_0004_0000_0000_0001_01e5, priority=0, tp-configuration=tcp-tp={keep-alives=false, nagles-algorithm=false, tcp-tp-port=dynamically-assigned=true}
              consumed service instance ConsSI_IdsCanSensor_Instance3_XIX_HCP5_P4_E3SWPAC: routing-group=SoAdRG_IdsCanSensor_Instance3_Methods, provided-service-instance=ProvSI_IdsCanSensor_Instance3_XIX_HCP3_IONode, sd-client-config={client-service-major-version=3, client-service-minor-version=0xFFFFFFFF, initial-find-behavior={initial-delay-max-value=0.0, initial-delay-min-value=0.0, initial-repetitions-base-delay=0.1, initial-repetitions-max=3}, ttl=0xFFFFFF}
                consumed event group periodicSignalElement0: application-endpoint=SA_Rx_fd53_7cb8_0383_0004_0000_0000_0001_01e5_dynamic_TCP_0/AE_dynamic_TCP, event-group-identifier=49153, routing-group=SoAdRG_IdsCanSensor_Instance3_periodicSignalElement0, sd-client-config={request-response-delay={max-value=0.0, min-value=0.0}, ttl=3}
                consumed event group canSensorFeaturesElement0: application-endpoint=SA_Rx_fd53_7cb8_0383_0004_0000_0000_0001_01e5_dynamic_TCP_0/AE_dynamic_TCP, event-group-identifier=49409, routing-group=SoAdRG_IdsCanSensor_Instance3_canSensorFeaturesElement0, sd-client-config={request-response-delay={max-value=0.0, min-value=0.0}, ttl=3}
              consumed service instance ConsSI_WakeUpMonitorData_Instance3_XIX_HCP5_P4_E3SWPAC: routing-group=SoAdRG_WakeUpMonitorData_Instance3_Methods, provided-service-instance=ProvSI_WakeUpMonitorData_Instance3_XIX_HCP3_IONode, sd-client-config={client-service-major-version=2, client-service-minor-version=0xFFFFFFFF, initial-find-behavior={initial-delay-max-value=0.0, initial-delay-min-value=0.0, initial-repetitions-base-delay=0.1, initial-repetitions-max=3}, ttl=0xFFFFFF}
          SA_Tx_fd53_7cb8_0383_0005_0000_0000_0000_0010_42994_UDP_4
            application endpoint AE_42994_UDP: network-endpoint=NE_fd53_7cb8_0383_0005_0000_0000_0000_0010, priority=4, tp-configuration=udp-tp=udp-tp-port={dynamically-assigned=false, port-number=42994}
          SA_Tx_fd53_7cb8_0383_0002_0000_0000_0000_00b3_42994_UDP_4
            application endpoint AE_42994_UDP: network-endpoint=NE_fd53_7cb8_0383_0002_0000_0000_0000_00b3, priority=4, tp-configuration=udp-tp=udp-tp-port={dynamically-assigned=false, port-number=42994}
          SA_Rx_ff14_0000_0000_0000_0000_0000_0000_0065_42557_UDP_4: multicast-connector=CN_VLAN_Cockpit
            application endpoint AE_42557_UDP: network-endpoint=NE_ff14_0000_0000_0000_0000_0000_0000_0065, priority=4, tp-configuration=udp-tp=udp-tp-port={dynamically-assigned=false, port-number=42557}
          SA_Rx_fd53_7cb8_0383_0004_0000_0000_0001_01e5_42991_UDP_3
            application endpoint AE_42991_UDP: network-endpoint=NE_fd53_7cb8_0383_0004_0000_0000_0001_01e5, priority=3, tp-configuration=udp-tp=udp-tp-port={dynamically-assigned=false, port-number=42991}
              consumed service instance ConsSI_IDSSecurityEventSmall_Instance3_XIX_HCP5_P4_E3SWPAC: provided-service-instance=ProvSI_IDSSecurityEventSmall_Instance3_XIX_HCP3_IONode, sd-client-config={client-service-major-version=1, client-service-minor-version=0xFFFFFFFF, initial-find-behavior={initial-delay-max-value=0.0, initial-delay-min-value=0.0, initial-repetitions-base-delay=0.1, initial-repetitions-max=3}, ttl=0xFFFFFF}
                consumed event group securityEvent: application-endpoint=SA_Rx_fd53_7cb8_0383_0004_0000_0000_0001_01e5_42991_UDP_3/AE_42991_UDP, event-group-identifier=32769, routing-group=SoAdRG_IDSSecurityEventSmall_Instance3_securityEvent, sd-client-config={request-response-delay={max-value=0.0, min-value=0.0}, ttl=3}
          SA_Tx_fd53_7cb8_0383_000e_0000_0000_0000_03aa_42990_UDP_0
            application endpoint AE_42990_UDP: network-endpoint=NE_fd53_7cb8_0383_000e_0000_0000_0000_03aa, priority=0, tp-configuration=udp-tp=udp-tp-port={dynamically-assigned=false, port-number=42990}
          SA_Rx_fd53_7cb8_0383_000e_0000_0000_0000_0073_50444_UDP_0: connector=CN_VLAN_Cockpit
            application endpoint AE_50444_UDP: network-endpoint=NE_fd53_7cb8_0383_000e_0000_0000_0000_0073, priority=0, tp-configuration=udp-tp=udp-tp-port={dynamically-assigned=false, port-number=50444}
          SA_Rx_fd53_7cb8_0383_000e_0000_0000_0000_0073_50445_UDP_0: connector=CN_VLAN_Cockpit
            application endpoint AE_50445_UDP: network-endpoint=NE_fd53_7cb8_0383_000e_0000_0000_0000_0073, priority=0, tp-configuration=udp-tp=udp-tp-port={dynamically-assigned=false, port-number=50445}
          SA_Rx_fd53_7cb8_0383_000e_0000_0000_0000_0073_50446_UDP_0: connector=CN_VLAN_Cockpit
            application endpoint AE_50446_UDP: network-endpoint=NE_fd53_7cb8_0383_000e_0000_0000_0000_0073, priority=0, tp-configuration=udp-tp=udp-tp-port={dynamically-assigned=false, port-number=50446}
          SA_Rx_fd53_7cb8_0383_000e_0000_0000_0000_0073_50447_UDP_0: connector=CN_VLAN_Cockpit
            application endpoint AE_50447_UDP: network-endpoint=NE_fd53_7cb8_0383_000e_0000_0000_0000_0073, priority=0, tp-configuration=udp-tp=udp-tp-port={dynamically-assigned=false, port-number=50447}
          SA_Rx_fd53_7cb8_0383_000e_0000_0000_0000_0073_50448_UDP_0: connector=CN_VLAN_Cockpit
            application endpoint AE_50448_UDP: network-endpoint=NE_fd53_7cb8_0383_000e_0000_0000_0000_0073, priority=0, tp-configuration=udp-tp=udp-tp-port={dynamically-assigned=false, port-number=50448}
          SA_Rx_ff14_0000_0000_0000_0000_0000_0000_0069_42557_UDP_4: multicast-connector=CN_VLAN_Cockpit
            application endpoint AE_42557_UDP: network-endpoint=NE_ff14_0000_0000_0000_0000_0000_0000_0069, priority=4, tp-configuration=udp-tp=udp-tp-port={dynamically-assigned=false, port-number=42557}
          SA_Tx_fd53_7cb8_0383_0002_0000_0000_0001_01e4_42994_UDP_4
            application endpoint AE_42994_UDP: network-endpoint=NE_fd53_7cb8_0383_0002_0000_0000_0001_01e4, priority=4, tp-configuration=udp-tp=udp-tp-port={dynamically-assigned=false, port-number=42994}
          SA_Rx_ff14_0000_0000_0000_0000_0000_0000_006f_42557_UDP_4: multicast-connector=CN_VLAN_Cockpit
            application endpoint AE_42557_UDP: network-endpoint=NE_ff14_0000_0000_0000_0000_0000_0000_006f, priority=4, tp-configuration=udp-tp=udp-tp-port={dynamically-assigned=false, port-number=42557}
          SA_Rx_fd53_7cb8_0383_000e_0000_0000_0000_0073_42557_UDP_4: connector=CN_VLAN_Cockpit
            application endpoint AE_42557_UDP: network-endpoint=NE_fd53_7cb8_0383_000e_0000_0000_0000_0073, priority=4, tp-configuration=udp-tp=udp-tp-port={dynamically-assigned=false, port-number=42557}
          SA_Rx_fd53_7cb8_0383_0005_0000_0000_0000_0010_42557_UDP_4
            application endpoint AE_42557_UDP: network-endpoint=NE_fd53_7cb8_0383_0005_0000_0000_0000_0010, priority=4, tp-configuration=udp-tp=udp-tp-port={dynamically-assigned=false, port-number=42557}
          SA_Rx_ff14_0000_0000_0000_0000_0000_0000_004a_42557_UDP_4: multicast-connector=CN_VLAN_Cockpit
            application endpoint AE_42557_UDP: network-endpoint=NE_ff14_0000_0000_0000_0000_0000_0000_004a, priority=4, tp-configuration=udp-tp=udp-tp-port={dynamically-assigned=false, port-number=42557}
          SA_Rx_ff14_0000_0000_0000_0000_0000_0000_004c_42557_UDP_4: multicast-connector=CN_VLAN_Cockpit
            application endpoint AE_42557_UDP: network-endpoint=NE_ff14_0000_0000_0000_0000_0000_0000_004c, priority=4, tp-configuration=udp-tp=udp-tp-port={dynamically-assigned=false, port-number=42557}
          SA_Rx_ff14_0000_0000_0000_0000_0000_0000_003b_42557_UDP_4: multicast-connector=CN_VLAN_Cockpit
            application endpoint AE_42557_UDP: network-endpoint=NE_ff14_0000_0000_0000_0000_0000_0000_003b, priority=4, tp-configuration=udp-tp=udp-tp-port={dynamically-assigned=false, port-number=42557}
          SA_Rx_fd53_7cb8_0383_0005_0000_0000_0000_0010_42559_UDP_4
            application endpoint AE_42559_UDP: network-endpoint=NE_fd53_7cb8_0383_0005_0000_0000_0000_0010, priority=4, tp-configuration=udp-tp=udp-tp-port={dynamically-assigned=false, port-number=42559}
          SA_Rx_fd53_7cb8_0383_000e_0000_0000_0000_0073_42559_UDP_4: connector=CN_VLAN_Cockpit
            application endpoint AE_42559_UDP: network-endpoint=NE_fd53_7cb8_0383_000e_0000_0000_0000_0073, priority=4, tp-configuration=udp-tp=udp-tp-port={dynamically-assigned=false, port-number=42559}
          SA_Rx_ff14_0000_0000_0000_0000_0000_0000_0071_42559_UDP_4: multicast-connector=CN_VLAN_Cockpit
            application endpoint AE_42559_UDP: network-endpoint=NE_ff14_0000_0000_0000_0000_0000_0000_0071, priority=4, tp-configuration=udp-tp=udp-tp-port={dynamically-assigned=false, port-number=42559}
          SA_Tx_fd53_7cb8_0383_0004_0000_0000_0001_01e5_42994_UDP_4
            application endpoint AE_42994_UDP: network-endpoint=NE_fd53_7cb8_0383_0004_0000_0000_0001_01e5, priority=4, tp-configuration=udp-tp=udp-tp-port={dynamically-assigned=false, port-number=42994}
          SA_Rx_ff14_0000_0000_0000_0000_0000_0000_0055_42557_UDP_4: multicast-connector=CN_VLAN_Cockpit
            application endpoint AE_42557_UDP: network-endpoint=NE_ff14_0000_0000_0000_0000_0000_0000_0055, priority=4, tp-configuration=udp-tp=udp-tp-port={dynamically-assigned=false, port-number=42557}
          SA_Rx_ff14_0000_0000_0000_0000_0000_0000_007f_42557_UDP_4: multicast-connector=CN_VLAN_Cockpit
            application endpoint AE_42557_UDP: network-endpoint=NE_ff14_0000_0000_0000_0000_0000_0000_007f, priority=4, tp-configuration=udp-tp=udp-tp-port={dynamically-assigned=false, port-number=42557}
          SA_Tx_fd53_7cb8_0383_000e_0000_0000_0000_0073_29180_TCP_0: connector=CN_VLAN_Cockpit
            application endpoint AE_29180_TCP: network-endpoint=NE_fd53_7cb8_0383_000e_0000_0000_0000_0073, priority=0, tp-configuration=tcp-tp={keep-alives=false, nagles-algorithm=false, tcp-tp-port={dynamically-assigned=false, port-number=29180}}
              provided service instance ProvSI_WakeUpMonitorData_Instance3_XIX_HCP3_IONode:
                routing-group=SoAdRG_WakeUpMonitorData_Instance3_Methods
                instance-identifier=3
                sd-server-config={initial-offer-behavior={initial-delay-max-value=0.0, initial-delay-min-value=0.0, initial-repetitions-base-delay=0.1, initial-repetitions-max=3}, offer-cyclic-delay=1.0, request-response-delay={max-value=0.0, min-value=0.0}, server-service-major-version=2, server-service-minor-version=0, ttl=3}
                service-identifier=24758
              provided service instance ProvSI_IdsCanSensor_Instance3_XIX_HCP3_IONode:
                routing-group=SoAdRG_IdsCanSensor_Instance3_Methods
                instance-identifier=3
                sd-server-config={initial-offer-behavior={initial-delay-max-value=0.0, initial-delay-min-value=0.0, initial-repetitions-base-delay=0.1, initial-repetitions-max=3}, offer-cyclic-delay=1.0, request-response-delay={max-value=0.0, min-value=0.0}, server-service-major-version=3, server-service-minor-version=0, ttl=3}
                service-identifier=24917
                event handler periodicSignalElement0: application-endpoint=AE_29180_TCP, consumed-event-group=periodicSignalElement0, multicast-threshold=0, routing-group=SoAdRG_IdsCanSensor_Instance3_periodicSignalElement0, sd-server-config={request-response-delay={max-value=0.0, min-value=0.0}, ttl=3}
                event handler canSensorFeaturesElement0: application-endpoint=AE_29180_TCP, consumed-event-group=canSensorFeaturesElement0, multicast-threshold=0, routing-group=SoAdRG_IdsCanSensor_Instance3_canSensorFeaturesElement0, sd-server-config={request-response-delay={max-value=0.0, min-value=0.0}, ttl=3}
          SA_Tx_fd53_7cb8_0383_0003_0000_0000_0000_0130_42994_UDP_4
            application endpoint AE_42994_UDP: network-endpoint=NE_fd53_7cb8_0383_0003_0000_0000_0000_0130, priority=4, tp-configuration=udp-tp=udp-tp-port={dynamically-assigned=false, port-number=42994}
          SA_Tx_fd53_7cb8_0383_000e_0000_0000_0000_0073_50445_TCP_0: connector=CN_VLAN_Cockpit
            application endpoint AE_50445_TCP: network-endpoint=NE_fd53_7cb8_0383_000e_0000_0000_0000_0073, priority=0, tp-configuration=tcp-tp={keep-alives=false, nagles-algorithm=false, tcp-tp-port={dynamically-assigned=false, port-number=50445}}
          SA_Tx_fd53_7cb8_0383_000e_0000_0000_0000_0073_50448_TCP_0: connector=CN_VLAN_Cockpit
            application endpoint AE_50448_TCP: network-endpoint=NE_fd53_7cb8_0383_000e_0000_0000_0000_0073, priority=0, tp-configuration=tcp-tp={keep-alives=false, nagles-algorithm=false, tcp-tp-port={dynamically-assigned=false, port-number=50448}}
          SA_Tx_fd53_7cb8_0383_000e_0000_0000_0000_0073_50447_TCP_0: connector=CN_VLAN_Cockpit
            application endpoint AE_50447_TCP: network-endpoint=NE_fd53_7cb8_0383_000e_0000_0000_0000_0073, priority=0, tp-configuration=tcp-tp={keep-alives=false, nagles-algorithm=false, tcp-tp-port={dynamically-assigned=false, port-number=50447}}
          SA_Tx_fd53_7cb8_0383_000e_0000_0000_0000_0073_50446_TCP_0: connector=CN_VLAN_Cockpit
            application endpoint AE_50446_TCP: network-endpoint=NE_fd53_7cb8_0383_000e_0000_0000_0000_0073, priority=0, tp-configuration=tcp-tp={keep-alives=false, nagles-algorithm=false, tcp-tp-port={dynamically-assigned=false, port-number=50446}}
          SA_Tx_fd53_7cb8_0383_000e_0000_0000_0000_0073_42810_UDP_3: connector=CN_VLAN_Cockpit
            application endpoint AE_42810_UDP: network-endpoint=NE_fd53_7cb8_0383_000e_0000_0000_0000_0073, priority=3, tp-configuration=udp-tp=udp-tp-port={dynamically-assigned=false, port-number=42810}
              provided service instance ProvSI_IDSSecurityEventSmall_Instance3_XIX_HCP3_IONode: instance-identifier=3, sd-server-config={initial-offer-behavior={initial-delay-max-value=0.0, initial-delay-min-value=0.0, initial-repetitions-base-delay=0.1, initial-repetitions-max=3}, offer-cyclic-delay=1.0, request-response-delay={max-value=0.0, min-value=0.0}, server-service-major-version=1, server-service-minor-version=0, ttl=3}, service-identifier=25107
                event handler securityEvent: application-endpoint=SA_Tx_fd53_7cb8_0383_000e_0000_0000_0000_0073_42810_UDP_3/AE_42810_UDP, consumed-event-group=securityEvent, multicast-threshold=0, routing-group=SoAdRG_IDSSecurityEventSmall_Instance3_securityEvent, sd-server-config={request-response-delay={max-value=0.0, min-value=0.0}, ttl=3}
          SA_Rx_ff14_0000_0000_0000_0000_0000_0000_0005_42557_UDP_4_XIX_SCB_SA_Tx_fd53_7cb8_0383_000e_0000_0000_0000_0073_42994_UDP_4
            application endpoint AE_42557_UDP: network-endpoint=NE_ff14_0000_0000_0000_0000_0000_0000_0005, priority=4, tp-configuration=udp-tp=udp-tp-port={dynamically-assigned=false, port-number=42557}
          SA_Rx_ff14_0000_0000_0000_0000_0000_0000_0005_42557_UDP_4_XIX_SCB_SA_Tx_fd53_7cb8_0383_000e_0000_0000_0000_0108_42994_UDP_4: multicast-connector=CN_VLAN_Cockpit
            application endpoint AE_42557_UDP: network-endpoint=NE_ff14_0000_0000_0000_0000_0000_0000_0005, priority=4, tp-configuration=udp-tp=udp-tp-port={dynamically-assigned=false, port-number=42557}
          SA_Rx_ff14_0000_0000_0000_0000_0000_0000_0005_42557_UDP_4_XIX_SCB_SA_Tx_fd53_7cb8_0383_0003_0000_0000_0000_0130_42994_UDP_4: multicast-connector=CN_VLAN_Cockpit
            application endpoint AE_42557_UDP: network-endpoint=NE_ff14_0000_0000_0000_0000_0000_0000_0005, priority=4, tp-configuration=udp-tp=udp-tp-port={dynamically-assigned=false, port-number=42557}
          SA_SDANY
            application endpoint AE_SD: network-endpoint=NE_SDANY, tp-configuration=udp-tp=udp-tp-port={dynamically-assigned=false, port-number=30490}
          SA_SDMulticast: multicast-connector=CN_VLAN_Cockpit
            application endpoint AE_SD: network-endpoint=NE_SDMulticast, tp-configuration=udp-tp=udp-tp-port={dynamically-assigned=false, port-number=30490}
          SA_SDUnicast_HCP3_IONode: connector=CN_VLAN_Cockpit
            application endpoint AE_SD: network-endpoint=NE_fd53_7cb8_0383_000e_0000_0000_0000_0073, tp-configuration=udp-tp=udp-tp-port={dynamically-assigned=false, port-number=30490}
          SA_SSOAUnicast_Gateway_dynamic
            application endpoint AE: network-endpoint=NE_fd53_7cb8_0383_0005_0000_0000_0000_0010, tp-configuration=tcp-tp={keep-alives=false, nagles-algorithm=false, tcp-tp-port=dynamically-assigned=true}
          SA_SSOAUnicast_SGW03_dynamic
            application endpoint AE: network-endpoint=NE_fd53_7cb8_0383_0004_0000_0000_0001_01e5, tp-configuration=tcp-tp={keep-alives=false, nagles-algorithm=false, tcp-tp-port=dynamically-assigned=true}
          SA_SSOAMulticast_Info_El: connector=CN_VLAN_Cockpit
            application endpoint AE_SSOA: network-endpoint=NE_fd53_7cb8_0383_000e_0000_0000_0000_0073, tp-configuration=udp-tp=udp-tp-port={dynamically-assigned=false, port-number=42515}
          SA_SSOAMulticast_SCB_SSOA_Info_El
            application endpoint AE_SSOA: network-endpoint=NE_SSOAMulticast, tp-configuration=udp-tp=udp-tp-port={dynamically-assigned=false, port-number=42515}
          SA_SSOAUnicast_Info_El: connector=CN_VLAN_Cockpit
            application endpoint AE: network-endpoint=NE_fd53_7cb8_0383_000e_0000_0000_0000_0073, tp-configuration=tcp-tp={keep-alives=false, nagles-algorithm=false, tcp-tp-port={dynamically-assigned=false, port-number=29801}}
          SA_Rx_ff02_0000_0000_0000_0000_0000_0000_0001_13400_UDP_0: multicast-connector=CN_VLAN_Cockpit
            application endpoint AE_13400_UDP: network-endpoint=NE_ff02_0000_0000_0000_0000_0000_0000_0001, priority=0, tp-configuration=udp-tp=udp-tp-port={dynamically-assigned=false, port-number=13400}
          SA_Tx_fd53_7cb8_0383_0004_0000_0000_0000_0107_13400_UDP_0
            application endpoint AE_13400_UDP: network-endpoint=NE_fd53_7cb8_0383_0004_0000_0000_0000_0107, priority=0, tp-configuration=udp-tp=udp-tp-port={dynamically-assigned=false, port-number=13400}
      vlan VC_VLAN_Cockpit: vlan-identifier=14
    22 x mac multicast group:
      MAC_33_33_00_00_00_7F: mac-multicast-address=33:33:00:00:00:7F
      MAC_33_33_00_00_00_05: mac-multicast-address=33:33:00:00:00:05
      MAC_33_33_00_00_00_01: mac-multicast-address=33:33:00:00:00:01
      MAC_33_33_00_00_00_6F: mac-multicast-address=33:33:00:00:00:6F
      MAC_33_33_00_00_00_71: mac-multicast-address=33:33:00:00:00:71
      MAC_33_33_00_00_00_61: mac-multicast-address=33:33:00:00:00:61
      MAC_33_33_00_00_00_63: mac-multicast-address=33:33:00:00:00:63
      MAC_33_33_00_00_00_62: mac-multicast-address=33:33:00:00:00:62
      MAC_33_33_00_00_00_69: mac-multicast-address=33:33:00:00:00:69
      MAC_33_33_00_00_00_65: mac-multicast-address=33:33:00:00:00:65
      MAC_33_33_00_00_00_64: mac-multicast-address=33:33:00:00:00:64
      MAC_33_33_00_00_00_67: mac-multicast-address=33:33:00:00:00:67
      MAC_33_33_00_00_00_4A: mac-multicast-address=33:33:00:00:00:4A
      MAC_33_33_00_00_00_4C: mac-multicast-address=33:33:00:00:00:4C
      MAC_33_33_00_00_00_4B: mac-multicast-address=33:33:00:00:00:4B
      MAC_33_33_00_00_00_52: mac-multicast-address=33:33:00:00:00:52
      MAC_33_33_00_00_00_51: mac-multicast-address=33:33:00:00:00:51
      MAC_33_33_00_00_00_55: mac-multicast-address=33:33:00:00:00:55
      MAC_33_33_00_00_00_3F: mac-multicast-address=33:33:00:00:00:3F
      MAC_33_33_00_00_00_3B: mac-multicast-address=33:33:00:00:00:3B
      MAC_33_33_00_00_00_3A: mac-multicast-address=33:33:00:00:00:3A
      MAC_33_33_00_00_00_2C: mac-multicast-address=33:33:00:00:00:2C
package /CouplingElements
  coupling element CE_HCP3_IONode: communication-cluster=ETH_Cluster_E3_1_2, coupling-type=SWITCH, ecu-instance=HCP3_IONode
    6 x coupling port, all with vlan-membership{send-activity=SENT-TAGGED, vlan=VLAN_Cockpit}:
      CP_HCP3_IONode_XIX_IONode_Switch_1_AMP
        coupling-port-details:
          coupling-port-structural-elements:
            8 x coupling port fifo:
              Fifo_IONode_Switch_1_AMP_{0..7}: assigned-traffic-classs={0..7}
          8 x ethernet priority regeneration:
            IngressPrio_IONode_Switch_1_AMP_{0..7}: ingress-priority={0..7}, regenerated-priority={0..7}
          ethernet-traffic-class-assignments:
            8 x coupling port traffic class assignment:
              TC_IONode_Switch_1_AMP_{0..7}: traffic-class={0..7}
      CP_HCP3_IONode_XIX_IONode_Switch_1_CN1_1: connection-negotiation-behavior=MASTER, physical-layer-type=1000BASE-T1
        coupling-port-details last-egress-scheduler=Schedule_IONode_Switch_1_CN1_1_7:
          coupling-port-structural-elements:
            8 x coupling port fifo:
              Fifo_IONode_Switch_1_CN1_1_{0..7}: assigned-traffic-classs={0..7}
            8 x coupling port scheduler, all with port-scheduler=STRICT-PRIORITY:
              Schedule_IONode_Switch_1_CN1_1_{0..7}
          8 x ethernet priority regeneration:
            IngressPrio_IONode_Switch_1_CN1_1_{0..7}: ingress-priority={0..7}, regenerated-priority={0..7}
          ethernet-traffic-class-assignments:
            8 x coupling port traffic class assignment:
              TC_IONode_Switch_1_CN1_1_{0..7}: prioritys={0..7}, traffic-class={0..7}
      CP_HCP3_IONode_XIX_IONode_Switch_1_CN1_2: connection-negotiation-behavior=MASTER, physical-layer-type=1000BASE-T1
        coupling-port-details last-egress-scheduler=Schedule_IONode_Switch_1_CN1_2_7:
          coupling-port-structural-elements:
            8 x coupling port fifo:
              Fifo_IONode_Switch_1_CN1_2_{0..7}: assigned-traffic-classs={0..7}
            8 x coupling port scheduler, all with port-scheduler=STRICT-PRIORITY:
              Schedule_IONode_Switch_1_CN1_2_{0..7}
          8 x ethernet priority regeneration:
            IngressPrio_IONode_Switch_1_CN1_2_{0..7}: ingress-priority={0..7}, regenerated-priority={0..7}
          ethernet-traffic-class-assignments:
            8 x coupling port traffic class assignment:
              TC_IONode_Switch_1_CN1_2_{0..7}: prioritys={0..7}, traffic-class={0..7}
      CP_HCP3_IONode_XIX_IONode_Switch_1_CN2_1: connection-negotiation-behavior=MASTER, physical-layer-type=1000BASE-T1
        coupling-port-details last-egress-scheduler=Schedule_IONode_Switch_1_CN2_1_7:
          coupling-port-structural-elements:
            8 x coupling port fifo:
              Fifo_IONode_Switch_1_CN2_1_{0..7}: assigned-traffic-classs={0..7}
            8 x coupling port scheduler, all with port-scheduler=STRICT-PRIORITY:
              Schedule_IONode_Switch_1_CN2_1_{0..7}
          8 x ethernet priority regeneration:
            IngressPrio_IONode_Switch_1_CN2_1_{0..7}: ingress-priority={0..7}, regenerated-priority={0..7}
          ethernet-traffic-class-assignments:
            8 x coupling port traffic class assignment:
              TC_IONode_Switch_1_CN2_1_{0..7}: prioritys={0..7}, traffic-class={0..7}
      CP_HCP3_IONode_XIX_IONode_Switch_1_CN2_2: connection-negotiation-behavior=MASTER, physical-layer-type=1000BASE-T1
        coupling-port-details last-egress-scheduler=Schedule_IONode_Switch_1_CN2_2_7:
          coupling-port-structural-elements:
            8 x coupling port fifo:
              Fifo_IONode_Switch_1_CN2_2_{0..7}: assigned-traffic-classs={0..7}
            8 x coupling port scheduler, all with port-scheduler=STRICT-PRIORITY:
              Schedule_IONode_Switch_1_CN2_2_{0..7}
          8 x ethernet priority regeneration:
            IngressPrio_IONode_Switch_1_CN2_2_{0..7}: ingress-priority={0..7}, regenerated-priority={0..7}
          ethernet-traffic-class-assignments:
            8 x coupling port traffic class assignment:
              TC_IONode_Switch_1_CN2_2_{0..7}: prioritys={0..7}, traffic-class={0..7}
      CP_HCP3_IONode_XIX_IONode_Switch_1_SOC
        coupling-port-details:
          coupling-port-structural-elements:
            8 x coupling port fifo:
              Fifo_IONode_Switch_1_SOC_{0..7}: assigned-traffic-classs={0..7}
          8 x ethernet priority regeneration:
            IngressPrio_IONode_Switch_1_SOC_{0..7}: ingress-priority={0..7}, regenerated-priority={0..7}
          ethernet-traffic-class-assignments:
            8 x coupling port traffic class assignment:
              TC_IONode_Switch_1_SOC_{0..7}: traffic-class={0..7}
package /NmConfig
  nm config NmConfig: can-nm-cluster-coupling{coupled-cluster=[NmCluster_HCP3_CANFD01, NmCluster_WU_HCP3_CANFD], nm-busload-reduction-enabled=false, nm-immediate-restart-enabled=false}
    can nm cluster NmCluster_HCP3_CANFD01: communication-cluster=HCP3_CANFD01, nm-channel-sleep-master=false, nm-pnc-participation=true, nm-synchronizing-network=false, nm-busload-reduction-active=false, nm-cbv-position=0, nm-immediate-nm-cycle-time=0.02, nm-immediate-nm-transmissions=10, nm-message-timeout-time=0.1, nm-msg-cycle-time=0.2, nm-network-timeout=1.0, nm-remote-sleep-indication-time=0.5, nm-repeat-message-time=4.0, nm-wait-bus-sleep-time=0.75
      can nm node NmNode_HCP3_IONode_XIX_HCP3_CANFD01: controller=CT_HCP3_CANFD01, nm-if-ecu=NmEcu_HCP3_IONode, nm-passive-mode-enabled=false, rx-nm-pdu=[NM_CCF_XIX_HCP3_CANFD01, NM_CID_XIX_HCP3_CANFD01, NM_DispKBI_FS_XIX_HCP3_CANFD01, NM_HUD_XIX_HCP3_CANFD01, NM_LSR_1_XIX_HCP3_CANFD01, NM_PID_XIX_HCP3_CANFD01, NM_WLC1_XIX_HCP3_CANFD01, NM_WLC2_XIX_HCP3_CANFD01], tx-nm-pdu=NM_Info_El_XIX_HCP3_CANFD01, nm-car-wake-up-rx-enabled=false, nm-msg-cycle-offset=0
    can nm cluster NmCluster_WU_HCP3_CANFD: communication-cluster=WU_HCP3_CANFD, nm-channel-sleep-master=false, nm-pnc-participation=true, nm-synchronizing-network=false, nm-busload-reduction-active=false, nm-cbv-position=0, nm-immediate-nm-cycle-time=0.02, nm-immediate-nm-transmissions=10, nm-message-timeout-time=0.1, nm-msg-cycle-time=0.2, nm-network-timeout=1.0, nm-remote-sleep-indication-time=0.5, nm-repeat-message-time=4.0, nm-wait-bus-sleep-time=0.75
      can nm node NmNode_HCP3_IONode_XIX_WU_HCP3_CANFD: controller=CT_WU_HCP3_CANFD, nm-if-ecu=NmEcu_HCP3_IONode, nm-passive-mode-enabled=false, rx-nm-pdu=NM_Gateway_XIX_WU_HCP3_CANFD, tx-nm-pdu=NM_Info_El_XIX_WU_HCP3_CANFD, nm-car-wake-up-rx-enabled=false, nm-msg-cycle-offset=0
    nm-if-ecus:
      nm ecu NmEcu_HCP3_IONode: ecu-instance=HCP3_IONode, nm-bus-synchronization-enabled=false, nm-com-control-enabled=false, nm-node-detection-enabled=false, nm-node-id-enabled=false, nm-pdu-rx-indication-enabled=true, nm-remote-sleep-ind-enabled=false, nm-repeat-msg-ind-enabled=false, nm-state-change-ind-enabled=true, nm-user-data-enabled=true
package /PDU
  dcm i pdu DCM_HCP3_CANFD01_XIX_TPCHType_CANFD_Diag_XIX_0x1C400693_XIX_0x1C420693_XIX_Physical: length=512, diag-pdu-type=DIAG-REQUEST
  dcm i pdu DCM_HCP3_CANFD01_XIX_TPCHType_CANFD_Diag_XIX_0x1C420693_XIX_0x1C400693_XIX_Physical: length=512, diag-pdu-type=DIAG-RESPONSE
  dcm i pdu DCM_HCP3_CANFD01_XIX_TPCHType_CANFD_Flash_DIA_XIX_0x1C401693_XIX_0x1C421693_XIX_Physical: length=512, diag-pdu-type=DIAG-REQUEST
  dcm i pdu DCM_HCP3_CANFD01_XIX_TPCHType_CANFD_Flash_DIA_XIX_0x1C421693_XIX_0x1C401693_XIX_Physical: length=512, diag-pdu-type=DIAG-RESPONSE
  dcm i pdu DCM_HCP3_CANFD01_XIX_TPCHType_CANFD_ISO_Diagnose_XIX_0x1C40001B_XIX_0x1C42001B_XIX_Physical: length=512, diag-pdu-type=DIAG-REQUEST
  dcm i pdu DCM_HCP3_CANFD01_XIX_TPCHType_CANFD_ISO_Diagnose_XIX_0x1C4000A5_XIX_0x1C4200A5_XIX_Physical: length=512, diag-pdu-type=DIAG-REQUEST
  dcm i pdu DCM_HCP3_CANFD01_XIX_TPCHType_CANFD_ISO_Diagnose_XIX_0x1C4000A6_XIX_0x1C4200A6_XIX_Physical: length=512, diag-pdu-type=DIAG-REQUEST
  dcm i pdu DCM_HCP3_CANFD01_XIX_TPCHType_CANFD_ISO_Diagnose_XIX_0x1C410000_XIX_Functional: length=62, diag-pdu-type=DIAG-REQUEST
  dcm i pdu DCM_HCP3_CANFD01_XIX_TPCHType_CANFD_ISO_Diagnose_XIX_0x1C42001B_XIX_0x1C40001B_XIX_Physical: length=512, diag-pdu-type=DIAG-RESPONSE
  dcm i pdu DCM_HCP3_CANFD01_XIX_TPCHType_CANFD_ISO_Diagnose_XIX_0x1C4200A5_XIX_0x1C4000A5_XIX_Physical: length=512, diag-pdu-type=DIAG-RESPONSE
  dcm i pdu DCM_HCP3_CANFD01_XIX_TPCHType_CANFD_ISO_Diagnose_XIX_0x1C4200A6_XIX_0x1C4000A6_XIX_Physical: length=512, diag-pdu-type=DIAG-RESPONSE
  dcm i pdu DCM_HCP3_CANFD01_XIX_TPCHType_CANFD_ISO_Diagnose_XIX_0x1C440022_XIX_0x1C460022_XIX_Physical: length=512, diag-pdu-type=DIAG-REQUEST
  dcm i pdu DCM_HCP3_CANFD01_XIX_TPCHType_CANFD_ISO_Diagnose_XIX_0x1C440023_XIX_0x1C460023_XIX_Physical: length=512, diag-pdu-type=DIAG-REQUEST
  dcm i pdu DCM_HCP3_CANFD01_XIX_TPCHType_CANFD_ISO_Diagnose_XIX_0x1C440024_XIX_0x1C460024_XIX_Physical: length=512, diag-pdu-type=DIAG-REQUEST
  dcm i pdu DCM_HCP3_CANFD01_XIX_TPCHType_CANFD_ISO_Diagnose_XIX_0x1C460022_XIX_0x1C440022_XIX_Physical: length=512, diag-pdu-type=DIAG-RESPONSE
  dcm i pdu DCM_HCP3_CANFD01_XIX_TPCHType_CANFD_ISO_Diagnose_XIX_0x1C460023_XIX_0x1C440023_XIX_Physical: length=512, diag-pdu-type=DIAG-RESPONSE
  dcm i pdu DCM_HCP3_CANFD01_XIX_TPCHType_CANFD_ISO_Diagnose_XIX_0x1C460024_XIX_0x1C440024_XIX_Physical: length=512, diag-pdu-type=DIAG-RESPONSE
  dcm i pdu DCM_HCP3_CANFD01_XIX_TPCHType_CANFD_OBDC_Diagnose_XIX_0x1C40021B_XIX_0x1C42021B_XIX_Physical: length=512, diag-pdu-type=DIAG-REQUEST
  dcm i pdu DCM_HCP3_CANFD01_XIX_TPCHType_CANFD_OBDC_Diagnose_XIX_0x1C4002A5_XIX_0x1C4202A5_XIX_Physical: length=512, diag-pdu-type=DIAG-REQUEST
  dcm i pdu DCM_HCP3_CANFD01_XIX_TPCHType_CANFD_OBDC_Diagnose_XIX_0x1C4002A6_XIX_0x1C4202A6_XIX_Physical: length=512, diag-pdu-type=DIAG-REQUEST
  dcm i pdu DCM_HCP3_CANFD01_XIX_TPCHType_CANFD_OBDC_Diagnose_XIX_0x1C410200_XIX_Functional: length=62, diag-pdu-type=DIAG-REQUEST
  dcm i pdu DCM_HCP3_CANFD01_XIX_TPCHType_CANFD_OBDC_Diagnose_XIX_0x1C42021B_XIX_0x1C40021B_XIX_Physical: length=512, diag-pdu-type=DIAG-RESPONSE
  dcm i pdu DCM_HCP3_CANFD01_XIX_TPCHType_CANFD_OBDC_Diagnose_XIX_0x1C4202A5_XIX_0x1C4002A5_XIX_Physical: length=512, diag-pdu-type=DIAG-RESPONSE
  dcm i pdu DCM_HCP3_CANFD01_XIX_TPCHType_CANFD_OBDC_Diagnose_XIX_0x1C4202A6_XIX_0x1C4002A6_XIX_Physical: length=512, diag-pdu-type=DIAG-RESPONSE
  dcm i pdu DCM_HCP3_CANFD01_XIX_TPCHType_CANFD_OBDC_Diagnose_XIX_0x1C440222_XIX_0x1C460222_XIX_Physical: length=512, diag-pdu-type=DIAG-REQUEST
  dcm i pdu DCM_HCP3_CANFD01_XIX_TPCHType_CANFD_OBDC_Diagnose_XIX_0x1C440223_XIX_0x1C460223_XIX_Physical: length=512, diag-pdu-type=DIAG-REQUEST
  dcm i pdu DCM_HCP3_CANFD01_XIX_TPCHType_CANFD_OBDC_Diagnose_XIX_0x1C440224_XIX_0x1C460224_XIX_Physical: length=512, diag-pdu-type=DIAG-REQUEST
  dcm i pdu DCM_HCP3_CANFD01_XIX_TPCHType_CANFD_OBDC_Diagnose_XIX_0x1C460222_XIX_0x1C440222_XIX_Physical: length=512, diag-pdu-type=DIAG-RESPONSE
  dcm i pdu DCM_HCP3_CANFD01_XIX_TPCHType_CANFD_OBDC_Diagnose_XIX_0x1C460223_XIX_0x1C440223_XIX_Physical: length=512, diag-pdu-type=DIAG-RESPONSE
  dcm i pdu DCM_HCP3_CANFD01_XIX_TPCHType_CANFD_OBDC_Diagnose_XIX_0x1C460224_XIX_0x1C440224_XIX_Physical: length=512, diag-pdu-type=DIAG-RESPONSE
  dcm i pdu DCM_HCP3_CANFD01_XIX_TPCHType_CANFD_OBDC_SSN_Diagnose_XIX_0x1C407093_XIX_0x1C427093_XIX_Physical: length=512, diag-pdu-type=DIAG-REQUEST
  dcm i pdu DCM_HCP3_CANFD01_XIX_TPCHType_CANFD_OBDC_SSN_Diagnose_XIX_0x1C427093_XIX_0x1C407093_XIX_Physical: length=512, diag-pdu-type=DIAG-RESPONSE
  dcm i pdu DCM_VLAN_Cockpit_XIX_TPCHType_DoIP_Cockpit_OBDC_XIX_0x101B_XIX_0xF02_XIX_Physical: length=4095
  dcm i pdu DCM_VLAN_Cockpit_XIX_TPCHType_DoIP_Cockpit_OBDC_XIX_0x1073_XIX_0xF02_XIX_Physical: length=4095
  dcm i pdu DCM_VLAN_Cockpit_XIX_TPCHType_DoIP_Cockpit_OBDC_XIX_0x30A5_XIX_0xF02_XIX_Physical: length=4095
  dcm i pdu DCM_VLAN_Cockpit_XIX_TPCHType_DoIP_Cockpit_OBDC_XIX_0x30A6_XIX_0xF02_XIX_Physical: length=4095
  dcm i pdu DCM_VLAN_Cockpit_XIX_TPCHType_DoIP_Cockpit_OBDC_XIX_0x{3122..3124}_XIX_0xF02_XIX_Physical: length=4095
  dcm i pdu DCM_VLAN_Cockpit_XIX_TPCHType_DoIP_Cockpit_OBDC_XIX_0x3493_XIX_0xF02_XIX_Physical: length=4095
  dcm i pdu DCM_VLAN_Cockpit_XIX_TPCHType_DoIP_Cockpit_OBDC_XIX_0xF02_XIX_0x101B_XIX_Physical: length=4095
  dcm i pdu DCM_VLAN_Cockpit_XIX_TPCHType_DoIP_Cockpit_OBDC_XIX_0xF02_XIX_0x1073_XIX_Physical: length=4095
  dcm i pdu DCM_VLAN_Cockpit_XIX_TPCHType_DoIP_Cockpit_OBDC_XIX_0xF02_XIX_0x30A5_XIX_Physical: length=4095
  dcm i pdu DCM_VLAN_Cockpit_XIX_TPCHType_DoIP_Cockpit_OBDC_XIX_0xF02_XIX_0x30A6_XIX_Physical: length=4095
  dcm i pdu DCM_VLAN_Cockpit_XIX_TPCHType_DoIP_Cockpit_OBDC_XIX_0xF02_XIX_0x{3122..3124}_XIX_Physical: length=4095
  dcm i pdu DCM_VLAN_Cockpit_XIX_TPCHType_DoIP_Cockpit_OBDC_XIX_0xF02_XIX_0x3493_XIX_Physical: length=4095
  dcm i pdu DCM_VLAN_Cockpit_XIX_TPCHType_DoIP_Cockpit_OBDC_XIX_0xF02_XIX_Functional: length=4095
  dcm i pdu DCM_VLAN_Cockpit_XIX_TPCHType_DoIP_Cockpit_XIX_0x101B_XIX_0xE80_XIX_Physical: length=4095
  dcm i pdu DCM_VLAN_Cockpit_XIX_TPCHType_DoIP_Cockpit_XIX_0x1073_XIX_0xE80_XIX_Physical: length=4095
  dcm i pdu DCM_VLAN_Cockpit_XIX_TPCHType_DoIP_Cockpit_XIX_0x30A5_XIX_0xE80_XIX_Physical: length=4095
  dcm i pdu DCM_VLAN_Cockpit_XIX_TPCHType_DoIP_Cockpit_XIX_0x30A6_XIX_0xE80_XIX_Physical: length=4095
  dcm i pdu DCM_VLAN_Cockpit_XIX_TPCHType_DoIP_Cockpit_XIX_0x{3122..3124}_XIX_0xE80_XIX_Physical: length=4095
  dcm i pdu DCM_VLAN_Cockpit_XIX_TPCHType_DoIP_Cockpit_XIX_0x3493_XIX_0xE80_XIX_Physical: length=4095
  dcm i pdu DCM_VLAN_Cockpit_XIX_TPCHType_DoIP_Cockpit_XIX_0xE80_XIX_0x101B_XIX_Physical: length=4095
  dcm i pdu DCM_VLAN_Cockpit_XIX_TPCHType_DoIP_Cockpit_XIX_0xE80_XIX_0x1073_XIX_Physical: length=4095
  dcm i pdu DCM_VLAN_Cockpit_XIX_TPCHType_DoIP_Cockpit_XIX_0xE80_XIX_0x30A5_XIX_Physical: length=4095
  dcm i pdu DCM_VLAN_Cockpit_XIX_TPCHType_DoIP_Cockpit_XIX_0xE80_XIX_0x30A6_XIX_Physical: length=4095
  dcm i pdu DCM_VLAN_Cockpit_XIX_TPCHType_DoIP_Cockpit_XIX_0xE80_XIX_0x{3122..3124}_XIX_Physical: length=4095
  dcm i pdu DCM_VLAN_Cockpit_XIX_TPCHType_DoIP_Cockpit_XIX_0xE80_XIX_0x3493_XIX_Physical: length=4095
  dcm i pdu DCM_VLAN_Cockpit_XIX_TPCHType_DoIP_Cockpit_XIX_0xE80_XIX_Functional: length=4095
  general purpose pdu DoIP_Gateway_Info_El_UC_XIX_VLAN_Cockpit: category=DoIP, length=1452
  general purpose pdu DoIP_Info_El_Gateway_UC_XIX_VLAN_Cockpit: category=DoIP, length=1452
  general purpose pdu DoIP_Info_El_MC_XIX_VLAN_Cockpit: category=DoIP, length=1452
  general purpose pdu TCPClient_DoIP_GW_Info_El_XIX_VLAN_Cockpit: category=DoIP, length=1440
  general purpose pdu TCPClient_DoIP_GW01_Info_El_XIX_VLAN_Cockpit: category=DoIP, length=1440
  general purpose pdu TCPClient_DoIP_OBDC_Info_El_XIX_VLAN_Cockpit: category=DoIP, length=1440
  general purpose pdu TCPServer_DoIP_Info_El_GW_XIX_VLAN_Cockpit: category=DoIP, length=1440
  general purpose pdu TCPServer_DoIP_Info_El_GW01_XIX_VLAN_Cockpit: category=DoIP, length=1440
  general purpose pdu TCPServer_DoIP_Info_El_OBDC_XIX_VLAN_Cockpit: category=DoIP, length=1440
