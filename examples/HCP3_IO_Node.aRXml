[part 9 of 15: package /PDU]
AUTOSAR XML (schema 4-3-0)
package /PDU  (continued)
  pdu DoorFunctions_HFS_01_XIX_VLAN_Cockpit: length=28, minimum-delay=0.02, transmission-mode-true-timing={cyclic-timing={time-offset=0.0, time-period=0.1}, event-controlled-timing={number-of-repetitions=10, repetition-period=0.02}}, unused-bit-pattern=0
    signal DoorFunctions_HFS_01_CRC_XIX_DoorFunctions_HFS_01_XIX_VLAN_Cockpit: start 0, 8 bit, little-endian, data-type-policy=OVERRIDE, i-signal-type=PRIMITIVE, init-value=0, base-type=BT_DoorFunctions_HFS_01_CRC, compu {phys=raw for raw 0..255}, range phys 0..255, raw 0..255, transfer-property=TRIGGERED-WITHOUT-REPETITION
    signal DoorFunctions_HFS_01_BZ_XIX_DoorFunctions_HFS_01_XIX_VLAN_Cockpit: start 8, 4 bit, little-endian, data-type-policy=OVERRIDE, i-signal-type=PRIMITIVE, init-value=0, base-type=BT_DoorFunctions_HFS_01_BZ, compu {phys=raw for raw 0..15}, range phys 0..15, raw 0..15, transfer-property=TRIGGERED-WITHOUT-REPETITION
    signal HFS_FH_S_HBFS_ManHoch_XIX_DoorFunctions_HFS_01_XIX_VLAN_Cockpit: start 12, 1 bit, little-endian, data-type-policy=OVERRIDE, i-signal-type=PRIMITIVE, init-value=0, base-type=BT_HFS_FH_S_HBFS_ManHoch, compu {1=Cx1_Manueller_Lauf_Angefordert (CM_HFS_FH_S_HBFS_ManHoch_Cx1_Manueller_Lauf_Angefordert), 0=Cx0_keine_Bedienung (CM_HFS_FH_S_HBFS_ManHoch_Cx0_keine_Bedienung)}, range raw 0..1, transfer-property=TRIGGERED-WITHOUT-REPETITION  # Manuelles Hochfahren der Seitenscheibe HBFS
    signal HFS_FH_S_HBFS_ManTief_XIX_DoorFunctions_HFS_01_XIX_VLAN_Cockpit: start 13, 1 bit, little-endian, data-type-policy=OVERRIDE, i-signal-type=PRIMITIVE, init-value=0, base-type=BT_HFS_FH_S_HBFS_ManTief, compu {0=Cx0_keine_Bedienung (CM_HFS_FH_S_HBFS_ManTief_Cx0_keine_Bedienung), 1=Cx1_Manueller_Lauf_Angefordert (CM_HFS_FH_S_HBFS_ManTief_Cx1_Manueller_Lauf_Angefordert)}, range raw 0..1, transfer-property=TRIGGERED-WITHOUT-REPETITION  # Manuelles Absenken der Seitenscheibe HBFS
    signal HFS_Tuer_Status_XIX_DoorFunctions_HFS_01_XIX_VLAN_Cockpit: start 14, 2 bit, little-endian, data-type-policy=OVERRIDE, i-signal-type=PRIMITIVE, init-value=0, base-type=BT_HFS_Tuer_Status, invalid-value=Invalid_HFS_Tuer_Status_XIX_DoorFunctions_HFS_01_XIX_VLAN_Cockpit:3, compu {3=Cx3_Fehler (CM_HFS_Tuer_Status_Cx3_Fehler), 2=Cx2_Tuer_offen (CM_HFS_Tuer_Status_Cx2_Tuer_offen), 0=Cx0_Init (CM_HFS_Tuer_Status_Cx0_Init), 1=Cx1_Tuer_geschlossen (CM_HFS_Tuer_Status_Cx1_Tuer_geschlossen)}, range raw 0..3, transfer-property=TRIGGERED-WITHOUT-REPETITION, to HCP3_IONode(timeout 1 s)  # Türstatus mit Fehler und Initwert
    signal HFS_SAD_Schalter_XIX_DoorFunctions_HFS_01_XIX_VLAN_Cockpit: start 16, 4 bit, little-endian, data-type-policy=OVERRIDE, i-signal-type=PRIMITIVE, init-value=14, base-type=BT_HFS_SAD_Schalter, invalid-value=Invalid_HFS_SAD_Schalter_XIX_DoorFunctions_HFS_01_XIX_VLAN_Cockpit:15, compu {15=Cxf_Fehler (CM_HFS_SAD_Schalter_Cxf_Fehler), 0=Cx0_nicht_betaetigt (CM_HFS_SAD_Schalter_Cx0_nicht_betaetigt), 5=Cx5_AUF_manuell (CM_HFS_SAD_Schalter_Cx5_AUF_manuell), 7=Cx7_ZU_manuell (CM_HFS_SAD_Schalter_Cx7_ZU_manuell), 6=Cx6_AUF_automatik (CM_HFS_SAD_Schalter_Cx6_AUF_automatik), 13=Cxd_nicht_verfuegbar (CM_HFS_SAD_Schalter_Cxd_nicht_verfuegbar), 8=Cx8_ZU_automatik (CM_HFS_SAD_Schalter_Cx8_ZU_automatik), 14=Cxe_Init (CM_HFS_SAD_Schalter_Cxe_Init)}, range raw 0..15, transfer-property=TRIGGERED-WITHOUT-REPETITION  # | Ausstelldach MD3 ----------------------------- 0 | nicht_betaetigt 1 | 2 | 3 | 4 | 5 | (m) Auf 6 | (a) Auf 7 | (m) Zu 8 | (a) Zu 13| Schalter nicht verfuegbar 14| Init 15| Fehlerfall
    signal HFS_FH_S_ManHoch_XIX_DoorFunctions_HFS_01_XIX_VLAN_Cockpit: start 20, 1 bit, little-endian, data-type-policy=OVERRIDE, i-signal-type=PRIMITIVE, init-value=0, base-type=BT_HFS_FH_S_ManHoch, compu {1=Cx1_betaetigt (CM_HFS_FH_S_ManHoch_Cx1_betaetigt), 0=Cx0_nicht_betaetigt (CM_HFS_FH_S_ManHoch_Cx0_nicht_betaetigt)}, range raw 0..1, transfer-property=TRIGGERED-WITHOUT-REPETITION  # Betaetigung FH Schalter man hoch
    signal HFS_FH_S_AutoHoch_XIX_DoorFunctions_HFS_01_XIX_VLAN_Cockpit: start 21, 1 bit, little-endian, data-type-policy=OVERRIDE, i-signal-type=PRIMITIVE, init-value=0, base-type=BT_HFS_FH_S_AutoHoch, compu {1=Cx1_betaetigt (CM_HFS_FH_S_AutoHoch_Cx1_betaetigt), 0=Cx0_nicht_betaetigt (CM_HFS_FH_S_AutoHoch_Cx0_nicht_betaetigt)}, range raw 0..1, transfer-property=TRIGGERED-WITHOUT-REPETITION  # Betaetigung FH Schalter auto hoch
    signal HFS_FH_S_ManTief_XIX_DoorFunctions_HFS_01_XIX_VLAN_Cockpit: start 22, 1 bit, little-endian, data-type-policy=OVERRIDE, i-signal-type=PRIMITIVE, init-value=0, base-type=BT_HFS_FH_S_ManTief, compu {1=Cx1_betaetigt (CM_HFS_FH_S_ManTief_Cx1_betaetigt), 0=Cx0_nicht_betaetigt (CM_HFS_FH_S_ManTief_Cx0_nicht_betaetigt)}, range raw 0..1, transfer-property=TRIGGERED-WITHOUT-REPETITION  # Betaetigung FH Schalter man tief
    signal HFS_FH_S_AutoTief_XIX_DoorFunctions_HFS_01_XIX_VLAN_Cockpit: start 23, 1 bit, little-endian, data-type-policy=OVERRIDE, i-signal-type=PRIMITIVE, init-value=0, base-type=BT_HFS_FH_S_AutoTief, compu {1=Cx1_betaetigt (CM_HFS_FH_S_AutoTief_Cx1_betaetigt), 0=Cx0_nicht_betaetigt (CM_HFS_FH_S_AutoTief_Cx0_nicht_betaetigt)}, range raw 0..1, transfer-property=TRIGGERED-WITHOUT-REPETITION  # Betaetigung FH Schalter auto tief
    signal HFS_FH_Oeffnung_XIX_DoorFunctions_HFS_01_XIX_VLAN_Cockpit: start 24, 8 bit, little-endian, data-type-policy=OVERRIDE, i-signal-type=PRIMITIVE, init-value=0, base-type=BT_HFS_FH_Oeffnung, compu {phys=raw*0.5 for raw 0..200; unit Unit_PerCent}, range phys 0..100 Unit_PerCent, raw 0..200, unit=Unit_PerCent, transfer-property=TRIGGERED-WITHOUT-REPETITION  # Gibt den Fensteröffnungswert in % an.
    signal HFS_FH_Bew_hoch_XIX_DoorFunctions_HFS_01_XIX_VLAN_Cockpit: start 32, 1 bit, little-endian, data-type-policy=OVERRIDE, i-signal-type=PRIMITIVE, init-value=0, base-type=BT_HFS_FH_Bew_hoch, compu {0=Cx0_inaktiv (CM_HFS_FH_Bew_hoch_Cx0_inaktiv), 1=Cx1_aktiv (CM_HFS_FH_Bew_hoch_Cx1_aktiv)}, range raw 0..1, transfer-property=TRIGGERED-WITHOUT-REPETITION  # HFS Fenster bewegt sich in Richtung hoch
    signal HFS_FH_Bew_tief_XIX_DoorFunctions_HFS_01_XIX_VLAN_Cockpit: start 33, 1 bit, little-endian, data-type-policy=OVERRIDE, i-signal-type=PRIMITIVE, init-value=0, base-type=BT_HFS_FH_Bew_tief, compu {0=Cx0_inaktiv (CM_HFS_FH_Bew_tief_Cx0_inaktiv), 1=Cx1_aktiv (CM_HFS_FH_Bew_tief_Cx1_aktiv)}, range raw 0..1, transfer-property=TRIGGERED-WITHOUT-REPETITION  # HFS Fenster bewegt sich in Richtung tief
    signal HFS_FH_Fang_XIX_DoorFunctions_HFS_01_XIX_VLAN_Cockpit: start 34, 1 bit, little-endian, data-type-policy=OVERRIDE, i-signal-type=PRIMITIVE, init-value=0, base-type=BT_HFS_FH_Fang, compu {0=Cx0_ausserhalb_Fangbereich (CM_HFS_FH_Fang_Cx0_ausserhalb_Fangbereich), 1=Cx1_innerhalb_Fangbereich (CM_HFS_FH_Fang_Cx1_innerhalb_Fangbereich)}, range raw 0..1, transfer-property=TRIGGERED-WITHOUT-REPETITION  # Fangbereich ist 4mm von oberer Lippendichtung
    signal HFS_FH_Block_XIX_DoorFunctions_HFS_01_XIX_VLAN_Cockpit: start 35, 1 bit, little-endian, data-type-policy=OVERRIDE, i-signal-type=PRIMITIVE, init-value=0, base-type=BT_HFS_FH_Block, compu {0=Cx0_inaktiv (CM_HFS_FH_Block_Cx0_inaktiv), 1=Cx1_aktiv (CM_HFS_FH_Block_Cx1_aktiv)}, range raw 0..1, transfer-property=TRIGGERED-WITHOUT-REPETITION  # Fensterscheibe befindet sich im mechanischen Block (oben oder unten)
    signal HFS_FH_Thermo_XIX_DoorFunctions_HFS_01_XIX_VLAN_Cockpit: start 36, 1 bit, little-endian, data-type-policy=OVERRIDE, i-signal-type=PRIMITIVE, init-value=0, base-type=BT_HFS_FH_Thermo, compu {0=Cx0_inaktiv (CM_HFS_FH_Thermo_Cx0_inaktiv), 1=Cx1_aktiv (CM_HFS_FH_Thermo_Cx1_aktiv)}, range raw 0..1, transfer-property=TRIGGERED-WITHOUT-REPETITION  # gibt an ob Fensterheber im Thermoschutz ist
    signal HFS_UEKB_aktiviert_XIX_DoorFunctions_HFS_01_XIX_VLAN_Cockpit: start 37, 1 bit, little-endian, data-type-policy=OVERRIDE, i-signal-type=PRIMITIVE, init-value=0, base-type=BT_HFS_UEKB_aktiviert, compu {0=Cx0_inaktiv (CM_HFS_UEKB_aktiviert_Cx0_inaktiv), 1=Cx1_aktiv (CM_HFS_UEKB_aktiviert_Cx1_aktiv)}, range raw 0..1, transfer-property=TRIGGERED-WITHOUT-REPETITION  # Überschutzbegrenzungskraft bei Reversieren
    signal HFS_Tueroeffnen_Warnung_XIX_DoorFunctions_HFS_01_XIX_VLAN_Cockpit: start 38, 1 bit, little-endian, data-type-policy=OVERRIDE, i-signal-type=PRIMITIVE, init-value=0, base-type=BT_HFS_Tueroeffnen_Warnung, compu {1=Cx1_Tuerwarnung_aktiv (CM_HFS_Tueroeffnen_Warnung_Cx1_Tuerwarnung_aktiv), 0=Cx0_Tuerwarnung_nicht_aktiv (CM_HFS_Tueroeffnen_Warnung_Cx0_Tuerwarnung_nicht_aktiv)}, range raw 0..1, transfer-property=TRIGGERED-WITHOUT-REPETITION  # Bit wird gesetzt, wenn Tür während der Fahrt geoeffnet werden soll.
    signal HFS_FH_normiert_XIX_DoorFunctions_HFS_01_XIX_VLAN_Cockpit: start 39, 1 bit, little-endian, data-type-policy=OVERRIDE, i-signal-type=PRIMITIVE, init-value=0, base-type=BT_HFS_FH_normiert, compu {1=Cx1_aktiv (CM_HFS_FH_normiert_Cx1_aktiv), 0=Cx0_inaktiv (CM_HFS_FH_normiert_Cx0_inaktiv)}, range raw 0..1, transfer-property=TRIGGERED-WITHOUT-REPETITION  # Die Position der Fensterheberscheibe ist bekannt.
    signal ASW_Warnung_aktiv_HFS_XIX_DoorFunctions_HFS_01_XIX_VLAN_Cockpit: start 40, 1 bit, little-endian, data-type-policy=OVERRIDE, i-signal-type=PRIMITIVE, init-value=0, base-type=BT_ASW_Warnung_aktiv_HFS, compu {0=Cx0_nicht_angefordert (CM_ASW_Warnung_aktiv_HFS_Cx0_nicht_angefordert), 1=Cx1_angefordert (CM_ASW_Warnung_aktiv_HFS_Cx1_angefordert)}, range raw 0..1, transfer-property=TRIGGERED-WITHOUT-REPETITION  # Abschaltung der Ambientefunktion Tür hinten der Fahrerseite bei aktiver ASW Warnung an der Fahrertür
    signal HFS_Zuziehhilfe_aktiv_XIX_DoorFunctions_HFS_01_XIX_VLAN_Cockpit: start 41, 1 bit, little-endian, data-type-policy=OVERRIDE, i-signal-type=PRIMITIVE, init-value=0, base-type=BT_HFS_Zuziehhilfe_aktiv, compu {0=Cx0_Init (CM_HFS_Zuziehhilfe_aktiv_Cx0_Init), 1=Cx1_Zuziehhilfe_aktiv (CM_HFS_Zuziehhilfe_aktiv_Cx1_Zuziehhilfe_aktiv)}, range raw 0..1, transfer-property=TRIGGERED-WITHOUT-REPETITION  # Zuziehhilfe aktiv
    signal HFS_Seitenrollo_hoch_XIX_DoorFunctions_HFS_01_XIX_VLAN_Cockpit: start 42, 1 bit, little-endian, data-type-policy=OVERRIDE, i-signal-type=PRIMITIVE, init-value=0, base-type=BT_HFS_Seitenrollo_hoch, compu {0=Cx0_Init (CM_HFS_Seitenrollo_hoch_Cx0_Init), 1=Cx1_Seitenrollo_in_Bewegung_hoch (CM_HFS_Seitenrollo_hoch_Cx1_Seitenrollo_in_Bewegung_hoch)}, range raw 0..1, transfer-property=TRIGGERED-WITHOUT-REPETITION  # Seitenrollo in Bewegung Richtung hoch
    signal HFS_Seitenrollo_tief_XIX_DoorFunctions_HFS_01_XIX_VLAN_Cockpit: start 43, 1 bit, little-endian, data-type-policy=OVERRIDE, i-signal-type=PRIMITIVE, init-value=0, base-type=BT_HFS_Seitenrollo_tief, compu {1=Cx1_Seitenrollo_in_Bewegung_tief (CM_HFS_Seitenrollo_tief_Cx1_Seitenrollo_in_Bewegung_tief), 0=Cx0_Init (CM_HFS_Seitenrollo_tief_Cx0_Init)}, range raw 0..1, transfer-property=TRIGGERED-WITHOUT-REPETITION  # Seitenrollo in Bewegung Richtung tief
    signal HFS_Status_KiSi_XIX_DoorFunctions_HFS_01_XIX_VLAN_Cockpit: start 44, 1 bit, little-endian, data-type-policy=OVERRIDE, i-signal-type=PRIMITIVE, init-value=0, base-type=BT_HFS_Status_KiSi, compu {0=Cx0_inaktiv (CM_HFS_Status_KiSi_Cx0_inaktiv), 1=Cx1_aktiv (CM_HFS_Status_KiSi_Cx1_aktiv)}, range raw 0..1, transfer-property=TRIGGERED-WITHOUT-REPETITION  # Status Kindersicherung hinten Fahrerseite
    signal SSR_HFS_Pos_Unten_XIX_DoorFunctions_HFS_01_XIX_VLAN_Cockpit: start 45, 1 bit, little-endian, data-type-policy=OVERRIDE, i-signal-type=PRIMITIVE, init-value=0, base-type=BT_SSR_HFS_Pos_Unten, compu {0=Cx0_SSR_Oben (CM_SSR_HFS_Pos_Unten_Cx0_SSR_Oben), 1=Cx1_SSR_Unten (CM_SSR_HFS_Pos_Unten_Cx1_SSR_Unten)}, range raw 0..1, transfer-property=TRIGGERED-WITHOUT-REPETITION  # Signal für die "Global Close". Über dieses Bit wissen die anderen TSGs, ob der SSR oder der FH verfahren werden darf.
    signal HFS_Oben_Block_erw_XIX_DoorFunctions_HFS_01_XIX_VLAN_Cockpit: start 46, 1 bit, little-endian, data-type-policy=OVERRIDE, i-signal-type=PRIMITIVE, init-value=0, base-type=BT_HFS_Oben_Block_erw, compu {1=Cx1_Fensterheber_in_Blockerwartung_o (CM_HFS_Oben_Block_erw_Cx1_Fensterheber_in_Blockerwartung_o), 0=Cx0_Fensterheber_nicht_in_Blockerwar (CM_HFS_Oben_Block_erw_Cx0_Fensterheber_nicht_in_Blockerwar)}, range raw 0..1, transfer-property=TRIGGERED-WITHOUT-REPETITION  # Fensterheber in Blockerwartung oben
    signal HFS_Unten_Block_erw_XIX_DoorFunctions_HFS_01_XIX_VLAN_Cockpit: start 47, 1 bit, little-endian, data-type-policy=OVERRIDE, i-signal-type=PRIMITIVE, init-value=0, base-type=BT_HFS_Unten_Block_erw, compu {0=Cx0_Fensterheber_nicht_in_Blockerwar (CM_HFS_Unten_Block_erw_Cx0_Fensterheber_nicht_in_Blockerwar), 1=Cx1_Fensterheber_in_Blockerwartung_u (CM_HFS_Unten_Block_erw_Cx1_Fensterheber_in_Blockerwartung_u)}, range raw 0..1, transfer-property=TRIGGERED-WITHOUT-REPETITION  # Fensterheber in Blockerwartung unten
    signal MTHFS_M_Taste_XIX_DoorFunctions_HFS_01_XIX_VLAN_Cockpit: start 48, 1 bit, little-endian, data-type-policy=OVERRIDE, i-signal-type=PRIMITIVE, init-value=0, base-type=BT_MTHFS_M_Taste, compu {1=Cx1_betaetigt (CM_MTHFS_M_Taste_Cx1_betaetigt), 0=Cx0_nicht_betaetigt (CM_MTHFS_M_Taste_Cx0_nicht_betaetigt)}, range raw 0..1, transfer-property=TRIGGERED-WITHOUT-REPETITION  # Betätigung M-Taste HFS
    signal MTHFS_Pos1_XIX_DoorFunctions_HFS_01_XIX_VLAN_Cockpit: start 49, 1 bit, little-endian, data-type-policy=OVERRIDE, i-signal-type=PRIMITIVE, init-value=0, base-type=BT_MTHFS_Pos1, compu {1=Cx1_betaetigt (CM_MTHFS_Pos1_Cx1_betaetigt), 0=Cx0_nicht_betaetigt (CM_MTHFS_Pos1_Cx0_nicht_betaetigt)}, range raw 0..1, transfer-property=TRIGGERED-WITHOUT-REPETITION  # Betätigung Postionstaste 1 HFS
    signal MTHFS_Pos2_XIX_DoorFunctions_HFS_01_XIX_VLAN_Cockpit: start 50, 1 bit, little-endian, data-type-policy=OVERRIDE, i-signal-type=PRIMITIVE, init-value=0, base-type=BT_MTHFS_Pos2, compu {1=Cx1_betaetigt (CM_MTHFS_Pos2_Cx1_betaetigt), 0=Cx0_nicht_betaetigt (CM_MTHFS_Pos2_Cx0_nicht_betaetigt)}, range raw 0..1, transfer-property=TRIGGERED-WITHOUT-REPETITION  # Betätigung Postionstaste 2 HFS
    signal MTHFS_Pos3_XIX_DoorFunctions_HFS_01_XIX_VLAN_Cockpit: start 51, 1 bit, little-endian, data-type-policy=OVERRIDE, i-signal-type=PRIMITIVE, init-value=0, base-type=BT_MTHFS_Pos3, compu {1=Cx1_betaetigt (CM_MTHFS_Pos3_Cx1_betaetigt), 0=Cx0_nicht_betaetigt (CM_MTHFS_Pos3_Cx0_nicht_betaetigt)}, range raw 0..1, transfer-property=TRIGGERED-WITHOUT-REPETITION  # Betätigung Postionstaste 3 HFS
    signal HFS_MRollo_Schalter_XIX_DoorFunctions_HFS_01_XIX_VLAN_Cockpit: start 52, 3 bit, little-endian, data-type-policy=OVERRIDE, i-signal-type=PRIMITIVE, init-value=6, base-type=BT_HFS_MRollo_Schalter, invalid-value=Invalid_HFS_MRollo_Schalter_XIX_DoorFunctions_HFS_01_XIX_VLAN_Cockpit:7, compu {7=Cx7_Fehler (CM_HFS_MRollo_Schalter_Cx7_Fehler), 6=Cx6_Init (CM_HFS_MRollo_Schalter_Cx6_Init), 5=Cx5_nicht_verfuegbar (CM_HFS_MRollo_Schalter_Cx5_nicht_verfuegbar), 4=Cx4_AUF_automatik (CM_HFS_MRollo_Schalter_Cx4_AUF_automatik), 3=Cx3_AUF_manuell (CM_HFS_MRollo_Schalter_Cx3_AUF_manuell), 2=Cx2_ZU_automatik (CM_HFS_MRollo_Schalter_Cx2_ZU_automatik), 0=Cx0_nicht_betaetigt (CM_HFS_MRollo_Schalter_Cx0_nicht_betaetigt), 1=Cx1_ZU_manuell (CM_HFS_MRollo_Schalter_Cx1_ZU_manuell)}, range raw 0..7, transfer-property=TRIGGERED-WITHOUT-REPETITION  # | MRollo2 ----------------------------- 0 | nicht_betaetigt 1 | (m) Zu 2 | (a) Zu 3 | (m) Auf 4 | (a) Auf 5 | Schalter nicht verfuegbar 6 | Init 7 | Fehlerfall
    signal HFS_Status_eTAG_XIX_DoorFunctions_HFS_01_XIX_VLAN_Cockpit: start 56, 2 bit, little-endian, data-type-policy=OVERRIDE, i-signal-type=PRIMITIVE, init-value=0, base-type=BT_HFS_Status_eTAG, invalid-value=Invalid_HFS_Status_eTAG_XIX_DoorFunctions_HFS_01_XIX_VLAN_Cockpit:3, compu {3=Cx3_Fehler (CM_HFS_Status_eTAG_Cx3_Fehler), 0=Cx0_Init (CM_HFS_Status_eTAG_Cx0_Init), 1=Cx1_Griff_ausgefahren (CM_HFS_Status_eTAG_Cx1_Griff_ausgefahren), 2=Cx2_Griff_eingefahren (CM_HFS_Status_eTAG_Cx2_Griff_eingefahren)}, range raw 0..3, transfer-property=TRIGGERED-WITHOUT-REPETITION  # Status des elektrischen Tueraussengriffes Tuer Fahrerseite hinten
    signal HFS_Tuer_Status_QBit_XIX_DoorFunctions_HFS_01_XIX_VLAN_Cockpit: start 58, 1 bit, little-endian, data-type-policy=OVERRIDE, i-signal-type=PRIMITIVE, init-value=0, base-type=BT_HFS_Tuer_Status_QBit, compu {1=Cx1_Status_Tuerkontakt_unsicher (CM_HFS_Tuer_Status_QBit_Cx1_Status_Tuerkontakt_unsicher), 0=Cx0_Status_Tuerkontakt_sicher (CM_HFS_Tuer_Status_QBit_Cx0_Status_Tuerkontakt_sicher)}, range raw 0..1, transfer-property=TRIGGERED-WITHOUT-REPETITION  # Dieses Bit gibt die Zuverlässigkeit des Türkontakts an. Ein auf dieses Bit folgender Fehlereintrag ist mit dem Sender des Bits abzustimmen (gültig ab PPE).
    signal HFS_TCR_Mode_aktiv_XIX_DoorFunctions_HFS_01_XIX_VLAN_Cockpit: start 59, 1 bit, little-endian, data-type-policy=OVERRIDE, i-signal-type=PRIMITIVE, init-value=0, base-type=BT_HFS_TCR_Mode_aktiv, compu {0=Cx0_TCR_Mode_deaktiv (CM_HFS_TCR_Mode_aktiv_Cx0_TCR_Mode_deaktiv), 1=Cx1_TCR_Mode_aktiv (CM_HFS_TCR_Mode_aktiv_Cx1_TCR_Mode_aktiv)}, range raw 0..1, transfer-property=TRIGGERED-WITHOUT-REPETITION  # Signal zeigt eine aktive mechanische Redundanz am Türschloss an.
    signal TSG_FlHz_HFS_NTC_A_XIX_DoorFunctions_HFS_01_XIX_VLAN_Cockpit: start 64, 7 bit, little-endian, data-type-policy=OVERRIDE, i-signal-type=PRIMITIVE, init-value=127, base-type=BT_TSG_FlHz_HFS_NTC_A, compu {phys=raw-40 for raw 0..120, 126=Cx7e_Fehler_NTC_Overload_KS_Minus (CM_TSG_FlHz_HFS_NTC_A_Cx7e_Fehler_NTC_Overload_KS_Minus) (Fehler_NTC_Overload__KS_Minus), 127=Cx7f_Init (CM_TSG_FlHz_HFS_NTC_A_Cx7f_Init), 125=Cx7d_Fehler_NTC_OpenLoad_KS_Plus (CM_TSG_FlHz_HFS_NTC_A_Cx7d_Fehler_NTC_OpenLoad_KS_Plus) (Fehler_NTC_OpenLoad__KS_Plus); unit Unit_DegreCelsi}, range phys -40..80 Unit_DegreCelsi, raw 0..127, unit=Unit_DegreCelsi, transfer-property=TRIGGERED-WITHOUT-REPETITION  # Flächenheizung: Temperatur und Fehlerwert des Heizaktors
    signal TSG_FlHz_HFS_FnAbbruchHzKreis_A_XIX_DoorFunctions_HFS_01_XIX_VLAN_Cockpit: start 71, 1 bit, little-endian, data-type-policy=OVERRIDE, i-signal-type=PRIMITIVE, init-value=0, base-type=BT_TSG_FlHz_HFS_FnAbbruchHzKreis_A, compu {1=Cx1_FunktionsAbbruch (CM_TSG_FlHz_HFS_FnAbbruchHzKreis_A_Cx1_FunktionsAbbruch), 0=Cx0_OK (CM_TSG_FlHz_HFS_FnAbbruchHzKreis_A_Cx0_OK)}, range raw 0..1, transfer-property=TRIGGERED-WITHOUT-REPETITION  # Flächenheizung: Status
    signal TSG_FlHz_HFS_NTC_B_XIX_DoorFunctions_HFS_01_XIX_VLAN_Cockpit: start 72, 7 bit, little-endian, data-type-policy=OVERRIDE, i-signal-type=PRIMITIVE, init-value=127, base-type=BT_TSG_FlHz_HFS_NTC_B, compu {phys=raw-40 for raw 0..120, 126=Cx7e_Fehler_NTC_Overload_KS_Minus (CM_TSG_FlHz_HFS_NTC_B_Cx7e_Fehler_NTC_Overload_KS_Minus) (Fehler_NTC_Overload__KS_Minus), 127=Cx7f_Init (CM_TSG_FlHz_HFS_NTC_B_Cx7f_Init), 125=Cx7d_Fehler_NTC_OpenLoad_KS_Plus (CM_TSG_FlHz_HFS_NTC_B_Cx7d_Fehler_NTC_OpenLoad_KS_Plus) (Fehler_NTC_OpenLoad__KS_Plus); unit Unit_DegreCelsi}, range phys -40..80 Unit_DegreCelsi, raw 0..127, unit=Unit_DegreCelsi, transfer-property=TRIGGERED-WITHOUT-REPETITION  # Flächenheizung: Temperatur und Fehlerwert des Heizaktors
    signal TSG_FlHz_HFS_FnAbbruchHzKreis_B_XIX_DoorFunctions_HFS_01_XIX_VLAN_Cockpit: start 79, 1 bit, little-endian, data-type-policy=OVERRIDE, i-signal-type=PRIMITIVE, init-value=0, base-type=BT_TSG_FlHz_HFS_FnAbbruchHzKreis_B, compu {0=Cx0_OK (CM_TSG_FlHz_HFS_FnAbbruchHzKreis_B_Cx0_OK), 1=Cx1_FunktionsAbbruch (CM_TSG_FlHz_HFS_FnAbbruchHzKreis_B_Cx1_FunktionsAbbruch)}, range raw 0..1, transfer-property=TRIGGERED-WITHOUT-REPETITION  # Flächenheizung: Status
    signal SSA_HFT_Tuerverschluss_Status_XIX_DoorFunctions_HFS_01_XIX_VLAN_Cockpit: start 80, 2 bit, little-endian, data-type-policy=OVERRIDE, i-signal-type=PRIMITIVE, init-value=0, base-type=BT_SSA_HFT_Tuerverschluss_Status, compu {1=Cx1_Tuer_geschlossen (CM_SSA_HFT_Tuerverschluss_Status_Cx1_Tuer_geschlossen), 0=Cx0_Init (CM_SSA_HFT_Tuerverschluss_Status_Cx0_Init), 2=Cx2_Tuer_offen (CM_SSA_HFT_Tuerverschluss_Status_Cx2_Tuer_offen)}, range raw 0..2, transfer-property=TRIGGERED-WITHOUT-REPETITION  # SmartSensorActor: Türstatus der hinteren Fahrertür (geschlossen, geöffnet)
    signal SSA_HFT_el_Tuerantrieb_Status_XIX_DoorFunctions_HFS_01_XIX_VLAN_Cockpit: start 82, 2 bit, little-endian, data-type-policy=OVERRIDE, i-signal-type=PRIMITIVE, init-value=0, base-type=BT_SSA_HFT_el_Tuerantrieb_Status, compu {0=Cx0_Init (CM_SSA_HFT_el_Tuerantrieb_Status_Cx0_Init), 2=Cx2_geschlossen (CM_SSA_HFT_el_Tuerantrieb_Status_Cx2_geschlossen), 1=Cx1_offen (CM_SSA_HFT_el_Tuerantrieb_Status_Cx1_offen)}, range raw 0..2, transfer-property=TRIGGERED-WITHOUT-REPETITION  # SmartSensorActor: Rückmeldung des Status des el. Tuerantriebes
    signal SSA_HFT_ZV_Status_XIX_DoorFunctions_HFS_01_XIX_VLAN_Cockpit: start 84, 4 bit, little-endian, data-type-policy=OVERRIDE, i-signal-type=PRIMITIVE, init-value=0, base-type=BT_SSA_HFT_ZV_Status, invalid-value=Invalid_SSA_HFT_ZV_Status_XIX_DoorFunctions_HFS_01_XIX_VLAN_Cockpit:15, compu {15=Cxf_Fehler (CM_SSA_HFT_ZV_Status_Cxf_Fehler), 1=Cx1_entriegelt_entsafet (CM_SSA_HFT_ZV_Status_Cx1_entriegelt_entsafet), 2=Cx2_verriegelt_entsafet (CM_SSA_HFT_ZV_Status_Cx2_verriegelt_entsafet), 0=Cx0_Init (CM_SSA_HFT_ZV_Status_Cx0_Init), 3=Cx3_verriegelt_gesafet (CM_SSA_HFT_ZV_Status_Cx3_verriegelt_gesafet)}, range raw 0..15, transfer-property=TRIGGERED-WITHOUT-REPETITION  # SmartSensorActor: Zustand des Türschlosses der hinteren Fahrertür
    signal eTAB_HFS_Oeffnen_Annaeh_XIX_DoorFunctions_HFS_01_XIX_VLAN_Cockpit: start 88, 1 bit, little-endian, data-type-policy=OVERRIDE, i-signal-type=PRIMITIVE, init-value=0, base-type=BT_eTAB_HFS_Oeffnen_Annaeh, compu {1=Cx1_Annaeherung_Oeffnen_erkannt (CM_eTAB_HFS_Oeffnen_Annaeh_Cx1_Annaeherung_Oeffnen_erkannt), 0=Cx0_Init_keine_Annaeherung (CM_eTAB_HFS_Oeffnen_Annaeh_Cx0_Init_keine_Annaeherung)}, range raw 0..1, transfer-property=TRIGGERED-WITHOUT-REPETITION  # Der Türgriffsensor hat eine Annaeherung zum Oeffnen erkannt.
    signal eTAB_HFS_Oeffnen_Betaet_XIX_DoorFunctions_HFS_01_XIX_VLAN_Cockpit: start 89, 1 bit, little-endian, data-type-policy=OVERRIDE, i-signal-type=PRIMITIVE, init-value=0, base-type=BT_eTAB_HFS_Oeffnen_Betaet, compu {1=Cx1_Betaetigung_Oeffnen_erkannt (CM_eTAB_HFS_Oeffnen_Betaet_Cx1_Betaetigung_Oeffnen_erkannt), 0=Cx0_Init_keine_Annaeherung (CM_eTAB_HFS_Oeffnen_Betaet_Cx0_Init_keine_Annaeherung)}, range raw 0..1, transfer-property=TRIGGERED-WITHOUT-REPETITION  # Der Türgriffsensor hat eine Betaetigung zum Oeffnen erkannt.
    signal eTAB_HFS_Schliessen_Annaeh_XIX_DoorFunctions_HFS_01_XIX_VLAN_Cockpit: start 90, 1 bit, little-endian, data-type-policy=OVERRIDE, i-signal-type=PRIMITIVE, init-value=0, base-type=BT_eTAB_HFS_Schliessen_Annaeh, compu {1=Cx1_Annaeherung_Schliessen_erkannt (CM_eTAB_HFS_Schliessen_Annaeh_Cx1_Annaeherung_Schliessen_erkannt), 0=Cx0_Init_keine_Annaeherung (CM_eTAB_HFS_Schliessen_Annaeh_Cx0_Init_keine_Annaeherung)}, range raw 0..1, transfer-property=TRIGGERED-WITHOUT-REPETITION  # Der Türgriffsensor hat eine Annaeherung zum Schliessen erkannt.
    signal eTAB_HFS_Schliessen_Betaet_XIX_DoorFunctions_HFS_01_XIX_VLAN_Cockpit: start 91, 1 bit, little-endian, data-type-policy=OVERRIDE, i-signal-type=PRIMITIVE, init-value=0, base-type=BT_eTAB_HFS_Schliessen_Betaet, compu {1=Cx1_Betaetigung_Schliessen_erkannt (CM_eTAB_HFS_Schliessen_Betaet_Cx1_Betaetigung_Schliessen_erkannt), 0=Cx0_Init_keine_Annaeherung (CM_eTAB_HFS_Schliessen_Betaet_Cx0_Init_keine_Annaeherung)}, range raw 0..1, transfer-property=TRIGGERED-WITHOUT-REPETITION  # Der Türgriffsensor hat eine Betaetigung zum Schliessen erkannt.
    signal SSA_HFT_Amb_Bel_Status_XIX_DoorFunctions_HFS_01_XIX_VLAN_Cockpit: start 92, 2 bit, little-endian, data-type-policy=OVERRIDE, i-signal-type=PRIMITIVE, init-value=0, base-type=BT_SSA_HFT_Amb_Bel_Status, compu {2=Cx2_aus (CM_SSA_HFT_Amb_Bel_Status_Cx2_aus), 1=Cx1_an (CM_SSA_HFT_Amb_Bel_Status_Cx1_an), 0=Cx0_Init (CM_SSA_HFT_Amb_Bel_Status_Cx0_Init)}, range raw 0..2, transfer-property=TRIGGERED-WITHOUT-REPETITION  # SmartSensorActor: Rückmeldung des Status der Ambiente Beleuchtung
    signal SSA_HFT_FH_Bewegungsrichutng_XIX_DoorFunctions_HFS_01_XIX_VLAN_Cockpit: start 94, 2 bit, little-endian, data-type-policy=OVERRIDE, i-signal-type=PRIMITIVE, init-value=0, base-type=BT_SSA_HFT_FH_Bewegungsrichutng, compu {2=Cx2_FH_in_Bewegung_Oeffnen (CM_SSA_HFT_FH_Bewegungsrichutng_Cx2_FH_in_Bewegung_Oeffnen), 0=Cx0_Stillstand (CM_SSA_HFT_FH_Bewegungsrichutng_Cx0_Stillstand), 1=Cx1_FH_in_Bewegung_Schliessen (CM_SSA_HFT_FH_Bewegungsrichutng_Cx1_FH_in_Bewegung_Schliessen)}, range raw 0..2, transfer-property=TRIGGERED-WITHOUT-REPETITION  # SmartSensorActor: Rückmeldung der Bewegungsrichtung der Seitenscheibe
    signal SSA_HFT_SSR_Status_XIX_DoorFunctions_HFS_01_XIX_VLAN_Cockpit: start 96, 2 bit, little-endian, data-type-policy=OVERRIDE, i-signal-type=PRIMITIVE, init-value=0, base-type=BT_SSA_HFT_SSR_Status, compu {1=Cx1_oben (CM_SSA_HFT_SSR_Status_Cx1_oben), 2=Cx2_unten (CM_SSA_HFT_SSR_Status_Cx2_unten), 0=Cx0_Init (CM_SSA_HFT_SSR_Status_Cx0_Init)}, range raw 0..2, transfer-property=TRIGGERED-WITHOUT-REPETITION  # SmartSensorActor: Rueckmeldung des Status des Seitenscheibenrollos
    signal SSA_HFS_eKisi_Status_XIX_DoorFunctions_HFS_01_XIX_VLAN_Cockpit: start 98, 2 bit, little-endian, data-type-policy=OVERRIDE, i-signal-type=PRIMITIVE, init-value=0, base-type=BT_SSA_HFS_eKisi_Status, compu {1=Cx1_inaktiv (CM_SSA_HFS_eKisi_Status_Cx1_inaktiv), 2=Cx2_aktiv (CM_SSA_HFS_eKisi_Status_Cx2_aktiv), 0=Cx0_Init (CM_SSA_HFS_eKisi_Status_Cx0_Init)}, range raw 0..2, transfer-property=TRIGGERED-WITHOUT-REPETITION  # SmartSensorActor: Rückmeldung des Status der elektrischen Kindersicherung auf der Fahrerseite hinten
    signal SSA_HFT_ZZH_Status_XIX_DoorFunctions_HFS_01_XIX_VLAN_Cockpit: start 100, 1 bit, little-endian, data-type-policy=OVERRIDE, i-signal-type=PRIMITIVE, init-value=0, base-type=BT_SSA_HFT_ZZH_Status, compu {1=Cx1_Zuziehvorgang_aktiv (CM_SSA_HFT_ZZH_Status_Cx1_Zuziehvorgang_aktiv), 0=Cx0_Init (CM_SSA_HFT_ZZH_Status_Cx0_Init)}, range raw 0..1, transfer-property=TRIGGERED-WITHOUT-REPETITION  # SmartSensorActor: Status des ZZH Motors
    signal SSA_HFT_ASW_Status_XIX_DoorFunctions_HFS_01_XIX_VLAN_Cockpit: start 101, 2 bit, little-endian, data-type-policy=OVERRIDE, i-signal-type=PRIMITIVE, init-value=0, base-type=BT_SSA_HFT_ASW_Status, compu {1=Cx1_InfoStufe_aktiv (CM_SSA_HFT_ASW_Status_Cx1_InfoStufe_aktiv), 0=Cx0_Init (CM_SSA_HFT_ASW_Status_Cx0_Init), 2=Cx2_Warnstufe_aktiv (CM_SSA_HFT_ASW_Status_Cx2_Warnstufe_aktiv)}, range raw 0..2, transfer-property=TRIGGERED-WITHOUT-REPETITION  # SmartSensorActor: Rückmeldung des Status der ASW Anzyeige.
    signal SSA_HFT_ZV_Ansteuern_XIX_DoorFunctions_HFS_01_XIX_VLAN_Cockpit: start 103, 8 bit, little-endian, data-type-policy=OVERRIDE, i-signal-type=PRIMITIVE, init-value=0, base-type=BT_SSA_HFT_ZV_Ansteuern, invalid-value=Invalid_SSA_HFT_ZV_Ansteuern_XIX_DoorFunctions_HFS_01_XIX_VLAN_Cockpit:255, compu {255=Cxff_Fehler (CM_SSA_HFT_ZV_Ansteuern_Cxff_Fehler), 0=Cx0_Init (CM_SSA_HFT_ZV_Ansteuern_Cx0_Init), 3=Cx3_verriegelnsafen (CM_SSA_HFT_ZV_Ansteuern_Cx3_verriegelnsafen), 2=Cx2_verriegelnentsafen (CM_SSA_HFT_ZV_Ansteuern_Cx2_verriegelnentsafen), 1=Cx1_entriegelnentsafen (CM_SSA_HFT_ZV_Ansteuern_Cx1_entriegelnentsafen)}, range raw 0..255, transfer-property=TRIGGERED-WITHOUT-REPETITION  # SmartSensorActor: Kommando zur Ansteuerung des Türschlosses der hinteren Fahrertür
    signal SSA_HFT_FH_Thermoschutz_XIX_DoorFunctions_HFS_01_XIX_VLAN_Cockpit: start 111, 1 bit, little-endian, data-type-policy=OVERRIDE, i-signal-type=PRIMITIVE, init-value=0, base-type=BT_SSA_HFT_FH_Thermoschutz, compu {0=Cx0_Thermoschutz_deaktiv (CM_SSA_HFT_FH_Thermoschutz_Cx0_Thermoschutz_deaktiv), 1=Cx1_Thermoschutz_aktiv (CM_SSA_HFT_FH_Thermoschutz_Cx1_Thermoschutz_aktiv)}, range raw 0..1, transfer-property=TRIGGERED-WITHOUT-REPETITION  # SmartSensorActor: Rückmeldung Status Thermoschutz
    signal SSA_HFT_Tuerverschluss_Fehler_XIX_DoorFunctions_HFS_01_XIX_VLAN_Cockpit: start 112, 3 bit, little-endian, data-type-policy=OVERRIDE, i-signal-type=PRIMITIVE, init-value=0, base-type=BT_SSA_HFT_Tuerverschluss_Fehler, compu {4=Cx4_elektrischer_Fehler (CM_SSA_HFT_Tuerverschluss_Fehler_Cx4_elektrischer_Fehler), 3=Cx3_Ueberspannung (CM_SSA_HFT_Tuerverschluss_Fehler_Cx3_Ueberspannung), 1=Cx1_nicht_verbaut (CM_SSA_HFT_Tuerverschluss_Fehler_Cx1_nicht_verbaut), 0=Cx0_In_Ordnung (CM_SSA_HFT_Tuerverschluss_Fehler_Cx0_In_Ordnung), 5=Cx5_Bedingung_nicht_erfuellt (CM_SSA_HFT_Tuerverschluss_Fehler_Cx5_Bedingung_nicht_erfuellt), 2=Cx2_Unterspannung (CM_SSA_HFT_Tuerverschluss_Fehler_Cx2_Unterspannung)}, range raw 0..5, transfer-property=TRIGGERED-WITHOUT-REPETITION  # SmartSensorActor: Fehlerzustand der hinteren Fahrertür
    signal SSA_HFT_SSR_Fehler_XIX_DoorFunctions_HFS_01_XIX_VLAN_Cockpit: start 115, 3 bit, little-endian, data-type-policy=OVERRIDE, i-signal-type=PRIMITIVE, init-value=0, base-type=BT_SSA_HFT_SSR_Fehler, compu {0=Cx0_in_Ordnung (CM_SSA_HFT_SSR_Fehler_Cx0_in_Ordnung), 5=Cx5_Bedingung_nicht_erfuellt (CM_SSA_HFT_SSR_Fehler_Cx5_Bedingung_nicht_erfuellt), 3=Cx3_Ueberspannung (CM_SSA_HFT_SSR_Fehler_Cx3_Ueberspannung), 2=Cx2_Unterspannung (CM_SSA_HFT_SSR_Fehler_Cx2_Unterspannung), 4=Cx4_elektrischer_Fehler (CM_SSA_HFT_SSR_Fehler_Cx4_elektrischer_Fehler), 1=Cx1_nicht_verbaut (CM_SSA_HFT_SSR_Fehler_Cx1_nicht_verbaut)}, range raw 0..5, transfer-property=TRIGGERED-WITHOUT-REPETITION  # SmartSensorActor: Rückmeldung des Fehlerzustand des Seitenscheibenrollos
    signal SSA_HFT_Amb_Bel_Fehler_XIX_DoorFunctions_HFS_01_XIX_VLAN_Cockpit: start 118, 3 bit, little-endian, data-type-policy=OVERRIDE, i-signal-type=PRIMITIVE, init-value=0, base-type=BT_SSA_HFT_Amb_Bel_Fehler, compu {2=Cx2_Unterspannung (CM_SSA_HFT_Amb_Bel_Fehler_Cx2_Unterspannung), 5=Cx5_Bedingung_nicht_erfuellt (CM_SSA_HFT_Amb_Bel_Fehler_Cx5_Bedingung_nicht_erfuellt), 4=Cx4_el_Fehler (CM_SSA_HFT_Amb_Bel_Fehler_Cx4_el_Fehler), 3=Cx3_Ueberspannung (CM_SSA_HFT_Amb_Bel_Fehler_Cx3_Ueberspannung), 0=Cx0_iO (CM_SSA_HFT_Amb_Bel_Fehler_Cx0_iO), 1=Cx1_nicht_verbaut (CM_SSA_HFT_Amb_Bel_Fehler_Cx1_nicht_verbaut)}, range raw 0..5, transfer-property=TRIGGERED-WITHOUT-REPETITION  # SmartSensorActor: Rückmeldung des Fehlerzustand der Ambiente Beleuchtung
    signal SSA_HFT_FH_Fehler_XIX_DoorFunctions_HFS_01_XIX_VLAN_Cockpit: start 121, 3 bit, little-endian, data-type-policy=OVERRIDE, i-signal-type=PRIMITIVE, init-value=0, base-type=BT_SSA_HFT_FH_Fehler, compu {1=Cx1_nicht_verbaut (CM_SSA_HFT_FH_Fehler_Cx1_nicht_verbaut), 2=Cx2_Unterspannung (CM_SSA_HFT_FH_Fehler_Cx2_Unterspannung), 4=Cx4_el_Fehler (CM_SSA_HFT_FH_Fehler_Cx4_el_Fehler), 3=Cx3_Ueberspannung (CM_SSA_HFT_FH_Fehler_Cx3_Ueberspannung), 0=Cx0_iO (CM_SSA_HFT_FH_Fehler_Cx0_iO), 5=Cx5_Bedingung_nicht_erfuellt (CM_SSA_HFT_FH_Fehler_Cx5_Bedingung_nicht_erfuellt)}, range raw 0..5, transfer-property=TRIGGERED-WITHOUT-REPETITION  # SmartSensorActor: Rückmeldung des Fehlerzustandes der Fensterheberfunktion
    signal SSA_HFS_eKisi_Fehler_XIX_DoorFunctions_HFS_01_XIX_VLAN_Cockpit: start 124, 3 bit, little-endian, data-type-policy=OVERRIDE, i-signal-type=PRIMITIVE, init-value=0, base-type=BT_SSA_HFS_eKisi_Fehler, compu {3=Cx3_Ueberspannung (CM_SSA_HFS_eKisi_Fehler_Cx3_Ueberspannung), 1=Cx1_nicht_verbaut (CM_SSA_HFS_eKisi_Fehler_Cx1_nicht_verbaut), 4=Cx4_el_Fehler (CM_SSA_HFS_eKisi_Fehler_Cx4_el_Fehler), 0=Cx0_iO (CM_SSA_HFS_eKisi_Fehler_Cx0_iO), 5=Cx5_Bedingung_nicht_erfuellt (CM_SSA_HFS_eKisi_Fehler_Cx5_Bedingung_nicht_erfuellt), 2=Cx2_Unterspannung (CM_SSA_HFS_eKisi_Fehler_Cx2_Unterspannung)}, range raw 0..5, transfer-property=TRIGGERED-WITHOUT-REPETITION  # SmartSensorActor: Rückmeldung des Fehlerzustandes der elektrischen Kindersicherung auf der Fahrerseite hinten
    signal SSA_HFT_ZZH_Fehler_XIX_DoorFunctions_HFS_01_XIX_VLAN_Cockpit: start 127, 3 bit, little-endian, data-type-policy=OVERRIDE, i-signal-type=PRIMITIVE, init-value=0, base-type=BT_SSA_HFT_ZZH_Fehler, compu {1=Cx1_nicht_verbaut (CM_SSA_HFT_ZZH_Fehler_Cx1_nicht_verbaut), 4=Cx4_elektrischer_Fehler (CM_SSA_HFT_ZZH_Fehler_Cx4_elektrischer_Fehler), 0=Cx0_in_Ordnung (CM_SSA_HFT_ZZH_Fehler_Cx0_in_Ordnung), 3=Cx3_Ueberspannung (CM_SSA_HFT_ZZH_Fehler_Cx3_Ueberspannung), 2=Cx2_Unterspannung (CM_SSA_HFT_ZZH_Fehler_Cx2_Unterspannung), 5=Cx5_Bedingung_nicht_erfuellt (CM_SSA_HFT_ZZH_Fehler_Cx5_Bedingung_nicht_erfuellt)}, range raw 0..5, transfer-property=TRIGGERED-WITHOUT-REPETITION  # SmartSensorActor: Rückmeldung des Fehlerzustandes des ZZH Systems
    signal SSA_HFT_ZV_Fehler_XIX_DoorFunctions_HFS_01_XIX_VLAN_Cockpit: start 130, 3 bit, little-endian, data-type-policy=OVERRIDE, i-signal-type=PRIMITIVE, init-value=0, base-type=BT_SSA_HFT_ZV_Fehler, compu {5=Cx5_Bedingung_nicht_erfuellt (CM_SSA_HFT_ZV_Fehler_Cx5_Bedingung_nicht_erfuellt), 4=Cx4_elektrischer_Fehler (CM_SSA_HFT_ZV_Fehler_Cx4_elektrischer_Fehler), 0=Cx0_in_Ordnung (CM_SSA_HFT_ZV_Fehler_Cx0_in_Ordnung), 1=Cx1_nicht_verbaut (CM_SSA_HFT_ZV_Fehler_Cx1_nicht_verbaut), 2=Cx2_Unterspannung (CM_SSA_HFT_ZV_Fehler_Cx2_Unterspannung), 3=Cx3_Ueberspannung (CM_SSA_HFT_ZV_Fehler_Cx3_Ueberspannung)}, range raw 0..5, transfer-property=TRIGGERED-WITHOUT-REPETITION  # SmartSensorActor: Rückmeldung des Fehlerzustandes des Türschlosses der hinteren Fahrertür
    signal SSA_HFT_el_Tuerantrieb_Fehler_XIX_DoorFunctions_HFS_01_XIX_VLAN_Cockpit: start 133, 3 bit, little-endian, data-type-policy=OVERRIDE, i-signal-type=PRIMITIVE, init-value=0, base-type=BT_SSA_HFT_el_Tuerantrieb_Fehler, compu {2=Cx2_Unterspannung (CM_SSA_HFT_el_Tuerantrieb_Fehler_Cx2_Unterspannung), 5=Cx5_Bedingung_nicht_erfuellt (CM_SSA_HFT_el_Tuerantrieb_Fehler_Cx5_Bedingung_nicht_erfuellt), 3=Cx3_Ueberspannung (CM_SSA_HFT_el_Tuerantrieb_Fehler_Cx3_Ueberspannung), 0=Cx0_iO (CM_SSA_HFT_el_Tuerantrieb_Fehler_Cx0_iO), 1=Cx1_nicht_verbaut (CM_SSA_HFT_el_Tuerantrieb_Fehler_Cx1_nicht_verbaut), 4=Cx4_el_Fehler (CM_SSA_HFT_el_Tuerantrieb_Fehler_Cx4_el_Fehler)}, range raw 0..5, transfer-property=TRIGGERED-WITHOUT-REPETITION  # SmartSensorActor: Rückmeldung des Fehlerzustand des el. Tuerantriebs
    signal SSA_HFT_ASW_Fehler_XIX_DoorFunctions_HFS_01_XIX_VLAN_Cockpit: start 136, 3 bit, little-endian, data-type-policy=OVERRIDE, i-signal-type=PRIMITIVE, init-value=0, base-type=BT_SSA_HFT_ASW_Fehler, compu {4=Cx4_el_Fehler (CM_SSA_HFT_ASW_Fehler_Cx4_el_Fehler), 2=Cx2_Unterspannung (CM_SSA_HFT_ASW_Fehler_Cx2_Unterspannung), 1=Cx1_nicht_verbaut (CM_SSA_HFT_ASW_Fehler_Cx1_nicht_verbaut), 3=Cx3_Ueberspannung (CM_SSA_HFT_ASW_Fehler_Cx3_Ueberspannung), 0=Cx0_iO (CM_SSA_HFT_ASW_Fehler_Cx0_iO), 5=Cx5_Bedingung_nicht_erfuellt (CM_SSA_HFT_ASW_Fehler_Cx5_Bedingung_nicht_erfuellt)}, range raw 0..5, transfer-property=TRIGGERED-WITHOUT-REPETITION  # SmartSensorActor: Rückmeldung des Fehlerzustand des Ausstiegswarners
    signal SSA_HFT_FH_Normierung_XIX_DoorFunctions_HFS_01_XIX_VLAN_Cockpit: start 139, 1 bit, little-endian, data-type-policy=OVERRIDE, i-signal-type=PRIMITIVE, init-value=0, base-type=BT_SSA_HFT_FH_Normierung, compu {1=Cx1_normiert (CM_SSA_HFT_FH_Normierung_Cx1_normiert), 0=Cx0_nicht_normiert (CM_SSA_HFT_FH_Normierung_Cx0_nicht_normiert)}, range raw 0..1, transfer-property=TRIGGERED-WITHOUT-REPETITION  # SmartSensorActor: Rückmeldung des Normierungszustandes des Fensterhebers
    signal HFS_Tuer_geoeffnet_XIX_DoorFunctions_HFS_01_XIX_VLAN_Cockpit: start 144, 1 bit, little-endian, data-type-policy=OVERRIDE, i-signal-type=PRIMITIVE, init-value=0, base-type=BT_HFS_Tuer_geoeffnet, compu {1=Cx1_offen (CM_HFS_Tuer_geoeffnet_Cx1_offen), 0=Cx0_geschlossen (CM_HFS_Tuer_geoeffnet_Cx0_geschlossen)}, range raw 0..1, transfer-property=TRIGGERED-WITHOUT-REPETITION  # HFS Tuer geoeffnet
    signal HFS_verriegelt_XIX_DoorFunctions_HFS_01_XIX_VLAN_Cockpit: start 145, 1 bit, little-endian, data-type-policy=OVERRIDE, i-signal-type=PRIMITIVE, init-value=0, base-type=BT_HFS_verriegelt, compu {1=Cx1_verriegelt (CM_HFS_verriegelt_Cx1_verriegelt), 0=Cx0_nicht_verriegelt (CM_HFS_verriegelt_Cx0_nicht_verriegelt)}, range raw 0..1, transfer-property=TRIGGERED-WITHOUT-REPETITION  # HFS Tuer verriegelt
    signal HFS_gesafet_XIX_DoorFunctions_HFS_01_XIX_VLAN_Cockpit: start 146, 1 bit, little-endian, data-type-policy=OVERRIDE, i-signal-type=PRIMITIVE, init-value=0, base-type=BT_HFS_gesafet, compu {0=Cx0_nicht_gesafet (CM_HFS_gesafet_Cx0_nicht_gesafet), 1=Cx1_gesafet (CM_HFS_gesafet_Cx1_gesafet)}, range raw 0..1, transfer-property=TRIGGERED-WITHOUT-REPETITION  # HFS Tuer gesafet. Im Zustand Safe wird auch das Signal HFS_verriegelt = 1 gesendet.
    signal HFS_Heckrollotaster_betaetigt_XIX_DoorFunctions_HFS_01_XIX_VLAN_Cockpit: start 147, 1 bit, little-endian, data-type-policy=OVERRIDE, i-signal-type=PRIMITIVE, init-value=0, base-type=BT_HFS_Heckrollotaster_betaetigt, compu {1=Cx1_In_Richtung_Hoch_Verfahren (CM_HFS_Heckrollotaster_betaetigt_Cx1_In_Richtung_Hoch_Verfahren), 0=Cx0_keine_Verfahranweisung_in_Richtung_Hoch (CM_HFS_Heckrollotaster_betaetigt_Cx0_keine_Verfahranweisung_in_Richtung_Hoch)}, range raw 0..1, transfer-property=TRIGGERED-WITHOUT-REPETITION  # Verfahren des Heckrollos in Richtung Hoch Bei Einfachtaster wird Bit als Togglebit verwendet (Heckrollo hoch, tief)
    signal HFS_Tuerschloss_defekt_XIX_DoorFunctions_HFS_01_XIX_VLAN_Cockpit: start 148, 1 bit, little-endian, data-type-policy=OVERRIDE, i-signal-type=PRIMITIVE, init-value=0, base-type=BT_HFS_Tuerschloss_defekt, compu {1=Cx1_Tuerschloss_defekt (CM_HFS_Tuerschloss_defekt_Cx1_Tuerschloss_defekt), 0=Cx0_Tuerschloss_funktionsfaehig (CM_HFS_Tuerschloss_defekt_Cx0_Tuerschloss_funktionsfaehig)}, range raw 0..1, transfer-property=TRIGGERED-WITHOUT-REPETITION  # Das hintere Tuerschloss auf der Fahrerseite ist nicht mehr funktionsfähig.
    signal HFS_Unlock_Taster_XIX_DoorFunctions_HFS_01_XIX_VLAN_Cockpit: start 149, 1 bit, little-endian, data-type-policy=OVERRIDE, i-signal-type=PRIMITIVE, init-value=0, base-type=BT_HFS_Unlock_Taster, compu {1=Cx1_betaetigt (CM_HFS_Unlock_Taster_Cx1_betaetigt), 0=Cx0_nicht_betaetigt (CM_HFS_Unlock_Taster_Cx0_nicht_betaetigt)}, range raw 0..1, transfer-property=TRIGGERED-WITHOUT-REPETITION  # Betaetigung Unlock Taster
    signal HFS_Lock_Taster_XIX_DoorFunctions_HFS_01_XIX_VLAN_Cockpit: start 150, 1 bit, little-endian, data-type-policy=OVERRIDE, i-signal-type=PRIMITIVE, init-value=0, base-type=BT_HFS_Lock_Taster, compu {1=Cx1_betaetigt (CM_HFS_Lock_Taster_Cx1_betaetigt), 0=Cx0_nicht_betaetigt (CM_HFS_Lock_Taster_Cx0_nicht_betaetigt)}, range raw 0..1, transfer-property=TRIGGERED-WITHOUT-REPETITION  # Betätigung Lock-Taster
    signal HFS_Sperrklinke_XIX_DoorFunctions_HFS_01_XIX_VLAN_Cockpit: start 151, 1 bit, little-endian, data-type-policy=OVERRIDE, i-signal-type=PRIMITIVE, init-value=0, base-type=BT_HFS_Sperrklinke, compu {1=Cx1_Tuer_auf_oder_Tuer_Position_zwischen_Vor_und_Hauptraste (CM_HFS_Sperrklinke_Cx1_Tuer_auf_oder_Tuer_Position_zwischen_Vor_und_Hauptraste), 0=Cx0_Schloss_in_Vorraste_und_Hauptraste (CM_HFS_Sperrklinke_Cx0_Schloss_in_Vorraste_und_Hauptraste)}, range raw 0..1, transfer-property=TRIGGERED-WITHOUT-REPETITION  # Vorraste für Schloß zwischen Vor- und Hauptraste Signal kurz auf 1, danach wieder auf 0 wenn Tür in Hauptraste (Tür ist sicher zu wenn Sperrklinke und Türkontakt auf 0 sind)
    signal HFS_TAG_betaetigt_XIX_DoorFunctions_HFS_01_XIX_VLAN_Cockpit: start 152, 1 bit, little-endian, data-type-policy=OVERRIDE, i-signal-type=PRIMITIVE, init-value=0, base-type=BT_HFS_TAG_betaetigt, compu {1=Cx1_betaetigt (CM_HFS_TAG_betaetigt_Cx1_betaetigt), 0=Cx0_nicht_betaetigt (CM_HFS_TAG_betaetigt_Cx0_nicht_betaetigt)}, range raw 0..1, transfer-property=TRIGGERED-WITHOUT-REPETITION  # Betaetigung Türaussengriff
    signal HFS_TIG_betaetigt_XIX_DoorFunctions_HFS_01_XIX_VLAN_Cockpit: start 153, 1 bit, little-endian, data-type-policy=OVERRIDE, i-signal-type=PRIMITIVE, init-value=0, base-type=BT_HFS_TIG_betaetigt, compu {1=Cx1_betaetigt (CM_HFS_TIG_betaetigt_Cx1_betaetigt), 0=Cx0_nicht_betaetigt (CM_HFS_TIG_betaetigt_Cx0_nicht_betaetigt)}, range raw 0..1, transfer-property=TRIGGERED-WITHOUT-REPETITION  # Betaetigung Türinnengriff
    signal HFS_FH_S_HBFS_AutoHoch_XIX_DoorFunctions_HFS_01_XIX_VLAN_Cockpit: start 154, 1 bit, little-endian, data-type-policy=OVERRIDE, i-signal-type=PRIMITIVE, init-value=0, base-type=BT_HFS_FH_S_HBFS_AutoHoch, compu {1=Cx1_Automatiklauf_Angefordert (CM_HFS_FH_S_HBFS_AutoHoch_Cx1_Automatiklauf_Angefordert), 0=Cx0_keine_Bedienung (CM_HFS_FH_S_HBFS_AutoHoch_Cx0_keine_Bedienung)}, range raw 0..1, transfer-property=TRIGGERED-WITHOUT-REPETITION  # Automatisches Hochfahren der Seitenscheibe HBFS
    signal HFS_FH_S_HBFS_AutoTief_XIX_DoorFunctions_HFS_01_XIX_VLAN_Cockpit: start 155, 1 bit, little-endian, data-type-policy=OVERRIDE, i-signal-type=PRIMITIVE, init-value=0, base-type=BT_HFS_FH_S_HBFS_AutoTief, compu {1=Cx1_Automatiklauf_Angefordert (CM_HFS_FH_S_HBFS_AutoTief_Cx1_Automatiklauf_Angefordert), 0=Cx0_keine_Bedienung (CM_HFS_FH_S_HBFS_AutoTief_Cx0_keine_Bedienung)}, range raw 0..1, transfer-property=TRIGGERED-WITHOUT-REPETITION  # Automatisches Absenken der Seitenscheibe HBFS
    signal TSG_FlHz_HFS_Unterbrech_HzK_A_XIX_DoorFunctions_HFS_01_XIX_VLAN_Cockpit: start 156, 1 bit, little-endian, data-type-policy=OVERRIDE, i-signal-type=PRIMITIVE, init-value=0, base-type=BT_TSG_FlHz_HFS_Unterbrech_HzK_A, compu {1=Cx1_Unterbrechung (CM_TSG_FlHz_HFS_Unterbrech_HzK_A_Cx1_Unterbrechung), 0=Cx0_keine_Unterbrechung (CM_TSG_FlHz_HFS_Unterbrech_HzK_A_Cx0_keine_Unterbrechung)}, range raw 0..1, transfer-property=TRIGGERED-WITHOUT-REPETITION  # Flächenheizung: Unterbrechungsstatus Heizkreis
    signal TSG_FlHz_HFS_Unterbrech_HzK_B_XIX_DoorFunctions_HFS_01_XIX_VLAN_Cockpit: start 157, 1 bit, little-endian, data-type-policy=OVERRIDE, i-signal-type=PRIMITIVE, init-value=0, base-type=BT_TSG_FlHz_HFS_Unterbrech_HzK_B, compu {0=Cx0_keine_Unterbrechung (CM_TSG_FlHz_HFS_Unterbrech_HzK_B_Cx0_keine_Unterbrechung), 1=Cx1_Unterbrechung (CM_TSG_FlHz_HFS_Unterbrech_HzK_B_Cx1_Unterbrechung)}, range raw 0..1, transfer-property=TRIGGERED-WITHOUT-REPETITION  # Flächenheizung: Unterbrechungsstatus Heizkreis
    signal HFT_Kisi_Fehler_XIX_DoorFunctions_HFS_01_XIX_VLAN_Cockpit: start 158, 1 bit, little-endian, data-type-policy=OVERRIDE, i-signal-type=PRIMITIVE, init-value=0, base-type=BT_HFT_Kisi_Fehler, invalid-value=Invalid_HFT_Kisi_Fehler_XIX_DoorFunctions_HFS_01_XIX_VLAN_Cockpit:1, compu {1=Cx1_Fehler (CM_HFT_Kisi_Fehler_Cx1_Fehler), 0=Cx0_kein_Fehler (CM_HFT_Kisi_Fehler_Cx0_kein_Fehler)}, range raw 0..1, transfer-property=TRIGGERED-WITHOUT-REPETITION  # Fehlerstatus Kindersicherungsfunktion
    signal HFS_ASW_Warnton_XIX_DoorFunctions_HFS_01_XIX_VLAN_Cockpit: start 206, 2 bit, little-endian, data-type-policy=OVERRIDE, i-signal-type=PRIMITIVE, init-value=0, base-type=BT_HFS_ASW_Warnton, invalid-value=Invalid_HFS_ASW_Warnton_XIX_DoorFunctions_HFS_01_XIX_VLAN_Cockpit:3, compu {3=Cx3_Fehler (CM_HFS_ASW_Warnton_Cx3_Fehler), 0=Cx0_kein_warnton (CM_HFS_ASW_Warnton_Cx0_kein_warnton), 1=Cx1_warnton_links (CM_HFS_ASW_Warnton_Cx1_warnton_links), 2=Cx2_warnton_rechts (CM_HFS_ASW_Warnton_Cx2_warnton_rechts)}, range raw 0..3, transfer-property=TRIGGERED-WITHOUT-REPETITION  # erzeugt ein Warnton bei AS Warnung
    signal HFS_ASW_Warnung_Aussenlicht_XIX_DoorFunctions_HFS_01_XIX_VLAN_Cockpit: start 208, 2 bit, little-endian, data-type-policy=OVERRIDE, i-signal-type=PRIMITIVE, init-value=0, base-type=BT_HFS_ASW_Warnung_Aussenlicht, invalid-value=Invalid_HFS_ASW_Warnung_Aussenlicht_XIX_DoorFunctions_HFS_01_XIX_VLAN_Cockpit:3, compu {3=Cx3_Fehler (CM_HFS_ASW_Warnung_Aussenlicht_Cx3_Fehler), 1=Cx1_licht_links (CM_HFS_ASW_Warnung_Aussenlicht_Cx1_licht_links), 0=Cx0_kein_licht (CM_HFS_ASW_Warnung_Aussenlicht_Cx0_kein_licht), 2=Cx2_licht_rechts (CM_HFS_ASW_Warnung_Aussenlicht_Cx2_licht_rechts)}, range raw 0..3, transfer-property=TRIGGERED-WITHOUT-REPETITION  # zeigt in den Heckleuchte ein Symbol an
    signal HFS_ASW_Warnung_VAS_XIX_DoorFunctions_HFS_01_XIX_VLAN_Cockpit: start 210, 2 bit, little-endian, data-type-policy=OVERRIDE, i-signal-type=PRIMITIVE, init-value=0, base-type=BT_HFS_ASW_Warnung_VAS, invalid-value=Invalid_HFS_ASW_Warnung_VAS_XIX_DoorFunctions_HFS_01_XIX_VLAN_Cockpit:3, compu {3=Cx3_Fehler (CM_HFS_ASW_Warnung_VAS_Cx3_Fehler), 2=Cx2_Warnung (CM_HFS_ASW_Warnung_VAS_Cx2_Warnung), 0=Cx0_Keine_Warnung (CM_HFS_ASW_Warnung_VAS_Cx0_Keine_Warnung), 1=Cx1_Info (CM_HFS_ASW_Warnung_VAS_Cx1_Info)}, range raw 0..3, transfer-property=TRIGGERED-WITHOUT-REPETITION  # Abschaltung der VAS hinter Fahrertür bei aktiver ASW Warnung an der hinnter Fahrertür
    signal HFS_ASW_HMI_defekt_XIX_DoorFunctions_HFS_01_XIX_VLAN_Cockpit: start 212, 1 bit, little-endian, data-type-policy=OVERRIDE, i-signal-type=PRIMITIVE, init-value=0, base-type=BT_HFS_ASW_HMI_defekt, compu {0=Cx0_ASW_kein_Fehler (CM_HFS_ASW_HMI_defekt_Cx0_ASW_kein_Fehler), 1=Cx1_ASW_Fehler (CM_HFS_ASW_HMI_defekt_Cx1_ASW_Fehler)}, range raw 0..1, transfer-property=TRIGGERED-WITHOUT-REPETITION  # HMI Status der Funktion AusstiegsWarnung (ASW), HMI wird durch das TSG angesteuert.
    signal SSA_HFT_FH_Oeffnungsweite_XIX_DoorFunctions_HFS_01_XIX_VLAN_Cockpit: start 216, 8 bit, little-endian, data-type-policy=OVERRIDE, i-signal-type=PRIMITIVE, init-value=0, base-type=BT_SSA_HFT_FH_Oeffnungsweite, compu {phys=raw*0.5 for raw 0..200; unit Unit_PerCent}, range phys 0..100 Unit_PerCent, raw 0..200, unit=Unit_PerCent, transfer-property=TRIGGERED-WITHOUT-REPETITION  # SmartSensorActor: Rückmeldung der Öffnungsweite des Fensterhebers (0% geschlossen, 100% geöffnet) Angabe gilt nur bei normierten Fensterheber
  pdu DS_CCF_XIX_VLAN_Cockpit: length=8, minimum-delay=0.08, transmission-mode-true-timing={cyclic-timing={time-offset=0.0, time-period=1.0}, event-controlled-timing={number-of-repetitions=0, repetition-period=0.0}}, unused-bit-pattern=0
    signal DS_CCF_DiagAdr_XIX_DS_CCF_XIX_VLAN_Cockpit: start 0, 16 bit, little-endian, data-type-policy=OVERRIDE, i-signal-type=PRIMITIVE, init-value=33093, base-type=BT_DS_CCF_DiagAdr, compu {phys=raw for raw 0..65535}, range phys 0..65535, raw 0..65535, transfer-property=PENDING  # Übertragung vom Diagnosestatus gem. 80114
    signal DS_CCF_TestFailedChanged_XIX_DS_CCF_XIX_VLAN_Cockpit: start 16, 1 bit, little-endian, data-type-policy=OVERRIDE, i-signal-type=PRIMITIVE, init-value=0, base-type=BT_DS_CCF_TestFailedChanged, compu {phys=raw for raw 0..1}, range phys 0..1, raw 0..1, transfer-property=TRIGGERED-ON-CHANGE-WITHOUT-REPETITION  # Übertragung vom Diagnosestatus gem. 80114
    signal DS_CCF_ConfDTCChanged_XIX_DS_CCF_XIX_VLAN_Cockpit: start 17, 1 bit, little-endian, data-type-policy=OVERRIDE, i-signal-type=PRIMITIVE, init-value=0, base-type=BT_DS_CCF_ConfDTCChanged, compu {phys=raw for raw 0..1}, range phys 0..1, raw 0..1, transfer-property=TRIGGERED-ON-CHANGE-WITHOUT-REPETITION  # Übertragung vom Diagnosestatus gem. 80114
    signal DS_CCF_WIRChanged_XIX_DS_CCF_XIX_VLAN_Cockpit: start 18, 1 bit, little-endian, data-type-policy=OVERRIDE, i-signal-type=PRIMITIVE, init-value=0, base-type=BT_DS_CCF_WIRChanged, compu {phys=raw for raw 0..1}, range phys 0..1, raw 0..1, transfer-property=TRIGGERED-ON-CHANGE-WITHOUT-REPETITION  # Übertragung vom Diagnosestatus gem. 80114
    signal DS_CCF_StMemChanged_XIX_DS_CCF_XIX_VLAN_Cockpit: start 19, 1 bit, little-endian, data-type-policy=OVERRIDE, i-signal-type=PRIMITIVE, init-value=0, base-type=BT_DS_CCF_StMemChanged, compu {phys=raw for raw 0..1}, range phys 0..1, raw 0..1, transfer-property=TRIGGERED-ON-CHANGE-WITHOUT-REPETITION  # Übertragung vom Diagnosestatus gem. 80114
    signal DS_CCF_MemSel10Changed_XIX_DS_CCF_XIX_VLAN_Cockpit: start 20, 1 bit, little-endian, data-type-policy=OVERRIDE, i-signal-type=PRIMITIVE, init-value=0, base-type=BT_DS_CCF_MemSel10Changed, compu {phys=raw for raw 0..1}, range phys 0..1, raw 0..1, transfer-property=TRIGGERED-ON-CHANGE-WITHOUT-REPETITION  # Übertragung vom Diagnosestatus gem. 80114
    signal DS_CCF_MemSelChanged_XIX_DS_CCF_XIX_VLAN_Cockpit: start 21, 1 bit, little-endian, data-type-policy=OVERRIDE, i-signal-type=PRIMITIVE, init-value=0, base-type=BT_DS_CCF_MemSelChanged, compu {phys=raw for raw 0..1}, range phys 0..1, raw 0..1, transfer-property=TRIGGERED-ON-CHANGE-WITHOUT-REPETITION  # Übertragung vom Diagnosestatus gem. 80114
    signal DS_CCF_IdentValid_XIX_DS_CCF_XIX_VLAN_Cockpit: start 22, 1 bit, little-endian, data-type-policy=OVERRIDE, i-signal-type=PRIMITIVE, init-value=1, base-type=BT_DS_CCF_IdentValid, compu {0=Cx0_Ungueltig (CM_DS_CCF_IdentValid_Cx0_Ungueltig), 1=Cx1_Gueltig (CM_DS_CCF_IdentValid_Cx1_Gueltig)}, range raw 0..1, transfer-property=TRIGGERED-ON-CHANGE-WITHOUT-REPETITION  # Signalisiert ob die Identifikationsdaten gueltig sind
    signal DS_CCF_Lokalaktiv_XIX_DS_CCF_XIX_VLAN_Cockpit: start 23, 1 bit, little-endian, data-type-policy=OVERRIDE, i-signal-type=PRIMITIVE, init-value=0, base-type=BT_DS_CCF_Lokalaktiv, compu {0=Cx0_war_nicht_lokal_aktiv (CM_DS_CCF_Lokalaktiv_Cx0_war_nicht_lokal_aktiv), 1=Cx1_war_lokal_aktiv (CM_DS_CCF_Lokalaktiv_Cx1_war_lokal_aktiv)}, range raw 0..1, transfer-property=PENDING  # Zeigt an ob das SG nach Klemme15 AUS und nach entsprechender MAX Aktivzeit noch aktiv war.
  pdu DS_CID_XIX_VLAN_Cockpit: length=8, minimum-delay=0.08, transmission-mode-true-timing={cyclic-timing={time-offset=0.0, time-period=1.0}, event-controlled-timing={number-of-repetitions=0, repetition-period=0.0}}, unused-bit-pattern=0
    signal DS_CID_DiagAdr_XIX_DS_CID_XIX_VLAN_Cockpit: start 0, 16 bit, little-endian, data-type-policy=OVERRIDE, i-signal-type=PRIMITIVE, init-value=33094, base-type=BT_DS_CID_DiagAdr, compu {phys=raw for raw 0..65535}, range phys 0..65535, raw 0..65535, transfer-property=PENDING  # Übertragung vom Diagnosestatus gem. 80114
    signal DS_CID_TestFailedChanged_XIX_DS_CID_XIX_VLAN_Cockpit: start 16, 1 bit, little-endian, data-type-policy=OVERRIDE, i-signal-type=PRIMITIVE, init-value=0, base-type=BT_DS_CID_TestFailedChanged, compu {phys=raw for raw 0..1}, range phys 0..1, raw 0..1, transfer-property=TRIGGERED-ON-CHANGE-WITHOUT-REPETITION  # Übertragung vom Diagnosestatus gem. 80114
    signal DS_CID_ConfDTCChanged_XIX_DS_CID_XIX_VLAN_Cockpit: start 17, 1 bit, little-endian, data-type-policy=OVERRIDE, i-signal-type=PRIMITIVE, init-value=0, base-type=BT_DS_CID_ConfDTCChanged, compu {phys=raw for raw 0..1}, range phys 0..1, raw 0..1, transfer-property=TRIGGERED-ON-CHANGE-WITHOUT-REPETITION  # Übertragung vom Diagnosestatus gem. 80114
    signal DS_CID_WIRChanged_XIX_DS_CID_XIX_VLAN_Cockpit: start 18, 1 bit, little-endian, data-type-policy=OVERRIDE, i-signal-type=PRIMITIVE, init-value=0, base-type=BT_DS_CID_WIRChanged, compu {phys=raw for raw 0..1}, range phys 0..1, raw 0..1, transfer-property=TRIGGERED-ON-CHANGE-WITHOUT-REPETITION  # Übertragung vom Diagnosestatus gem. 80114
    signal DS_CID_StMemChanged_XIX_DS_CID_XIX_VLAN_Cockpit: start 19, 1 bit, little-endian, data-type-policy=OVERRIDE, i-signal-type=PRIMITIVE, init-value=0, base-type=BT_DS_CID_StMemChanged, compu {phys=raw for raw 0..1}, range phys 0..1, raw 0..1, transfer-property=TRIGGERED-ON-CHANGE-WITHOUT-REPETITION  # Übertragung vom Diagnosestatus gem. 80114
    signal DS_CID_MemSel10Changed_XIX_DS_CID_XIX_VLAN_Cockpit: start 20, 1 bit, little-endian, data-type-policy=OVERRIDE, i-signal-type=PRIMITIVE, init-value=0, base-type=BT_DS_CID_MemSel10Changed, compu {phys=raw for raw 0..1}, range phys 0..1, raw 0..1, transfer-property=TRIGGERED-ON-CHANGE-WITHOUT-REPETITION  # Übertragung vom Diagnosestatus gem. 80114
    signal DS_CID_MemSelChanged_XIX_DS_CID_XIX_VLAN_Cockpit: start 21, 1 bit, little-endian, data-type-policy=OVERRIDE, i-signal-type=PRIMITIVE, init-value=0, base-type=BT_DS_CID_MemSelChanged, compu {phys=raw for raw 0..1}, range phys 0..1, raw 0..1, transfer-property=TRIGGERED-ON-CHANGE-WITHOUT-REPETITION  # Übertragung vom Diagnosestatus gem. 80114
    signal DS_CID_IdentValid_XIX_DS_CID_XIX_VLAN_Cockpit: start 22, 1 bit, little-endian, data-type-policy=OVERRIDE, i-signal-type=PRIMITIVE, init-value=1, base-type=BT_DS_CID_IdentValid, compu {1=Cx1_Gueltig (CM_DS_CID_IdentValid_Cx1_Gueltig), 0=Cx0_Ungueltig (CM_DS_CID_IdentValid_Cx0_Ungueltig)}, range raw 0..1, transfer-property=TRIGGERED-ON-CHANGE-WITHOUT-REPETITION  # Signalisiert ob die Identifikationsdaten gueltig sind
    signal DS_CID_Lokalaktiv_XIX_DS_CID_XIX_VLAN_Cockpit: start 23, 1 bit, little-endian, data-type-policy=OVERRIDE, i-signal-type=PRIMITIVE, init-value=0, base-type=BT_DS_CID_Lokalaktiv, compu {0=Cx0_war_nicht_lokal_aktiv (CM_DS_CID_Lokalaktiv_Cx0_war_nicht_lokal_aktiv), 1=Cx1_war_lokal_aktiv (CM_DS_CID_Lokalaktiv_Cx1_war_lokal_aktiv)}, range raw 0..1, transfer-property=PENDING  # Zeigt an ob das SG nach Klemme15 AUS und nach entsprechender MAX Aktivzeit noch aktiv war.
    signal DS_CID_Subsystemaktiv_XIX_DS_CID_XIX_VLAN_Cockpit: start 24, 1 bit, little-endian, data-type-policy=OVERRIDE, i-signal-type=PRIMITIVE, init-value=0, base-type=BT_DS_CID_Subsystemaktiv, compu {1=Cx1_war_lokal_aktiv (CM_DS_CID_Subsystemaktiv_Cx1_war_lokal_aktiv), 0=Cx0_war_nicht_lokal_aktiv (CM_DS_CID_Subsystemaktiv_Cx0_war_nicht_lokal_aktiv)}, range raw 0..1, transfer-property=PENDING  # Zeigt an ob ein Subsystem des SGs nach Klemme15 AUS und nach entsprechender MAX Aktivzeit noch aktiv war
  pdu DS_HUD_XIX_VLAN_Cockpit: length=8, minimum-delay=0.08, transmission-mode-true-timing={cyclic-timing={time-offset=0.0, time-period=1.0}, event-controlled-timing={number-of-repetitions=0, repetition-period=0.0}}, unused-bit-pattern=0
    signal DS_HUD_DiagAdr_XIX_DS_HUD_XIX_VLAN_Cockpit: start 0, 16 bit, little-endian, data-type-policy=OVERRIDE, i-signal-type=PRIMITIVE, init-value=130, base-type=BT_DS_HUD_DiagAdr, compu {phys=raw for raw 0..65535}, range phys 0..65535, raw 0..65535, transfer-property=PENDING  # Übertragung vom Diagnosestatus gem. 80114
    signal DS_HUD_TestFailedChanged_XIX_DS_HUD_XIX_VLAN_Cockpit: start 16, 1 bit, little-endian, data-type-policy=OVERRIDE, i-signal-type=PRIMITIVE, init-value=0, base-type=BT_DS_HUD_TestFailedChanged, compu {phys=raw for raw 0..1}, range phys 0..1, raw 0..1, transfer-property=TRIGGERED-ON-CHANGE-WITHOUT-REPETITION  # Übertragung vom Diagnosestatus gem. 80114
    signal DS_HUD_ConfDTCChanged_XIX_DS_HUD_XIX_VLAN_Cockpit: start 17, 1 bit, little-endian, data-type-policy=OVERRIDE, i-signal-type=PRIMITIVE, init-value=0, base-type=BT_DS_HUD_ConfDTCChanged, compu {phys=raw for raw 0..1}, range phys 0..1, raw 0..1, transfer-property=TRIGGERED-ON-CHANGE-WITHOUT-REPETITION  # Übertragung vom Diagnosestatus gem. 80114
    signal DS_HUD_WIRChanged_XIX_DS_HUD_XIX_VLAN_Cockpit: start 18, 1 bit, little-endian, data-type-policy=OVERRIDE, i-signal-type=PRIMITIVE, init-value=0, base-type=BT_DS_HUD_WIRChanged, compu {phys=raw for raw 0..1}, range phys 0..1, raw 0..1, transfer-property=TRIGGERED-ON-CHANGE-WITHOUT-REPETITION  # Übertragung vom Diagnosestatus gem. 80114
    signal DS_HUD_StMemChanged_XIX_DS_HUD_XIX_VLAN_Cockpit: start 19, 1 bit, little-endian, data-type-policy=OVERRIDE, i-signal-type=PRIMITIVE, init-value=0, base-type=BT_DS_HUD_StMemChanged, compu {phys=raw for raw 0..1}, range phys 0..1, raw 0..1, transfer-property=TRIGGERED-ON-CHANGE-WITHOUT-REPETITION  # Übertragung vom Diagnosestatus gem. 80114
    signal DS_HUD_MemSel10Changed_XIX_DS_HUD_XIX_VLAN_Cockpit: start 20, 1 bit, little-endian, data-type-policy=OVERRIDE, i-signal-type=PRIMITIVE, init-value=0, base-type=BT_DS_HUD_MemSel10Changed, compu {phys=raw for raw 0..1}, range phys 0..1, raw 0..1, transfer-property=TRIGGERED-ON-CHANGE-WITHOUT-REPETITION  # Übertragung vom Diagnosestatus gem. 80114
    signal DS_HUD_MemSelChanged_XIX_DS_HUD_XIX_VLAN_Cockpit: start 21, 1 bit, little-endian, data-type-policy=OVERRIDE, i-signal-type=PRIMITIVE, init-value=0, base-type=BT_DS_HUD_MemSelChanged, compu {phys=raw for raw 0..1}, range phys 0..1, raw 0..1, transfer-property=TRIGGERED-ON-CHANGE-WITHOUT-REPETITION  # Übertragung vom Diagnosestatus gem. 80114
    signal DS_HUD_IdentValid_XIX_DS_HUD_XIX_VLAN_Cockpit: start 22, 1 bit, little-endian, data-type-policy=OVERRIDE, i-signal-type=PRIMITIVE, init-value=1, base-type=BT_DS_HUD_IdentValid, compu {1=Cx1_Gueltig (CM_DS_HUD_IdentValid_Cx1_Gueltig), 0=Cx0_Ungueltig (CM_DS_HUD_IdentValid_Cx0_Ungueltig)}, range raw 0..1, transfer-property=TRIGGERED-ON-CHANGE-WITHOUT-REPETITION  # Signalisiert ob die Identifikationsdaten gueltig sind
    signal DS_HUD_Lokalaktiv_XIX_DS_HUD_XIX_VLAN_Cockpit: start 23, 1 bit, little-endian, data-type-policy=OVERRIDE, i-signal-type=PRIMITIVE, init-value=0, base-type=BT_DS_HUD_Lokalaktiv, compu {1=Cx1_war_lokal_aktiv (CM_DS_HUD_Lokalaktiv_Cx1_war_lokal_aktiv), 0=Cx0_war_nicht_lokal_aktiv (CM_DS_HUD_Lokalaktiv_Cx0_war_nicht_lokal_aktiv)}, range raw 0..1, transfer-property=PENDING  # Zeigt an ob das SG nach Klemme15 AUS und nach entsprechender MAX Aktivzeit noch aktiv war.
    signal DS_HUD_Subsystemaktiv_XIX_DS_HUD_XIX_VLAN_Cockpit: start 24, 1 bit, little-endian, data-type-policy=OVERRIDE, i-signal-type=PRIMITIVE, init-value=0, base-type=BT_DS_HUD_Subsystemaktiv, compu {1=Cx1_war_lokal_aktiv (CM_DS_HUD_Subsystemaktiv_Cx1_war_lokal_aktiv), 0=Cx0_war_nicht_lokal_aktiv (CM_DS_HUD_Subsystemaktiv_Cx0_war_nicht_lokal_aktiv)}, range raw 0..1, transfer-property=PENDING  # Zeigt an ob ein Subsystem des SGs nach Klemme15 AUS und nach entsprechender MAX Aktivzeit noch aktiv war
  pdu DS_Info_El_XIX_VLAN_Cockpit: length=8, minimum-delay=0.08, transmission-mode-true-timing={cyclic-timing={time-offset=0.0, time-period=1.0}, event-controlled-timing={number-of-repetitions=0, repetition-period=0.0}}, unused-bit-pattern=0
    signal DS_Info_El_DiagAdr_XIX_DS_Info_El_XIX_VLAN_Cockpit: start 0, 16 bit, little-endian, data-type-policy=OVERRIDE, i-signal-type=PRIMITIVE, init-value=95, base-type=BT_DS_Info_El_DiagAdr, compu {phys=raw for raw 0..65535}, range phys 0..65535, raw 0..65535, transfer-property=PENDING  # Übertragung vom Diagnosestatus gem. 80114
    signal DS_Info_El_TestFailedChanged_XIX_DS_Info_El_XIX_VLAN_Cockpit: start 16, 1 bit, little-endian, data-type-policy=OVERRIDE, i-signal-type=PRIMITIVE, init-value=0, base-type=BT_DS_Info_El_TestFailedChanged, compu {phys=raw for raw 0..1}, range phys 0..1, raw 0..1, transfer-property=TRIGGERED-ON-CHANGE-WITHOUT-REPETITION  # Übertragung vom Diagnosestatus gem. 80114
    signal DS_Info_El_ConfDTCChanged_XIX_DS_Info_El_XIX_VLAN_Cockpit: start 17, 1 bit, little-endian, data-type-policy=OVERRIDE, i-signal-type=PRIMITIVE, init-value=0, base-type=BT_DS_Info_El_ConfDTCChanged, compu {phys=raw for raw 0..1}, range phys 0..1, raw 0..1, transfer-property=TRIGGERED-ON-CHANGE-WITHOUT-REPETITION  # Übertragung vom Diagnosestatus gem. 80114
    signal DS_Info_El_WIRChanged_XIX_DS_Info_El_XIX_VLAN_Cockpit: start 18, 1 bit, little-endian, data-type-policy=OVERRIDE, i-signal-type=PRIMITIVE, init-value=0, base-type=BT_DS_Info_El_WIRChanged, compu {phys=raw for raw 0..1}, range phys 0..1, raw 0..1, transfer-property=TRIGGERED-ON-CHANGE-WITHOUT-REPETITION  # Übertragung vom Diagnosestatus gem. 80114
    signal DS_Info_El_StMemChanged_XIX_DS_Info_El_XIX_VLAN_Cockpit: start 19, 1 bit, little-endian, data-type-policy=OVERRIDE, i-signal-type=PRIMITIVE, init-value=0, base-type=BT_DS_Info_El_StMemChanged, compu {phys=raw for raw 0..1}, range phys 0..1, raw 0..1, transfer-property=TRIGGERED-ON-CHANGE-WITHOUT-REPETITION  # Übertragung vom Diagnosestatus gem. 80114
    signal DS_Info_El_MemSel10Changed_XIX_DS_Info_El_XIX_VLAN_Cockpit: start 20, 1 bit, little-endian, data-type-policy=OVERRIDE, i-signal-type=PRIMITIVE, init-value=0, base-type=BT_DS_Info_El_MemSel10Changed, compu {phys=raw for raw 0..1}, range phys 0..1, raw 0..1, transfer-property=TRIGGERED-ON-CHANGE-WITHOUT-REPETITION  # Übertragung vom Diagnosestatus gem. 80114
    signal DS_Info_El_MemSelChanged_XIX_DS_Info_El_XIX_VLAN_Cockpit: start 21, 1 bit, little-endian, data-type-policy=OVERRIDE, i-signal-type=PRIMITIVE, init-value=0, base-type=BT_DS_Info_El_MemSelChanged, compu {phys=raw for raw 0..1}, range phys 0..1, raw 0..1, transfer-property=TRIGGERED-ON-CHANGE-WITHOUT-REPETITION  # Übertragung vom Diagnosestatus gem. 80114
    signal DS_Info_El_IdentValid_XIX_DS_Info_El_XIX_VLAN_Cockpit: start 22, 1 bit, little-endian, data-type-policy=OVERRIDE, i-signal-type=PRIMITIVE, init-value=1, base-type=BT_DS_Info_El_IdentValid, compu {0=Cx0_Ungueltig (CM_DS_Info_El_IdentValid_Cx0_Ungueltig), 1=Cx1_Gueltig (CM_DS_Info_El_IdentValid_Cx1_Gueltig)}, range raw 0..1, transfer-property=TRIGGERED-ON-CHANGE-WITHOUT-REPETITION  # Signalisiert ob die Identifikationsdaten gueltig sind
    signal DS_Info_El_Lokalaktiv_XIX_DS_Info_El_XIX_VLAN_Cockpit: start 23, 1 bit, little-endian, data-type-policy=OVERRIDE, i-signal-type=PRIMITIVE, init-value=0, base-type=BT_DS_Info_El_Lokalaktiv, compu {0=Cx0_war_nicht_lokal_aktiv (CM_DS_Info_El_Lokalaktiv_Cx0_war_nicht_lokal_aktiv), 1=Cx1_war_lokal_aktiv (CM_DS_Info_El_Lokalaktiv_Cx1_war_lokal_aktiv)}, range raw 0..1, transfer-property=PENDING  # Zeigt an ob das SG nach Klemme15 AUS und nach entsprechender MAX Aktivzeit noch aktiv war.
  pdu DS_PID_XIX_VLAN_Cockpit: length=8, minimum-delay=0.08, transmission-mode-true-timing={cyclic-timing={time-offset=0.0, time-period=1.0}, event-controlled-timing={number-of-repetitions=0, repetition-period=0.0}}, unused-bit-pattern=0
    signal DS_PID_DiagAdr_XIX_DS_PID_XIX_VLAN_Cockpit: start 0, 16 bit, little-endian, data-type-policy=OVERRIDE, i-signal-type=PRIMITIVE, init-value=33095, base-type=BT_DS_PID_DiagAdr, compu {phys=raw for raw 0..65535}, range phys 0..65535, raw 0..65535, transfer-property=PENDING  # Übertragung vom Diagnosestatus gem. 80114
    signal DS_PID_TestFailedChanged_XIX_DS_PID_XIX_VLAN_Cockpit: start 16, 1 bit, little-endian, data-type-policy=OVERRIDE, i-signal-type=PRIMITIVE, init-value=0, base-type=BT_DS_PID_TestFailedChanged, compu {phys=raw for raw 0..1}, range phys 0..1, raw 0..1, transfer-property=TRIGGERED-ON-CHANGE-WITHOUT-REPETITION  # Übertragung vom Diagnosestatus gem. 80114
    signal DS_PID_ConfDTCChanged_XIX_DS_PID_XIX_VLAN_Cockpit: start 17, 1 bit, little-endian, data-type-policy=OVERRIDE, i-signal-type=PRIMITIVE, init-value=0, base-type=BT_DS_PID_ConfDTCChanged, compu {phys=raw for raw 0..1}, range phys 0..1, raw 0..1, transfer-property=TRIGGERED-ON-CHANGE-WITHOUT-REPETITION  # Übertragung vom Diagnosestatus gem. 80114
    signal DS_PID_WIRChanged_XIX_DS_PID_XIX_VLAN_Cockpit: start 18, 1 bit, little-endian, data-type-policy=OVERRIDE, i-signal-type=PRIMITIVE, init-value=0, base-type=BT_DS_PID_WIRChanged, compu {phys=raw for raw 0..1}, range phys 0..1, raw 0..1, transfer-property=TRIGGERED-ON-CHANGE-WITHOUT-REPETITION  # Übertragung vom Diagnosestatus gem. 80114
    signal DS_PID_StMemChanged_XIX_DS_PID_XIX_VLAN_Cockpit: start 19, 1 bit, little-endian, data-type-policy=OVERRIDE, i-signal-type=PRIMITIVE, init-value=0, base-type=BT_DS_PID_StMemChanged, compu {phys=raw for raw 0..1}, range phys 0..1, raw 0..1, transfer-property=TRIGGERED-ON-CHANGE-WITHOUT-REPETITION  # Übertragung vom Diagnosestatus gem. 80114
    signal DS_PID_MemSel10Changed_XIX_DS_PID_XIX_VLAN_Cockpit: start 20, 1 bit, little-endian, data-type-policy=OVERRIDE, i-signal-type=PRIMITIVE, init-value=0, base-type=BT_DS_PID_MemSel10Changed, compu {phys=raw for raw 0..1}, range phys 0..1, raw 0..1, transfer-property=TRIGGERED-ON-CHANGE-WITHOUT-REPETITION  # Übertragung vom Diagnosestatus gem. 80114
    signal DS_PID_MemSelChanged_XIX_DS_PID_XIX_VLAN_Cockpit: start 21, 1 bit, little-endian, data-type-policy=OVERRIDE, i-signal-type=PRIMITIVE, init-value=0, base-type=BT_DS_PID_MemSelChanged, compu {phys=raw for raw 0..1}, range phys 0..1, raw 0..1, transfer-property=TRIGGERED-ON-CHANGE-WITHOUT-REPETITION  # Übertragung vom Diagnosestatus gem. 80114
    signal DS_PID_IdentValid_XIX_DS_PID_XIX_VLAN_Cockpit: start 22, 1 bit, little-endian, data-type-policy=OVERRIDE, i-signal-type=PRIMITIVE, init-value=1, base-type=BT_DS_PID_IdentValid, compu {1=Cx1_Gueltig (CM_DS_PID_IdentValid_Cx1_Gueltig), 0=Cx0_Ungueltig (CM_DS_PID_IdentValid_Cx0_Ungueltig)}, range raw 0..1, transfer-property=TRIGGERED-ON-CHANGE-WITHOUT-REPETITION  # Signalisiert ob die Identifikationsdaten gueltig sind
    signal DS_PID_Lokalaktiv_XIX_DS_PID_XIX_VLAN_Cockpit: start 23, 1 bit, little-endian, data-type-policy=OVERRIDE, i-signal-type=PRIMITIVE, init-value=0, base-type=BT_DS_PID_Lokalaktiv, compu {0=Cx0_war_nicht_lokal_aktiv (CM_DS_PID_Lokalaktiv_Cx0_war_nicht_lokal_aktiv), 1=Cx1_war_lokal_aktiv (CM_DS_PID_Lokalaktiv_Cx1_war_lokal_aktiv)}, range raw 0..1, transfer-property=PENDING  # Zeigt an ob das SG nach Klemme15 AUS und nach entsprechender MAX Aktivzeit noch aktiv war.
    signal DS_PID_Subsystemaktiv_XIX_DS_PID_XIX_VLAN_Cockpit: start 24, 1 bit, little-endian, data-type-policy=OVERRIDE, i-signal-type=PRIMITIVE, init-value=0, base-type=BT_DS_PID_Subsystemaktiv, compu {0=Cx0_war_nicht_lokal_aktiv (CM_DS_PID_Subsystemaktiv_Cx0_war_nicht_lokal_aktiv), 1=Cx1_war_lokal_aktiv (CM_DS_PID_Subsystemaktiv_Cx1_war_lokal_aktiv)}, range raw 0..1, transfer-property=PENDING  # Zeigt an ob ein Subsystem des SGs nach Klemme15 AUS und nach entsprechender MAX Aktivzeit noch aktiv war
  pdu DS_WLC1_XIX_VLAN_Cockpit: length=8, minimum-delay=0.08, transmission-mode-true-timing={cyclic-timing={time-offset=0.0, time-period=1.0}, event-controlled-timing={number-of-repetitions=0, repetition-period=0.0}}, unused-bit-pattern=0
    signal DS_WLC1_DiagAdr_XIX_DS_WLC1_XIX_VLAN_Cockpit: start 0, 16 bit, little-endian, data-type-policy=OVERRIDE, i-signal-type=PRIMITIVE, init-value=222, base-type=BT_DS_WLC1_DiagAdr, compu {phys=raw for raw 0..65535}, range phys 0..65535, raw 0..65535, transfer-property=PENDING  # Übertragung vom Diagnosestatus gem. 80114
    signal DS_WLC1_TestFailedChanged_XIX_DS_WLC1_XIX_VLAN_Cockpit: start 16, 1 bit, little-endian, data-type-policy=OVERRIDE, i-signal-type=PRIMITIVE, init-value=0, base-type=BT_DS_WLC1_TestFailedChanged, compu {phys=raw for raw 0..1}, range phys 0..1, raw 0..1, transfer-property=TRIGGERED-ON-CHANGE-WITHOUT-REPETITION  # Übertragung vom Diagnosestatus gem. 80114
    signal DS_WLC1_ConfDTCChanged_XIX_DS_WLC1_XIX_VLAN_Cockpit: start 17, 1 bit, little-endian, data-type-policy=OVERRIDE, i-signal-type=PRIMITIVE, init-value=0, base-type=BT_DS_WLC1_ConfDTCChanged, compu {phys=raw for raw 0..1}, range phys 0..1, raw 0..1, transfer-property=TRIGGERED-ON-CHANGE-WITHOUT-REPETITION  # Übertragung vom Diagnosestatus gem. 80114
    signal DS_WLC1_WIRChanged_XIX_DS_WLC1_XIX_VLAN_Cockpit: start 18, 1 bit, little-endian, data-type-policy=OVERRIDE, i-signal-type=PRIMITIVE, init-value=0, base-type=BT_DS_WLC1_WIRChanged, compu {phys=raw for raw 0..1}, range phys 0..1, raw 0..1, transfer-property=TRIGGERED-ON-CHANGE-WITHOUT-REPETITION  # Übertragung vom Diagnosestatus gem. 80114
    signal DS_WLC1_StMemChanged_XIX_DS_WLC1_XIX_VLAN_Cockpit: start 19, 1 bit, little-endian, data-type-policy=OVERRIDE, i-signal-type=PRIMITIVE, init-value=0, base-type=BT_DS_WLC1_StMemChanged, compu {phys=raw for raw 0..1}, range phys 0..1, raw 0..1, transfer-property=TRIGGERED-ON-CHANGE-WITHOUT-REPETITION  # Übertragung vom Diagnosestatus gem. 80114
    signal DS_WLC1_MemSel10Changed_XIX_DS_WLC1_XIX_VLAN_Cockpit: start 20, 1 bit, little-endian, data-type-policy=OVERRIDE, i-signal-type=PRIMITIVE, init-value=0, base-type=BT_DS_WLC1_MemSel10Changed, compu {phys=raw for raw 0..1}, range phys 0..1, raw 0..1, transfer-property=TRIGGERED-ON-CHANGE-WITHOUT-REPETITION  # Übertragung vom Diagnosestatus gem. 80114
    signal DS_WLC1_MemSelChanged_XIX_DS_WLC1_XIX_VLAN_Cockpit: start 21, 1 bit, little-endian, data-type-policy=OVERRIDE, i-signal-type=PRIMITIVE, init-value=0, base-type=BT_DS_WLC1_MemSelChanged, compu {phys=raw for raw 0..1}, range phys 0..1, raw 0..1, transfer-property=TRIGGERED-ON-CHANGE-WITHOUT-REPETITION  # Übertragung vom Diagnosestatus gem. 80114
    signal DS_WLC1_IdentValid_XIX_DS_WLC1_XIX_VLAN_Cockpit: start 22, 1 bit, little-endian, data-type-policy=OVERRIDE, i-signal-type=PRIMITIVE, init-value=1, base-type=BT_DS_WLC1_IdentValid, compu {1=Cx1_Gueltig (CM_DS_WLC1_IdentValid_Cx1_Gueltig), 0=Cx0_Ungueltig (CM_DS_WLC1_IdentValid_Cx0_Ungueltig)}, range raw 0..1, transfer-property=TRIGGERED-ON-CHANGE-WITHOUT-REPETITION  # Signalisiert ob die Identifikationsdaten gueltig sind
    signal DS_WLC1_Lokalaktiv_XIX_DS_WLC1_XIX_VLAN_Cockpit: start 23, 1 bit, little-endian, data-type-policy=OVERRIDE, i-signal-type=PRIMITIVE, init-value=0, base-type=BT_DS_WLC1_Lokalaktiv, compu {0=Cx0_war_nicht_lokal_aktiv (CM_DS_WLC1_Lokalaktiv_Cx0_war_nicht_lokal_aktiv), 1=Cx1_war_lokal_aktiv (CM_DS_WLC1_Lokalaktiv_Cx1_war_lokal_aktiv)}, range raw 0..1, transfer-property=PENDING  # Zeigt an ob das SG nach Klemme15 AUS und nach entsprechender MAX Aktivzeit noch aktiv war.
  pdu DS_WLC2_XIX_VLAN_Cockpit: length=8, minimum-delay=0.08, transmission-mode-true-timing={cyclic-timing={time-offset=0.0, time-period=1.0}, event-controlled-timing={number-of-repetitions=0, repetition-period=0.0}}, unused-bit-pattern=0
    signal DS_WLC2_DiagAdr_XIX_DS_WLC2_XIX_VLAN_Cockpit: start 0, 16 bit, little-endian, data-type-policy=OVERRIDE, i-signal-type=PRIMITIVE, init-value=223, base-type=BT_DS_WLC2_DiagAdr, compu {phys=raw for raw 0..65535}, range phys 0..65535, raw 0..65535, transfer-property=PENDING  # Übertragung vom Diagnosestatus gem. 80114
    signal DS_WLC2_TestFailedChanged_XIX_DS_WLC2_XIX_VLAN_Cockpit: start 16, 1 bit, little-endian, data-type-policy=OVERRIDE, i-signal-type=PRIMITIVE, init-value=0, base-type=BT_DS_WLC2_TestFailedChanged, compu {phys=raw for raw 0..1}, range phys 0..1, raw 0..1, transfer-property=TRIGGERED-ON-CHANGE-WITHOUT-REPETITION  # Übertragung vom Diagnosestatus gem. 80114
    signal DS_WLC2_ConfDTCChanged_XIX_DS_WLC2_XIX_VLAN_Cockpit: start 17, 1 bit, little-endian, data-type-policy=OVERRIDE, i-signal-type=PRIMITIVE, init-value=0, base-type=BT_DS_WLC2_ConfDTCChanged, compu {phys=raw for raw 0..1}, range phys 0..1, raw 0..1, transfer-property=TRIGGERED-ON-CHANGE-WITHOUT-REPETITION  # Übertragung vom Diagnosestatus gem. 80114
    signal DS_WLC2_WIRChanged_XIX_DS_WLC2_XIX_VLAN_Cockpit: start 18, 1 bit, little-endian, data-type-policy=OVERRIDE, i-signal-type=PRIMITIVE, init-value=0, base-type=BT_DS_WLC2_WIRChanged, compu {phys=raw for raw 0..1}, range phys 0..1, raw 0..1, transfer-property=TRIGGERED-ON-CHANGE-WITHOUT-REPETITION  # Übertragung vom Diagnosestatus gem. 80114
    signal DS_WLC2_StMemChanged_XIX_DS_WLC2_XIX_VLAN_Cockpit: start 19, 1 bit, little-endian, data-type-policy=OVERRIDE, i-signal-type=PRIMITIVE, init-value=0, base-type=BT_DS_WLC2_StMemChanged, compu {phys=raw for raw 0..1}, range phys 0..1, raw 0..1, transfer-property=TRIGGERED-ON-CHANGE-WITHOUT-REPETITION  # Übertragung vom Diagnosestatus gem. 80114
    signal DS_WLC2_MemSel10Changed_XIX_DS_WLC2_XIX_VLAN_Cockpit: start 20, 1 bit, little-endian, data-type-policy=OVERRIDE, i-signal-type=PRIMITIVE, init-value=0, base-type=BT_DS_WLC2_MemSel10Changed, compu {phys=raw for raw 0..1}, range phys 0..1, raw 0..1, transfer-property=TRIGGERED-ON-CHANGE-WITHOUT-REPETITION  # Übertragung vom Diagnosestatus gem. 80114
    signal DS_WLC2_MemSelChanged_XIX_DS_WLC2_XIX_VLAN_Cockpit: start 21, 1 bit, little-endian, data-type-policy=OVERRIDE, i-signal-type=PRIMITIVE, init-value=0, base-type=BT_DS_WLC2_MemSelChanged, compu {phys=raw for raw 0..1}, range phys 0..1, raw 0..1, transfer-property=TRIGGERED-ON-CHANGE-WITHOUT-REPETITION  # Übertragung vom Diagnosestatus gem. 80114
    signal DS_WLC2_IdentValid_XIX_DS_WLC2_XIX_VLAN_Cockpit: start 22, 1 bit, little-endian, data-type-policy=OVERRIDE, i-signal-type=PRIMITIVE, init-value=1, base-type=BT_DS_WLC2_IdentValid, compu {1=Cx1_Gueltig (CM_DS_WLC2_IdentValid_Cx1_Gueltig), 0=Cx0_Ungueltig (CM_DS_WLC2_IdentValid_Cx0_Ungueltig)}, range raw 0..1, transfer-property=TRIGGERED-ON-CHANGE-WITHOUT-REPETITION  # Signalisiert ob die Identifikationsdaten gueltig sind
    signal DS_WLC2_Lokalaktiv_XIX_DS_WLC2_XIX_VLAN_Cockpit: start 23, 1 bit, little-endian, data-type-policy=OVERRIDE, i-signal-type=PRIMITIVE, init-value=0, base-type=BT_DS_WLC2_Lokalaktiv, compu {1=Cx1_war_lokal_aktiv (CM_DS_WLC2_Lokalaktiv_Cx1_war_lokal_aktiv), 0=Cx0_war_nicht_lokal_aktiv (CM_DS_WLC2_Lokalaktiv_Cx0_war_nicht_lokal_aktiv)}, range raw 0..1, transfer-property=PENDING  # Zeigt an ob das SG nach Klemme15 AUS und nach entsprechender MAX Aktivzeit noch aktiv war.
  pdu DTSO_01_XIX_VLAN_Cockpit: length=8, transmission-mode-true-timing=cyclic-timing={time-offset=0.0, time-period=0.01}, unused-bit-pattern=0
    signal DTSO_StPTEgySrc_XIX_DTSO_01_XIX_VLAN_Cockpit: start 12, 4 bit, little-endian, data-type-policy=OVERRIDE, i-signal-type=PRIMITIVE, init-value=0, base-type=BT_DTSO_StPTEgySrc, compu {14=Cxe_Battery_Wheel_Hydrogen (CM_DTSO_StPTEgySrc_Cxe_Battery_Wheel_Hydrogen), 7=Cx7_Fuel_Battery_Wheel (CM_DTSO_StPTEgySrc_Cx7_Fuel_Battery_Wheel), 15=Cxf_Fuel_Battery_Wheel_Hydrogen (CM_DTSO_StPTEgySrc_Cxf_Fuel_Battery_Wheel_Hydrogen), 10=Cxa_Battery_Hydrogen (CM_DTSO_StPTEgySrc_Cxa_Battery_Hydrogen), 6=Cx6_Battery_Wheel (CM_DTSO_StPTEgySrc_Cx6_Battery_Wheel), 0=Cx0_None (CM_DTSO_StPTEgySrc_Cx0_None), 12=Cxc_Wheel_Hydrogen (CM_DTSO_StPTEgySrc_Cxc_Wheel_Hydrogen), 13=Cxd_Fuel_Wheel_Hydrogen (CM_DTSO_StPTEgySrc_Cxd_Fuel_Wheel_Hydrogen), 3=Cx3_Fuel_Battery (CM_DTSO_StPTEgySrc_Cx3_Fuel_Battery), 9=Cx9_Fuel_Hydrogen (CM_DTSO_StPTEgySrc_Cx9_Fuel_Hydrogen), 11=Cxb_Fuel_Battery_Hydrogen (CM_DTSO_StPTEgySrc_Cxb_Fuel_Battery_Hydrogen), 1=Cx1_Fuel (CM_DTSO_StPTEgySrc_Cx1_Fuel), 8=Cx8_Hydrogen (CM_DTSO_StPTEgySrc_Cx8_Hydrogen), 5=Cx5_Fuel_Wheel (CM_DTSO_StPTEgySrc_Cx5_Fuel_Wheel), 2=Cx2_Battery (CM_DTSO_StPTEgySrc_Cx2_Battery), 4=Cx4_Wheel (CM_DTSO_StPTEgySrc_Cx4_Wheel)}, range raw 0..15, transfer-property=PENDING, to HCP3_IONode(timeout 0.5 s)  # Energy_Source_in_Powertrain
    signal DTSO_StCELvStrtInfo_XIX_DTSO_01_XIX_VLAN_Cockpit: start 16, 2 bit, little-endian, data-type-policy=OVERRIDE, i-signal-type=PRIMITIVE, init-value=0, base-type=BT_DTSO_StCELvStrtInfo, compu {3=Cx3_12V_ReStart (CM_DTSO_StCELvStrtInfo_Cx3_12V_ReStart), 0=Cx0_No_12V_Start_active (CM_DTSO_StCELvStrtInfo_Cx0_No_12V_Start_active), 1=Cx1_12V_First_Start_Vehicle_Stop (CM_DTSO_StCELvStrtInfo_Cx1_12V_First_Start_Vehicle_Stop), 2=Cx2_12V_First_Start_Vehicle_Move (CM_DTSO_StCELvStrtInfo_Cx2_12V_First_Start_Vehicle_Move)}, range raw 0..3, transfer-property=PENDING  # Information_about_12V_Start_Device_for_Combustion_Engine
    signal DTSO_StCEStrtStop_XIX_DTSO_01_XIX_VLAN_Cockpit: start 18, 3 bit, little-endian, data-type-policy=OVERRIDE, i-signal-type=PRIMITIVE, init-value=7, base-type=BT_DTSO_StCEStrtStop, compu {3=Cx3_VKM_Startvorgang (CM_DTSO_StCEStrtStop_Cx3_VKM_Startvorgang), 6=Cx6_VKM_Abstellvorgang (CM_DTSO_StCEStrtStop_Cx6_VKM_Abstellvorgang), 7=Cx7_INIT (CM_DTSO_StCEStrtStop_Cx7_INIT), 1=Cx1_VKM_Aus (CM_DTSO_StCEStrtStop_Cx1_VKM_Aus), 0=Cx0_VKM_Aktivierungszustand_Unbekannt (CM_DTSO_StCEStrtStop_Cx0_VKM_Aktivierungszustand_Unbekannt), 2=Cx2_VKM_Aus_Startverzoegerung_Wirksam (CM_DTSO_StCEStrtStop_Cx2_VKM_Aus_Startverzoegerung_Wirksam), 4=Cx4_VKM_An (CM_DTSO_StCEStrtStop_Cx4_VKM_An), 5=Cx5_VKM_An_Stoppverzoegerung_Wirksam (CM_DTSO_StCEStrtStop_Cx5_VKM_An_Stoppverzoegerung_Wirksam)}, range raw 0..7, transfer-property=PENDING  # IST-Aktivierungszustand der VKM
    signal DTSO_StPrpUnitAcvWhl_XIX_DTSO_01_XIX_VLAN_Cockpit: start 21, 3 bit, little-endian, data-type-policy=OVERRIDE, i-signal-type=PRIMITIVE, init-value=0, base-type=BT_DTSO_StPrpUnitAcvWhl, compu {0=Cx0_INIT (CM_DTSO_StPrpUnitAcvWhl_Cx0_INIT), 6=Cx6_Boost_CE_And_EM_Active_At_Wheel (CM_DTSO_StPrpUnitAcvWhl_Cx6_Boost_CE_And_EM_Active_At_Wheel), 2=Cx2_CE_Active_At_Wheel (CM_DTSO_StPrpUnitAcvWhl_Cx2_CE_Active_At_Wheel), 7=Cx7_reserved (CM_DTSO_StPrpUnitAcvWhl_Cx7_reserved) ([reserved]), 1=Cx1_No_Propulsion_Device_At_Wheel (CM_DTSO_StPrpUnitAcvWhl_Cx1_No_Propulsion_Device_At_Wheel), 3=Cx3_reserved (CM_DTSO_StPrpUnitAcvWhl_Cx3_reserved) ([reserved]), 5=Cx5_reserved (CM_DTSO_StPrpUnitAcvWhl_Cx5_reserved) ([reserved]), 4=Cx4_EM_Active_At_Wheel (CM_DTSO_StPrpUnitAcvWhl_Cx4_EM_Active_At_Wheel)}, range raw 0..7, transfer-property=PENDING, to HCP3_IONode(timeout 0.5 s)  # Active_Propulsion_Unit_At_Wheel
    signal DTSO_StElmAxp_XIX_DTSO_01_XIX_VLAN_Cockpit: start 24, 3 bit, little-endian, data-type-policy=OVERRIDE, i-signal-type=PRIMITIVE, init-value=7, base-type=BT_DTSO_StElmAxp, compu {6=Cx6_ElmAxp_Deaktivierungsvorgang (CM_DTSO_StElmAxp_Cx6_ElmAxp_Deaktivierungsvorgang), 7=Cx7_INIT (CM_DTSO_StElmAxp_Cx7_INIT), 2=Cx2_ElmAxp_Deaktiv_Aktivierungsverzoegerung_Wirksam (CM_DTSO_StElmAxp_Cx2_ElmAxp_Deaktiv_Aktivierungsverzoegerung_Wirksam), 0=Cx0_ElmAxp_Aktivierungszustand_Unbekannt (CM_DTSO_StElmAxp_Cx0_ElmAxp_Aktivierungszustand_Unbekannt), 3=Cx3_ElmAxp_Aktivierungsvorgang (CM_DTSO_StElmAxp_Cx3_ElmAxp_Aktivierungsvorgang), 1=Cx1_ElmAxp_Deaktiv (CM_DTSO_StElmAxp_Cx1_ElmAxp_Deaktiv), 4=Cx4_ElmAxp_Aktiv (CM_DTSO_StElmAxp_Cx4_ElmAxp_Aktiv), 5=Cx5_ElmAxp_Aktiv_Deaktivierungsverzoegerung_Wirksam (CM_DTSO_StElmAxp_Cx5_ElmAxp_Aktiv_Deaktivierungsverzoegerung_Wirksam)}, range raw 0..7, transfer-property=PENDING  # Ist_Aktivierungszustand_ElmAxp
    signal DTSO_StElmAxs_XIX_DTSO_01_XIX_VLAN_Cockpit: start 27, 3 bit, little-endian, data-type-policy=OVERRIDE, i-signal-type=PRIMITIVE, init-value=7, base-type=BT_DTSO_StElmAxs, compu {0=Cx0_ElmAxs_Aktivierungszustand_Unbekannt (CM_DTSO_StElmAxs_Cx0_ElmAxs_Aktivierungszustand_Unbekannt), 2=Cx2_ElmAxs_Deaktiv_Aktivierungsverzoegerung_Wirksam (CM_DTSO_StElmAxs_Cx2_ElmAxs_Deaktiv_Aktivierungsverzoegerung_Wirksam), 3=Cx3_ElmAxs_Aktivierungsvorgang (CM_DTSO_StElmAxs_Cx3_ElmAxs_Aktivierungsvorgang), 1=Cx1_ElmAxs_Deaktiv (CM_DTSO_StElmAxs_Cx1_ElmAxs_Deaktiv), 6=Cx6_ElmAxs_Deaktivierungsvorgang (CM_DTSO_StElmAxs_Cx6_ElmAxs_Deaktivierungsvorgang), 4=Cx4_ElmAxs_Aktiv (CM_DTSO_StElmAxs_Cx4_ElmAxs_Aktiv), 5=Cx5_ElmAxs_Aktiv_Deaktivierungsverzoegerung_Wirksam (CM_DTSO_StElmAxs_Cx5_ElmAxs_Aktiv_Deaktivierungsverzoegerung_Wirksam), 7=Cx7_INIT (CM_DTSO_StElmAxs_Cx7_INIT)}, range raw 0..7, transfer-property=PENDING  # Ist_Aktivierungszustand_ElmAxs
    signal DTSO_StElmHyb_XIX_DTSO_01_XIX_VLAN_Cockpit: start 30, 3 bit, little-endian, data-type-policy=OVERRIDE, i-signal-type=PRIMITIVE, init-value=7, base-type=BT_DTSO_StElmHyb, compu {7=Cx7_INIT (CM_DTSO_StElmHyb_Cx7_INIT), 6=Cx6_ElmHyb_Deaktivierungsvorgang (CM_DTSO_StElmHyb_Cx6_ElmHyb_Deaktivierungsvorgang), 2=Cx2_ElmHyb_Deaktiv_Aktivierungsverzoegerung_Wirksam (CM_DTSO_StElmHyb_Cx2_ElmHyb_Deaktiv_Aktivierungsverzoegerung_Wirksam), 3=Cx3_ElmHyb_Aktivierungsvorgang (CM_DTSO_StElmHyb_Cx3_ElmHyb_Aktivierungsvorgang), 4=Cx4_ElmHyb_Aktiv (CM_DTSO_StElmHyb_Cx4_ElmHyb_Aktiv), 0=Cx0_ElmHyb_Aktivierungszustand_Unbekannt (CM_DTSO_StElmHyb_Cx0_ElmHyb_Aktivierungszustand_Unbekannt), 5=Cx5_ElmHyb_Aktiv_Deaktivierungsverzoegerung_Wirksam (CM_DTSO_StElmHyb_Cx5_ElmHyb_Aktiv_Deaktivierungsverzoegerung_Wirksam), 1=Cx1_ElmHyb_Deaktiv (CM_DTSO_StElmHyb_Cx1_ElmHyb_Deaktiv)}, range raw 0..7, transfer-property=PENDING  # Ist_Aktivierungszustand_ElmHyb
    signal DTSO_StPsa_XIX_DTSO_01_XIX_VLAN_Cockpit: start 33, 1 bit, little-endian, data-type-policy=OVERRIDE, i-signal-type=PRIMITIVE, init-value=0, base-type=BT_DTSO_StPsa, compu {0=Cx0_Ritzelstarter_Keine_Ansteuerung (CM_DTSO_StPsa_Cx0_Ritzelstarter_Keine_Ansteuerung), 1=Cx1_Ritzelstarter_VKM_Start_Aktiv (CM_DTSO_StPsa_Cx1_Ritzelstarter_VKM_Start_Aktiv)}, range raw 0..1, transfer-property=PENDING  # Ist_Aktivierungszustand_Ritzelstarter
  pdu FBS_MKGO_01_XIX_VLAN_Cockpit: length=64, transmission-mode-true-timing=event-controlled-timing={number-of-repetitions=0, repetition-period=0.0}, unused-bit-pattern=0
    signal FBS_MKGO_01_XIX_FBS_MKGO_01_XIX_VLAN_Cockpit: start 0, 512 bit, opaque, data-type-policy=OVERRIDE, i-signal-type=ARRAY, init-value=64 x 0, base-type=BT_FBS_MKGO_01, implementation-data-type=FBS_MKGO_01, transfer-property=TRIGGERED-WITHOUT-REPETITION  # NFC Kommunikation FBS zu MKGO
  pdu FBS_MKGO_02_XIX_VLAN_Cockpit: length=64, transmission-mode-true-timing=event-controlled-timing={number-of-repetitions=0, repetition-period=0.0}, unused-bit-pattern=0
    signal FBS_MKGO_02_XIX_FBS_MKGO_02_XIX_VLAN_Cockpit: start 0, 512 bit, opaque, data-type-policy=OVERRIDE, i-signal-type=ARRAY, init-value=64 x 0, base-type=BT_FBS_MKGO_02, implementation-data-type=FBS_MKGO_02, transfer-property=TRIGGERED-WITHOUT-REPETITION  # NFC Kommunikation FBS zu MKGO
  pdu FBS_MKGO_03_XIX_VLAN_Cockpit: length=64, transmission-mode-true-timing=event-controlled-timing={number-of-repetitions=0, repetition-period=0.0}, unused-bit-pattern=0
    signal FBS_MKGO_03_XIX_FBS_MKGO_03_XIX_VLAN_Cockpit: start 0, 512 bit, opaque, data-type-policy=OVERRIDE, i-signal-type=ARRAY, init-value=64 x 0, base-type=BT_FBS_MKGO_03, implementation-data-type=FBS_MKGO_03, transfer-property=TRIGGERED-WITHOUT-REPETITION  # NFC Kommunikation FBS zu MKGO
  pdu FBS_MKGO_04_XIX_VLAN_Cockpit: length=64, transmission-mode-true-timing=event-controlled-timing={number-of-repetitions=0, repetition-period=0.0}, unused-bit-pattern=0
    signal FBS_MKGO_04_XIX_FBS_MKGO_04_XIX_VLAN_Cockpit: start 0, 512 bit, opaque, data-type-policy=OVERRIDE, i-signal-type=ARRAY, init-value=64 x 0, base-type=BT_FBS_MKGO_04, implementation-data-type=FBS_MKGO_04, transfer-property=TRIGGERED-WITHOUT-REPETITION  # NFC Kommunikation FBS zu MKGO
  pdu FBS_MKGO_05_XIX_VLAN_Cockpit: length=64, transmission-mode-true-timing=event-controlled-timing={number-of-repetitions=0, repetition-period=0.0}, unused-bit-pattern=0
    signal FBS_MKGO_05_XIX_FBS_MKGO_05_XIX_VLAN_Cockpit: start 0, 512 bit, opaque, data-type-policy=OVERRIDE, i-signal-type=ARRAY, init-value=64 x 0, base-type=BT_FBS_MKGO_05, implementation-data-type=FBS_MKGO_05, transfer-property=TRIGGERED-WITHOUT-REPETITION  # NFC Kommunikation FBS zu MKGO
  pdu FID_01_XIX_VLAN_Cockpit: length=44, minimum-delay=0.04, transmission-mode-true-timing={cyclic-timing={time-offset=0.0, time-period=1.0}, event-controlled-timing={number-of-repetitions=0, repetition-period=0.0}}, unused-bit-pattern=0
    signal FID_01_CRC_XIX_FID_01_XIX_VLAN_Cockpit: start 0, 8 bit, little-endian, data-type-policy=OVERRIDE, i-signal-type=PRIMITIVE, init-value=0, base-type=BT_FID_01_CRC, compu {phys=raw for raw 0..255}, range phys 0..255, raw 0..255, transfer-property=TRIGGERED-WITHOUT-REPETITION
    signal FID_01_BZ_XIX_FID_01_XIX_VLAN_Cockpit: start 8, 4 bit, little-endian, data-type-policy=OVERRIDE, i-signal-type=PRIMITIVE, init-value=0, base-type=BT_FID_01_BZ, compu {phys=raw for raw 0..15}, range phys 0..15, raw 0..15, transfer-property=TRIGGERED-WITHOUT-REPETITION
    signal FID_LVDS_State_XIX_FID_01_XIX_VLAN_Cockpit: start 12, 1 bit, little-endian, data-type-policy=OVERRIDE, i-signal-type=PRIMITIVE, init-value=0, base-type=BT_FID_LVDS_State, compu {1=Cx1_LVDS_Lock (CM_FID_LVDS_State_Cx1_LVDS_Lock), 0=Cx0_LVDS_Unlocked (CM_FID_LVDS_State_Cx0_LVDS_Unlocked)}, range raw 0..1, transfer-property=TRIGGERED-WITHOUT-REPETITION, to HCP3_IONode(timeout 5 s)  # LVDS_Lock= 1 Valide videosignal from MU LVDS_Unlocked = 0 No valid videosignal from MU
    signal FID_State_XIX_FID_01_XIX_VLAN_Cockpit: start 13, 3 bit, little-endian, data-type-policy=OVERRIDE, i-signal-type=PRIMITIVE, init-value=0, base-type=BT_FID_State, compu {6=Cx6_Reserved (CM_FID_State_Cx6_Reserved), 3=Cx3_Disp_LowPow (CM_FID_State_Cx3_Disp_LowPow), 4=Cx4_Reserved (CM_FID_State_Cx4_Reserved), 1=Cx1_Disp_Off (CM_FID_State_Cx1_Disp_Off), 5=Cx5_Reserved (CM_FID_State_Cx5_Reserved), 0=Cx0_Disp_not_Ready (CM_FID_State_Cx0_Disp_not_Ready), 7=Cx7_Reserved (CM_FID_State_Cx7_Reserved), 2=Cx2_Disp_On (CM_FID_State_Cx2_Disp_On)}, range raw 0..7, transfer-property=TRIGGERED-WITHOUT-REPETITION, to HCP3_IONode(timeout 5 s)  # Power state of FID
    signal FID_Photosensor_XIX_FID_01_XIX_VLAN_Cockpit: start 16, 9 bit, little-endian, data-type-policy=OVERRIDE, i-signal-type=PRIMITIVE, init-value=510, base-type=BT_FID_Photosensor, invalid-value=Invalid_FID_Photosensor_XIX_FID_01_XIX_VLAN_Cockpit:511, compu {phys=raw*0.25 for raw 0..400, 511=Cx1ff_Fehler (CM_FID_Photosensor_Cx1ff_Fehler), 510=Cx1fe_init (CM_FID_Photosensor_Cx1fe_init); unit Unit_PerCent}, range phys 0..100 Unit_PerCent, raw 0..511, unit=Unit_PerCent, transfer-property=TRIGGERED-WITHOUT-REPETITION, to HCP3_IONode(timeout 5 s)  # Measured value photosensor of the display unit (PCM or CDR) logarithmically distorted (see description of functions Nightdesign - according to Audi Spec) PCM/CDR_Signal
    signal FID_PCB_Temp_Error_XIX_FID_01_XIX_VLAN_Cockpit: start 25, 1 bit, little-endian, data-type-policy=OVERRIDE, i-signal-type=PRIMITIVE, init-value=0, base-type=BT_FID_PCB_Temp_Error, invalid-value=Invalid_FID_PCB_Temp_Error_XIX_FID_01_XIX_VLAN_Cockpit:1, compu {1=Cx1_Fehler (CM_FID_PCB_Temp_Error_Cx1_Fehler), 0=Cx0_normal (CM_FID_PCB_Temp_Error_Cx0_normal)}, range raw 0..1, transfer-property=TRIGGERED-WITHOUT-REPETITION, to HCP3_IONode(timeout 5 s)  # Display unit has detected a temperature error of the PCB
    signal FID_Temp_Error_XIX_FID_01_XIX_VLAN_Cockpit: start 26, 1 bit, little-endian, data-type-policy=OVERRIDE, i-signal-type=PRIMITIVE, init-value=0, base-type=BT_FID_Temp_Error, invalid-value=Invalid_FID_Temp_Error_XIX_FID_01_XIX_VLAN_Cockpit:1, compu {1=Cx1_Fehler (CM_FID_Temp_Error_Cx1_Fehler), 0=Cx0_normal (CM_FID_Temp_Error_Cx0_normal)}, range raw 0..1, transfer-property=TRIGGERED-WITHOUT-REPETITION, to HCP3_IONode(timeout 5 s)  # Display unit has detected a temperature error of the display panel
    signal FID_SystemMode_XIX_FID_01_XIX_VLAN_Cockpit: start 27, 1 bit, little-endian, data-type-policy=OVERRIDE, i-signal-type=PRIMITIVE, init-value=0, base-type=BT_FID_SystemMode, compu {1=Cx1_applikation (CM_FID_SystemMode_Cx1_applikation), 0=Cx0_bootloader (CM_FID_SystemMode_Cx0_bootloader)}, range raw 0..1, transfer-property=TRIGGERED-WITHOUT-REPETITION, to HCP3_IONode(timeout 5 s)  # Current system mode
    signal FID_Backlight_OpenCircuit_XIX_FID_01_XIX_VLAN_Cockpit: start 28, 1 bit, little-endian, data-type-policy=OVERRIDE, i-signal-type=PRIMITIVE, init-value=0, base-type=BT_FID_Backlight_OpenCircuit, invalid-value=Invalid_FID_Backlight_OpenCircuit_XIX_FID_01_XIX_VLAN_Cockpit:1, compu {1=Cx1_Fehler (CM_FID_Backlight_OpenCircuit_Cx1_Fehler), 0=Cx0_normal (CM_FID_Backlight_OpenCircuit_Cx0_normal)}, range raw 0..1, transfer-property=TRIGGERED-WITHOUT-REPETITION, to HCP3_IONode(timeout 5 s)  # With current measurements, at least one LED line is broken
    signal FID_Backlight_ShortCircuit_XIX_FID_01_XIX_VLAN_Cockpit: start 29, 1 bit, little-endian, data-type-policy=OVERRIDE, i-signal-type=PRIMITIVE, init-value=0, base-type=BT_FID_Backlight_ShortCircuit, invalid-value=Invalid_FID_Backlight_ShortCircuit_XIX_FID_01_XIX_VLAN_Cockpit:1, compu {1=Cx1_Fehler (CM_FID_Backlight_ShortCircuit_Cx1_Fehler), 0=Cx0_normal (CM_FID_Backlight_ShortCircuit_Cx0_normal)}, range raw 0..1, transfer-property=TRIGGERED-WITHOUT-REPETITION, to HCP3_IONode(timeout 5 s)  # Backlight has a short circuit
    signal FID_CL30_Overvolt_Error_XIX_FID_01_XIX_VLAN_Cockpit: start 30, 1 bit, little-endian, data-type-policy=OVERRIDE, i-signal-type=PRIMITIVE, init-value=0, base-type=BT_FID_CL30_Overvolt_Error, invalid-value=Invalid_FID_CL30_Overvolt_Error_XIX_FID_01_XIX_VLAN_Cockpit:1, compu {1=Cx1_Fehler (CM_FID_CL30_Overvolt_Error_Cx1_Fehler), 0=Cx0_normal (CM_FID_CL30_Overvolt_Error_Cx0_normal)}, range raw 0..1, transfer-property=TRIGGERED-WITHOUT-REPETITION, to HCP3_IONode(timeout 5 s)  # Display unit detected overvoltage error
    signal FID_CL30_Undervolt_Error_XIX_FID_01_XIX_VLAN_Cockpit: start 31, 1 bit, little-endian, data-type-policy=OVERRIDE, i-signal-type=PRIMITIVE, init-value=0, base-type=BT_FID_CL30_Undervolt_Error, invalid-value=Invalid_FID_CL30_Undervolt_Error_XIX_FID_01_XIX_VLAN_Cockpit:1, compu {1=Cx1_Fehler (CM_FID_CL30_Undervolt_Error_Cx1_Fehler), 0=Cx0_normal (CM_FID_CL30_Undervolt_Error_Cx0_normal)}, range raw 0..1, transfer-property=TRIGGERED-WITHOUT-REPETITION, to HCP3_IONode(timeout 5 s)  # Display unit detected undervoltage error
    signal FID_CL_30F_XIX_FID_01_XIX_VLAN_Cockpit: start 32, 8 bit, little-endian, data-type-policy=OVERRIDE, i-signal-type=PRIMITIVE, init-value=254, base-type=BT_FID_CL_30F, invalid-value=Invalid_FID_CL_30F_XIX_FID_01_XIX_VLAN_Cockpit:255, compu {phys=raw*0.1 for raw 0..253, 255=Cxff_Fehler (CM_FID_CL_30F_Cxff_Fehler), 254=Cxfe_init (CM_FID_CL_30F_Cxfe_init); unit Unit_Volt}, range phys 0..25.3 Unit_Volt, raw 0..255, unit=Unit_Volt, transfer-property=TRIGGERED-WITHOUT-REPETITION, to HCP3_IONode(timeout 5 s)  # Measured supply voltage of the display unit in volt
    signal FID_DispDerating_XIX_FID_01_XIX_VLAN_Cockpit: start 40, 8 bit, little-endian, data-type-policy=OVERRIDE, i-signal-type=PRIMITIVE, init-value=254, base-type=BT_FID_DispDerating, invalid-value=Invalid_FID_DispDerating_XIX_FID_01_XIX_VLAN_Cockpit:255, compu {phys=raw for raw 0..100, 255=Cxff_Fehler (CM_FID_DispDerating_Cxff_Fehler), 254=Cxfe_init (CM_FID_DispDerating_Cxfe_init); unit Unit_PerCent}, range phys 0..100 Unit_PerCent, raw 0..255, unit=Unit_PerCent, transfer-property=TRIGGERED-WITHOUT-REPETITION, to HCP3_IONode(timeout 5 s)  # Limitation of power dissipation depending on the temperature
    signal FID_TempSensor_XIX_FID_01_XIX_VLAN_Cockpit: start 48, 8 bit, little-endian, data-type-policy=OVERRIDE, i-signal-type=PRIMITIVE, init-value=254, base-type=BT_FID_TempSensor, invalid-value=Invalid_FID_TempSensor_XIX_FID_01_XIX_VLAN_Cockpit:255, compu {phys=raw-55 for raw 0..182, 255=Cxff_Fehler (CM_FID_TempSensor_Cxff_Fehler), 254=Cxfe_init (CM_FID_TempSensor_Cxfe_init); unit Unit_DegreCelsi}, range phys -55..127 Unit_DegreCelsi, raw 0..255, unit=Unit_DegreCelsi, transfer-property=TRIGGERED-WITHOUT-REPETITION, to HCP3_IONode(timeout 5 s)  # Display Unit current temperatur of the displaypanel
    signal FID_TempSensorMax_XIX_FID_01_XIX_VLAN_Cockpit: start 56, 8 bit, little-endian, data-type-policy=OVERRIDE, i-signal-type=PRIMITIVE, init-value=254, base-type=BT_FID_TempSensorMax, invalid-value=Invalid_FID_TempSensorMax_XIX_FID_01_XIX_VLAN_Cockpit:255, compu {phys=raw-55 for raw 0..182, 255=Cxff_Fehler (CM_FID_TempSensorMax_Cxff_Fehler), 254=Cxfe_init (CM_FID_TempSensorMax_Cxfe_init); unit Unit_DegreCelsi}, range phys -55..127 Unit_DegreCelsi, raw 0..255, unit=Unit_DegreCelsi, transfer-property=TRIGGERED-WITHOUT-REPETITION, to HCP3_IONode(timeout 5 s)  # Stored maximum sensor temperature of the display panel. Value remains over quiescent current
    signal FID_PCB_TempSensor_XIX_FID_01_XIX_VLAN_Cockpit: start 64, 8 bit, little-endian, data-type-policy=OVERRIDE, i-signal-type=PRIMITIVE, init-value=254, base-type=BT_FID_PCB_TempSensor, invalid-value=Invalid_FID_PCB_TempSensor_XIX_FID_01_XIX_VLAN_Cockpit:255, compu {phys=raw-55 for raw 0..182, 255=Cxff_Fehler (CM_FID_PCB_TempSensor_Cxff_Fehler), 254=Cxfe_init (CM_FID_PCB_TempSensor_Cxfe_init); unit Unit_DegreCelsi}, range phys -55..127 Unit_DegreCelsi, raw 0..255, unit=Unit_DegreCelsi, transfer-property=TRIGGERED-WITHOUT-REPETITION, to HCP3_IONode(timeout 5 s)  # Display Unit current temperatur of the PCB
    signal FID_PCB_TempSensorMax_XIX_FID_01_XIX_VLAN_Cockpit: start 72, 8 bit, little-endian, data-type-policy=OVERRIDE, i-signal-type=PRIMITIVE, init-value=254, base-type=BT_FID_PCB_TempSensorMax, invalid-value=Invalid_FID_PCB_TempSensorMax_XIX_FID_01_XIX_VLAN_Cockpit:255, compu {phys=raw-55 for raw 0..182, 255=Cxff_Fehler (CM_FID_PCB_TempSensorMax_Cxff_Fehler), 254=Cxfe_init (CM_FID_PCB_TempSensorMax_Cxfe_init); unit Unit_DegreCelsi}, range phys -55..127 Unit_DegreCelsi, raw 0..255, unit=Unit_DegreCelsi, transfer-property=TRIGGERED-WITHOUT-REPETITION, to HCP3_IONode(timeout 5 s)  # Stored maximum sensor temperature of the PCB (display unit). Value remains over quiescent current
    signal FID_OperatingTime_min_XIX_FID_01_XIX_VLAN_Cockpit: start 80, 8 bit, little-endian, data-type-policy=OVERRIDE, i-signal-type=PRIMITIVE, init-value=254, base-type=BT_FID_OperatingTime_min, invalid-value=Invalid_FID_OperatingTime_min_XIX_FID_01_XIX_VLAN_Cockpit:255, compu {phys=raw for raw 0..59, 255=Cxff_Fehler (CM_FID_OperatingTime_min_Cxff_Fehler), 254=Cxfe_init (CM_FID_OperatingTime_min_Cxfe_init); unit Unit_Minut}, range phys 0..59 Unit_Minut, raw 0..255, unit=Unit_Minut, transfer-property=TRIGGERED-WITHOUT-REPETITION, to HCP3_IONode(timeout 5 s)  # Display Unit operatingtime minutes share
    signal FID_OperatingTime_hr_XIX_FID_01_XIX_VLAN_Cockpit: start 88, 16 bit, little-endian, data-type-policy=OVERRIDE, i-signal-type=PRIMITIVE, init-value=65534, base-type=BT_FID_OperatingTime_hr, invalid-value=Invalid_FID_OperatingTime_hr_XIX_FID_01_XIX_VLAN_Cockpit:65535, compu {phys=raw for raw 0..65533, 65535=Cxffff_Fehler (CM_FID_OperatingTime_hr_Cxffff_Fehler), 65534=Cxfffe_init (CM_FID_OperatingTime_hr_Cxfffe_init); unit Unit_Hours}, range phys 0..65533 Unit_Hours, raw 0..65535, unit=Unit_Hours, transfer-property=TRIGGERED-WITHOUT-REPETITION, to HCP3_IONode(timeout 5 s)  # Display Unit operatingtime hours share
    signal FID_EEPROM_Error_XIX_FID_01_XIX_VLAN_Cockpit: start 104, 1 bit, little-endian, data-type-policy=OVERRIDE, i-signal-type=PRIMITIVE, init-value=0, base-type=BT_FID_EEPROM_Error, invalid-value=Invalid_FID_EEPROM_Error_XIX_FID_01_XIX_VLAN_Cockpit:1, compu {1=Cx1_Fehler (CM_FID_EEPROM_Error_Cx1_Fehler), 0=Cx0_normal (CM_FID_EEPROM_Error_Cx0_normal)}, range raw 0..1, transfer-property=TRIGGERED-WITHOUT-REPETITION, to HCP3_IONode(timeout 5 s)  # EEPROM error detected
    signal FID_LVDS_Errorstate_XIX_FID_01_XIX_VLAN_Cockpit: start 105, 2 bit, little-endian, data-type-policy=OVERRIDE, i-signal-type=PRIMITIVE, init-value=0, base-type=BT_FID_LVDS_Errorstate, compu {2=Cx2_HW_error (CM_FID_LVDS_Errorstate_Cx2_HW_error), 0=Cx0_no_error (CM_FID_LVDS_Errorstate_Cx0_no_error), 1=Cx1_SW_error (CM_FID_LVDS_Errorstate_Cx1_SW_error)}, range raw 0..2, transfer-property=TRIGGERED-WITHOUT-REPETITION, to HCP3_IONode(timeout 5 s)  # FID_LVDS_Errorstate = 0 no error detected FID_LVDS_Errorstate = 1 SW error detected FID_LVDS_Errorstate = 2 HW error detected
    signal FID_SW_inconsistent_XIX_FID_01_XIX_VLAN_Cockpit: start 107, 1 bit, little-endian, data-type-policy=OVERRIDE, i-signal-type=PRIMITIVE, init-value=0, base-type=BT_FID_SW_inconsistent, invalid-value=Invalid_FID_SW_inconsistent_XIX_FID_01_XIX_VLAN_Cockpit:1, compu {1=Cx1_Fehler (CM_FID_SW_inconsistent_Cx1_Fehler), 0=Cx0_no_error (CM_FID_SW_inconsistent_Cx0_no_error)}, range raw 0..1, transfer-property=TRIGGERED-WITHOUT-REPETITION, to HCP3_IONode(timeout 5 s)  # SW_inconsistent = 1 SW Status is inconsistent - error SW_inconsistent = 0 no error - SW is consistent
    signal FID_Telltale_State_XIX_FID_01_XIX_VLAN_Cockpit: start 108, 2 bit, little-endian, data-type-policy=OVERRIDE, i-signal-type=PRIMITIVE, init-value=0, base-type=BT_FID_Telltale_State, compu {2=Cx2_Safestate_2 (CM_FID_Telltale_State_Cx2_Safestate_2), 0=Cx0_Normal_Operation (CM_FID_Telltale_State_Cx0_Normal_Operation), 3=Cx3_Safestate_3 (CM_FID_Telltale_State_Cx3_Safestate_3), 1=Cx1_Safestate_1 (CM_FID_Telltale_State_Cx1_Safestate_1)}, range raw 0..3, transfer-property=TRIGGERED-WITHOUT-REPETITION  # Fehlerzustand der vom FID gezeichneten Kontrollleuchten.
    signal FID_Telltale_Check_XIX_FID_01_XIX_VLAN_Cockpit: start 110, 1 bit, little-endian, data-type-policy=OVERRIDE, i-signal-type=PRIMITIVE, init-value=0, base-type=BT_FID_Telltale_Check, compu {0=Cx0_inactive (CM_FID_Telltale_Check_Cx0_inactive), 1=Cx1_active (CM_FID_Telltale_Check_Cx1_active)}, range raw 0..1, transfer-property=TRIGGERED-WITHOUT-REPETITION  # The signal informs if the telltales are curently being checked (i.e. duricng a terminal15 activation).
    signal FID_Display_Ready_XIX_FID_01_XIX_VLAN_Cockpit: start 111, 1 bit, little-endian, data-type-policy=OVERRIDE, i-signal-type=PRIMITIVE, init-value=0, base-type=BT_FID_Display_Ready, compu {0=Cx0_not_ready (CM_FID_Display_Ready_Cx0_not_ready), 1=Cx1_ready (CM_FID_Display_Ready_Cx1_ready)}, range raw 0..1, transfer-property=TRIGGERED-WITHOUT-REPETITION  # The Signal informs if the display is functional whereas if the video stream is being displayed.
    signal FID_Video_State_XIX_FID_01_XIX_VLAN_Cockpit: start 112, 2 bit, little-endian, data-type-policy=OVERRIDE, i-signal-type=PRIMITIVE, init-value=0, base-type=BT_FID_Video_State, invalid-value=Invalid_FID_Video_State_XIX_FID_01_XIX_VLAN_Cockpit:2, compu {2=Cx2_Fehler (CM_FID_Video_State_Cx2_Fehler), 1=Cx1_Video_Ready (CM_FID_Video_State_Cx1_Video_Ready), 0=Cx0_Video_not_Ready (CM_FID_Video_State_Cx0_Video_not_Ready)}, range raw 0..2, transfer-property=TRIGGERED-WITHOUT-REPETITION  # Video stream state at FID generated from the video protocol analysis.
    signal FID_Acoustics_State_XIX_FID_01_XIX_VLAN_Cockpit: start 114, 3 bit, little-endian, data-type-policy=OVERRIDE, i-signal-type=PRIMITIVE, init-value=0, base-type=BT_FID_Acoustics_State, compu {4=Cx4_Acoustics_not_Installed (CM_FID_Acoustics_State_Cx4_Acoustics_not_Installed), 0=Cx0_Acoustics_not_Ready (CM_FID_Acoustics_State_Cx0_Acoustics_not_Ready), 1=Cx1_Acoustics_Off (CM_FID_Acoustics_State_Cx1_Acoustics_Off), 3=Cx3_Acoustics_Error (CM_FID_Acoustics_State_Cx3_Acoustics_Error), 5=Cx5_Acoustics_Mute (CM_FID_Acoustics_State_Cx5_Acoustics_Mute), 2=Cx2_Acoustics_On (CM_FID_Acoustics_State_Cx2_Acoustics_On), 6=Cx6_Reserved (CM_FID_Acoustics_State_Cx6_Reserved), 7=Cx7_Reserved (CM_FID_Acoustics_State_Cx7_Reserved)}, range raw 0..7, transfer-property=TRIGGERED-WITHOUT-REPETITION  # Describes the opperational state of the FID acoustics.
    signal FID_E2E_SF_XIX_FID_01_XIX_VLAN_Cockpit: start 117, 1 bit, little-endian, data-type-policy=OVERRIDE, i-signal-type=PRIMITIVE, init-value=0, base-type=BT_FID_E2E_SF, compu {1=Cx1_E2E_Error_detected (CM_FID_E2E_SF_Cx1_E2E_Error_detected), 0=Cx0_InitWert_no_E2E_Error_detected (CM_FID_E2E_SF_Cx0_InitWert_no_E2E_Error_detected)}, range raw 0..1, transfer-property=TRIGGERED-WITHOUT-REPETITION  # The signal informs of an existing End2End Error
  pdu FID_VA_Communication_Init_Ack_XIX_VLAN_Cockpit: length=20, minimum-delay=0.1, transmission-mode-true-timing={cyclic-timing={time-offset=0.0, time-period=1.0}, event-controlled-timing={number-of-repetitions=0, repetition-period=0.0}}, unused-bit-pattern=0
    signal FID_VA_Communication_Init_Ack_XIX_FID_VA_Communication_Init_Ack_XIX_VLAN_Cockpit: start 0, 136 bit, opaque, data-type-policy=OVERRIDE, i-signal-type=ARRAY, init-value=17 x 0, base-type=BT_FID_VA_Communication_Init_Ack, implementation-data-type=FID_VA_Communication_Init_Ack, transfer-property=TRIGGERED-ON-CHANGE-WITHOUT-REPETITION, to HCP3_IONode(timeout 5 s)  # Init communication acknowledge of video-authentication for FID
  pdu FID_VA_Communication_Init_XIX_VLAN_Cockpit: length=20, minimum-delay=0.1, transmission-mode-true-timing={cyclic-timing={time-offset=0.0, time-period=1.0}, event-controlled-timing={number-of-repetitions=0, repetition-period=0.0}}, unused-bit-pattern=0
    signal FID_VA_Communication_Init_XIX_FID_VA_Communication_Init_XIX_VLAN_Cockpit: start 0, 136 bit, opaque, data-type-policy=OVERRIDE, i-signal-type=ARRAY, init-value=17 x 0, base-type=BT_FID_VA_Communication_Init, implementation-data-type=FID_VA_Communication_Init, transfer-property=TRIGGERED-ON-CHANGE-WITHOUT-REPETITION, to HCP3_IONode(timeout 5 s)  # This data channel is used for display video authentication of FID.
  pdu FID_VA_Response_XIX_VLAN_Cockpit: length=64, minimum-delay=0.1, transmission-mode-true-timing={cyclic-timing={time-offset=0.0, time-period=1.0}, event-controlled-timing={number-of-repetitions=0, repetition-period=0.0}}, unused-bit-pattern=0
    signal FID_VA_Response_XIX_FID_VA_Response_XIX_VLAN_Cockpit: start 0, 512 bit, opaque, data-type-policy=OVERRIDE, i-signal-type=ARRAY, init-value=64 x 0, base-type=BT_FID_VA_Response, implementation-data-type=FID_VA_Response, transfer-property=TRIGGERED-ON-CHANGE-WITHOUT-REPETITION, to HCP3_IONode(timeout 5 s)  # Video-authentication response for FID
  pdu FoD_Info_El_Req_XIX_VLAN_Cockpit: length=402, transmission-mode-true-timing=event-controlled-timing={number-of-repetitions=0, repetition-period=0.0}, unused-bit-pattern=0
    signal FoD_Info_El_Req_Eth_Data_XIX_FoD_Info_El_Req_XIX_VLAN_Cockpit: start 0, 3216 bit, opaque, data-type-policy=OVERRIDE, i-signal-type=ARRAY, init-value=402 x 0, base-type=BT_FoD_Info_El_Req_Eth_Data, dynamic-length=true, implementation-data-type=FoD_Info_El_Req_Eth_Data, transfer-property=TRIGGERED-WITHOUT-REPETITION, to HCP3_IONode  # Function on Demand - Request FoD Master (HCP5) to FoD Slave (HCP3) | Length = 1 + 1 + 4*100 = 402 byte = 3216 bit
  pdu FoD_Info_El_Resp_XIX_VLAN_Cockpit: length=502, transmission-mode-true-timing=event-controlled-timing={number-of-repetitions=0, repetition-period=0.0}, unused-bit-pattern=0
    signal FoD_Info_El_Resp_Eth_Data_XIX_FoD_Info_El_Resp_XIX_VLAN_Cockpit: start 0, 4016 bit, opaque, data-type-policy=OVERRIDE, i-signal-type=ARRAY, init-value=502 x 0, base-type=BT_FoD_Info_El_Resp_Eth_Data, dynamic-length=true, implementation-data-type=FoD_Info_El_Resp_Eth_Data, transfer-property=TRIGGERED-WITHOUT-REPETITION  # Function on Demand - Response FoD Slave (HCP3) to FoD Master (HCP5) | Length = 1 + 1 + 4*100 + 1*100 = 502 byte = 4016 bit
  pdu HCP1_02_XIX_VLAN_Cockpit: length=16, transmission-mode-true-timing=cyclic-timing={time-offset=0.0, time-period=0.01}, unused-bit-pattern=0
    signal HCP1_02_CRC_XIX_HCP1_02_XIX_VLAN_Cockpit: start 0, 8 bit, little-endian, data-type-policy=OVERRIDE, i-signal-type=PRIMITIVE, init-value=0, base-type=BT_HCP1_02_CRC, compu {phys=raw for raw 0..255}, range phys 0..255, raw 0..255, transfer-property=TRIGGERED-WITHOUT-REPETITION  # Für MLB: Berechnung siehe Lastenheft "Kommunikationsabsicherung für FlexRay und CAN" Ab MQB und MLBevo: Berechnung siehe Lastenheft "End-to-End Kommunikationsabsicherung" Endwerte siehe Begleitdokument "S-PDU Kennungsfolgen"
    signal HCP1_02_BZ_XIX_HCP1_02_XIX_VLAN_Cockpit: start 8, 4 bit, little-endian, data-type-policy=OVERRIDE, i-signal-type=PRIMITIVE, init-value=0, base-type=BT_HCP1_02_BZ, compu {phys=raw for raw 0..15}, range phys 0..15, raw 0..15, transfer-property=TRIGGERED-WITHOUT-REPETITION  # 4bit Botschaftszähler, wird mit jeder Sendebotschaft inkrementiert
    signal DSI_OvrstrIdx_XIX_HCP1_02_XIX_VLAN_Cockpit: start 12, 7 bit, little-endian, data-type-policy=OVERRIDE, i-signal-type=PRIMITIVE, init-value=126, base-type=BT_DSI_OvrstrIdx, invalid-value=Invalid_DSI_OvrstrIdx_XIX_HCP1_02_XIX_VLAN_Cockpit:127, compu {phys=raw*0.01 for raw 0..100, 127=Cx7f_Fehler (CM_DSI_OvrstrIdx_Cx7f_Fehler), 126=Cx7e_Init (CM_DSI_OvrstrIdx_Cx7e_Init), 125=Cx7d_nicht_verbaut (CM_DSI_OvrstrIdx_Cx7d_nicht_verbaut); unit Unit_None}, range phys 0..1 Unit_None, raw 0..127, unit=Unit_None, transfer-property=TRIGGERED-WITHOUT-REPETITION  # normalized oversteer index
    signal DSI_UndstrIdx_XIX_HCP1_02_XIX_VLAN_Cockpit: start 19, 7 bit, little-endian, data-type-policy=OVERRIDE, i-signal-type=PRIMITIVE, init-value=126, base-type=BT_DSI_UndstrIdx, invalid-value=Invalid_DSI_UndstrIdx_XIX_HCP1_02_XIX_VLAN_Cockpit:127, compu {phys=raw*0.01 for raw 0..100, 127=Cx7f_Fehler (CM_DSI_UndstrIdx_Cx7f_Fehler), 126=Cx7e_Init (CM_DSI_UndstrIdx_Cx7e_Init), 125=Cx7d_nicht_verbaut (CM_DSI_UndstrIdx_Cx7d_nicht_verbaut); unit Unit_None}, range phys 0..1 Unit_None, raw 0..127, unit=Unit_None, transfer-property=TRIGGERED-WITHOUT-REPETITION  # normalized understeer index
    signal DSI_YawRateAyDyn_XIX_HCP1_02_XIX_VLAN_Cockpit: start 26, 13 bit, little-endian, data-type-policy=OVERRIDE, i-signal-type=PRIMITIVE, init-value=8190, base-type=BT_DSI_YawRateAyDyn, invalid-value=Invalid_DSI_YawRateAyDyn_XIX_HCP1_02_XIX_VLAN_Cockpit:8191, compu {phys=raw*0.001-4.093 for raw 0..8187, 8191=Cx1fff_Fehler (CM_DSI_YawRateAyDyn_Cx1fff_Fehler), 8190=Cx1ffe_Init (CM_DSI_YawRateAyDyn_Cx1ffe_Init), 8189=Cx1ffd_nicht_verbaut (CM_DSI_YawRateAyDyn_Cx1ffd_nicht_verbaut); unit Unit_RadiaPerSecon}, range phys -4.093..4.094 Unit_RadiaPerSecon, raw 0..8191, unit=Unit_RadiaPerSecon, transfer-property=TRIGGERED-WITHOUT-REPETITION  # dynamic desired yaw rate calculated from current lateral acceleration
    signal DSI_SlipAgOvrstr_XIX_HCP1_02_XIX_VLAN_Cockpit: start 39, 12 bit, little-endian, data-type-policy=OVERRIDE, i-signal-type=PRIMITIVE, init-value=4094, base-type=BT_DSI_SlipAgOvrstr, invalid-value=Invalid_DSI_SlipAgOvrstr_XIX_HCP1_02_XIX_VLAN_Cockpit:4095, compu {phys=raw*0.0015-3.069 for raw 0..4092, 4095=Cxfff_Fehler (CM_DSI_SlipAgOvrstr_Cxfff_Fehler), 4094=Cxffe_Init (CM_DSI_SlipAgOvrstr_Cxffe_Init), 4093=Cxffd_nicht_verbaut (CM_DSI_SlipAgOvrstr_Cxffd_nicht_verbaut); unit Unit_Radia}, range phys -3.069..3.069 Unit_Radia, raw 0..4095, unit=Unit_Radia, transfer-property=TRIGGERED-WITHOUT-REPETITION  # slip angle during oversteer situation (integration of yaw rate difference)
    signal PTAcvSrv_StPwrMd_XIX_HCP1_02_XIX_VLAN_Cockpit: start 51, 3 bit, little-endian, data-type-policy=OVERRIDE, i-signal-type=PRIMITIVE, init-value=0, base-type=BT_PTAcvSrv_StPwrMd, invalid-value=Invalid_PTAcvSrv_StPwrMd_XIX_HCP1_02_XIX_VLAN_Cockpit:7, compu {7=Cx7_Fehler (CM_PTAcvSrv_StPwrMd_Cx7_Fehler), 4=Cx4_DeactivatingPowerOnMode (CM_PTAcvSrv_StPwrMd_Cx4_DeactivatingPowerOnMode), 3=Cx3_PowerOnMode (CM_PTAcvSrv_StPwrMd_Cx3_PowerOnMode), 1=Cx1_PowerOffMode (CM_PTAcvSrv_StPwrMd_Cx1_PowerOffMode), 2=Cx2_ActivatingPowerOnMode (CM_PTAcvSrv_StPwrMd_Cx2_ActivatingPowerOnMode), 0=Cx0_Init (CM_PTAcvSrv_StPwrMd_Cx0_Init)}, range raw 0..7, transfer-property=TRIGGERED-WITHOUT-REPETITION, to HCP3_IONode(timeout 0.5 s)  # Status Leistungsbereitstellung, unabhängig der Vortriebsbereitstellung (z.B. Motor läuft bei RemoteStart)
    signal PTAcvSrv_StDrvMd_XIX_HCP1_02_XIX_VLAN_Cockpit: start 54, 3 bit, little-endian, data-type-policy=OVERRIDE, i-signal-type=PRIMITIVE, init-value=0, base-type=BT_PTAcvSrv_StDrvMd, invalid-value=Invalid_PTAcvSrv_StDrvMd_XIX_HCP1_02_XIX_VLAN_Cockpit:7, compu {7=Cx7_Fehler (CM_PTAcvSrv_StDrvMd_Cx7_Fehler), 4=Cx4_DeactivatingDrivingEnabledMode (CM_PTAcvSrv_StDrvMd_Cx4_DeactivatingDrivingEnabledMode), 3=Cx3_DrivingEnabledMode (CM_PTAcvSrv_StDrvMd_Cx3_DrivingEnabledMode), 2=Cx2_ActivatingDrivingEnabledMode (CM_PTAcvSrv_StDrvMd_Cx2_ActivatingDrivingEnabledMode), 1=Cx1_DrivingDisabledMode (CM_PTAcvSrv_StDrvMd_Cx1_DrivingDisabledMode), 0=Cx0_Init (CM_PTAcvSrv_StDrvMd_Cx0_Init)}, range raw 0..7, transfer-property=TRIGGERED-WITHOUT-REPETITION, to HCP3_IONode(timeout 0.5 s)  # Vortriebsbereitstellung unabhängig der Energiequelle (losfahren möglich)
    signal PTAcvSrv_StDrvPTAcvReqPmd_XIX_HCP1_02_XIX_VLAN_Cockpit: start 57, 2 bit, little-endian, data-type-policy=OVERRIDE, i-signal-type=PRIMITIVE, init-value=0, base-type=BT_PTAcvSrv_StDrvPTAcvReqPmd, compu {0=Cx0_NoRequest (CM_PTAcvSrv_StDrvPTAcvReqPmd_Cx0_NoRequest), 2=Cx2_RequestDrivingEnabledMode (CM_PTAcvSrv_StDrvPTAcvReqPmd_Cx2_RequestDrivingEnabledMode), 1=Cx1_RequestPowerOnMode (CM_PTAcvSrv_StDrvPTAcvReqPmd_Cx1_RequestPowerOnMode)}, range raw 0..2, transfer-property=TRIGGERED-WITHOUT-REPETITION  # state of powertrain activation requested by driver considering relevant activation conditions (e.g. immobilizer release)
    signal PTAcvSrv_StPTAcvReq_XIX_HCP1_02_XIX_VLAN_Cockpit: start 59, 2 bit, little-endian, data-type-policy=OVERRIDE, i-signal-type=PRIMITIVE, init-value=0, base-type=BT_PTAcvSrv_StPTAcvReq, compu {3=Cx3_RequestDrivingEnabledMode (CM_PTAcvSrv_StPTAcvReq_Cx3_RequestDrivingEnabledMode), 1=Cx1_RequestPowerOffMode (CM_PTAcvSrv_StPTAcvReq_Cx1_RequestPowerOffMode), 2=Cx2_RequestPowerOnMode (CM_PTAcvSrv_StPTAcvReq_Cx2_RequestPowerOnMode), 0=Cx0_Init (CM_PTAcvSrv_StPTAcvReq_Cx0_Init)}, range raw 0..3, transfer-property=TRIGGERED-WITHOUT-REPETITION  # requested state of powertrain activation
    signal API_StDrvPed_XIX_HCP1_02_XIX_VLAN_Cockpit: start 61, 2 bit, little-endian, data-type-policy=OVERRIDE, i-signal-type=PRIMITIVE, init-value=0, base-type=BT_API_StDrvPed, compu {1=Cx1_Applied (CM_API_StDrvPed_Cx1_Applied), 0=Cx0_NotApplied (CM_API_StDrvPed_Cx0_NotApplied), 2=Cx2_Kickdown (CM_API_StDrvPed_Cx2_Kickdown)}, range raw 0..2, transfer-property=TRIGGERED-WITHOUT-REPETITION  # state of driver acceleration pedal
    signal API_StDrvPedCnfd_XIX_HCP1_02_XIX_VLAN_Cockpit: start 63, 2 bit, little-endian, data-type-policy=OVERRIDE, i-signal-type=PRIMITIVE, init-value=0, base-type=BT_API_StDrvPedCnfd, invalid-value=Invalid_API_StDrvPedCnfd_XIX_HCP1_02_XIX_VLAN_Cockpit:3, compu {3=Cx3_Fehler (CM_API_StDrvPedCnfd_Cx3_Fehler), 1=Cx1_Valid (CM_API_StDrvPedCnfd_Cx1_Valid), 0=Cx0_Init (CM_API_StDrvPedCnfd_Cx0_Init), 2=Cx2_ReducedQuality (CM_API_StDrvPedCnfd_Cx2_ReducedQuality)}, range raw 0..3, transfer-property=TRIGGERED-WITHOUT-REPETITION  # transmission performance of driver acceleration pedal
    signal API_PrctDrvPed_XIX_HCP1_02_XIX_VLAN_Cockpit: start 65, 8 bit, little-endian, data-type-policy=OVERRIDE, i-signal-type=PRIMITIVE, init-value=254, base-type=BT_API_PrctDrvPed, invalid-value=Invalid_API_PrctDrvPed_XIX_HCP1_02_XIX_VLAN_Cockpit:255, compu {phys=raw*0.5 for raw 0..200, 255=Cxff_Fehler (CM_API_PrctDrvPed_Cxff_Fehler), 254=Cxfe_Init (CM_API_PrctDrvPed_Cxfe_Init); unit Unit_PerCent}, range phys 0..100 Unit_PerCent, raw 0..255, unit=Unit_PerCent, transfer-property=TRIGGERED-WITHOUT-REPETITION  # driver acceleration pedal in percent
    signal API_PrctGrdDrvPed_XIX_HCP1_02_XIX_VLAN_Cockpit: start 73, 9 bit, little-endian, data-type-policy=OVERRIDE, i-signal-type=PRIMITIVE, init-value=510, base-type=BT_API_PrctGrdDrvPed, invalid-value=Invalid_API_PrctGrdDrvPed_XIX_HCP1_02_XIX_VLAN_Cockpit:511, compu {phys=raw*25-6350 for raw 0..509, 511=Cx1ff_Fehler (CM_API_PrctGrdDrvPed_Cx1ff_Fehler), 510=Cx1fe_Init (CM_API_PrctGrdDrvPed_Cx1fe_Init); unit Unit_PerCentPerSecon}, range phys -6350..6375 Unit_PerCentPerSecon, raw 0..511, unit=Unit_PerCentPerSecon, transfer-property=TRIGGERED-WITHOUT-REPETITION  # gradient of driver acceleration pedal in percent per second
    signal DLO_StAllWd_XIX_HCP1_02_XIX_VLAN_Cockpit: start 82, 3 bit, little-endian, data-type-policy=OVERRIDE, i-signal-type=PRIMITIVE, init-value=6, base-type=BT_DLO_StAllWd, invalid-value=Invalid_DLO_StAllWd_XIX_HCP1_02_XIX_VLAN_Cockpit:7, compu {7=Cx7_Fehler (CM_DLO_StAllWd_Cx7_Fehler), 3=Cx3_Function_deactivated (CM_DLO_StAllWd_Cx3_Function_deactivated), 6=Cx6_Init (CM_DLO_StAllWd_Cx6_Init), 1=Cx1_Controlmode (CM_DLO_StAllWd_Cx1_Controlmode), 0=Cx0_Handshake (CM_DLO_StAllWd_Cx0_Handshake), 2=Cx2_Function_degraded (CM_DLO_StAllWd_Cx2_Function_degraded)}, range raw 0..7, transfer-property=TRIGGERED-WITHOUT-REPETITION  # Desired state Hang-On clutch
    signal DLO_StAllWdCluDes_XIX_HCP1_02_XIX_VLAN_Cockpit: start 85, 3 bit, little-endian, data-type-policy=OVERRIDE, i-signal-type=PRIMITIVE, init-value=0, base-type=BT_DLO_StAllWdCluDes, compu {3=Cx3_demand_state_touchpoint (CM_DLO_StAllWdCluDes_Cx3_demand_state_touchpoint), 1=Cx1_demand_state_slow_open (CM_DLO_StAllWdCluDes_Cx1_demand_state_slow_open), 0=Cx0_no_request (CM_DLO_StAllWdCluDes_Cx0_no_request), 2=Cx2_demand_state_fast_open (CM_DLO_StAllWdCluDes_Cx2_demand_state_fast_open)}, range raw 0..3, transfer-property=TRIGGERED-WITHOUT-REPETITION  # Special desired states Hang-On clutch
    signal DLO_TqReqAllWdClu_XIX_HCP1_02_XIX_VLAN_Cockpit: start 88, 12 bit, little-endian, data-type-policy=OVERRIDE, i-signal-type=PRIMITIVE, init-value=0, base-type=BT_DLO_TqReqAllWdClu, invalid-value=Invalid_DLO_TqReqAllWdClu_XIX_HCP1_02_XIX_VLAN_Cockpit:4095, compu {phys=raw for raw 0..4000, 4095=Cxfff_Fehler (CM_DLO_TqReqAllWdClu_Cxfff_Fehler); unit Unit_NewtoMeter}, range phys 0..4000 Unit_NewtoMeter, raw 0..4095, unit=Unit_NewtoMeter, transfer-property=TRIGGERED-WITHOUT-REPETITION  # Desired torque Hang-On clutch
    signal AICluT_TqWhlDesAllWd_XIX_HCP1_02_XIX_VLAN_Cockpit: start 104, 16 bit, little-endian, data-type-policy=OVERRIDE, i-signal-type=PRIMITIVE, init-value=65534, base-type=BT_AICluT_TqWhlDesAllWd, invalid-value=Invalid_AICluT_TqWhlDesAllWd_XIX_HCP1_02_XIX_VLAN_Cockpit:65535, compu {phys=raw-32767 for raw 0..65533, 65535=Cxffff_Fehler (CM_AICluT_TqWhlDesAllWd_Cxffff_Fehler), 65534=Cxfffe_Init (CM_AICluT_TqWhlDesAllWd_Cxfffe_Init); unit Unit_NewtoMeter}, range phys -32767..32766 Unit_NewtoMeter, raw 0..65535, unit=Unit_NewtoMeter, transfer-property=TRIGGERED-WITHOUT-REPETITION  # desired wheel torque to all wheel drive system
    signal CMM_ReqAcvHdc_XIX_HCP1_02_XIX_VLAN_Cockpit: start 120, 2 bit, little-endian, data-type-policy=OVERRIDE, i-signal-type=PRIMITIVE, init-value=2, base-type=BT_CMM_ReqAcvHdc, invalid-value=Invalid_CMM_ReqAcvHdc_XIX_HCP1_02_XIX_VLAN_Cockpit:3, compu {3=Cx3_Fehler (CM_CMM_ReqAcvHdc_Cx3_Fehler), 1=Cx1_request_active (CM_CMM_ReqAcvHdc_Cx1_request_active), 2=Cx2_Init (CM_CMM_ReqAcvHdc_Cx2_Init), 0=Cx0_request_not_active (CM_CMM_ReqAcvHdc_Cx0_request_not_active)}, range raw 0..3, transfer-property=TRIGGERED-WITHOUT-REPETITION  # State of the activation request for hill descent control
    signal AID_StsSysDgrd_XIX_HCP1_02_XIX_VLAN_Cockpit: start 122, 3 bit, little-endian, data-type-policy=OVERRIDE, i-signal-type=PRIMITIVE, init-value=0, base-type=BT_AID_StsSysDgrd, invalid-value=Invalid_AID_StsSysDgrd_XIX_HCP1_02_XIX_VLAN_Cockpit:7, compu {7=Cx7_Fehler (CM_AID_StsSysDgrd_Cx7_Fehler), 3=Cx3_degradation_level2 (CM_AID_StsSysDgrd_Cx3_degradation_level2), 6=Cx6_failsafe_system_deactivated (CM_AID_StsSysDgrd_Cx6_failsafe_system_deactivated), 4=Cx4_failsafe_constant_current (CM_AID_StsSysDgrd_Cx4_failsafe_constant_current), 0=Cx0_Init (CM_AID_StsSysDgrd_Cx0_Init), 2=Cx2_degradation_level1 (CM_AID_StsSysDgrd_Cx2_degradation_level1), 1=Cx1_no_degradation_normal_mode (CM_AID_StsSysDgrd_Cx1_no_degradation_normal_mode), 5=Cx5_failsafe_powerstages_deactivated (CM_AID_StsSysDgrd_Cx5_failsafe_powerstages_deactivated)}, range raw 0..7, transfer-property=TRIGGERED-WITHOUT-REPETITION  # indicator of status of the (semi-active) damper system
    signal PTERM_StCEStopDesHisSto_XIX_HCP1_02_XIX_VLAN_Cockpit: start 125, 2 bit, little-endian, data-type-policy=OVERRIDE, i-signal-type=PRIMITIVE, init-value=0, base-type=BT_PTERM_StCEStopDesHisSto, compu {0=Cx0_kein_VKM_Abstellwunsch_STST_Koordinator (CM_PTERM_StCEStopDesHisSto_Cx0_kein_VKM_Abstellwunsch_STST_Koordinator), 1=Cx1_VKM_Abstellwunsch_STST_Koordinator (CM_PTERM_StCEStopDesHisSto_Cx1_VKM_Abstellwunsch_STST_Koordinator), 2=Cx2_Vorhalt (CM_PTERM_StCEStopDesHisSto_Cx2_Vorhalt), 3=Cx3_Vorhalt (CM_PTERM_StCEStopDesHisSto_Cx3_Vorhalt)}, range raw 0..3, transfer-property=TRIGGERED-WITHOUT-REPETITION  # combustion engine stop desired by powertrain energy routing manager for history storage
    signal DTC_StAllWdCluCal_XIX_HCP1_02_XIX_VLAN_Cockpit: start 127, 1 bit, little-endian, data-type-policy=OVERRIDE, i-signal-type=PRIMITIVE, init-value=0, base-type=BT_DTC_StAllWdCluCal, compu {0=Cx0_Calibration_not_allowed (CM_DTC_StAllWdCluCal_Cx0_Calibration_not_allowed), 1=Cx1_Calibration_allowed (CM_DTC_StAllWdCluCal_Cx1_Calibration_allowed)}, range raw 0..1, transfer-property=TRIGGERED-WITHOUT-REPETITION  # Calibration state permission Hang-On clutch
  pdu HCP1_07_XIX_VLAN_Cockpit: length=12, minimum-delay=0.02, transmission-mode-true-timing={cyclic-timing={time-offset=0.0, time-period=0.2}, event-controlled-timing={number-of-repetitions=5, repetition-period=0.02}}, unused-bit-pattern=0
    signal VDSO_DKmtg_Auth_XIX_HCP1_07_XIX_VLAN_Cockpit: start 12, 32 bit, little-endian, data-type-policy=OVERRIDE, i-signal-type=PRIMITIVE, init-value=4294967294, base-type=BT_VDSO_DKmtg_Auth, invalid-value=Invalid_VDSO_DKmtg_Auth_XIX_HCP1_07_XIX_VLAN_Cockpit:4294967295, compu {phys=raw for raw 0..4294967293, 4294967295=Cxffffffff_Fehler (CM_VDSO_DKmtg_Auth_Cxffffffff_Fehler), 4294967294=Cxfffffffe_Init (CM_VDSO_DKmtg_Auth_Cxfffffffe_Init); unit Unit_Meter}, range phys 0..4294967293 Unit_Meter, raw 0..4294967295, unit=Unit_Meter, transfer-property=PENDING, to HCP3_IONode(timeout 2 s)  # Vehicle lifetime traveled distance authenticated
    signal AIAD_PwrCnsOvf_XIX_HCP1_07_XIX_VLAN_Cockpit: start 44, 1 bit, little-endian, data-type-policy=OVERRIDE, i-signal-type=PRIMITIVE, init-value=0, base-type=BT_AIAD_PwrCnsOvf, compu {1=Cx1_counter_overflow (CM_AIAD_PwrCnsOvf_Cx1_counter_overflow), 0=Cx0_no_counter_overflow (CM_AIAD_PwrCnsOvf_Cx0_no_counter_overflow)}, range raw 0..1, transfer-property=PENDING  # Active Damper Power Consumption Counter Overflow Indicator
    signal AIAD_PwrCns_XIX_HCP1_07_XIX_VLAN_Cockpit: start 45, 12 bit, little-endian, data-type-policy=OVERRIDE, i-signal-type=PRIMITIVE, init-value=4094, base-type=BT_AIAD_PwrCns, invalid-value=Invalid_AIAD_PwrCns_XIX_HCP1_07_XIX_VLAN_Cockpit:4095, compu {phys=raw*10-2000 for raw 0..4093, 4095=Cxfff_Fehler (CM_AIAD_PwrCns_Cxfff_Fehler), 4094=Cxffe_Init (CM_AIAD_PwrCns_Cxffe_Init); unit Unit_Watt}, range phys -2000..38930 Unit_Watt, raw 0..4095, unit=Unit_Watt, transfer-property=PENDING  # Active Damper Power Consumption Counter
    signal PTERO_StStrtStopDeacUsr_XIX_HCP1_07_XIX_VLAN_Cockpit: start 57, 1 bit, little-endian, data-type-policy=OVERRIDE, i-signal-type=PRIMITIVE, init-value=0, base-type=BT_PTERO_StStrtStopDeacUsr, compu {0=Cx0_STST_active_LED_off (CM_PTERO_StStrtStopDeacUsr_Cx0_STST_active_LED_off) (STST_active_/_LED_off), 1=Cx1_STST_deactivated_LED_on (CM_PTERO_StStrtStopDeacUsr_Cx1_STST_deactivated_LED_on) (STST_deactivated_/_LED_on)}, range raw 0..1, transfer-property=TRIGGERED-ON-CHANGE  # Start stop deactivation by user
    signal VDSO_StDKmtg_Auth_XIX_HCP1_07_XIX_VLAN_Cockpit: start 58, 1 bit, little-endian, data-type-policy=OVERRIDE, i-signal-type=PRIMITIVE, init-value=0, base-type=BT_VDSO_StDKmtg_Auth, compu {0=Cx0_QTS_NotActive (CM_VDSO_StDKmtg_Auth_Cx0_QTS_NotActive), 1=Cx1_QTS_Active (CM_VDSO_StDKmtg_Auth_Cx1_QTS_Active)}, range raw 0..1, transfer-property=PENDING  # State of VDSO_DKmtg_Auth. Shows if necessary QTS activities were performed after exchange of HCP1
    signal PTERO_WThDeacEv_XIX_HCP1_07_XIX_VLAN_Cockpit: start 59, 10 bit, little-endian, data-type-policy=OVERRIDE, i-signal-type=PRIMITIVE, init-value=1023, base-type=BT_PTERO_WThDeacEv, compu {phys=raw*4 for raw 0..1022, 1023=Cx3ff_Init (CM_PTERO_WThDeacEv_Cx3ff_Init); unit Unit_WattHour}, range phys 0..4088 Unit_WattHour, raw 0..1023, unit=Unit_WattHour, transfer-property=PENDING  # EV-Abwurfschwelle für RWB
  pdu HWP_01_XIX_VLAN_Cockpit_E2E: length=8, transmission-mode-true-timing=event-controlled-timing={number-of-repetitions=0, repetition-period=0.0}, unused-bit-pattern=0  # Fuer die Botschaft ist das Cyclic-Timing 0.04 zu verwenden.
    signal HWP_01_CRC_XIX_HWP_01_XIX_VLAN_Cockpit: start 0, 8 bit, little-endian, data-type-policy=OVERRIDE, i-signal-type=PRIMITIVE, init-value=0, base-type=BT_HWP_01_CRC, compu {phys=raw for raw 0..255}, range phys 0..255, raw 0..255, to HCP3_IONode(timeout 0.5 s)  # Für MLB: Berechnung siehe Lastenheft "Kommunikationsabsicherung für FlexRay und CAN" Ab MQB und MLBevo: Berechnung siehe Lastenheft "End-to-End Kommunikationsabsicherung" Endwerte siehe Begleitdokument "S-PDU Kennungsfolgen"
    signal HWP_01_BZ_XIX_HWP_01_XIX_VLAN_Cockpit: start 8, 4 bit, little-endian, data-type-policy=OVERRIDE, i-signal-type=PRIMITIVE, init-value=0, base-type=BT_HWP_01_BZ, compu {phys=raw for raw 0..15}, range phys 0..15, raw 0..15, to HCP3_IONode(timeout 0.5 s)  # 4bit Botschaftszähler, wird mit jeder Sendebotschaft inkrementiert
    signal HWP_HMI_ASIL_Color_XIX_HWP_01_XIX_VLAN_Cockpit: start 12, 4 bit, little-endian, data-type-policy=OVERRIDE, i-signal-type=PRIMITIVE, init-value=0, base-type=BT_HWP_HMI_ASIL_Color, invalid-value=Invalid_HWP_HMI_ASIL_Color_XIX_HWP_01_XIX_VLAN_Cockpit:15, compu {15=Cxf_Fehler (CM_HWP_HMI_ASIL_Color_Cxf_Fehler), 6=Cx6_Turquoise_Pulsing (CM_HWP_HMI_ASIL_Color_Cx6_Turquoise_Pulsing), 7=Cx7_Green_Pulsing (CM_HWP_HMI_ASIL_Color_Cx7_Green_Pulsing), 1=Cx1_Off (CM_HWP_HMI_ASIL_Color_Cx1_Off), 9=Cx9_White_Pulsing (CM_HWP_HMI_ASIL_Color_Cx9_White_Pulsing), 4=Cx4_Red_Static (CM_HWP_HMI_ASIL_Color_Cx4_Red_Static), 8=Cx8_Red_Pulsing (CM_HWP_HMI_ASIL_Color_Cx8_Red_Pulsing), 5=Cx5_White_Static (CM_HWP_HMI_ASIL_Color_Cx5_White_Static), 2=Cx2_Turquoise_Static (CM_HWP_HMI_ASIL_Color_Cx2_Turquoise_Static), 3=Cx3_Green_Static (CM_HWP_HMI_ASIL_Color_Cx3_Green_Static), 0=Cx0_Init (CM_HWP_HMI_ASIL_Color_Cx0_Init)}, range raw 0..15, to HCP3_IONode(timeout 0.5 s)  # ASIL D State of Highway Pilot HMI controller including color information
    signal ISignalVoid_HWP_01_XIX_VLAN_Cockpit_0: start 16, 8 bit, little-endian, system signal SignalVoid_HWP_01_0, data-type-policy=OVERRIDE, i-signal-type=PRIMITIVE, base-type=BT_SignalVoid
    signal ISignalVoid_HWP_01_XIX_VLAN_Cockpit_1: start 24, 8 bit, little-endian, system signal SignalVoid_HWP_01_1, data-type-policy=OVERRIDE, i-signal-type=PRIMITIVE, base-type=BT_SignalVoid
    signal ISignalVoid_HWP_01_XIX_VLAN_Cockpit_2: start 32, 8 bit, little-endian, system signal SignalVoid_HWP_01_2, data-type-policy=OVERRIDE, i-signal-type=PRIMITIVE, base-type=BT_SignalVoid
    signal ISignalVoid_HWP_01_XIX_VLAN_Cockpit_3: start 40, 8 bit, little-endian, system signal SignalVoid_HWP_01_3, data-type-policy=OVERRIDE, i-signal-type=PRIMITIVE, base-type=BT_SignalVoid
    signal ISignalVoid_HWP_01_XIX_VLAN_Cockpit_4: start 48, 8 bit, little-endian, system signal SignalVoid_HWP_01_4, data-type-policy=OVERRIDE, i-signal-type=PRIMITIVE, base-type=BT_SignalVoid
    signal ISignalVoid_HWP_01_XIX_VLAN_Cockpit_5: start 56, 8 bit, little-endian, system signal SignalVoid_HWP_01_5, data-type-policy=OVERRIDE, i-signal-type=PRIMITIVE, base-type=BT_SignalVoid
    mapping SG_HWP_01_XIX_VLAN_Cockpit: i-signal-group=SG_HWP_01_XIX_VLAN_Cockpit, transfer-property=TRIGGERED-WITHOUT-REPETITION
  pdu HWP_02_XIX_VLAN_Cockpit: length=8, transmission-mode-true-timing=cyclic-timing={time-offset=0.0, time-period=0.04}, unused-bit-pattern=0
    signal HWP_HMI_State_XIX_HWP_02_XIX_VLAN_Cockpit: start 12, 5 bit, little-endian, data-type-policy=OVERRIDE, i-signal-type=PRIMITIVE, init-value=0, base-type=BT_HWP_HMI_State, invalid-value=Invalid_HWP_HMI_State_XIX_HWP_02_XIX_VLAN_Cockpit:31, compu {31=Cx1f_Fehler (CM_HWP_HMI_State_Cx1f_Fehler), 3=Cx3_Passive (CM_HWP_HMI_State_Cx3_Passive), 14=Cxe_Error_Irreversible (CM_HWP_HMI_State_Cxe_Error_Irreversible), 4=Cx4_SwitchedOff (CM_HWP_HMI_State_Cx4_SwitchedOff), 8=Cx8_ActiveWithDegradation (CM_HWP_HMI_State_Cx8_ActiveWithDegradation), 16=Cx10_RiskMinimal (CM_HWP_HMI_State_Cx10_RiskMinimal), 10=Cxa_Esk_Lvl_1 (CM_HWP_HMI_State_Cxa_Esk_Lvl_1), 2=Cx2_Uncoded (CM_HWP_HMI_State_Cx2_Uncoded), 12=Cxc_Esk_Lvl_3 (CM_HWP_HMI_State_Cxc_Esk_Lvl_3), 6=Cx6_ActivationProcess (CM_HWP_HMI_State_Cx6_ActivationProcess), 11=Cxb_Esk_Lvl_2 (CM_HWP_HMI_State_Cxb_Esk_Lvl_2), 0=Cx0_Init (CM_HWP_HMI_State_Cx0_Init), 7=Cx7_Active (CM_HWP_HMI_State_Cx7_Active), 9=Cx9_Esk_Lvl_0 (CM_HWP_HMI_State_Cx9_Esk_Lvl_0), 18=Cx12_ReversibleDeactivation (CM_HWP_HMI_State_Cx12_ReversibleDeactivation), 15=Cxf_RiskMinimizing (CM_HWP_HMI_State_Cxf_RiskMinimizing), 5=Cx5_Ready (CM_HWP_HMI_State_Cx5_Ready), 1=Cx1_Kl15_Off (CM_HWP_HMI_State_Cx1_Kl15_Off), 13=Cxd_Error_Reversible (CM_HWP_HMI_State_Cxd_Error_Reversible), 17=Cx11_SafeDeactivation (CM_HWP_HMI_State_Cx11_SafeDeactivation)}, range raw 0..31, transfer-property=PENDING, to HCP3_IONode(timeout 0.5 s)  # State of Highway Pilot provided by HMI HWP control function block
  pdu IdsCanSensor_Events_canSensorFeaturesElement0: length=65962, transmission-mode-true-timing=event-controlled-timing={number-of-repetitions=0, repetition-period=0.0}, unused-bit-pattern=0
    signal IdsCanSensor_Events_canSensorFeaturesElement0: start 0, 527696 bit, opaque, data-transformations=SOMEIPOnlyTransformerChain, data-type-policy=TRANSFORMING-I-SIGNAL, i-signal-type=ARRAY, someip-transformation-i-signal-props{transformer=TransformationTechnologySOMEIP, interface-version=3, message-type=NOTIFICATION, size-of-array-length-fields=2, size-of-struct-length-fields=2, size-of-union-length-fields=2}, dynamic-length=true, transfer-property=TRIGGERED  # IDS CAN sensor data (anomalies, configuration settings, control instructions etc.)
  pdu IdsCanSensor_Events_periodicSignalElement0: length=27, transmission-mode-true-timing=event-controlled-timing={number-of-repetitions=0, repetition-period=0.0}, unused-bit-pattern=0
    signal IdsCanSensor_Events_periodicSignalElement0: start 0, 216 bit, opaque, data-transformations=SOMEIPOnlyTransformerChain, data-type-policy=TRANSFORMING-I-SIGNAL, i-signal-type=ARRAY, someip-transformation-i-signal-props{transformer=TransformationTechnologySOMEIP, interface-version=3, message-type=NOTIFICATION, size-of-array-length-fields=2, size-of-struct-length-fields=2, size-of-union-length-fields=2}, dynamic-length=true, transfer-property=TRIGGERED  # IDS CAN sensor data (anomalies, configuration settings, control instructions etc.)
  pdu IdsCanSensor_Methods_setCanSensorFeaturesElement0_Request_XIX_TCPServer_SomeIP_01_Info_El_SGW03_XIX_VLAN_Cockpit: length=65576, transmission-mode-true-timing=event-controlled-timing={number-of-repetitions=0, repetition-period=0.0}, unused-bit-pattern=0
    signal IdsCanSensor_Methods_setCanSensorFeaturesElement0_Request_XIX_TCPServer_SomeIP_01_Info_El_SGW03_XIX_VLAN_Cockpit: start 0, 524608 bit, opaque, data-transformations=SOMEIPOnlyTransformerChain, data-type-policy=TRANSFORMING-I-SIGNAL, i-signal-type=ARRAY, someip-transformation-i-signal-props{cs-error-reaction=AUTONOMOUS, transformer=TransformationTechnologySOMEIP, interface-version=3, message-type=REQUEST, size-of-array-length-fields=2, size-of-struct-length-fields=2, size-of-union-length-fields=2}, dynamic-length=true, transfer-property=TRIGGERED, to HCP3_IONode  # IDS CAN sensor data (anomalies, configuration settings, control instructions etc.)
  pdu IdsCanSensor_Methods_setCanSensorFeaturesElement0_Response_XIX_TCPServer_SomeIP_01_Info_El_SGW03_XIX_VLAN_Cockpit: length=12, transmission-mode-true-timing=event-controlled-timing={number-of-repetitions=0, repetition-period=0.0}, unused-bit-pattern=0
    signal IdsCanSensor_Methods_setCanSensorFeaturesElement0_Response_XIX_TCPServer_SomeIP_01_Info_El_SGW03_XIX_VLAN_Cockpit: start 0, 96 bit, opaque, data-transformations=SOMEIPOnlyTransformerChain, data-type-policy=TRANSFORMING-I-SIGNAL, i-signal-type=ARRAY, someip-transformation-i-signal-props{cs-error-reaction=AUTONOMOUS, transformer=TransformationTechnologySOMEIP, interface-version=3, message-type=RESPONSE, size-of-array-length-fields=2, size-of-struct-length-fields=2, size-of-union-length-fields=2}, dynamic-length=true, transfer-property=TRIGGERED  # IDS CAN sensor data (anomalies, configuration settings, control instructions etc.)
  pdu IdsCanSensor_Methods_undefineCanSensorFeaturesElement0_Request_XIX_TCPServer_SomeIP_01_Info_El_SGW03_XIX_VLAN_Cockpit: length=15, transmission-mode-true-timing=event-controlled-timing={number-of-repetitions=0, repetition-period=0.0}, unused-bit-pattern=0
    signal IdsCanSensor_Methods_undefineCanSensorFeaturesElement0_Request_XIX_TCPServer_SomeIP_01_Info_El_SGW03_XIX_VLAN_Cockpit: start 0, 120 bit, opaque, data-transformations=SOMEIPOnlyTransformerChain, data-type-policy=TRANSFORMING-I-SIGNAL, i-signal-type=ARRAY, someip-transformation-i-signal-props{cs-error-reaction=AUTONOMOUS, transformer=TransformationTechnologySOMEIP, interface-version=3, message-type=REQUEST, size-of-array-length-fields=2, size-of-struct-length-fields=2, size-of-union-length-fields=2}, dynamic-length=true, transfer-property=TRIGGERED, to HCP3_IONode  # IDS CAN sensor data (anomalies, configuration settings, control instructions etc.)
  pdu IdsCanSensor_Methods_undefineCanSensorFeaturesElement0_Response_XIX_TCPServer_SomeIP_01_Info_El_SGW03_XIX_VLAN_Cockpit: length=12, transmission-mode-true-timing=event-controlled-timing={number-of-repetitions=0, repetition-period=0.0}, unused-bit-pattern=0
    signal IdsCanSensor_Methods_undefineCanSensorFeaturesElement0_Response_XIX_TCPServer_SomeIP_01_Info_El_SGW03_XIX_VLAN_Cockpit: start 0, 96 bit, opaque, data-transformations=SOMEIPOnlyTransformerChain, data-type-policy=TRANSFORMING-I-SIGNAL, i-signal-type=ARRAY, someip-transformation-i-signal-props{cs-error-reaction=AUTONOMOUS, transformer=TransformationTechnologySOMEIP, interface-version=3, message-type=RESPONSE, size-of-array-length-fields=2, size-of-struct-length-fields=2, size-of-union-length-fields=2}, dynamic-length=true, transfer-property=TRIGGERED  # IDS CAN sensor data (anomalies, configuration settings, control instructions etc.)
  pdu IdsCanSensor_MethodsGet_canSensorFeaturesElement0_Request_XIX_TCPServer_SomeIP_01_Info_El_SGW03_XIX_VLAN_Cockpit: length=8, transmission-mode-true-timing=event-controlled-timing={number-of-repetitions=0, repetition-period=0.0}, unused-bit-pattern=0
    signal IdsCanSensor_MethodsGet_canSensorFeaturesElement0_Request_XIX_TCPServer_SomeIP_01_Info_El_SGW03_XIX_VLAN_Cockpit: start 0, 64 bit, opaque, data-transformations=SOMEIPOnlyTransformerChain, data-type-policy=TRANSFORMING-I-SIGNAL, i-signal-type=ARRAY, someip-transformation-i-signal-props{cs-error-reaction=AUTONOMOUS, transformer=TransformationTechnologySOMEIP, interface-version=3, message-type=REQUEST, size-of-array-length-fields=2, size-of-struct-length-fields=2, size-of-union-length-fields=2}, dynamic-length=true, transfer-property=TRIGGERED, to HCP3_IONode  # IDS CAN sensor data (anomalies, configuration settings, control instructions etc.)
  pdu IdsCanSensor_MethodsGet_canSensorFeaturesElement0_Response_XIX_TCPServer_SomeIP_01_Info_El_SGW03_XIX_VLAN_Cockpit: length=65962, transmission-mode-true-timing=event-controlled-timing={number-of-repetitions=0, repetition-period=0.0}, unused-bit-pattern=0
    signal IdsCanSensor_MethodsGet_canSensorFeaturesElement0_Response_XIX_TCPServer_SomeIP_01_Info_El_SGW03_XIX_VLAN_Cockpit: start 0, 527696 bit, opaque, data-transformations=SOMEIPOnlyTransformerChain, data-type-policy=TRANSFORMING-I-SIGNAL, i-signal-type=ARRAY, someip-transformation-i-signal-props{cs-error-reaction=AUTONOMOUS, transformer=TransformationTechnologySOMEIP, interface-version=3, message-type=RESPONSE, size-of-array-length-fields=2, size-of-struct-length-fields=2, size-of-union-length-fields=2}, dynamic-length=true, transfer-property=TRIGGERED  # IDS CAN sensor data (anomalies, configuration settings, control instructions etc.)
  pdu IdsCanSensor_MethodsGet_periodicSignalElement0_Request_XIX_TCPServer_SomeIP_01_Info_El_SGW03_XIX_VLAN_Cockpit: length=8, transmission-mode-true-timing=event-controlled-timing={number-of-repetitions=0, repetition-period=0.0}, unused-bit-pattern=0
    signal IdsCanSensor_MethodsGet_periodicSignalElement0_Request_XIX_TCPServer_SomeIP_01_Info_El_SGW03_XIX_VLAN_Cockpit: start 0, 64 bit, opaque, data-transformations=SOMEIPOnlyTransformerChain, data-type-policy=TRANSFORMING-I-SIGNAL, i-signal-type=ARRAY, someip-transformation-i-signal-props{cs-error-reaction=AUTONOMOUS, transformer=TransformationTechnologySOMEIP, interface-version=3, message-type=REQUEST, size-of-array-length-fields=2, size-of-struct-length-fields=2, size-of-union-length-fields=2}, dynamic-length=true, transfer-property=TRIGGERED, to HCP3_IONode  # IDS CAN sensor data (anomalies, configuration settings, control instructions etc.)
  pdu IdsCanSensor_MethodsGet_periodicSignalElement0_Response_XIX_TCPServer_SomeIP_01_Info_El_SGW03_XIX_VLAN_Cockpit: length=27, transmission-mode-true-timing=event-controlled-timing={number-of-repetitions=0, repetition-period=0.0}, unused-bit-pattern=0
    signal IdsCanSensor_MethodsGet_periodicSignalElement0_Response_XIX_TCPServer_SomeIP_01_Info_El_SGW03_XIX_VLAN_Cockpit: start 0, 216 bit, opaque, data-transformations=SOMEIPOnlyTransformerChain, data-type-policy=TRANSFORMING-I-SIGNAL, i-signal-type=ARRAY, someip-transformation-i-signal-props{cs-error-reaction=AUTONOMOUS, transformer=TransformationTechnologySOMEIP, interface-version=3, message-type=RESPONSE, size-of-array-length-fields=2, size-of-struct-length-fields=2, size-of-union-length-fields=2}, dynamic-length=true, transfer-property=TRIGGERED  # IDS CAN sensor data (anomalies, configuration settings, control instructions etc.)
  pdu IDSSecurityEventSmall_Events_securityEvent: length=1064, transmission-mode-true-timing=event-controlled-timing={number-of-repetitions=0, repetition-period=0.0}, unused-bit-pattern=0
    signal IDSSecurityEventSmall_Events_securityEvent: start 0, 8512 bit, opaque, data-transformations=SOMEIPOnlyTransformerChain, data-type-policy=TRANSFORMING-I-SIGNAL, i-signal-type=ARRAY, someip-transformation-i-signal-props{transformer=TransformationTechnologySOMEIP, interface-version=1, message-type=NOTIFICATION, size-of-array-length-fields=2, size-of-struct-length-fields=2, size-of-union-length-fields=2}, dynamic-length=true, transfer-property=TRIGGERED  # IDS Security Event sensor data (small flavor / class 1 service)
  pdu Info_FID_01_XIX_VLAN_Cockpit: length=12, minimum-delay=0.04, transmission-mode-true-timing={cyclic-timing={time-offset=0.0, time-period=1.0}, event-controlled-timing={number-of-repetitions=0, repetition-period=0.0}}, unused-bit-pattern=0
    signal ZR_State_FID_XIX_Info_FID_01_XIX_VLAN_Cockpit: start 12, 3 bit, little-endian, data-type-policy=OVERRIDE, i-signal-type=PRIMITIVE, init-value=0, base-type=BT_ZR_State_FID, compu {0=Cx0_Disp_Off (CM_ZR_State_FID_Cx0_Disp_Off), 2=Cx2_LowPow (CM_ZR_State_FID_Cx2_LowPow), 1=Cx1_Disp_On (CM_ZR_State_FID_Cx1_Disp_On)}, range raw 0..2, transfer-property=TRIGGERED-ON-CHANGE-WITHOUT-REPETITION  # This signal contains MMI State for FID.
  pdu IP_TS_Info_El_CTO_01_XIX_VLAN_Cockpit: length=1452, unused-bit-pattern=0
    signal IP_TS_CTO_01_Data_XIX_IP_TS_Info_El_CTO_01_XIX_VLAN_Cockpit: start 0, 11616 bit, opaque, data-type-policy=OVERRIDE, i-signal-type=ARRAY, base-type=BT_IP_TS_CTO_01_Data, implementation-data-type=IP_TS_CTO_01_Data, transfer-property=TRIGGERED, to HCP3_IONode
  pdu IP_TS_Info_El_DTO_01_XIX_VLAN_Cockpit: length=1452, unused-bit-pattern=0
    signal IP_TS_DTO_01_Data_XIX_IP_TS_Info_El_DTO_01_XIX_VLAN_Cockpit: start 0, 11616 bit, opaque, data-type-policy=OVERRIDE, i-signal-type=ARRAY, base-type=BT_IP_TS_DTO_01_Data, implementation-data-type=IP_TS_DTO_01_Data, transfer-property=TRIGGERED, to HCP3_IONode
  pdu IP_TS_Info_El_DTO_02_XIX_VLAN_Cockpit: length=1452, unused-bit-pattern=0
    signal IP_TS_DTO_02_Data_XIX_IP_TS_Info_El_DTO_02_XIX_VLAN_Cockpit: start 0, 11616 bit, opaque, data-type-policy=OVERRIDE, i-signal-type=ARRAY, base-type=BT_IP_TS_DTO_02_Data, implementation-data-type=IP_TS_DTO_02_Data, transfer-property=TRIGGERED, to HCP3_IONode
  pdu IP_TS_Info_El_DTO_03_XIX_VLAN_Cockpit: length=1452, unused-bit-pattern=0
    signal IP_TS_DTO_03_Data_XIX_IP_TS_Info_El_DTO_03_XIX_VLAN_Cockpit: start 0, 11616 bit, opaque, data-type-policy=OVERRIDE, i-signal-type=ARRAY, base-type=BT_IP_TS_DTO_03_Data, implementation-data-type=IP_TS_DTO_03_Data, transfer-property=TRIGGERED, to HCP3_IONode
  pdu IP_TS_Info_El_DTO_04_XIX_VLAN_Cockpit: length=1452, unused-bit-pattern=0
    signal IP_TS_DTO_04_Data_XIX_IP_TS_Info_El_DTO_04_XIX_VLAN_Cockpit: start 0, 11616 bit, opaque, data-type-policy=OVERRIDE, i-signal-type=ARRAY, base-type=BT_IP_TS_DTO_04_Data, implementation-data-type=IP_TS_DTO_04_Data, transfer-property=TRIGGERED, to HCP3_IONode
