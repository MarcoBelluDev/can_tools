[part 10 of 15: package /PDU]
AUTOSAR XML (schema 4-3-0)
package /PDU  (continued)
  pdu KeylessAccess_01_XIX_VLAN_Cockpit:
    length=32
    minimum-delay=0.02
    transmission-mode-condition{data-filter={data-filter-type=MASKED-NEW-DIFFERS-X, mask=1, x=0}, i-signal-in-i-pdu=KeylessAccess_01_XIX_VLAN_Cockpit/VIP_Sensor_betaetigt}
    transmission-mode-false-timing={cyclic-timing={time-offset=0.0, time-period=0.2}, event-controlled-timing={number-of-repetitions=7, repetition-period=0.04}}
    transmission-mode-true-timing={cyclic-timing={time-offset=0.0, time-period=0.04}, event-controlled-timing={number-of-repetitions=7, repetition-period=0.04}}
    unused-bit-pattern=0
    signal Kessy_KeylessAccess_01_CRC_XIX_KeylessAccess_01_XIX_VLAN_Cockpit: start 0, 8 bit, little-endian, data-type-policy=OVERRIDE, i-signal-type=PRIMITIVE, init-value=0, base-type=BT_Kessy_KeylessAccess_01_CRC, compu {phys=raw for raw 0..255}, range phys 0..255, raw 0..255, transfer-property=TRIGGERED-WITHOUT-REPETITION  # Für MLB: Berechnung siehe Lastenheft "Kommunikationsabsicherung für FlexRay und CAN" Ab MQB und MLBevo: Berechnung siehe Lastenheft "End-to-End Kommunikationsabsicherung" Endwerte siehe Begleitdokument "S-PDU Kennungsfolgen"
    signal Kessy_KeylessAccess_01_BZ_XIX_KeylessAccess_01_XIX_VLAN_Cockpit: start 8, 4 bit, little-endian, data-type-policy=OVERRIDE, i-signal-type=PRIMITIVE, init-value=0, base-type=BT_Kessy_KeylessAccess_01_BZ, compu {phys=raw for raw 0..15}, range phys 0..15, raw 0..15, transfer-property=TRIGGERED-WITHOUT-REPETITION  # 4bit Botschaftszähler, wird mit jeder Sendebotschaft inkrementiert
    signal KY_Fzg_Verlassen_erkannt_XIX_KeylessAccess_01_XIX_VLAN_Cockpit: start 19, 1 bit, little-endian, data-type-policy=OVERRIDE, i-signal-type=PRIMITIVE, init-value=0, base-type=BT_KY_Fzg_Verlassen_erkannt, compu {1=Cx1_erkannt (CM_KY_Fzg_Verlassen_erkannt_Cx1_erkannt), 0=Cx0_nicht_erkannt (CM_KY_Fzg_Verlassen_erkannt_Cx0_nicht_erkannt)}, range raw 0..1, transfer-property=TRIGGERED-WITHOUT-REPETITION  # Fahrer/Schlüssel hat das Fahrzeug verlassen und FT wurde geschlossen
    signal KY_Front_Entr_Autorisiert_02_XIX_KeylessAccess_01_XIX_VLAN_Cockpit: start 20, 2 bit, little-endian, data-type-policy=OVERRIDE, i-signal-type=PRIMITIVE, init-value=0, base-type=BT_KY_Front_Entr_Autorisiert_02, invalid-value=Invalid_KY_Front_Entr_Autorisiert_02_XIX_KeylessAccess_01_XIX_VLAN_Cockpit:3, compu {3=Cx3_Fehler (CM_KY_Front_Entr_Autorisiert_02_Cx3_Fehler), 1=Cx1_kein_Keylessschluessel_erkannt (CM_KY_Front_Entr_Autorisiert_02_Cx1_kein_Keylessschluessel_erkannt), 2=Cx2_Keyless_Schluessel_erkannt_und_authorisiert (CM_KY_Front_Entr_Autorisiert_02_Cx2_Keyless_Schluessel_erkannt_und_authorisiert), 0=Cx0_Init_oder_nicht_verbaut (CM_KY_Front_Entr_Autorisiert_02_Cx0_Init_oder_nicht_verbaut)}, range raw 0..3, transfer-property=TRIGGERED-WITHOUT-REPETITION  # Erkennung / Authorisierung Keyless Front
    signal KY_Front_Verr_Autorisiert_02_XIX_KeylessAccess_01_XIX_VLAN_Cockpit: start 22, 2 bit, little-endian, data-type-policy=OVERRIDE, i-signal-type=PRIMITIVE, init-value=0, base-type=BT_KY_Front_Verr_Autorisiert_02, invalid-value=Invalid_KY_Front_Verr_Autorisiert_02_XIX_KeylessAccess_01_XIX_VLAN_Cockpit:3, compu {3=Cx3_Fehler (CM_KY_Front_Verr_Autorisiert_02_Cx3_Fehler), 1=Cx1_Verriegelungssensor_erkannt (CM_KY_Front_Verr_Autorisiert_02_Cx1_Verriegelungssensor_erkannt), 0=Cx0_Init_oder_nicht_verbaut (CM_KY_Front_Verr_Autorisiert_02_Cx0_Init_oder_nicht_verbaut), 2=Cx2_Verriegelungssensor_erkannt_und_authorisiert (CM_KY_Front_Verr_Autorisiert_02_Cx2_Verriegelungssensor_erkannt_und_authorisiert)}, range raw 0..3, transfer-property=TRIGGERED-WITHOUT-REPETITION  # Authorisierung Verriegelungssensor Keyless Front
    signal KY_HD_Entr_Autorisiert_02_XIX_KeylessAccess_01_XIX_VLAN_Cockpit: start 32, 2 bit, little-endian, data-type-policy=OVERRIDE, i-signal-type=PRIMITIVE, init-value=0, base-type=BT_KY_HD_Entr_Autorisiert_02, invalid-value=Invalid_KY_HD_Entr_Autorisiert_02_XIX_KeylessAccess_01_XIX_VLAN_Cockpit:3, compu {3=Cx3_Fehler (CM_KY_HD_Entr_Autorisiert_02_Cx3_Fehler), 0=Cx0_Init_oder_nicht_verbaut (CM_KY_HD_Entr_Autorisiert_02_Cx0_Init_oder_nicht_verbaut), 1=Cx1_kein_Keylessschluessel_erkannt (CM_KY_HD_Entr_Autorisiert_02_Cx1_kein_Keylessschluessel_erkannt), 2=Cx2_Keyless_Schluessel_erkannt_und_authorisiert (CM_KY_HD_Entr_Autorisiert_02_Cx2_Keyless_Schluessel_erkannt_und_authorisiert)}, range raw 0..3, transfer-property=TRIGGERED-WITHOUT-REPETITION  # Erkennung / Authorisierung Keyless Heck
    signal KY_HD_Verr_Autorisiert_02_XIX_KeylessAccess_01_XIX_VLAN_Cockpit: start 34, 2 bit, little-endian, data-type-policy=OVERRIDE, i-signal-type=PRIMITIVE, init-value=0, base-type=BT_KY_HD_Verr_Autorisiert_02, invalid-value=Invalid_KY_HD_Verr_Autorisiert_02_XIX_KeylessAccess_01_XIX_VLAN_Cockpit:3, compu {3=Cx3_Fehler (CM_KY_HD_Verr_Autorisiert_02_Cx3_Fehler), 1=Cx1_Verriegelungssensor_erkannt (CM_KY_HD_Verr_Autorisiert_02_Cx1_Verriegelungssensor_erkannt), 0=Cx0_Init_oder_nicht_verbaut (CM_KY_HD_Verr_Autorisiert_02_Cx0_Init_oder_nicht_verbaut), 2=Cx2_Verriegelungssensor_erkannt_und_authorisiert (CM_KY_HD_Verr_Autorisiert_02_Cx2_Verriegelungssensor_erkannt_und_authorisiert)}, range raw 0..3, transfer-property=TRIGGERED-WITHOUT-REPETITION  # Autorisierung der Schließanforderung über Verriegelungsinnentaster
    signal FBS_Anf_Access_Auth_XIX_KeylessAccess_01_XIX_VLAN_Cockpit: start 36, 1 bit, little-endian, data-type-policy=OVERRIDE, i-signal-type=PRIMITIVE, init-value=0, base-type=BT_FBS_Anf_Access_Auth, compu {0=Cx0_Init_kein_Auth_Request (CM_FBS_Anf_Access_Auth_Cx0_Init_kein_Auth_Request), 1=Cx1_Auth_Request (CM_FBS_Anf_Access_Auth_Cx1_Auth_Request)}, range raw 0..1, transfer-property=TRIGGERED-WITHOUT-REPETITION  # Trigger um Authentifikation für Zugang zu starten
    signal KY_FDF_Taste_XIX_KeylessAccess_01_XIX_VLAN_Cockpit: start 37, 1 bit, little-endian, data-type-policy=OVERRIDE, i-signal-type=PRIMITIVE, init-value=0, base-type=BT_KY_FDF_Taste, compu {0=Cx0_Taste_nicht_betaetigt (CM_KY_FDF_Taste_Cx0_Taste_nicht_betaetigt), 1=Cx1_FDF_Taste_am_Funkschluessel_betaetigt (CM_KY_FDF_Taste_Cx1_FDF_Taste_am_Funkschluessel_betaetigt)}, range raw 0..1, transfer-property=TRIGGERED-WITHOUT-REPETITION  # Front Deckel Fernentriegelung Taste am Funkschluessel
    signal KY_Mehrere_Schluessel_aussen_XIX_KeylessAccess_01_XIX_VLAN_Cockpit: start 38, 1 bit, little-endian, data-type-policy=OVERRIDE, i-signal-type=PRIMITIVE, init-value=0, base-type=BT_KY_Mehrere_Schluessel_aussen, compu {0=Cx0_keine_Indikation (CM_KY_Mehrere_Schluessel_aussen_Cx0_keine_Indikation), 1=Cx1_Mehrere_Schluessel_aussen_gefunden (CM_KY_Mehrere_Schluessel_aussen_Cx1_Mehrere_Schluessel_aussen_gefunden)}, range raw 0..1, transfer-property=TRIGGERED-WITHOUT-REPETITION  # Indikator, dass sich mehr als ein Schlüssel im Aussenbereich befindet
    signal FBS_MDK_in_Reichweite_XIX_KeylessAccess_01_XIX_VLAN_Cockpit: start 39, 1 bit, little-endian, data-type-policy=OVERRIDE, i-signal-type=PRIMITIVE, init-value=0, base-type=BT_FBS_MDK_in_Reichweite, compu {0=Cx0_ausser_Reichweite (CM_FBS_MDK_in_Reichweite_Cx0_ausser_Reichweite), 1=Cx1_innerhalb_Reichweite (CM_FBS_MDK_in_Reichweite_Cx1_innerhalb_Reichweite)}, range raw 0..1, transfer-property=TRIGGERED-WITHOUT-REPETITION  # Für elektrisch betätigte Türen und Klappen muss für eine Remote-Betätigung mittels MobileDeviceKey eine Reichweitenbegrenzung eingeführt werden. Dieses Bit zeigt an, dass sich der MobileDeviceKey innerhalb der geforderten Reichweite befindet
    signal KY_Fzg_Zugang_erkannt_XIX_KeylessAccess_01_XIX_VLAN_Cockpit: start 41, 1 bit, little-endian, data-type-policy=OVERRIDE, i-signal-type=PRIMITIVE, init-value=0, base-type=BT_KY_Fzg_Zugang_erkannt, compu {1=Cx1_erkannt (CM_KY_Fzg_Zugang_erkannt_Cx1_erkannt), 0=Cx0_nicht_erkannt (CM_KY_Fzg_Zugang_erkannt_Cx0_nicht_erkannt)}, range raw 0..1, transfer-property=TRIGGERED-WITHOUT-REPETITION  # Fahrer/Schlüssel hat Fahrzeug betreten und die FT geschlossen
    signal KY_HD_Auffahrt_XIX_KeylessAccess_01_XIX_VLAN_Cockpit: start 42, 1 bit, little-endian, data-type-policy=OVERRIDE, i-signal-type=PRIMITIVE, base-type=BT_KY_HD_Auffahrt, compu {0=Cx0_keine_Anforderung (CM_KY_HD_Auffahrt_Cx0_keine_Anforderung), 1=Cx1_HD_Auffahrt_angefordert (CM_KY_HD_Auffahrt_Cx1_HD_Auffahrt_angefordert)}, range raw 0..1, transfer-property=TRIGGERED-WITHOUT-REPETITION  # Auffahrt HD nach Wiedereintritt ID-Geber in EasyClose Nahbereich
    signal KY_HD_Zufahrt_XIX_KeylessAccess_01_XIX_VLAN_Cockpit: start 43, 1 bit, little-endian, data-type-policy=OVERRIDE, i-signal-type=PRIMITIVE, base-type=BT_KY_HD_Zufahrt, compu {1=Cx1_HD_Zufahrt_angefordert (CM_KY_HD_Zufahrt_Cx1_HD_Zufahrt_angefordert), 0=Cx0_keine_Anforderung (CM_KY_HD_Zufahrt_Cx0_keine_Anforderung)}, range raw 0..1, transfer-property=TRIGGERED-WITHOUT-REPETITION  # Zufahrt HD nach erfolgreicher Funktion EasyClose
    signal KY_EasyClose_Abbruch_XIX_KeylessAccess_01_XIX_VLAN_Cockpit: start 48, 1 bit, little-endian, data-type-policy=OVERRIDE, i-signal-type=PRIMITIVE, init-value=0, base-type=BT_KY_EasyClose_Abbruch, compu {1=Cx1_EasyClose_Abbruch (CM_KY_EasyClose_Abbruch_Cx1_EasyClose_Abbruch), 0=Cx0_EasyClose_kein_Abbruch (CM_KY_EasyClose_Abbruch_Cx0_EasyClose_kein_Abbruch)}, range raw 0..1, transfer-property=TRIGGERED-WITHOUT-REPETITION  # ID-Geber während HD-Zufahrt im Nahbereich EasyClose erkannt
    signal KY_EasyClose_Status_XIX_KeylessAccess_01_XIX_VLAN_Cockpit: start 49, 3 bit, little-endian, data-type-policy=OVERRIDE, i-signal-type=PRIMITIVE, init-value=0, base-type=BT_KY_EasyClose_Status, compu {2=Cx2_Lampe_NORMAL (CM_KY_EasyClose_Status_Cx2_Lampe_NORMAL), 1=Cx1_Lampe_EIN (CM_KY_EasyClose_Status_Cx1_Lampe_EIN), 4=Cx4_Akustik_Verweigerung (CM_KY_EasyClose_Status_Cx4_Akustik_Verweigerung), 0=Cx0_Lampe_AUS (CM_KY_EasyClose_Status_Cx0_Lampe_AUS), 3=Cx3_Lampe_HEKTIK (CM_KY_EasyClose_Status_Cx3_Lampe_HEKTIK)}, range raw 0..4, transfer-property=TRIGGERED-WITHOUT-REPETITION  # Signal zur LED Ansteuerung im HD-Verriegelungstaster für die Funktion EasyClose.
    signal KY_IDG_in_Reichweite_XIX_KeylessAccess_01_XIX_VLAN_Cockpit: start 54, 1 bit, little-endian, data-type-policy=OVERRIDE, i-signal-type=PRIMITIVE, init-value=0, base-type=BT_KY_IDG_in_Reichweite, compu {1=Cx1_innerhalb_Reichweite (CM_KY_IDG_in_Reichweite_Cx1_innerhalb_Reichweite), 0=Cx0_ausser_Reichweite_bzw_nicht_ermittelbar (CM_KY_IDG_in_Reichweite_Cx0_ausser_Reichweite_bzw_nicht_ermittelbar)}, range raw 0..1, transfer-property=TRIGGERED-WITHOUT-REPETITION  # Für elektrisch betätigte Türen und Klappen muss für eine Betätigung über Funk eine Reichweitenbegrenzung eingeführt werden. Diese Bit zeigt an, dass sich der Funkschlüssel innerhalb der geforderten Reichweite befindet
    signal KY_Indikator_Mehrere_Schluessel_XIX_KeylessAccess_01_XIX_VLAN_Cockpit: start 55, 1 bit, little-endian, data-type-policy=OVERRIDE, i-signal-type=PRIMITIVE, init-value=0, base-type=BT_KY_Indikator_Mehrere_Schluessel, compu {0=Cx0_Init (CM_KY_Indikator_Mehrere_Schluessel_Cx0_Init), 1=Cx1_Mehrere_Schluessel_im_Fahrzeug_gefunden (CM_KY_Indikator_Mehrere_Schluessel_Cx1_Mehrere_Schluessel_im_Fahrzeug_gefunden)}, range raw 0..1, transfer-property=TRIGGERED-WITHOUT-REPETITION  # Indikator für u.a. Sitzmemory, dass sich mehr als ein Schlüssel im Fahrzeug befinden.
    signal KY_ZV_Signatur_XIX_KeylessAccess_01_XIX_VLAN_Cockpit: start 56, 11 bit, little-endian, data-type-policy=OVERRIDE, i-signal-type=PRIMITIVE, init-value=0, base-type=BT_KY_ZV_Signatur, compu {phys=raw for raw 0..2047; unit Unit_None}, range phys 0..2047 Unit_None, raw 0..2047, unit=Unit_None, transfer-property=TRIGGERED-WITHOUT-REPETITION  # Signatur der ZV
    signal KY_Schluessel_im_Fzg_XIX_KeylessAccess_01_XIX_VLAN_Cockpit: start 67, 1 bit, little-endian, data-type-policy=OVERRIDE, i-signal-type=PRIMITIVE, base-type=BT_KY_Schluessel_im_Fzg, compu {0=Cx0_Schluessel_nicht_im_Fahrzeug (CM_KY_Schluessel_im_Fzg_Cx0_Schluessel_nicht_im_Fahrzeug), 1=Cx1_Schluessel_im_Fahrzeug (CM_KY_Schluessel_im_Fzg_Cx1_Schluessel_im_Fahrzeug)}, range raw 0..1, transfer-property=TRIGGERED-WITHOUT-REPETITION  # Zeigt einen erkannten Schlüssel im Fzg an.
    signal FBS_KSY_VIP_XIX_KeylessAccess_01_XIX_VLAN_Cockpit: start 75, 3 bit, little-endian, data-type-policy=OVERRIDE, i-signal-type=PRIMITIVE, init-value=0, base-type=BT_FBS_KSY_VIP, compu {6=Cx6_reserved (CM_FBS_KSY_VIP_Cx6_reserved), 0=Cx0_init (CM_FBS_KSY_VIP_Cx0_init), 2=Cx2_approach_valid (CM_FBS_KSY_VIP_Cx2_approach_valid), 4=Cx4_reserved (CM_FBS_KSY_VIP_Cx4_reserved), 5=Cx5_reserved (CM_FBS_KSY_VIP_Cx5_reserved), 7=Cx7_failure (CM_FBS_KSY_VIP_Cx7_failure), 1=Cx1_detection_valid (CM_FBS_KSY_VIP_Cx1_detection_valid), 3=Cx3_reserved (CM_FBS_KSY_VIP_Cx3_reserved)}, range raw 0..7, transfer-property=TRIGGERED-WITHOUT-REPETITION  # virtual pedal signalling
    signal FBS_KSY_easy_close2_XIX_KeylessAccess_01_XIX_VLAN_Cockpit: start 78, 2 bit, little-endian, data-type-policy=OVERRIDE, i-signal-type=PRIMITIVE, init-value=0, base-type=BT_FBS_KSY_easy_close2, compu {1=Cx1_tailgate_active_opening (CM_FBS_KSY_easy_close2_Cx1_tailgate_active_opening), 0=Cx0_init (CM_FBS_KSY_easy_close2_Cx0_init), 3=Cx3_reserved (CM_FBS_KSY_easy_close2_Cx3_reserved), 2=Cx2_tailgate_active_closing (CM_FBS_KSY_easy_close2_Cx2_tailgate_active_closing)}, range raw 0..3, transfer-property=TRIGGERED-WITHOUT-REPETITION  # HD_Zufahrt HD_Auffahrt
    signal FBS_KSY_adv_position_XIX_KeylessAccess_01_XIX_VLAN_Cockpit: start 86, 3 bit, little-endian, data-type-policy=OVERRIDE, i-signal-type=PRIMITIVE, init-value=0, base-type=BT_FBS_KSY_adv_position, compu {4=Cx4_position_3 (CM_FBS_KSY_adv_position_Cx4_position_3), 6=Cx6_reserved (CM_FBS_KSY_adv_position_Cx6_reserved), 5=Cx5_position_4 (CM_FBS_KSY_adv_position_Cx5_position_4), 3=Cx3_position_2 (CM_FBS_KSY_adv_position_Cx3_position_2), 2=Cx2_position_1 (CM_FBS_KSY_adv_position_Cx2_position_1), 7=Cx7_no_ID_found (CM_FBS_KSY_adv_position_Cx7_no_ID_found), 1=Cx1_position_0 (CM_FBS_KSY_adv_position_Cx1_position_0), 0=Cx0_Init (CM_FBS_KSY_adv_position_Cx0_Init)}, range raw 0..7, transfer-property=TRIGGERED-WITHOUT-REPETITION  # KY_Position
    signal FBS_KSY_adv_zone_XIX_KeylessAccess_01_XIX_VLAN_Cockpit: start 89, 3 bit, little-endian, data-type-policy=OVERRIDE, i-signal-type=PRIMITIVE, init-value=0, base-type=BT_FBS_KSY_adv_zone, compu {4=Cx4_zone_3 (CM_FBS_KSY_adv_zone_Cx4_zone_3), 1=Cx1_zone_0 (CM_FBS_KSY_adv_zone_Cx1_zone_0), 0=Cx0_Init (CM_FBS_KSY_adv_zone_Cx0_Init), 3=Cx3_zone_2 (CM_FBS_KSY_adv_zone_Cx3_zone_2), 7=Cx7_no_ID_found (CM_FBS_KSY_adv_zone_Cx7_no_ID_found), 5=Cx5_zone_4 (CM_FBS_KSY_adv_zone_Cx5_zone_4), 2=Cx2_zone_1 (CM_FBS_KSY_adv_zone_Cx2_zone_1), 6=Cx6_zone_5 (CM_FBS_KSY_adv_zone_Cx6_zone_5)}, range raw 0..7, transfer-property=TRIGGERED-WITHOUT-REPETITION  # KY_Bereich
    signal FBS_KSY_driver_warning_XIX_KeylessAccess_01_XIX_VLAN_Cockpit: start 92, 4 bit, little-endian, data-type-policy=OVERRIDE, i-signal-type=PRIMITIVE, init-value=0, base-type=BT_FBS_KSY_driver_warning, compu {9=Cx9_reserved (CM_FBS_KSY_driver_warning_Cx9_reserved), 12=Cxc_FBS_TxT_Warn_kein_Schluessel (CM_FBS_KSY_driver_warning_Cxc_FBS_TxT_Warn_kein_Schluessel), 15=Cxf_reserved (CM_FBS_KSY_driver_warning_Cxf_reserved), 0=Cx0_no_warning (CM_FBS_KSY_driver_warning_Cx0_no_warning), 3=Cx3_Schluessel_im_Kofferraum_gefund (CM_FBS_KSY_driver_warning_Cx3_Schluessel_im_Kofferraum_gefund), 4=Cx4_Start_Kein_Schluessel_erkannt (CM_FBS_KSY_driver_warning_Cx4_Start_Kein_Schluessel_erkannt), 5=Cx5_Start_Kein_Schluessel_oder_MDK (CM_FBS_KSY_driver_warning_Cx5_Start_Kein_Schluessel_oder_MDK), 6=Cx6_Warn_kein_MDK_erkannt (CM_FBS_KSY_driver_warning_Cx6_Warn_kein_MDK_erkannt), 14=Cxe_Warn_gueltiges_Keyless_kein_MDK (CM_FBS_KSY_driver_warning_Cxe_Warn_gueltiges_Keyless_kein_MDK), 1=Cx1_Zugang_Kein_Schluessel_erkannt (CM_FBS_KSY_driver_warning_Cx1_Zugang_Kein_Schluessel_erkannt), 8=Cx8_VIP_sensor_verschmutzt (CM_FBS_KSY_driver_warning_Cx8_VIP_sensor_verschmutzt), 13=Cxd_Warn_kein_Keyless_gueltiger_MDK (CM_FBS_KSY_driver_warning_Cxd_Warn_kein_Keyless_gueltiger_MDK), 2=Cx2_Schluessel_im_Innenraum_gefunden (CM_FBS_KSY_driver_warning_Cx2_Schluessel_im_Innenraum_gefunden), 7=Cx7_KL15_Keine_Autom_Aktivierung (CM_FBS_KSY_driver_warning_Cx7_KL15_Keine_Autom_Aktivierung), 10=Cxa_reserved (CM_FBS_KSY_driver_warning_Cxa_reserved), 11=Cxb_FBS_TxT_Warn_Schluessel_Batt (CM_FBS_KSY_driver_warning_Cxb_FBS_TxT_Warn_Schluessel_Batt)}, range raw 0..15, transfer-property=TRIGGERED-WITHOUT-REPETITION  # Kombi Fahrer Hinweise Keyless
    signal FBS_KSY_enable_park_XIX_KeylessAccess_01_XIX_VLAN_Cockpit: start 96, 2 bit, little-endian, data-type-policy=OVERRIDE, i-signal-type=PRIMITIVE, init-value=0, base-type=BT_FBS_KSY_enable_park, compu {1=Cx1_enable_piloted_parking (CM_FBS_KSY_enable_park_Cx1_enable_piloted_parking), 0=Cx0_Init (CM_FBS_KSY_enable_park_Cx0_Init)}, range raw 0..1, transfer-property=TRIGGERED-WITHOUT-REPETITION  # KY_Aktivierung_Pilot_Parken
    signal FBS_KSY_HF_XIX_KeylessAccess_01_XIX_VLAN_Cockpit: start 98, 3 bit, little-endian, data-type-policy=OVERRIDE, i-signal-type=PRIMITIVE, base-type=BT_FBS_KSY_HF, compu {2=Cx2_active_rx_ch2 (CM_FBS_KSY_HF_Cx2_active_rx_ch2), 0=Cx0_inactive (CM_FBS_KSY_HF_Cx0_inactive), 3=Cx3_active_rx_ch3 (CM_FBS_KSY_HF_Cx3_active_rx_ch3), 1=Cx1_active_rx_ch1 (CM_FBS_KSY_HF_Cx1_active_rx_ch1), 4=Cx4_active_tx_ch1 (CM_FBS_KSY_HF_Cx4_active_tx_ch1), 6=Cx6_active_tx_ch3 (CM_FBS_KSY_HF_Cx6_active_tx_ch3), 5=Cx5_active_tx_ch2 (CM_FBS_KSY_HF_Cx5_active_tx_ch2), 7=Cx7_reserved (CM_FBS_KSY_HF_Cx7_reserved) (-reserved-)}, range raw 0..7, transfer-property=TRIGGERED-WITHOUT-REPETITION  # HF active signalling
    signal FBS_KSY_HF_telegram_XIX_KeylessAccess_01_XIX_VLAN_Cockpit: start 101, 8 bit, little-endian, data-type-policy=OVERRIDE, i-signal-type=PRIMITIVE, base-type=BT_FBS_KSY_HF_telegram, compu {8=Cx8_valid_4 (CM_FBS_KSY_HF_telegram_Cx8_valid_4), 32=Cx20_valid_6 (CM_FBS_KSY_HF_telegram_Cx20_valid_6), 128=Cx80_valid_8 (CM_FBS_KSY_HF_telegram_Cx80_valid_8), 64=Cx40_valid_7 (CM_FBS_KSY_HF_telegram_Cx40_valid_7), 2=Cx2_valid_2 (CM_FBS_KSY_HF_telegram_Cx2_valid_2), 16=Cx10_valid_5 (CM_FBS_KSY_HF_telegram_Cx10_valid_5), 1=Cx1_valid_1 (CM_FBS_KSY_HF_telegram_Cx1_valid_1), 0=Cx0_inactive (CM_FBS_KSY_HF_telegram_Cx0_inactive), 4=Cx4_valid_3 (CM_FBS_KSY_HF_telegram_Cx4_valid_3)}, range raw 0..128, transfer-property=TRIGGERED-WITHOUT-REPETITION  # HF telegram status signalling
    signal FBS_KSY_ID_battery_XIX_KeylessAccess_01_XIX_VLAN_Cockpit: start 109, 3 bit, little-endian, data-type-policy=OVERRIDE, i-signal-type=PRIMITIVE, init-value=0, base-type=BT_FBS_KSY_ID_battery, compu {0=Cx0_init (CM_FBS_KSY_ID_battery_Cx0_init), 2=Cx2_battery_level_2 (CM_FBS_KSY_ID_battery_Cx2_battery_level_2), 5=Cx5_battery_level_5 (CM_FBS_KSY_ID_battery_Cx5_battery_level_5), 1=Cx1_battery_level_0_or_battery_level_1 (CM_FBS_KSY_ID_battery_Cx1_battery_level_0_or_battery_level_1) (battery_level_0 or battery_level_1), 6=Cx6_battery_level_6 (CM_FBS_KSY_ID_battery_Cx6_battery_level_6), 4=Cx4_battery_level_4 (CM_FBS_KSY_ID_battery_Cx4_battery_level_4), 3=Cx3_battery_level_3 (CM_FBS_KSY_ID_battery_Cx3_battery_level_3), 7=Cx7_battery_level_7 (CM_FBS_KSY_ID_battery_Cx7_battery_level_7)}, range raw 0..7, transfer-property=TRIGGERED-WITHOUT-REPETITION  # battery status of ID or remote key
    signal FBS_KSY_jobnumber_XIX_KeylessAccess_01_XIX_VLAN_Cockpit: start 112, 8 bit, little-endian, data-type-policy=OVERRIDE, i-signal-type=PRIMITIVE, base-type=BT_FBS_KSY_jobnumber, compu {69=Cx45_job_69 (CM_FBS_KSY_jobnumber_Cx45_job_69), 186=Cxba_job_186 (CM_FBS_KSY_jobnumber_Cxba_job_186), 60=Cx3c_job_60 (CM_FBS_KSY_jobnumber_Cx3c_job_60), 130=Cx82_job_130 (CM_FBS_KSY_jobnumber_Cx82_job_130), 99=Cx63_job_99 (CM_FBS_KSY_jobnumber_Cx63_job_99), 114=Cx72_job_114 (CM_FBS_KSY_jobnumber_Cx72_job_114), 109=Cx6d_job_109 (CM_FBS_KSY_jobnumber_Cx6d_job_109), 16=Cx10_job_16 (CM_FBS_KSY_jobnumber_Cx10_job_16), 221=Cxdd_job_221 (CM_FBS_KSY_jobnumber_Cxdd_job_221), 197=Cxc5_job_197 (CM_FBS_KSY_jobnumber_Cxc5_job_197), 190=Cxbe_job_190 (CM_FBS_KSY_jobnumber_Cxbe_job_190), 205=Cxcd_job_205 (CM_FBS_KSY_jobnumber_Cxcd_job_205), 128=Cx80_job_128 (CM_FBS_KSY_jobnumber_Cx80_job_128), 217=Cxd9_job_217 (CM_FBS_KSY_jobnumber_Cxd9_job_217), 244=Cxf4_job_244 (CM_FBS_KSY_jobnumber_Cxf4_job_244), 119=Cx77_job_119 (CM_FBS_KSY_jobnumber_Cx77_job_119), 209=Cxd1_job_209 (CM_FBS_KSY_jobnumber_Cxd1_job_209), 85=Cx55_job_85 (CM_FBS_KSY_jobnumber_Cx55_job_85), 232=Cxe8_job_232 (CM_FBS_KSY_jobnumber_Cxe8_job_232), 245=Cxf5_job_245 (CM_FBS_KSY_jobnumber_Cxf5_job_245), 138=Cx8a_job_138 (CM_FBS_KSY_jobnumber_Cx8a_job_138), 226=Cxe2_job_226 (CM_FBS_KSY_jobnumber_Cxe2_job_226), 175=Cxaf_job_175 (CM_FBS_KSY_jobnumber_Cxaf_job_175), 173=Cxad_job_173 (CM_FBS_KSY_jobnumber_Cxad_job_173), 240=Cxf0_job_240 (CM_FBS_KSY_jobnumber_Cxf0_job_240), 89=Cx59_job_89 (CM_FBS_KSY_jobnumber_Cx59_job_89), 24=Cx18_job_24 (CM_FBS_KSY_jobnumber_Cx18_job_24), 80=Cx50_job_80 (CM_FBS_KSY_jobnumber_Cx50_job_80), 48=Cx30_job_48 (CM_FBS_KSY_jobnumber_Cx30_job_48), 93=Cx5d_job_93 (CM_FBS_KSY_jobnumber_Cx5d_job_93), 135=Cx87_job_135 (CM_FBS_KSY_jobnumber_Cx87_job_135), 13=Cxd_job_13 (CM_FBS_KSY_jobnumber_Cxd_job_13), 255=Cxff_job_255 (CM_FBS_KSY_jobnumber_Cxff_job_255), 3=Cx3_job_3 (CM_FBS_KSY_jobnumber_Cx3_job_3), 66=Cx42_job_66 (CM_FBS_KSY_jobnumber_Cx42_job_66), 233=Cxe9_job_233 (CM_FBS_KSY_jobnumber_Cxe9_job_233), 108=Cx6c_job_108 (CM_FBS_KSY_jobnumber_Cx6c_job_108), 207=Cxcf_job_207 (CM_FBS_KSY_jobnumber_Cxcf_job_207), 5=Cx5_job_5 (CM_FBS_KSY_jobnumber_Cx5_job_5), 239=Cxef_job_239 (CM_FBS_KSY_jobnumber_Cxef_job_239), 63=Cx3f_job_63 (CM_FBS_KSY_jobnumber_Cx3f_job_63), 143=Cx8f_job_143 (CM_FBS_KSY_jobnumber_Cx8f_job_143), 43=Cx2b_job_43 (CM_FBS_KSY_jobnumber_Cx2b_job_43), 2=Cx2_job_2 (CM_FBS_KSY_jobnumber_Cx2_job_2), 95=Cx5f_job_95 (CM_FBS_KSY_jobnumber_Cx5f_job_95), 28=Cx1c_job_28 (CM_FBS_KSY_jobnumber_Cx1c_job_28), 140=Cx8c_job_140 (CM_FBS_KSY_jobnumber_Cx8c_job_140), 171=Cxab_job_171 (CM_FBS_KSY_jobnumber_Cxab_job_171), 51=Cx33_job_51 (CM_FBS_KSY_jobnumber_Cx33_job_51), 62=Cx3e_job_62 (CM_FBS_KSY_jobnumber_Cx3e_job_62), 167=Cxa7_job_167 (CM_FBS_KSY_jobnumber_Cxa7_job_167), 50=Cx32_job_50 (CM_FBS_KSY_jobnumber_Cx32_job_50), 248=Cxf8_job_248 (CM_FBS_KSY_jobnumber_Cxf8_job_248), 246=Cxf6_job_246 (CM_FBS_KSY_jobnumber_Cxf6_job_246), 98=Cx62_job_98 (CM_FBS_KSY_jobnumber_Cx62_job_98), 70=Cx46_job_70 (CM_FBS_KSY_jobnumber_Cx46_job_70), 160=Cxa0_job_160 (CM_FBS_KSY_jobnumber_Cxa0_job_160), 180=Cxb4_job_180 (CM_FBS_KSY_jobnumber_Cxb4_job_180), 176=Cxb0_job_176 (CM_FBS_KSY_jobnumber_Cxb0_job_176), 198=Cxc6_job_198 (CM_FBS_KSY_jobnumber_Cxc6_job_198), 9=Cx9_job_9 (CM_FBS_KSY_jobnumber_Cx9_job_9), 254=Cxfe_job_254 (CM_FBS_KSY_jobnumber_Cxfe_job_254), 225=Cxe1_job_225 (CM_FBS_KSY_jobnumber_Cxe1_job_225), 92=Cx5c_job_92 (CM_FBS_KSY_jobnumber_Cx5c_job_92), 193=Cxc1_job_193 (CM_FBS_KSY_jobnumber_Cxc1_job_193), 37=Cx25_job_37 (CM_FBS_KSY_jobnumber_Cx25_job_37), 54=Cx36_job_54 (CM_FBS_KSY_jobnumber_Cx36_job_54), 40=Cx28_job_40 (CM_FBS_KSY_jobnumber_Cx28_job_40), 241=Cxf1_job_241 (CM_FBS_KSY_jobnumber_Cxf1_job_241), 22=Cx16_job_22 (CM_FBS_KSY_jobnumber_Cx16_job_22), 79=Cx4f_job_79 (CM_FBS_KSY_jobnumber_Cx4f_job_79), 187=Cxbb_job_187 (CM_FBS_KSY_jobnumber_Cxbb_job_187), 194=Cxc2_job_194 (CM_FBS_KSY_jobnumber_Cxc2_job_194), 131=Cx83_job_131 (CM_FBS_KSY_jobnumber_Cx83_job_131), 35=Cx23_job_35 (CM_FBS_KSY_jobnumber_Cx23_job_35), 177=Cxb1_job_177 (CM_FBS_KSY_jobnumber_Cxb1_job_177), 44=Cx2c_job_44 (CM_FBS_KSY_jobnumber_Cx2c_job_44), 189=Cxbd_job_189 (CM_FBS_KSY_jobnumber_Cxbd_job_189), 77=Cx4d_job_77 (CM_FBS_KSY_jobnumber_Cx4d_job_77), 61=Cx3d_job_61 (CM_FBS_KSY_jobnumber_Cx3d_job_61), 15=Cxf_job_15 (CM_FBS_KSY_jobnumber_Cxf_job_15), 196=Cxc4_job_196 (CM_FBS_KSY_jobnumber_Cxc4_job_196), 20=Cx14_job_20 (CM_FBS_KSY_jobnumber_Cx14_job_20), 147=Cx93_job_147 (CM_FBS_KSY_jobnumber_Cx93_job_147), 116=Cx74_job_116 (CM_FBS_KSY_jobnumber_Cx74_job_116), 26=Cx1a_job_26 (CM_FBS_KSY_jobnumber_Cx1a_job_26), 101=Cx65_job_101 (CM_FBS_KSY_jobnumber_Cx65_job_101), 215=Cxd7_job_215 (CM_FBS_KSY_jobnumber_Cxd7_job_215), 71=Cx47_job_71 (CM_FBS_KSY_jobnumber_Cx47_job_71), 238=Cxee_job_238 (CM_FBS_KSY_jobnumber_Cxee_job_238), 117=Cx75_job_117 (CM_FBS_KSY_jobnumber_Cx75_job_117), 123=Cx7b_job_123 (CM_FBS_KSY_jobnumber_Cx7b_job_123), 110=Cx6e_job_110 (CM_FBS_KSY_jobnumber_Cx6e_job_110), 154=Cx9a_job_154 (CM_FBS_KSY_jobnumber_Cx9a_job_154), 206=Cxce_job_206 (CM_FBS_KSY_jobnumber_Cxce_job_206), 192=Cxc0_job_192 (CM_FBS_KSY_jobnumber_Cxc0_job_192), 73=Cx49_job_73 (CM_FBS_KSY_jobnumber_Cx49_job_73), 84=Cx54_job_84 (CM_FBS_KSY_jobnumber_Cx54_job_84), 243=Cxf3_job_243 (CM_FBS_KSY_jobnumber_Cxf3_job_243), 29=Cx1d_job_29 (CM_FBS_KSY_jobnumber_Cx1d_job_29), 94=Cx5e_job_94 (CM_FBS_KSY_jobnumber_Cx5e_job_94), 172=Cxac_job_172 (CM_FBS_KSY_jobnumber_Cxac_job_172), 251=Cxfb_job_251 (CM_FBS_KSY_jobnumber_Cxfb_job_251), 134=Cx86_job_134 (CM_FBS_KSY_jobnumber_Cx86_job_134), 31=Cx1f_job_31 (CM_FBS_KSY_jobnumber_Cx1f_job_31), 155=Cx9b_job_155 (CM_FBS_KSY_jobnumber_Cx9b_job_155), 200=Cxc8_job_200 (CM_FBS_KSY_jobnumber_Cxc8_job_200), 97=Cx61_job_97 (CM_FBS_KSY_jobnumber_Cx61_job_97), 144=Cx90_job_144 (CM_FBS_KSY_jobnumber_Cx90_job_144), 113=Cx71_job_113 (CM_FBS_KSY_jobnumber_Cx71_job_113), 120=Cx78_job_120 (CM_FBS_KSY_jobnumber_Cx78_job_120), 34=Cx22_job_34 (CM_FBS_KSY_jobnumber_Cx22_job_34), 169=Cxa9_job_169 (CM_FBS_KSY_jobnumber_Cxa9_job_169), 87=Cx57_job_87 (CM_FBS_KSY_jobnumber_Cx57_job_87), 156=Cx9c_job_156 (CM_FBS_KSY_jobnumber_Cx9c_job_156), 178=Cxb2_job_178 (CM_FBS_KSY_jobnumber_Cxb2_job_178), 42=Cx2a_job_42 (CM_FBS_KSY_jobnumber_Cx2a_job_42), 220=Cxdc_job_220 (CM_FBS_KSY_jobnumber_Cxdc_job_220), 49=Cx31_job_49 (CM_FBS_KSY_jobnumber_Cx31_job_49), 142=Cx8e_job_142 (CM_FBS_KSY_jobnumber_Cx8e_job_142), 12=Cxc_job_12 (CM_FBS_KSY_jobnumber_Cxc_job_12), 41=Cx29_job_41 (CM_FBS_KSY_jobnumber_Cx29_job_41), 102=Cx66_job_102 (CM_FBS_KSY_jobnumber_Cx66_job_102), 56=Cx38_job_56 (CM_FBS_KSY_jobnumber_Cx38_job_56), 211=Cxd3_job_211 (CM_FBS_KSY_jobnumber_Cxd3_job_211), 150=Cx96_job_150 (CM_FBS_KSY_jobnumber_Cx96_job_150), 185=Cxb9_job_185 (CM_FBS_KSY_jobnumber_Cxb9_job_185), 129=Cx81_job_129 (CM_FBS_KSY_jobnumber_Cx81_job_129), 72=Cx48_job_72 (CM_FBS_KSY_jobnumber_Cx48_job_72), 58=Cx3a_job_58 (CM_FBS_KSY_jobnumber_Cx3a_job_58), 7=Cx7_job_7 (CM_FBS_KSY_jobnumber_Cx7_job_7), 191=Cxbf_job_191 (CM_FBS_KSY_jobnumber_Cxbf_job_191), 199=Cxc7_job_199 (CM_FBS_KSY_jobnumber_Cxc7_job_199), 19=Cx13_job_19 (CM_FBS_KSY_jobnumber_Cx13_job_19), 170=Cxaa_job_170 (CM_FBS_KSY_jobnumber_Cxaa_job_170), 65=Cx41_job_65 (CM_FBS_KSY_jobnumber_Cx41_job_65), 18=Cx12_job_18 (CM_FBS_KSY_jobnumber_Cx12_job_18), 126=Cx7e_job_126 (CM_FBS_KSY_jobnumber_Cx7e_job_126), 237=Cxed_job_237 (CM_FBS_KSY_jobnumber_Cxed_job_237), 124=Cx7c_job_124 (CM_FBS_KSY_jobnumber_Cx7c_job_124), 30=Cx1e_job_30 (CM_FBS_KSY_jobnumber_Cx1e_job_30), 45=Cx2d_job_45 (CM_FBS_KSY_jobnumber_Cx2d_job_45), 202=Cxca_job_202 (CM_FBS_KSY_jobnumber_Cxca_job_202), 166=Cxa6_job_166 (CM_FBS_KSY_jobnumber_Cxa6_job_166), 164=Cxa4_job_164 (CM_FBS_KSY_jobnumber_Cxa4_job_164), 27=Cx1b_job_27 (CM_FBS_KSY_jobnumber_Cx1b_job_27), 104=Cx68_job_104 (CM_FBS_KSY_jobnumber_Cx68_job_104), 234=Cxea_job_234 (CM_FBS_KSY_jobnumber_Cxea_job_234), 214=Cxd6_job_214 (CM_FBS_KSY_jobnumber_Cxd6_job_214), 118=Cx76_job_118 (CM_FBS_KSY_jobnumber_Cx76_job_118), 179=Cxb3_job_179 (CM_FBS_KSY_jobnumber_Cxb3_job_179), 82=Cx52_job_82 (CM_FBS_KSY_jobnumber_Cx52_job_82), 91=Cx5b_job_91 (CM_FBS_KSY_jobnumber_Cx5b_job_91), 1=Cx1_job_1 (CM_FBS_KSY_jobnumber_Cx1_job_1), 157=Cx9d_job_157 (CM_FBS_KSY_jobnumber_Cx9d_job_157), 203=Cxcb_job_203 (CM_FBS_KSY_jobnumber_Cxcb_job_203), 249=Cxf9_job_249 (CM_FBS_KSY_jobnumber_Cxf9_job_249), 231=Cxe7_job_231 (CM_FBS_KSY_jobnumber_Cxe7_job_231), 227=Cxe3_job_227 (CM_FBS_KSY_jobnumber_Cxe3_job_227), 223=Cxdf_job_223 (CM_FBS_KSY_jobnumber_Cxdf_job_223), 0=Cx0_inactive (CM_FBS_KSY_jobnumber_Cx0_inactive), 47=Cx2f_job_47 (CM_FBS_KSY_jobnumber_Cx2f_job_47), 57=Cx39_job_57 (CM_FBS_KSY_jobnumber_Cx39_job_57), 188=Cxbc_job_188 (CM_FBS_KSY_jobnumber_Cxbc_job_188), 159=Cx9f_job_159 (CM_FBS_KSY_jobnumber_Cx9f_job_159), 88=Cx58_job_88 (CM_FBS_KSY_jobnumber_Cx58_job_88), 105=Cx69_job_105 (CM_FBS_KSY_jobnumber_Cx69_job_105), 158=Cx9e_job_158 (CM_FBS_KSY_jobnumber_Cx9e_job_158), 96=Cx60_job_96 (CM_FBS_KSY_jobnumber_Cx60_job_96), 125=Cx7d_job_125 (CM_FBS_KSY_jobnumber_Cx7d_job_125), 81=Cx51_job_81 (CM_FBS_KSY_jobnumber_Cx51_job_81), 165=Cxa5_job_165 (CM_FBS_KSY_jobnumber_Cxa5_job_165), 103=Cx67_job_103 (CM_FBS_KSY_jobnumber_Cx67_job_103), 74=Cx4a_job_74 (CM_FBS_KSY_jobnumber_Cx4a_job_74), 242=Cxf2_job_242 (CM_FBS_KSY_jobnumber_Cxf2_job_242), 8=Cx8_job_8 (CM_FBS_KSY_jobnumber_Cx8_job_8), 152=Cx98_job_152 (CM_FBS_KSY_jobnumber_Cx98_job_152), 168=Cxa8_job_168 (CM_FBS_KSY_jobnumber_Cxa8_job_168), 112=Cx70_job_112 (CM_FBS_KSY_jobnumber_Cx70_job_112), 136=Cx88_job_136 (CM_FBS_KSY_jobnumber_Cx88_job_136), 174=Cxae_job_174 (CM_FBS_KSY_jobnumber_Cxae_job_174), 106=Cx6a_job_106 (CM_FBS_KSY_jobnumber_Cx6a_job_106), 133=Cx85_job_133 (CM_FBS_KSY_jobnumber_Cx85_job_133), 115=Cx73_job_115 (CM_FBS_KSY_jobnumber_Cx73_job_115), 4=Cx4_job_4 (CM_FBS_KSY_jobnumber_Cx4_job_4), 83=Cx53_job_83 (CM_FBS_KSY_jobnumber_Cx53_job_83), 75=Cx4b_job_75 (CM_FBS_KSY_jobnumber_Cx4b_job_75), 111=Cx6f_job_111 (CM_FBS_KSY_jobnumber_Cx6f_job_111), 46=Cx2e_job_46 (CM_FBS_KSY_jobnumber_Cx2e_job_46), 218=Cxda_job_218 (CM_FBS_KSY_jobnumber_Cxda_job_218), 195=Cxc3_job_195 (CM_FBS_KSY_jobnumber_Cxc3_job_195), 10=Cxa_job_10 (CM_FBS_KSY_jobnumber_Cxa_job_10), 121=Cx79_job_121 (CM_FBS_KSY_jobnumber_Cx79_job_121), 86=Cx56_job_86 (CM_FBS_KSY_jobnumber_Cx56_job_86), 17=Cx11_job_17 (CM_FBS_KSY_jobnumber_Cx11_job_17), 39=Cx27_job_39 (CM_FBS_KSY_jobnumber_Cx27_job_39), 33=Cx21_job_33 (CM_FBS_KSY_jobnumber_Cx21_job_33), 53=Cx35_job_53 (CM_FBS_KSY_jobnumber_Cx35_job_53), 14=Cxe_job_14 (CM_FBS_KSY_jobnumber_Cxe_job_14), 235=Cxeb_job_235 (CM_FBS_KSY_jobnumber_Cxeb_job_235), 148=Cx94_job_148 (CM_FBS_KSY_jobnumber_Cx94_job_148), 52=Cx34_job_52 (CM_FBS_KSY_jobnumber_Cx34_job_52), 250=Cxfa_job_250 (CM_FBS_KSY_jobnumber_Cxfa_job_250), 38=Cx26_job_38 (CM_FBS_KSY_jobnumber_Cx26_job_38), 212=Cxd4_job_212 (CM_FBS_KSY_jobnumber_Cxd4_job_212), 107=Cx6b_job_107 (CM_FBS_KSY_jobnumber_Cx6b_job_107), 219=Cxdb_job_219 (CM_FBS_KSY_jobnumber_Cxdb_job_219), 253=Cxfd_job_253 (CM_FBS_KSY_jobnumber_Cxfd_job_253), 208=Cxd0_job_208 (CM_FBS_KSY_jobnumber_Cxd0_job_208), 163=Cxa3_job_163 (CM_FBS_KSY_jobnumber_Cxa3_job_163), 76=Cx4c_job_76 (CM_FBS_KSY_jobnumber_Cx4c_job_76), 146=Cx92_job_146 (CM_FBS_KSY_jobnumber_Cx92_job_146), 229=Cxe5_job_229 (CM_FBS_KSY_jobnumber_Cxe5_job_229), 32=Cx20_job_32 (CM_FBS_KSY_jobnumber_Cx20_job_32), 11=Cxb_job_11 (CM_FBS_KSY_jobnumber_Cxb_job_11), 122=Cx7a_job_122 (CM_FBS_KSY_jobnumber_Cx7a_job_122), 149=Cx95_job_149 (CM_FBS_KSY_jobnumber_Cx95_job_149), 68=Cx44_job_68 (CM_FBS_KSY_jobnumber_Cx44_job_68), 100=Cx64_job_100 (CM_FBS_KSY_jobnumber_Cx64_job_100), 6=Cx6_job_6 (CM_FBS_KSY_jobnumber_Cx6_job_6), 184=Cxb8_job_184 (CM_FBS_KSY_jobnumber_Cxb8_job_184), 78=Cx4e_job_78 (CM_FBS_KSY_jobnumber_Cx4e_job_78), 162=Cxa2_job_162 (CM_FBS_KSY_jobnumber_Cxa2_job_162), 21=Cx15_job_21 (CM_FBS_KSY_jobnumber_Cx15_job_21), 228=Cxe4_job_228 (CM_FBS_KSY_jobnumber_Cxe4_job_228), 25=Cx19_job_25 (CM_FBS_KSY_jobnumber_Cx19_job_25), 141=Cx8d_job_141 (CM_FBS_KSY_jobnumber_Cx8d_job_141), 210=Cxd2_job_210 (CM_FBS_KSY_jobnumber_Cxd2_job_210), 224=Cxe0_job_224 (CM_FBS_KSY_jobnumber_Cxe0_job_224), 55=Cx37_job_55 (CM_FBS_KSY_jobnumber_Cx37_job_55), 161=Cxa1_job_161 (CM_FBS_KSY_jobnumber_Cxa1_job_161), 145=Cx91_job_145 (CM_FBS_KSY_jobnumber_Cx91_job_145), 90=Cx5a_job_90 (CM_FBS_KSY_jobnumber_Cx5a_job_90), 67=Cx43_job_67 (CM_FBS_KSY_jobnumber_Cx43_job_67), 222=Cxde_job_222 (CM_FBS_KSY_jobnumber_Cxde_job_222), 213=Cxd5_job_213 (CM_FBS_KSY_jobnumber_Cxd5_job_213), 23=Cx17_job_23 (CM_FBS_KSY_jobnumber_Cx17_job_23), 127=Cx7f_job_127 (CM_FBS_KSY_jobnumber_Cx7f_job_127), 132=Cx84_job_132 (CM_FBS_KSY_jobnumber_Cx84_job_132), 181=Cxb5_job_181 (CM_FBS_KSY_jobnumber_Cxb5_job_181), 64=Cx40_job_64 (CM_FBS_KSY_jobnumber_Cx40_job_64), 183=Cxb7_job_183 (CM_FBS_KSY_jobnumber_Cxb7_job_183), 36=Cx24_job_36 (CM_FBS_KSY_jobnumber_Cx24_job_36), 137=Cx89_job_137 (CM_FBS_KSY_jobnumber_Cx89_job_137), 216=Cxd8_job_216 (CM_FBS_KSY_jobnumber_Cxd8_job_216), 59=Cx3b_job_59 (CM_FBS_KSY_jobnumber_Cx3b_job_59), 153=Cx99_job_153 (CM_FBS_KSY_jobnumber_Cx99_job_153), 139=Cx8b_job_139 (CM_FBS_KSY_jobnumber_Cx8b_job_139), 201=Cxc9_job_201 (CM_FBS_KSY_jobnumber_Cxc9_job_201), 230=Cxe6_job_230 (CM_FBS_KSY_jobnumber_Cxe6_job_230), 151=Cx97_job_151 (CM_FBS_KSY_jobnumber_Cx97_job_151), 204=Cxcc_job_204 (CM_FBS_KSY_jobnumber_Cxcc_job_204), 247=Cxf7_job_247 (CM_FBS_KSY_jobnumber_Cxf7_job_247), 182=Cxb6_job_182 (CM_FBS_KSY_jobnumber_Cxb6_job_182), 252=Cxfc_job_252 (CM_FBS_KSY_jobnumber_Cxfc_job_252), 236=Cxec_job_236 (CM_FBS_KSY_jobnumber_Cxec_job_236)}, range raw 0..255, transfer-property=TRIGGERED-WITHOUT-REPETITION  # FBS job signalling
    signal FBS_KSY_LF_XIX_KeylessAccess_01_XIX_VLAN_Cockpit: start 120, 3 bit, little-endian, data-type-policy=OVERRIDE, i-signal-type=PRIMITIVE, init-value=0, base-type=BT_FBS_KSY_LF, compu {1=Cx1_active_LF (CM_FBS_KSY_LF_Cx1_active_LF), 3=Cx3_active_immo_LM (CM_FBS_KSY_LF_Cx3_active_immo_LM), 0=Cx0_inactive (CM_FBS_KSY_LF_Cx0_inactive), 2=Cx2_active_immo_CnT (CM_FBS_KSY_LF_Cx2_active_immo_CnT)}, range raw 0..3, transfer-property=TRIGGERED-WITHOUT-REPETITION  # LF active signalling
    signal FBS_KSY_lock_sensor_auth_XIX_KeylessAccess_01_XIX_VLAN_Cockpit: start 123, 4 bit, little-endian, data-type-policy=OVERRIDE, i-signal-type=PRIMITIVE, init-value=0, base-type=BT_FBS_KSY_lock_sensor_auth, compu {8=Cx8_charge_terminal2_lock_auth (CM_FBS_KSY_lock_sensor_auth_Cx8_charge_terminal2_lock_auth), 4=Cx4_RCDD_lock_authorized (CM_FBS_KSY_lock_sensor_auth_Cx4_RCDD_lock_authorized), 14=Cxe_ctrl_F_authorized (CM_FBS_KSY_lock_sensor_auth_Cxe_ctrl_F_authorized), 9=Cx9_ctrl_A_authorized (CM_FBS_KSY_lock_sensor_auth_Cx9_ctrl_A_authorized), 0=Cx0_no_lock_authorized (CM_FBS_KSY_lock_sensor_auth_Cx0_no_lock_authorized), 5=Cx5_rear_trunk_lock_authorized (CM_FBS_KSY_lock_sensor_auth_Cx5_rear_trunk_lock_authorized), 13=Cxd_ctrl_E_authorized (CM_FBS_KSY_lock_sensor_auth_Cxd_ctrl_E_authorized), 6=Cx6_front_trunk_lock_authorized (CM_FBS_KSY_lock_sensor_auth_Cx6_front_trunk_lock_authorized), 7=Cx7_charge_terminal1_lock_auth (CM_FBS_KSY_lock_sensor_auth_Cx7_charge_terminal1_lock_auth), 2=Cx2_CDD_lock_authorized (CM_FBS_KSY_lock_sensor_auth_Cx2_CDD_lock_authorized), 1=Cx1_DD_lock_authorized (CM_FBS_KSY_lock_sensor_auth_Cx1_DD_lock_authorized), 12=Cxc_ctrl_D_authorized (CM_FBS_KSY_lock_sensor_auth_Cxc_ctrl_D_authorized), 15=Cxf_ctrl_G_authorized (CM_FBS_KSY_lock_sensor_auth_Cxf_ctrl_G_authorized), 11=Cxb_ctrl_C_authorized (CM_FBS_KSY_lock_sensor_auth_Cxb_ctrl_C_authorized), 3=Cx3_RDD_lock_authorized (CM_FBS_KSY_lock_sensor_auth_Cx3_RDD_lock_authorized), 10=Cxa_ctrl_B_authorized (CM_FBS_KSY_lock_sensor_auth_Cxa_ctrl_B_authorized)}, range raw 0..15, transfer-property=TRIGGERED-WITHOUT-REPETITION  # Autorisierung einer Verriegelung an Keyless-Bedienstelle
    signal FBS_KSY_lock_sensor_prox_XIX_KeylessAccess_01_XIX_VLAN_Cockpit: start 127, 4 bit, little-endian, data-type-policy=OVERRIDE, i-signal-type=PRIMITIVE, init-value=0, base-type=BT_FBS_KSY_lock_sensor_prox, compu {4=Cx4_RCDD_lock_prox (CM_FBS_KSY_lock_sensor_prox_Cx4_RCDD_lock_prox), 3=Cx3_RDD_lock_prox (CM_FBS_KSY_lock_sensor_prox_Cx3_RDD_lock_prox), 6=Cx6_front_trunk_lock_prox (CM_FBS_KSY_lock_sensor_prox_Cx6_front_trunk_lock_prox), 15=Cxf_ctrl_G_prox (CM_FBS_KSY_lock_sensor_prox_Cxf_ctrl_G_prox), 14=Cxe_ctrl_F_prox (CM_FBS_KSY_lock_sensor_prox_Cxe_ctrl_F_prox), 5=Cx5_rear_trunk_lock_prox (CM_FBS_KSY_lock_sensor_prox_Cx5_rear_trunk_lock_prox), 11=Cxb_ctrl_C_prox (CM_FBS_KSY_lock_sensor_prox_Cxb_ctrl_C_prox), 10=Cxa_ctrl_B_prox (CM_FBS_KSY_lock_sensor_prox_Cxa_ctrl_B_prox), 12=Cxc_ctrl_D_prox (CM_FBS_KSY_lock_sensor_prox_Cxc_ctrl_D_prox), 2=Cx2_CDD_lock_prox (CM_FBS_KSY_lock_sensor_prox_Cx2_CDD_lock_prox), 9=Cx9_ctrl_A_prox (CM_FBS_KSY_lock_sensor_prox_Cx9_ctrl_A_prox), 1=Cx1_DD_lock_prox (CM_FBS_KSY_lock_sensor_prox_Cx1_DD_lock_prox), 0=Cx0_no_lock_prox (CM_FBS_KSY_lock_sensor_prox_Cx0_no_lock_prox), 13=Cxd_ctrl_E_prox (CM_FBS_KSY_lock_sensor_prox_Cxd_ctrl_E_prox), 7=Cx7_charge_terminal_1_lock_prox (CM_FBS_KSY_lock_sensor_prox_Cx7_charge_terminal_1_lock_prox), 8=Cx8_charge_terminal_2_lock_prox (CM_FBS_KSY_lock_sensor_prox_Cx8_charge_terminal_2_lock_prox)}, range raw 0..15, transfer-property=TRIGGERED-WITHOUT-REPETITION  # lock sensor approximation detected
    signal FBS_KSY_unlock_sensor_auth_XIX_KeylessAccess_01_XIX_VLAN_Cockpit: start 131, 4 bit, little-endian, data-type-policy=OVERRIDE, i-signal-type=PRIMITIVE, init-value=0, base-type=BT_FBS_KSY_unlock_sensor_auth, compu {7=Cx7_charge_terminal1_unlock_auth (CM_FBS_KSY_unlock_sensor_auth_Cx7_charge_terminal1_unlock_auth), 11=Cxb_ctrl_C_authorized (CM_FBS_KSY_unlock_sensor_auth_Cxb_ctrl_C_authorized), 12=Cxc_ctrl_D_authorized (CM_FBS_KSY_unlock_sensor_auth_Cxc_ctrl_D_authorized), 2=Cx2_CDD_unlock_authorized (CM_FBS_KSY_unlock_sensor_auth_Cx2_CDD_unlock_authorized), 14=Cxe_ctrl_F_authorized (CM_FBS_KSY_unlock_sensor_auth_Cxe_ctrl_F_authorized), 10=Cxa_ctrl_B_authorized (CM_FBS_KSY_unlock_sensor_auth_Cxa_ctrl_B_authorized), 5=Cx5_rear_trunk_unlock_authorized (CM_FBS_KSY_unlock_sensor_auth_Cx5_rear_trunk_unlock_authorized), 13=Cxd_ctrl_E_authorized (CM_FBS_KSY_unlock_sensor_auth_Cxd_ctrl_E_authorized), 8=Cx8_charge_terminal2_unlock_auth (CM_FBS_KSY_unlock_sensor_auth_Cx8_charge_terminal2_unlock_auth), 6=Cx6_front_trunk_unlock_authorized (CM_FBS_KSY_unlock_sensor_auth_Cx6_front_trunk_unlock_authorized), 4=Cx4_RCDD_unlock_authorized (CM_FBS_KSY_unlock_sensor_auth_Cx4_RCDD_unlock_authorized), 0=Cx0_no_unlock_authorized (CM_FBS_KSY_unlock_sensor_auth_Cx0_no_unlock_authorized), 1=Cx1_DD_unlock_authorized (CM_FBS_KSY_unlock_sensor_auth_Cx1_DD_unlock_authorized), 15=Cxf_ctrl_G_authorized (CM_FBS_KSY_unlock_sensor_auth_Cxf_ctrl_G_authorized), 9=Cx9_ctrl_A_authorized (CM_FBS_KSY_unlock_sensor_auth_Cx9_ctrl_A_authorized), 3=Cx3_RDD_unlock_authorized (CM_FBS_KSY_unlock_sensor_auth_Cx3_RDD_unlock_authorized)}, range raw 0..15, transfer-property=TRIGGERED-WITHOUT-REPETITION  # Autorisierung einer Entriegelung an Keyless-Bedienstelle
    signal FBS_KSY_unlock_sensor_prox_XIX_KeylessAccess_01_XIX_VLAN_Cockpit: start 135, 4 bit, little-endian, data-type-policy=OVERRIDE, i-signal-type=PRIMITIVE, init-value=0, base-type=BT_FBS_KSY_unlock_sensor_prox, compu {7=Cx7_charge_terminal_1_unlock_prox (CM_FBS_KSY_unlock_sensor_prox_Cx7_charge_terminal_1_unlock_prox), 14=Cxe_ctrl_F_prox (CM_FBS_KSY_unlock_sensor_prox_Cxe_ctrl_F_prox), 11=Cxb_ctrl_C_prox (CM_FBS_KSY_unlock_sensor_prox_Cxb_ctrl_C_prox), 8=Cx8_charge_terminal_2_unlock_prox (CM_FBS_KSY_unlock_sensor_prox_Cx8_charge_terminal_2_unlock_prox), 0=Cx0_no_unlock_prox (CM_FBS_KSY_unlock_sensor_prox_Cx0_no_unlock_prox), 2=Cx2_CDD_unlock_prox (CM_FBS_KSY_unlock_sensor_prox_Cx2_CDD_unlock_prox), 9=Cx9_ctrl_A_prox (CM_FBS_KSY_unlock_sensor_prox_Cx9_ctrl_A_prox), 15=Cxf_ctrl_G_prox (CM_FBS_KSY_unlock_sensor_prox_Cxf_ctrl_G_prox), 3=Cx3_RDD_unlock_prox (CM_FBS_KSY_unlock_sensor_prox_Cx3_RDD_unlock_prox), 6=Cx6_front_trunk_unlock_prox (CM_FBS_KSY_unlock_sensor_prox_Cx6_front_trunk_unlock_prox), 4=Cx4_RCDD_unlock_prox (CM_FBS_KSY_unlock_sensor_prox_Cx4_RCDD_unlock_prox), 1=Cx1_DD_unlock_prox (CM_FBS_KSY_unlock_sensor_prox_Cx1_DD_unlock_prox), 5=Cx5_rear_trunk_unlock_prox (CM_FBS_KSY_unlock_sensor_prox_Cx5_rear_trunk_unlock_prox), 13=Cxd_ctrl_E_prox (CM_FBS_KSY_unlock_sensor_prox_Cxd_ctrl_E_prox), 12=Cxc_ctrl_D_prox (CM_FBS_KSY_unlock_sensor_prox_Cxc_ctrl_D_prox), 10=Cxa_ctrl_B_prox (CM_FBS_KSY_unlock_sensor_prox_Cxa_ctrl_B_prox)}, range raw 0..15, transfer-property=TRIGGERED-WITHOUT-REPETITION  # unlock sensor approximation detected
    signal FBS_KSY_UWB_range_XIX_KeylessAccess_01_XIX_VLAN_Cockpit: start 139, 8 bit, little-endian, data-type-policy=OVERRIDE, i-signal-type=PRIMITIVE, init-value=0, base-type=BT_FBS_KSY_UWB_range, compu {phys=raw*0.1 for raw 0..255; unit Unit_Meter}, range phys 0..25.5 Unit_Meter, raw 0..255, unit=Unit_Meter, transfer-property=TRIGGERED-WITHOUT-REPETITION  # range result in decimeter.
    signal FBS_RKE_button_XIX_KeylessAccess_01_XIX_VLAN_Cockpit: start 147, 8 bit, little-endian, data-type-policy=OVERRIDE, i-signal-type=PRIMITIVE, init-value=0, base-type=BT_FBS_RKE_button, compu {0=Cx0_no_button_pressed (CM_FBS_RKE_button_Cx0_no_button_pressed), 8=Cx8_front_trunk_pressed (CM_FBS_RKE_button_Cx8_front_trunk_pressed), 2=Cx2_lock_pressed (CM_FBS_RKE_button_Cx2_lock_pressed), 32=Cx20_joker_pressed (CM_FBS_RKE_button_Cx20_joker_pressed), 4=Cx4_rear_trunk_pressed (CM_FBS_RKE_button_Cx4_rear_trunk_pressed), 64=Cx40_park_pressed (CM_FBS_RKE_button_Cx40_park_pressed), 128=Cx80_remotestart_pressed (CM_FBS_RKE_button_Cx80_remotestart_pressed), 1=Cx1_unlock_pressed (CM_FBS_RKE_button_Cx1_unlock_pressed), 16=Cx10_panic_pressed (CM_FBS_RKE_button_Cx10_panic_pressed)}, range raw 0..128, transfer-property=TRIGGERED-WITHOUT-REPETITION  # button pressed signalling of ID or key fob device
    signal KY_Position_XIX_KeylessAccess_01_XIX_VLAN_Cockpit: start 159, 3 bit, little-endian, data-type-policy=OVERRIDE, i-signal-type=PRIMITIVE, init-value=0, base-type=BT_KY_Position, compu {6=Cx6_Kein_Schluessel_gefunden (CM_KY_Position_Cx6_Kein_Schluessel_gefunden), 0=Cx0_Position_0 (CM_KY_Position_Cx0_Position_0), 1=Cx1_Postition_1 (CM_KY_Position_Cx1_Postition_1), 2=Cx2_Postition_2 (CM_KY_Position_Cx2_Postition_2), 7=Cx7_Init (CM_KY_Position_Cx7_Init), 4=Cx4_Postition_4 (CM_KY_Position_Cx4_Postition_4), 3=Cx3_Postition_3 (CM_KY_Position_Cx3_Postition_3)}, range raw 0..7, transfer-property=TRIGGERED-WITHOUT-REPETITION  # Schlüsselposition für Funktionen Annäherungslicht, automatisches Entriegeln
    signal VIP_Sensor_betaetigt_XIX_KeylessAccess_01_XIX_VLAN_Cockpit: start 162, 1 bit, little-endian, data-type-policy=OVERRIDE, i-signal-type=PRIMITIVE, init-value=0, base-type=BT_VIP_Sensor_betaetigt, compu {0=Cx0_Heckentr_VIP_nicht_angefordert (CM_VIP_Sensor_betaetigt_Cx0_Heckentr_VIP_nicht_angefordert), 1=Cx1_Heckentr_VIP_angefordert (CM_VIP_Sensor_betaetigt_Cx1_Heckentr_VIP_angefordert)}, range raw 0..1, transfer-property=TRIGGERED-WITHOUT-REPETITION  # Heckentriegelung durch die Bedienstelle Virtuelles Pedal(VIP) erkannt. Der VIP Sensor hat eine Fusskickbewegung erkannt und es wurde ein Kessy - Schlüssel im Heckaussenbereich erkannt.
    signal KY_Bereich_XIX_KeylessAccess_01_XIX_VLAN_Cockpit: start 163, 3 bit, little-endian, data-type-policy=OVERRIDE, i-signal-type=PRIMITIVE, init-value=7, base-type=BT_KY_Bereich, compu {4=Cx4_Bereich_4 (CM_KY_Bereich_Cx4_Bereich_4), 0=Cx0_Bereich_0 (CM_KY_Bereich_Cx0_Bereich_0), 5=Cx5_Bereich_5 (CM_KY_Bereich_Cx5_Bereich_5), 7=Cx7_Init (CM_KY_Bereich_Cx7_Init), 3=Cx3_Bereich_3 (CM_KY_Bereich_Cx3_Bereich_3), 6=Cx6_Kein_Schluessel_gefunden (CM_KY_Bereich_Cx6_Kein_Schluessel_gefunden), 1=Cx1_Bereich_1 (CM_KY_Bereich_Cx1_Bereich_1), 2=Cx2_Bereich_2 (CM_KY_Bereich_Cx2_Bereich_2)}, range raw 0..7, transfer-property=TRIGGERED-WITHOUT-REPETITION  # Schlüsselentfernung für Funktionen Annäherungslicht, automatisches Entriegeln
    signal FBS_KSY_ID_active_XIX_KeylessAccess_01_XIX_VLAN_Cockpit: start 168, 4 bit, little-endian, data-type-policy=OVERRIDE, i-signal-type=PRIMITIVE, init-value=0, base-type=BT_FBS_KSY_ID_active, compu {11=Cxb_S_device_03 (CM_FBS_KSY_ID_active_Cxb_S_device_03), 13=Cxd_S_device_05 (CM_FBS_KSY_ID_active_Cxd_S_device_05), 10=Cxa_S_device_02 (CM_FBS_KSY_ID_active_Cxa_S_device_02), 5=Cx5_ID_device_05 (CM_FBS_KSY_ID_active_Cx5_ID_device_05), 8=Cx8_ID_device_08 (CM_FBS_KSY_ID_active_Cx8_ID_device_08), 12=Cxc_S_device_04 (CM_FBS_KSY_ID_active_Cxc_S_device_04), 6=Cx6_ID_device_06 (CM_FBS_KSY_ID_active_Cx6_ID_device_06), 1=Cx1_ID_device_01 (CM_FBS_KSY_ID_active_Cx1_ID_device_01), 2=Cx2_ID_device_02 (CM_FBS_KSY_ID_active_Cx2_ID_device_02), 15=Cxf_S_device_07 (CM_FBS_KSY_ID_active_Cxf_S_device_07), 3=Cx3_ID_device_03 (CM_FBS_KSY_ID_active_Cx3_ID_device_03), 0=Cx0_Init (CM_FBS_KSY_ID_active_Cx0_Init), 4=Cx4_ID_device_04 (CM_FBS_KSY_ID_active_Cx4_ID_device_04), 9=Cx9_S_device_01 (CM_FBS_KSY_ID_active_Cx9_S_device_01), 7=Cx7_ID_device_07 (CM_FBS_KSY_ID_active_Cx7_ID_device_07), 14=Cxe_S_device_06 (CM_FBS_KSY_ID_active_Cxe_S_device_06)}, range raw 0..15, transfer-property=TRIGGERED-WITHOUT-REPETITION  # active ID- or smart device
    signal WLC_laden_unterbrechen_XIX_KeylessAccess_01_XIX_VLAN_Cockpit: start 175, 1 bit, little-endian, data-type-policy=OVERRIDE, i-signal-type=PRIMITIVE, init-value=0, base-type=BT_WLC_laden_unterbrechen, compu {1=Cx1_Laden_unterbrechen (CM_WLC_laden_unterbrechen_Cx1_Laden_unterbrechen), 0=Cx0_Laden_nicht_unterbrechen (CM_WLC_laden_unterbrechen_Cx0_Laden_nicht_unterbrechen)}, range raw 0..1, transfer-property=TRIGGERED-WITHOUT-REPETITION  # Kommunikation zur Phonebox, das Laden zu unterbrechen
    signal KST_Wegstrecke_Challenge_XIX_KeylessAccess_01_XIX_VLAN_Cockpit: start 176, 20 bit, little-endian, data-type-policy=OVERRIDE, i-signal-type=PRIMITIVE, init-value=0, base-type=BT_KST_Wegstrecke_Challenge, compu {0=Cx0_Init (CM_KST_Wegstrecke_Challenge_Cx0_Init)}, range raw 0, transfer-property=TRIGGERED-WITHOUT-REPETITION  # Wegstreckenchallenge ans Kombi und ESC
    signal FBS_Anf_Start_Auth_XIX_KeylessAccess_01_XIX_VLAN_Cockpit: start 196, 1 bit, little-endian, data-type-policy=OVERRIDE, i-signal-type=PRIMITIVE, init-value=0, base-type=BT_FBS_Anf_Start_Auth, compu {0=Cx0_Init_kein_Auth_Request (CM_FBS_Anf_Start_Auth_Cx0_Init_kein_Auth_Request), 1=Cx1_Auth_Request (CM_FBS_Anf_Start_Auth_Cx1_Auth_Request)}, range raw 0..1, transfer-property=TRIGGERED-WITHOUT-REPETITION  # Trigger um Authentifikation zu starten
    signal FBS_KSY_easy_close1_XIX_KeylessAccess_01_XIX_VLAN_Cockpit: start 204, 3 bit, little-endian, data-type-policy=OVERRIDE, i-signal-type=PRIMITIVE, init-value=0, base-type=BT_FBS_KSY_easy_close1, compu {1=Cx1_Lampe_Aus (CM_FBS_KSY_easy_close1_Cx1_Lampe_Aus), 6=Cx6_easy_close_kein_Abbruch (CM_FBS_KSY_easy_close1_Cx6_easy_close_kein_Abbruch), 7=Cx7_easy_close_Abbruch (CM_FBS_KSY_easy_close1_Cx7_easy_close_Abbruch), 0=Cx0_Init (CM_FBS_KSY_easy_close1_Cx0_Init), 2=Cx2_Lampe_Ein (CM_FBS_KSY_easy_close1_Cx2_Lampe_Ein), 5=Cx5_Akustik_Verweigerung (CM_FBS_KSY_easy_close1_Cx5_Akustik_Verweigerung), 4=Cx4_Lampe_Hektik (CM_FBS_KSY_easy_close1_Cx4_Lampe_Hektik), 3=Cx3_Lampe_Normal (CM_FBS_KSY_easy_close1_Cx3_Lampe_Normal)}, range raw 0..7, transfer-property=TRIGGERED-WITHOUT-REPETITION  # Schliessende Heckklappe mittels Easy Close Funktion
    signal NFC_TGS_Kapa_deaktivieren_XIX_KeylessAccess_01_XIX_VLAN_Cockpit: start 207, 1 bit, little-endian, data-type-policy=OVERRIDE, i-signal-type=PRIMITIVE, init-value=0, base-type=BT_NFC_TGS_Kapa_deaktivieren, compu {1=Cx1_Deaktivierung (CM_NFC_TGS_Kapa_deaktivieren_Cx1_Deaktivierung), 0=Cx0_keine_Deaktivierung (CM_NFC_TGS_Kapa_deaktivieren_Cx0_keine_Deaktivierung)}, range raw 0..1, transfer-property=TRIGGERED-WITHOUT-REPETITION  # Deaktiviert den Kapa-Sensor im eTAB
    signal FBS_MDK_BLE_lock_sensor_auth_XIX_KeylessAccess_01_XIX_VLAN_Cockpit: start 208, 4 bit, little-endian, data-type-policy=OVERRIDE, i-signal-type=PRIMITIVE, init-value=0, base-type=BT_FBS_MDK_BLE_lock_sensor_auth, compu {12=Cxc_ctrl_D_authorized (CM_FBS_MDK_BLE_lock_sensor_auth_Cxc_ctrl_D_authorized), 4=Cx4_RCDD_lock_authorized (CM_FBS_MDK_BLE_lock_sensor_auth_Cx4_RCDD_lock_authorized), 8=Cx8_charge_terminal2_lock_auth (CM_FBS_MDK_BLE_lock_sensor_auth_Cx8_charge_terminal2_lock_auth), 15=Cxf_ctrl_G_authorized (CM_FBS_MDK_BLE_lock_sensor_auth_Cxf_ctrl_G_authorized), 14=Cxe_ctrl_F_authorized (CM_FBS_MDK_BLE_lock_sensor_auth_Cxe_ctrl_F_authorized), 3=Cx3_RDD_lock_authorized (CM_FBS_MDK_BLE_lock_sensor_auth_Cx3_RDD_lock_authorized), 7=Cx7_charge_terminal1_lock_auth (CM_FBS_MDK_BLE_lock_sensor_auth_Cx7_charge_terminal1_lock_auth), 10=Cxa_ctrl_B_authorized (CM_FBS_MDK_BLE_lock_sensor_auth_Cxa_ctrl_B_authorized), 11=Cxb_ctrl_C_authorized (CM_FBS_MDK_BLE_lock_sensor_auth_Cxb_ctrl_C_authorized), 9=Cx9_ctrl_A_authorized (CM_FBS_MDK_BLE_lock_sensor_auth_Cx9_ctrl_A_authorized), 1=Cx1_DD_lock_authorized (CM_FBS_MDK_BLE_lock_sensor_auth_Cx1_DD_lock_authorized), 13=Cxd_ctrl_E_authorized (CM_FBS_MDK_BLE_lock_sensor_auth_Cxd_ctrl_E_authorized), 5=Cx5_rear_trunk_lock_authorized (CM_FBS_MDK_BLE_lock_sensor_auth_Cx5_rear_trunk_lock_authorized), 2=Cx2_CDD_lock_authorized (CM_FBS_MDK_BLE_lock_sensor_auth_Cx2_CDD_lock_authorized), 0=Cx0_no_lock_authorized (CM_FBS_MDK_BLE_lock_sensor_auth_Cx0_no_lock_authorized), 6=Cx6_front_trunk_lock_authorized (CM_FBS_MDK_BLE_lock_sensor_auth_Cx6_front_trunk_lock_authorized)}, range raw 0..15, transfer-property=TRIGGERED-WITHOUT-REPETITION  # Autorisierung einer Verriegelung an MDK-Bedienstelle (BLE)
    signal FBS_MDK_BLE_unlock_sensor_auth_XIX_KeylessAccess_01_XIX_VLAN_Cockpit: start 212, 4 bit, little-endian, data-type-policy=OVERRIDE, i-signal-type=PRIMITIVE, init-value=0, base-type=BT_FBS_MDK_BLE_unlock_sensor_auth, compu {4=Cx4_RCDD_unlock_authorized (CM_FBS_MDK_BLE_unlock_sensor_auth_Cx4_RCDD_unlock_authorized), 7=Cx7_charge_terminal1_unlock_auth (CM_FBS_MDK_BLE_unlock_sensor_auth_Cx7_charge_terminal1_unlock_auth), 11=Cxb_ctrl_C_authorized (CM_FBS_MDK_BLE_unlock_sensor_auth_Cxb_ctrl_C_authorized), 9=Cx9_ctrl_A_authorized (CM_FBS_MDK_BLE_unlock_sensor_auth_Cx9_ctrl_A_authorized), 3=Cx3_RDD_unlock_authorized (CM_FBS_MDK_BLE_unlock_sensor_auth_Cx3_RDD_unlock_authorized), 6=Cx6_front_trunk_unlock_authorized (CM_FBS_MDK_BLE_unlock_sensor_auth_Cx6_front_trunk_unlock_authorized), 14=Cxe_ctrl_F_authorized (CM_FBS_MDK_BLE_unlock_sensor_auth_Cxe_ctrl_F_authorized), 0=Cx0_no_unlock_authorized (CM_FBS_MDK_BLE_unlock_sensor_auth_Cx0_no_unlock_authorized), 10=Cxa_ctrl_B_authorized (CM_FBS_MDK_BLE_unlock_sensor_auth_Cxa_ctrl_B_authorized), 13=Cxd_ctrl_E_authorized (CM_FBS_MDK_BLE_unlock_sensor_auth_Cxd_ctrl_E_authorized), 1=Cx1_DD_unlock_authorized (CM_FBS_MDK_BLE_unlock_sensor_auth_Cx1_DD_unlock_authorized), 2=Cx2_CDD_unlock_authorized (CM_FBS_MDK_BLE_unlock_sensor_auth_Cx2_CDD_unlock_authorized), 8=Cx8_charge_terminal2_unlock_auth (CM_FBS_MDK_BLE_unlock_sensor_auth_Cx8_charge_terminal2_unlock_auth), 12=Cxc_ctrl_D_authorized (CM_FBS_MDK_BLE_unlock_sensor_auth_Cxc_ctrl_D_authorized), 5=Cx5_rear_trunk_unlock_authorized (CM_FBS_MDK_BLE_unlock_sensor_auth_Cx5_rear_trunk_unlock_authorized), 15=Cxf_ctrl_G_authorized (CM_FBS_MDK_BLE_unlock_sensor_auth_Cxf_ctrl_G_authorized)}, range raw 0..15, transfer-property=TRIGGERED-WITHOUT-REPETITION  # Autorisierung einer Entriegelung an MDK-Bedienstelle (BLE)
    signal FBS_MDK_NFC_lock_sensor_auth_XIX_KeylessAccess_01_XIX_VLAN_Cockpit: start 216, 4 bit, little-endian, data-type-policy=OVERRIDE, i-signal-type=PRIMITIVE, init-value=0, base-type=BT_FBS_MDK_NFC_lock_sensor_auth, compu {12=Cxc_ctrl_D_authorized (CM_FBS_MDK_NFC_lock_sensor_auth_Cxc_ctrl_D_authorized), 13=Cxd_ctrl_E_authorized (CM_FBS_MDK_NFC_lock_sensor_auth_Cxd_ctrl_E_authorized), 6=Cx6_front_trunk_lock_authorized (CM_FBS_MDK_NFC_lock_sensor_auth_Cx6_front_trunk_lock_authorized), 8=Cx8_charge_terminal2_lock_auth (CM_FBS_MDK_NFC_lock_sensor_auth_Cx8_charge_terminal2_lock_auth), 2=Cx2_CDD_lock_authorized (CM_FBS_MDK_NFC_lock_sensor_auth_Cx2_CDD_lock_authorized), 1=Cx1_DD_lock_authorized (CM_FBS_MDK_NFC_lock_sensor_auth_Cx1_DD_lock_authorized), 7=Cx7_charge_terminal1_lock_auth (CM_FBS_MDK_NFC_lock_sensor_auth_Cx7_charge_terminal1_lock_auth), 5=Cx5_rear_trunk_lock_authorized (CM_FBS_MDK_NFC_lock_sensor_auth_Cx5_rear_trunk_lock_authorized), 11=Cxb_ctrl_C_authorized (CM_FBS_MDK_NFC_lock_sensor_auth_Cxb_ctrl_C_authorized), 14=Cxe_ctrl_F_authorized (CM_FBS_MDK_NFC_lock_sensor_auth_Cxe_ctrl_F_authorized), 3=Cx3_RDD_lock_authorized (CM_FBS_MDK_NFC_lock_sensor_auth_Cx3_RDD_lock_authorized), 0=Cx0_no_lock_authorized (CM_FBS_MDK_NFC_lock_sensor_auth_Cx0_no_lock_authorized), 9=Cx9_ctrl_A_authorized (CM_FBS_MDK_NFC_lock_sensor_auth_Cx9_ctrl_A_authorized), 4=Cx4_RCDD_lock_authorized (CM_FBS_MDK_NFC_lock_sensor_auth_Cx4_RCDD_lock_authorized), 15=Cxf_ctrl_G_authorized (CM_FBS_MDK_NFC_lock_sensor_auth_Cxf_ctrl_G_authorized), 10=Cxa_ctrl_B_authorized (CM_FBS_MDK_NFC_lock_sensor_auth_Cxa_ctrl_B_authorized)}, range raw 0..15, transfer-property=TRIGGERED-WITHOUT-REPETITION  # Autorisierung einer Verriegelung an MDK-Bedienstelle (NFC)
    signal FBS_MDK_NFC_unlock_sensor_auth_XIX_KeylessAccess_01_XIX_VLAN_Cockpit: start 220, 4 bit, little-endian, data-type-policy=OVERRIDE, i-signal-type=PRIMITIVE, init-value=0, base-type=BT_FBS_MDK_NFC_unlock_sensor_auth, compu {11=Cxb_ctrl_C_authorized (CM_FBS_MDK_NFC_unlock_sensor_auth_Cxb_ctrl_C_authorized), 14=Cxe_ctrl_F_authorized (CM_FBS_MDK_NFC_unlock_sensor_auth_Cxe_ctrl_F_authorized), 9=Cx9_ctrl_A_authorized (CM_FBS_MDK_NFC_unlock_sensor_auth_Cx9_ctrl_A_authorized), 1=Cx1_DD_unlock_authorized (CM_FBS_MDK_NFC_unlock_sensor_auth_Cx1_DD_unlock_authorized), 10=Cxa_ctrl_B_authorized (CM_FBS_MDK_NFC_unlock_sensor_auth_Cxa_ctrl_B_authorized), 3=Cx3_RDD_unlock_authorized (CM_FBS_MDK_NFC_unlock_sensor_auth_Cx3_RDD_unlock_authorized), 2=Cx2_CDD_unlock_authorized (CM_FBS_MDK_NFC_unlock_sensor_auth_Cx2_CDD_unlock_authorized), 12=Cxc_ctrl_D_authorized (CM_FBS_MDK_NFC_unlock_sensor_auth_Cxc_ctrl_D_authorized), 8=Cx8_charge_terminal2_unlock_auth (CM_FBS_MDK_NFC_unlock_sensor_auth_Cx8_charge_terminal2_unlock_auth), 4=Cx4_RCDD_unlock_authorized (CM_FBS_MDK_NFC_unlock_sensor_auth_Cx4_RCDD_unlock_authorized), 0=Cx0_no_unlock_authorized (CM_FBS_MDK_NFC_unlock_sensor_auth_Cx0_no_unlock_authorized), 7=Cx7_charge_terminal1_unlock_auth (CM_FBS_MDK_NFC_unlock_sensor_auth_Cx7_charge_terminal1_unlock_auth), 6=Cx6_front_trunk_unlock_authorized (CM_FBS_MDK_NFC_unlock_sensor_auth_Cx6_front_trunk_unlock_authorized), 13=Cxd_ctrl_E_authorized (CM_FBS_MDK_NFC_unlock_sensor_auth_Cxd_ctrl_E_authorized), 5=Cx5_rear_trunk_unlock_authorized (CM_FBS_MDK_NFC_unlock_sensor_auth_Cx5_rear_trunk_unlock_authorized), 15=Cxf_ctrl_G_authorized (CM_FBS_MDK_NFC_unlock_sensor_auth_Cxf_ctrl_G_authorized)}, range raw 0..15, transfer-property=TRIGGERED-WITHOUT-REPETITION  # Autorisierung einer Entriegelung an MDK-Bedienstelle (NFC)
    signal FBS_MDK_button_XIX_KeylessAccess_01_XIX_VLAN_Cockpit: start 224, 8 bit, little-endian, data-type-policy=OVERRIDE, i-signal-type=PRIMITIVE, init-value=0, base-type=BT_FBS_MDK_button, compu {10=Cxa_close_convertible (CM_FBS_MDK_button_Cxa_close_convertible), 3=Cx3_rear_trunk (CM_FBS_MDK_button_Cx3_rear_trunk), 8=Cx8_remotestart (CM_FBS_MDK_button_Cx8_remotestart), 9=Cx9_open_convertible (CM_FBS_MDK_button_Cx9_open_convertible), 5=Cx5_panic (CM_FBS_MDK_button_Cx5_panic), 0=Cx0_no_command (CM_FBS_MDK_button_Cx0_no_command), 2=Cx2_lock (CM_FBS_MDK_button_Cx2_lock), 7=Cx7_park (CM_FBS_MDK_button_Cx7_park), 4=Cx4_front_trunk (CM_FBS_MDK_button_Cx4_front_trunk), 6=Cx6_joker (CM_FBS_MDK_button_Cx6_joker), 1=Cx1_unlock (CM_FBS_MDK_button_Cx1_unlock)}, range raw 0..10, transfer-property=TRIGGERED-WITHOUT-REPETITION  # smart device button pressed signalling for remote keyless entry
  pdu KN_AMP_XIX_VLAN_Cockpit: length=16, transmission-mode-true-timing=cyclic-timing={time-offset=0.0, time-period=0.5}, unused-bit-pattern=0
    signal AMP_KompSchutz_XIX_KN_AMP_XIX_VLAN_Cockpit: start 0, 1 bit, little-endian, data-type-policy=OVERRIDE, i-signal-type=PRIMITIVE, init-value=0, base-type=BT_AMP_KompSchutz, compu {0=Cx0_inaktiv (CM_AMP_KompSchutz_Cx0_inaktiv), 1=Cx1_aktiv (CM_AMP_KompSchutz_Cx1_aktiv)}, range raw 0..1, transfer-property=PENDING  # Funktionseinschränkung aufgrund Komponentenschutz aktiv
    signal AMP_Nachlauftyp_XIX_KN_AMP_XIX_VLAN_Cockpit: start 4, 4 bit, little-endian, data-type-policy=OVERRIDE, i-signal-type=PRIMITIVE, init-value=2, base-type=BT_AMP_Nachlauftyp, compu {1=Cx1_Komm_nach_KL15_AUS (CM_AMP_Nachlauftyp_Cx1_Komm_nach_KL15_AUS), 2=Cx2_Komm_bei_KL15_AUS (CM_AMP_Nachlauftyp_Cx2_Komm_bei_KL15_AUS), 4=Cx4_Buskopplung (CM_AMP_Nachlauftyp_Cx4_Buskopplung), 0=Cx0_Komm_bei_KL15_EIN (CM_AMP_Nachlauftyp_Cx0_Komm_bei_KL15_EIN)}, range raw 0..4, transfer-property=PENDING, to HCP3_IONode(timeout 5 s)  # Abgebildet wird die von der Hardware vorgegebene Möglichkeit, die Kommunikation nach Klemme 15 = AUS aufrecht zu erhalten. Es wird ein Init-Wert gesendet.
    signal AMP_SNI_10_XIX_KN_AMP_XIX_VLAN_Cockpit: start 8, 10 bit, little-endian, data-type-policy=OVERRIDE, i-signal-type=PRIMITIVE, init-value=111, base-type=BT_AMP_SNI_10, compu {phys=raw for raw 0..1023}, range phys 0..1023, raw 0..1023, transfer-property=PENDING, to HCP3_IONode(timeout 5 s)  # Source Node-Identifier (SNI) identifiziert den Sender der NM-Botschaft (Knotenadresse) eindeutig im Fahrzeug
    signal KN_AMP_ECUKnockOut_XIX_KN_AMP_XIX_VLAN_Cockpit: start 18, 2 bit, little-endian, data-type-policy=OVERRIDE, i-signal-type=PRIMITIVE, init-value=0, base-type=BT_KN_AMP_ECUKnockOut, compu {3=Cx3_Funktion_deaktiviert (CM_KN_AMP_ECUKnockOut_Cx3_Funktion_deaktiviert), 0=Cx0_Funktion_nicht_ausgeloest (CM_KN_AMP_ECUKnockOut_Cx0_Funktion_nicht_ausgeloest), 1=Cx1_Veto_war_aktiv (CM_KN_AMP_ECUKnockOut_Cx1_Veto_war_aktiv), 2=Cx2_Funktion_ausgeloest (CM_KN_AMP_ECUKnockOut_Cx2_Funktion_ausgeloest)}, range raw 0..3, transfer-property=PENDING  # Ausgabe des ECUKnockout-Status
    signal KN_AMP_DiagPfad_V12_XIX_KN_AMP_XIX_VLAN_Cockpit: start 20, 1 bit, little-endian, data-type-policy=OVERRIDE, i-signal-type=PRIMITIVE, init-value=0, base-type=BT_KN_AMP_DiagPfad_V12, compu {1=Cx1_inaktiv (CM_KN_AMP_DiagPfad_V12_Cx1_inaktiv), 0=Cx0_Aktiv (CM_KN_AMP_DiagPfad_V12_Cx0_Aktiv)}, range raw 0..1, transfer-property=PENDING, to HCP3_IONode(timeout 5 s)  # Kennzeichnung der Diagnosefaehigkeit des BusInterfaces eines Steuergeraetes (Knoten) Umfang LAH 80127 Bei Nutzung des Signal explizit pro angebundenem BusInterface zu setzen
    signal AMP_KD_Fehler_XIX_KN_AMP_XIX_VLAN_Cockpit: start 23, 1 bit, little-endian, data-type-policy=OVERRIDE, i-signal-type=PRIMITIVE, init-value=0, base-type=BT_AMP_KD_Fehler, compu {1=Cx1_KD_Fehler (CM_AMP_KD_Fehler_Cx1_KD_Fehler), 0=Cx0_Kein_KD_Fehler (CM_AMP_KD_Fehler_Cx0_Kein_KD_Fehler) (Kein KD_Fehler)}, range raw 0..1, transfer-property=PENDING, to HCP3_IONode(timeout 2.5 s)  # Bei gesetztem Bit ist mindestens ein Kundendienstfehler eingetragen
    signal KN_AMP_ECUKnockOutTimer_XIX_KN_AMP_XIX_VLAN_Cockpit: start 24, 6 bit, little-endian, data-type-policy=OVERRIDE, i-signal-type=PRIMITIVE, init-value=15, base-type=BT_KN_AMP_ECUKnockOutTimer, compu {phys=raw for raw 0..62, 63=Cx3f_ECUKnockOut_deaktiviert (CM_KN_AMP_ECUKnockOutTimer_Cx3f_ECUKnockOut_deaktiviert)}, range phys 0..62, raw 0..63, transfer-property=PENDING  # Ausgabe des ECUKnockOut-Timer
    signal KN_AMP_BusKnockOut_XIX_KN_AMP_XIX_VLAN_Cockpit: start 30, 2 bit, little-endian, data-type-policy=OVERRIDE, i-signal-type=PRIMITIVE, init-value=0, base-type=BT_KN_AMP_BusKnockOut, compu {0=Cx0_Funktion_nicht_ausgeloest (CM_KN_AMP_BusKnockOut_Cx0_Funktion_nicht_ausgeloest), 2=Cx2_Funktion_ausgeloest (CM_KN_AMP_BusKnockOut_Cx2_Funktion_ausgeloest), 3=Cx3_Funktion_deaktiviert (CM_KN_AMP_BusKnockOut_Cx3_Funktion_deaktiviert), 1=Cx1_Veto_aktiv (CM_KN_AMP_BusKnockOut_Cx1_Veto_aktiv)}, range raw 0..3, transfer-property=PENDING  # Ausgabe des BusKnockout-Status
    signal KN_AMP_BusKnockOutTimer_XIX_KN_AMP_XIX_VLAN_Cockpit: start 32, 8 bit, little-endian, data-type-policy=OVERRIDE, i-signal-type=PRIMITIVE, init-value=15, base-type=BT_KN_AMP_BusKnockOutTimer, compu {phys=raw for raw 0..254, 255=Cxff_BusKnockOut_deaktiviert (CM_KN_AMP_BusKnockOutTimer_Cxff_BusKnockOut_deaktiviert)}, range phys 0..254, raw 0..255, transfer-property=PENDING  # Ausgabe des BusKnockOut-Timer
    signal NM_AMP_FCIB_XIX_KN_AMP_XIX_VLAN_Cockpit: start 40, 56 bit, opaque, data-type-policy=OVERRIDE, i-signal-type=ARRAY, init-value=[1, 0, 1, 0, 0, 8, 0], base-type=BT_NM_AMP_FCIB, compu {70368744177664=Cx400000000000_47_Diagnosis_ComfortLINs (CM_NM_AMP_FCIB_Cx400000000000_47_Diagnosis_ComfortLINs), 131072=Cx20000_18_VirtualSideMirrors (CM_NM_AMP_FCIB_Cx20000_18_VirtualSideMirrors), 140737488355328=Cx800000000000_48_Diagnosis_ClimateTmeLINs (CM_NM_AMP_FCIB_Cx800000000000_48_Diagnosis_ClimateTmeLINs), 8796093022208=Cx80000000000_44_Diagnosis_Infotainment (CM_NM_AMP_FCIB_Cx80000000000_44_Diagnosis_Infotainment), 36028797018963968=Cx80000000000000_56_ChargingStatus (CM_NM_AMP_FCIB_Cx80000000000000_56_ChargingStatus), 1073741824=Cx40000000_31_MultifunctionalSteeringWheel (CM_NM_AMP_FCIB_Cx40000000_31_MultifunctionalSteeringWheel), 4096=Cx1000_13_Airbag (CM_NM_AMP_FCIB_Cx1000_13_Airbag), 2=Cx2_02_Basefunction_Powertrain (CM_NM_AMP_FCIB_Cx2_02_Basefunction_Powertrain), 134217728=Cx8000000_28_OnboardTester_DataCollector (CM_NM_AMP_FCIB_Cx8000000_28_OnboardTester_DataCollector), 16777216=Cx1000000_25_AccessSystemSensors (CM_NM_AMP_FCIB_Cx1000000_25_AccessSystemSensors), 68719476736=Cx1000000000_37_HighVoltage_WirelessChargingStation (CM_NM_AMP_FCIB_Cx1000000000_37_HighVoltage_WirelessChargingStation), 16384=Cx4000_15_InstrumentclusterDisplay (CM_NM_AMP_FCIB_Cx4000_15_InstrumentclusterDisplay), 1024=Cx400_11_Chassis (CM_NM_AMP_FCIB_Cx400_11_Chassis), 2097152=Cx200000_22_ExteriorLights (CM_NM_AMP_FCIB_Cx200000_22_ExteriorLights), 4=Cx4_03_Basefunction_Chassis (CM_NM_AMP_FCIB_Cx4_03_Basefunction_Chassis), 268435456=Cx10000000_29_SteeringColumnLock (CM_NM_AMP_FCIB_Cx10000000_29_SteeringColumnLock), 8=Cx8_04_Basefunction_DrivingAssistance (CM_NM_AMP_FCIB_Cx8_04_Basefunction_DrivingAssistance), 33554432=Cx2000000_26_HighVoltage_Charging (CM_NM_AMP_FCIB_Cx2000000_26_HighVoltage_Charging), 17179869184=Cx400000000_35_ExteriorSound (CM_NM_AMP_FCIB_Cx400000000_35_ExteriorSound), 4503599627370496=Cx10000000000000_53_Lock_Unlock (CM_NM_AMP_FCIB_Cx10000000000000_53_Lock_Unlock), 8192=Cx2000_14_InfotainmentExtensions (CM_NM_AMP_FCIB_Cx2000_14_InfotainmentExtensions), 16=Cx10_05_Basefunction_Infotainment (CM_NM_AMP_FCIB_Cx10_05_Basefunction_Infotainment), 262144=Cx40000_19_Doors_Hatches (CM_NM_AMP_FCIB_Cx40000_19_Doors_Hatches), 1=Cx1_01_CarWakeUp (CM_NM_AMP_FCIB_Cx1_01_CarWakeUp), 281474976710656=Cx1000000000000_49_reserved (CM_NM_AMP_FCIB_Cx1000000000000_49_reserved) (49_<reserved>), 4194304=Cx400000_23_Climate (CM_NM_AMP_FCIB_Cx400000_23_Climate), 67108864=Cx4000000_27_Timemaster_Timer (CM_NM_AMP_FCIB_Cx4000000_27_Timemaster_Timer), 128=Cx80_08_Basefunction_Connectivity (CM_NM_AMP_FCIB_Cx80_08_Basefunction_Connectivity), 549755813888=Cx8000000000_40_Diagnosis_Energy (CM_NM_AMP_FCIB_Cx8000000000_40_Diagnosis_Energy), 4398046511104=Cx40000000000_43_Diagnosis_DrivingAssistance (CM_NM_AMP_FCIB_Cx40000000000_43_Diagnosis_DrivingAssistance), 2048=Cx800_12_GearSelector (CM_NM_AMP_FCIB_Cx800_12_GearSelector), 8796093087745=Cx80000010001_InitValueFCIB (CM_NM_AMP_FCIB_Cx80000010001_InitValueFCIB), 2199023255552=Cx20000000000_42_Diagnosis_FlexRay (CM_NM_AMP_FCIB_Cx20000000000_42_Diagnosis_FlexRay), 65536=Cx10000_17_Audio (CM_NM_AMP_FCIB_Cx10000_17_Audio), 32=Cx20_06_Basefunction_ComfortLight (CM_NM_AMP_FCIB_Cx20_06_Basefunction_ComfortLight), 35184372088832=Cx200000000000_46_Diagnosis_Light (CM_NM_AMP_FCIB_Cx200000000000_46_Diagnosis_Light), 32768=Cx8000_16_InfotainmentDisplay (CM_NM_AMP_FCIB_Cx8000_16_InfotainmentDisplay), 512=Cx200_10_Powertrain (CM_NM_AMP_FCIB_Cx200_10_Powertrain), 34359738368=Cx800000000_36_Preheater (CM_NM_AMP_FCIB_Cx800000000_36_Preheater), 2147483648=Cx80000000_32_OnlineAccess (CM_NM_AMP_FCIB_Cx80000000_32_OnlineAccess), 524288=Cx80000_20_OptionalComfort (CM_NM_AMP_FCIB_Cx80000_20_OptionalComfort), 8388608=Cx800000_24_ThermoManagement (CM_NM_AMP_FCIB_Cx800000_24_ThermoManagement), 1048576=Cx100000_21_AirSuspension (CM_NM_AMP_FCIB_Cx100000_21_AirSuspension), 18014398509481984=Cx40000000000000_55_Dimming (CM_NM_AMP_FCIB_Cx40000000000000_55_Dimming), 1099511627776=Cx10000000000_41_Diagnosis_Powertrain (CM_NM_AMP_FCIB_Cx10000000000_41_Diagnosis_Powertrain), 8589934592=Cx200000000_34_GPS_Localization (CM_NM_AMP_FCIB_Cx200000000_34_GPS_Localization), 9007199254740992=Cx20000000000000_54_reserved (CM_NM_AMP_FCIB_Cx20000000000000_54_reserved) (54_<reserved>), 17592186044416=Cx100000000000_45_Diagnosis_Comfort (CM_NM_AMP_FCIB_Cx100000000000_45_Diagnosis_Comfort), 4294967296=Cx100000000_33_ExternalWirelessCommunication (CM_NM_AMP_FCIB_Cx100000000_33_ExternalWirelessCommunication), 64=Cx40_07_Basefunction_CrossSection (CM_NM_AMP_FCIB_Cx40_07_Basefunction_CrossSection), 256=Cx100_09_reserved (CM_NM_AMP_FCIB_Cx100_09_reserved) (09_<reserved>), 536870912=Cx20000000_30_EnergyManagement (CM_NM_AMP_FCIB_Cx20000000_30_EnergyManagement)}, range raw 1..36028797018963968, transfer-property=PENDING  # FCIB = Funktions-Cluster-Initialisierungs-Bits
  pdu KN_HCP3Sys03_XIX_VLAN_Cockpit: length=16, transmission-mode-true-timing=cyclic-timing={time-offset=0.0, time-period=0.5}, unused-bit-pattern=0
    signal HCP3Sys03_SNI_10_XIX_KN_HCP3Sys03_XIX_VLAN_Cockpit: start 8, 10 bit, little-endian, data-type-policy=OVERRIDE, i-signal-type=PRIMITIVE, init-value=304, base-type=BT_HCP3Sys03_SNI_10, compu {phys=raw for raw 0..1023}, range phys 0..1023, raw 0..1023, transfer-property=PENDING, to HCP3_IONode(timeout 5 s)  # Source Node-Identifier (SNI) identifiziert den Sender der NM-Botschaft (Knotenadresse) eindeutig im Fahrzeug
    signal KN_HCP3Sys03_DiagPfad_V12_XIX_KN_HCP3Sys03_XIX_VLAN_Cockpit: start 20, 1 bit, little-endian, data-type-policy=OVERRIDE, i-signal-type=PRIMITIVE, init-value=0, base-type=BT_KN_HCP3Sys03_DiagPfad_V12, compu {0=Cx0_Aktiv (CM_KN_HCP3Sys03_DiagPfad_V12_Cx0_Aktiv), 1=Cx1_inaktiv (CM_KN_HCP3Sys03_DiagPfad_V12_Cx1_inaktiv)}, range raw 0..1, transfer-property=PENDING, to HCP3_IONode(timeout 5 s)  # Kennzeichnung der Diagnosefaehigkeit des BusInterfaces eines Steuergeraetes (Knoten) Umfang LAH 80127 Bei Nutzung des Signal explizit pro angebundenem BusInterface zu setzen
    signal HCP3Sys03_KD_Fehler_XIX_KN_HCP3Sys03_XIX_VLAN_Cockpit: start 23, 1 bit, little-endian, data-type-policy=OVERRIDE, i-signal-type=PRIMITIVE, init-value=0, base-type=BT_HCP3Sys03_KD_Fehler, compu {1=Cx1_KD_Fehler (CM_HCP3Sys03_KD_Fehler_Cx1_KD_Fehler), 0=Cx0_Kein_KD_Fehler (CM_HCP3Sys03_KD_Fehler_Cx0_Kein_KD_Fehler)}, range raw 0..1, transfer-property=PENDING, to HCP3_IONode(timeout 5 s)  # Bei gesetztem Bit ist mindestens ein Kundendienstfehler eingetragen
  pdu KN_ICAS3Sys01_XIX_VLAN_Cockpit: length=16, transmission-mode-true-timing=cyclic-timing={time-offset=0.0, time-period=0.5}, unused-bit-pattern=0
    signal ICAS3Sys01_SNI_10_XIX_KN_ICAS3Sys01_XIX_VLAN_Cockpit: start 8, 10 bit, little-endian, data-type-policy=OVERRIDE, i-signal-type=PRIMITIVE, init-value=264, base-type=BT_ICAS3Sys01_SNI_10, compu {phys=raw for raw 0..1023}, range phys 0..1023, raw 0..1023, transfer-property=PENDING, to HCP3_IONode(timeout 5 s)  # Source Node-Identifier (SNI) identifiziert den Sender der NM-Botschaft (Knotenadresse) eindeutig im Fahrzeug
    signal KN_ICAS3Sys01_DiagPfad_V12_XIX_KN_ICAS3Sys01_XIX_VLAN_Cockpit: start 20, 1 bit, little-endian, data-type-policy=OVERRIDE, i-signal-type=PRIMITIVE, init-value=0, base-type=BT_KN_ICAS3Sys01_DiagPfad_V12, compu {0=Cx0_Aktiv (CM_KN_ICAS3Sys01_DiagPfad_V12_Cx0_Aktiv), 1=Cx1_inaktiv (CM_KN_ICAS3Sys01_DiagPfad_V12_Cx1_inaktiv)}, range raw 0..1, transfer-property=PENDING, to HCP3_IONode(timeout 5 s)  # Kennzeichnung der Diagnosefaehigkeit des BusInterfaces eines Steuergeraetes (Knoten) Umfang LAH 80127 Bei Nutzung des Signal explizit pro angebundenem BusInterface zu setzen
    signal ICAS3Sys01_KD_Fehler_XIX_KN_ICAS3Sys01_XIX_VLAN_Cockpit: start 23, 1 bit, little-endian, data-type-policy=OVERRIDE, i-signal-type=PRIMITIVE, init-value=0, base-type=BT_ICAS3Sys01_KD_Fehler, compu {0=Cx0_Kein_KD_Fehler (CM_ICAS3Sys01_KD_Fehler_Cx0_Kein_KD_Fehler), 1=Cx1_KD_Fehler (CM_ICAS3Sys01_KD_Fehler_Cx1_KD_Fehler)}, range raw 0..1, transfer-property=PENDING, to HCP3_IONode(timeout 2.5 s)  # Bei gesetztem Bit ist mindestens ein Kundendienstfehler eingetragen
  pdu KN_Info_El_XIX_VLAN_Cockpit: length=16, transmission-mode-true-timing=cyclic-timing={time-offset=0.0, time-period=0.5}, unused-bit-pattern=0
    signal Info_El_Nachlauftyp_XIX_KN_Info_El_XIX_VLAN_Cockpit: start 4, 4 bit, little-endian, data-type-policy=OVERRIDE, i-signal-type=PRIMITIVE, init-value=2, base-type=BT_Info_El_Nachlauftyp, compu {0=Cx0_Komm_bei_KL15_EIN (CM_Info_El_Nachlauftyp_Cx0_Komm_bei_KL15_EIN), 2=Cx2_Komm_bei_KL15_AUS (CM_Info_El_Nachlauftyp_Cx2_Komm_bei_KL15_AUS), 1=Cx1_Komm_nach_KL15_AUS (CM_Info_El_Nachlauftyp_Cx1_Komm_nach_KL15_AUS)}, range raw 0..2, transfer-property=PENDING  # Abgebildet wird die von der Hardware vorgegebene Möglichkeit, die Kommunikation nach Klemme 15 = AUS aufrecht zu erhalten. Es wird ein Init-Wert gesendet.
    signal Info_El_SNI_10_XIX_KN_Info_El_XIX_VLAN_Cockpit: start 8, 10 bit, little-endian, data-type-policy=OVERRIDE, i-signal-type=PRIMITIVE, init-value=115, base-type=BT_Info_El_SNI_10, compu {phys=raw for raw 0..1023}, range phys 0..1023, raw 0..1023, transfer-property=PENDING  # Source Node-Identifier (SNI) identifiziert den Sender der NM-Botschaft (Knotenadresse) eindeutig im Fahrzeug
    signal KN_Info_El_ECUKnockOut_XIX_KN_Info_El_XIX_VLAN_Cockpit: start 18, 2 bit, little-endian, data-type-policy=OVERRIDE, i-signal-type=PRIMITIVE, init-value=0, base-type=BT_KN_Info_El_ECUKnockOut, compu {2=Cx2_Funktion_ausgeloest (CM_KN_Info_El_ECUKnockOut_Cx2_Funktion_ausgeloest), 1=Cx1_Veto_war_aktiv (CM_KN_Info_El_ECUKnockOut_Cx1_Veto_war_aktiv), 0=Cx0_Funktion_nicht_ausgeloest (CM_KN_Info_El_ECUKnockOut_Cx0_Funktion_nicht_ausgeloest), 3=Cx3_Funktion_deaktiviert (CM_KN_Info_El_ECUKnockOut_Cx3_Funktion_deaktiviert)}, range raw 0..3, transfer-property=PENDING  # Ausgabe des ECUKnockout-Status
    signal KN_Info_El_DiagPfad_V12_XIX_KN_Info_El_XIX_VLAN_Cockpit: start 20, 1 bit, little-endian, data-type-policy=OVERRIDE, i-signal-type=PRIMITIVE, base-type=BT_KN_Info_El_DiagPfad_V12, compu {0=Cx0_Aktiv (CM_KN_Info_El_DiagPfad_V12_Cx0_Aktiv), 1=Cx1_inaktiv (CM_KN_Info_El_DiagPfad_V12_Cx1_inaktiv)}, range raw 0..1, transfer-property=PENDING  # Kennzeichnung der Diagnosefaehigkeit des BusInterfaces eines Steuergeraetes (Knoten) Umfang LAH 80127 Bei Nutzung des Signal explizit pro angebundenem BusInterface zu setzen
    signal Info_El_KD_Fehler_XIX_KN_Info_El_XIX_VLAN_Cockpit: start 23, 1 bit, little-endian, data-type-policy=OVERRIDE, i-signal-type=PRIMITIVE, init-value=0, base-type=BT_Info_El_KD_Fehler, compu {0=Cx0_Kein_KD_Fehler (CM_Info_El_KD_Fehler_Cx0_Kein_KD_Fehler), 1=Cx1_KD_Fehler (CM_Info_El_KD_Fehler_Cx1_KD_Fehler)}, range raw 0..1, transfer-property=PENDING  # Bei gesetztem Bit ist mindestens ein Kundendienstfehler eingetragen
    signal KN_Info_El_ECUKnockOutTimer_XIX_KN_Info_El_XIX_VLAN_Cockpit: start 24, 6 bit, little-endian, data-type-policy=OVERRIDE, i-signal-type=PRIMITIVE, init-value=15, base-type=BT_KN_Info_El_ECUKnockOutTimer, compu {phys=raw for raw 0..62, 63=Cx3f_ECUKnockOut_deaktiviert (CM_KN_Info_El_ECUKnockOutTimer_Cx3f_ECUKnockOut_deaktiviert); unit Unit_Minut}, range phys 0..62 Unit_Minut, raw 0..63, unit=Unit_Minut, transfer-property=PENDING  # Ausgabe des ECUKnockOut-Timer
    signal KN_Info_El_BusKnockOut_XIX_KN_Info_El_XIX_VLAN_Cockpit: start 30, 2 bit, little-endian, data-type-policy=OVERRIDE, i-signal-type=PRIMITIVE, init-value=0, base-type=BT_KN_Info_El_BusKnockOut, compu {0=Cx0_Funktion_nicht_ausgeloest (CM_KN_Info_El_BusKnockOut_Cx0_Funktion_nicht_ausgeloest), 2=Cx2_Funktion_ausgeloest (CM_KN_Info_El_BusKnockOut_Cx2_Funktion_ausgeloest), 1=Cx1_Veto_aktiv (CM_KN_Info_El_BusKnockOut_Cx1_Veto_aktiv), 3=Cx3_Funktion_deaktiviert (CM_KN_Info_El_BusKnockOut_Cx3_Funktion_deaktiviert)}, range raw 0..3, transfer-property=PENDING  # Ausgabe des BusKnockout-Status
    signal KN_Info_El_BusKnockOutTimer_XIX_KN_Info_El_XIX_VLAN_Cockpit: start 32, 8 bit, little-endian, data-type-policy=OVERRIDE, i-signal-type=PRIMITIVE, init-value=15, base-type=BT_KN_Info_El_BusKnockOutTimer, compu {phys=raw for raw 0..254, 255=Cxff_BusKnockOut_deaktiviert (CM_KN_Info_El_BusKnockOutTimer_Cxff_BusKnockOut_deaktiviert); unit Unit_Minut}, range phys 0..254 Unit_Minut, raw 0..255, unit=Unit_Minut, transfer-property=PENDING  # Ausgabe des BusKnockOut-Timer
    signal NM_Info_El_FCIB_XIX_KN_Info_El_XIX_VLAN_Cockpit: start 40, 56 bit, opaque, data-type-policy=OVERRIDE, i-signal-type=ARRAY, init-value=[17, 0, 0, 0, 0, 0, 0], base-type=BT_NM_Info_El_FCIB, compu {256=Cx100_09_reserved (CM_NM_Info_El_FCIB_Cx100_09_reserved) (09_<reserved>), 16=Cx10_05_Basefunction_Infotainment (CM_NM_Info_El_FCIB_Cx10_05_Basefunction_Infotainment), 4503599627370496=Cx10000000000000_53_Lock_Unlock (CM_NM_Info_El_FCIB_Cx10000000000000_53_Lock_Unlock), 17=Cx11_InitValueFCIB (CM_NM_Info_El_FCIB_Cx11_InitValueFCIB), 536870912=Cx20000000_30_EnergyManagement (CM_NM_Info_El_FCIB_Cx20000000_30_EnergyManagement), 16777216=Cx1000000_25_AccessSystemSensors (CM_NM_Info_El_FCIB_Cx1000000_25_AccessSystemSensors), 1=Cx1_01_CarWakeUp (CM_NM_Info_El_FCIB_Cx1_01_CarWakeUp), 2199023255552=Cx20000000000_42_Diagnosis_FlexRay (CM_NM_Info_El_FCIB_Cx20000000000_42_Diagnosis_FlexRay), 34359738368=Cx800000000_36_Preheater (CM_NM_Info_El_FCIB_Cx800000000_36_Preheater), 268435456=Cx10000000_29_SteeringColumnLock (CM_NM_Info_El_FCIB_Cx10000000_29_SteeringColumnLock), 2048=Cx800_12_GearSelector (CM_NM_Info_El_FCIB_Cx800_12_GearSelector), 128=Cx80_08_Basefunction_Connectivity (CM_NM_Info_El_FCIB_Cx80_08_Basefunction_Connectivity), 4=Cx4_03_Basefunction_Chassis (CM_NM_Info_El_FCIB_Cx4_03_Basefunction_Chassis), 1048576=Cx100000_21_AirSuspension (CM_NM_Info_El_FCIB_Cx100000_21_AirSuspension), 16384=Cx4000_15_InstrumentclusterDisplay (CM_NM_Info_El_FCIB_Cx4000_15_InstrumentclusterDisplay), 2=Cx2_02_Basefunction_Powertrain (CM_NM_Info_El_FCIB_Cx2_02_Basefunction_Powertrain), 134217728=Cx8000000_28_OnboardTester_DataCollector (CM_NM_Info_El_FCIB_Cx8000000_28_OnboardTester_DataCollector), 17179869184=Cx400000000_35_ExteriorSound (CM_NM_Info_El_FCIB_Cx400000000_35_ExteriorSound), 70368744177664=Cx400000000000_47_Diagnosis_ComfortLINs (CM_NM_Info_El_FCIB_Cx400000000000_47_Diagnosis_ComfortLINs), 4194304=Cx400000_23_Climate (CM_NM_Info_El_FCIB_Cx400000_23_Climate), 281474976710656=Cx1000000000000_49_reserved (CM_NM_Info_El_FCIB_Cx1000000000000_49_reserved) (49_<reserved>), 4096=Cx1000_13_Airbag (CM_NM_Info_El_FCIB_Cx1000_13_Airbag), 140737488355328=Cx800000000000_48_Diagnosis_ClimateTmeLINs (CM_NM_Info_El_FCIB_Cx800000000000_48_Diagnosis_ClimateTmeLINs), 36028797018963968=Cx80000000000000_56_ChargingStatus (CM_NM_Info_El_FCIB_Cx80000000000000_56_ChargingStatus), 2147483648=Cx80000000_32_OnlineAccess (CM_NM_Info_El_FCIB_Cx80000000_32_OnlineAccess), 4398046511104=Cx40000000000_43_Diagnosis_DrivingAssistance (CM_NM_Info_El_FCIB_Cx40000000000_43_Diagnosis_DrivingAssistance), 65536=Cx10000_17_Audio (CM_NM_Info_El_FCIB_Cx10000_17_Audio), 17592186044416=Cx100000000000_45_Diagnosis_Comfort (CM_NM_Info_El_FCIB_Cx100000000000_45_Diagnosis_Comfort), 33554432=Cx2000000_26_HighVoltage_Charging (CM_NM_Info_El_FCIB_Cx2000000_26_HighVoltage_Charging), 549755813888=Cx8000000000_40_Diagnosis_Energy (CM_NM_Info_El_FCIB_Cx8000000000_40_Diagnosis_Energy), 4294967296=Cx100000000_33_ExternalWirelessCommunication (CM_NM_Info_El_FCIB_Cx100000000_33_ExternalWirelessCommunication), 262144=Cx40000_19_Doors_Hatches (CM_NM_Info_El_FCIB_Cx40000_19_Doors_Hatches), 9007199254740992=Cx20000000000000_54_reserved (CM_NM_Info_El_FCIB_Cx20000000000000_54_reserved) (54_<reserved>), 18014398509481984=Cx40000000000000_55_Dimming (CM_NM_Info_El_FCIB_Cx40000000000000_55_Dimming), 32768=Cx8000_16_InfotainmentDisplay (CM_NM_Info_El_FCIB_Cx8000_16_InfotainmentDisplay), 524288=Cx80000_20_OptionalComfort (CM_NM_Info_El_FCIB_Cx80000_20_OptionalComfort), 1073741824=Cx40000000_31_MultifunctionalSteeringWheel (CM_NM_Info_El_FCIB_Cx40000000_31_MultifunctionalSteeringWheel), 512=Cx200_10_Powertrain (CM_NM_Info_El_FCIB_Cx200_10_Powertrain), 1024=Cx400_11_Chassis (CM_NM_Info_El_FCIB_Cx400_11_Chassis), 8388608=Cx800000_24_ThermoManagement (CM_NM_Info_El_FCIB_Cx800000_24_ThermoManagement), 32=Cx20_06_Basefunction_ComfortLight (CM_NM_Info_El_FCIB_Cx20_06_Basefunction_ComfortLight), 35184372088832=Cx200000000000_46_Diagnosis_Light (CM_NM_Info_El_FCIB_Cx200000000000_46_Diagnosis_Light), 8589934592=Cx200000000_34_GPS_Localization (CM_NM_Info_El_FCIB_Cx200000000_34_GPS_Localization), 8=Cx8_04_Basefunction_DrivingAssistance (CM_NM_Info_El_FCIB_Cx8_04_Basefunction_DrivingAssistance), 8192=Cx2000_14_InfotainmentExtensions (CM_NM_Info_El_FCIB_Cx2000_14_InfotainmentExtensions), 68719476736=Cx1000000000_37_HighVoltage_WirelessChargingStation (CM_NM_Info_El_FCIB_Cx1000000000_37_HighVoltage_WirelessChargingStation), 67108864=Cx4000000_27_Timemaster_Timer (CM_NM_Info_El_FCIB_Cx4000000_27_Timemaster_Timer), 64=Cx40_07_Basefunction_CrossSection (CM_NM_Info_El_FCIB_Cx40_07_Basefunction_CrossSection), 8796093022208=Cx80000000000_44_Diagnosis_Infotainment (CM_NM_Info_El_FCIB_Cx80000000000_44_Diagnosis_Infotainment), 131072=Cx20000_18_VirtualSideMirrors (CM_NM_Info_El_FCIB_Cx20000_18_VirtualSideMirrors), 2097152=Cx200000_22_ExteriorLights (CM_NM_Info_El_FCIB_Cx200000_22_ExteriorLights), 1099511627776=Cx10000000000_41_Diagnosis_Powertrain (CM_NM_Info_El_FCIB_Cx10000000000_41_Diagnosis_Powertrain)}, range raw 1..36028797018963968, transfer-property=PENDING  # FCIB = Funktions-Cluster-Initialisierungs-Bits
  pdu MDK_02_XIX_VLAN_Cockpit: length=8, transmission-mode-true-timing=cyclic-timing={time-offset=0.0, time-period=0.2}, unused-bit-pattern=0
    signal MDK_Change_Polling_Mode_XIX_MDK_02_XIX_VLAN_Cockpit: start 12, 4 bit, little-endian, data-type-policy=OVERRIDE, i-signal-type=PRIMITIVE, init-value=0, base-type=BT_MDK_Change_Polling_Mode, compu {1=Cx1_NormalMode (CM_MDK_Change_Polling_Mode_Cx1_NormalMode), 2=Cx2_OwnerPairingMode (CM_MDK_Change_Polling_Mode_Cx2_OwnerPairingMode), 0=Cx0_Init (CM_MDK_Change_Polling_Mode_Cx0_Init)}, range raw 0..2, transfer-property=PENDING  # Trigger um den Polling Modus zu wechseln
    signal MDK_Function_State_XIX_MDK_02_XIX_VLAN_Cockpit: start 16, 2 bit, little-endian, data-type-policy=OVERRIDE, i-signal-type=PRIMITIVE, init-value=0, base-type=BT_MDK_Function_State, compu {0=Cx0_Init (CM_MDK_Function_State_Cx0_Init), 1=Cx1_MDK_aktiviert (CM_MDK_Function_State_Cx1_MDK_aktiviert), 3=Cx3_MDK_auskodiert (CM_MDK_Function_State_Cx3_MDK_auskodiert), 2=Cx2_MDK_deaktiviert (CM_MDK_Function_State_Cx2_MDK_deaktiviert)}, range raw 0..3, transfer-property=PENDING  # Status über die Funktionalität des SW-Moduls MDK.
  pdu MFL_01_XIX_VLAN_Cockpit: length=8, minimum-delay=0.01, transmission-mode-false-timing={cyclic-timing={time-offset=0.0, time-period=0.5}, event-controlled-timing={number-of-repetitions=0, repetition-period=0.0}}, transmission-mode-true-timing={cyclic-timing={time-offset=0.0, time-period=0.03}, event-controlled-timing={number-of-repetitions=0, repetition-period=0.0}}, unused-bit-pattern=0
    transmission-mode-conditions:
      {data-filter={data-filter-type=MASKED-NEW-DIFFERS-X, mask=1, x=0}, i-signal-in-i-pdu=MFL_Tip_Down}
      {data-filter={data-filter-type=MASKED-NEW-DIFFERS-X, mask=1, x=0}, i-signal-in-i-pdu=MFL_Tip_Up}
      {data-filter={data-filter-type=MASKED-NEW-DIFFERS-X, mask=1, x=0}, i-signal-in-i-pdu=MFL_Signalhorn}
    signal MFL_Paddle_Verbau_XIX_MFL_01_XIX_VLAN_Cockpit: start 7, 1 bit, little-endian, data-type-policy=OVERRIDE, i-signal-type=PRIMITIVE, init-value=0, base-type=BT_MFL_Paddle_Verbau, compu {0=Cx0_verbaut (CM_MFL_Paddle_Verbau_Cx0_verbaut), 1=Cx1_nicht_verbaut (CM_MFL_Paddle_Verbau_Cx1_nicht_verbaut)}, range raw 0..1, transfer-property=PENDING, to HCP3_IONode(timeout 5 s)  # Signalisiert den Zustand des Tipp-Paddle-Verbaus
    signal MFL_Tip_Down_XIX_MFL_01_XIX_VLAN_Cockpit: start 48, 1 bit, little-endian, data-type-policy=OVERRIDE, i-signal-type=PRIMITIVE, init-value=0, base-type=BT_MFL_Tip_Down, compu {1=Cx1_betaetigt (CM_MFL_Tip_Down_Cx1_betaetigt), 0=Cx0_nicht_betaetigt (CM_MFL_Tip_Down_Cx0_nicht_betaetigt)}, range raw 0..1, transfer-property=PENDING  # MFL-Tiptronic Tasten vom MFL für Getriebe 0x0 = kein Tip_Down 0x1 = Tip_Down
    signal MFL_Tip_Up_XIX_MFL_01_XIX_VLAN_Cockpit: start 49, 1 bit, little-endian, data-type-policy=OVERRIDE, i-signal-type=PRIMITIVE, init-value=0, base-type=BT_MFL_Tip_Up, compu {1=Cx1_betaetigt (CM_MFL_Tip_Up_Cx1_betaetigt), 0=Cx0_nicht_betaetigt (CM_MFL_Tip_Up_Cx0_nicht_betaetigt)}, range raw 0..1, transfer-property=PENDING  # MFL-Tiptronic Tasten vom MFL für Getriebe 0x0 = kein Tip_Up 0x1 = Tip_Up
    signal MFL_Signalhorn_XIX_MFL_01_XIX_VLAN_Cockpit: start 56, 1 bit, little-endian, data-type-policy=OVERRIDE, i-signal-type=PRIMITIVE, init-value=0, base-type=BT_MFL_Signalhorn, compu {1=Cx1_betaetigt (CM_MFL_Signalhorn_Cx1_betaetigt), 0=Cx0_nicht_betaetigt (CM_MFL_Signalhorn_Cx0_nicht_betaetigt)}, range raw 0..1, transfer-property=TRIGGERED-ON-CHANGE-WITHOUT-REPETITION  # Signalhorn nicht betaetigt/betaetigt
    signal MFL_Tip_links_Err_XIX_MFL_01_XIX_VLAN_Cockpit: start 58, 1 bit, little-endian, data-type-policy=OVERRIDE, i-signal-type=PRIMITIVE, init-value=0, base-type=BT_MFL_Tip_links_Err, invalid-value=Invalid_MFL_Tip_links_Err_XIX_MFL_01_XIX_VLAN_Cockpit:1, compu {1=Cx1_Fehler (CM_MFL_Tip_links_Err_Cx1_Fehler), 0=Cx0_normal (CM_MFL_Tip_links_Err_Cx0_normal)}, range raw 0..1, transfer-property=PENDING  # Tiptronic links Fehler
    signal MFL_Tip_rechts_Err_XIX_MFL_01_XIX_VLAN_Cockpit: start 59, 1 bit, little-endian, data-type-policy=OVERRIDE, i-signal-type=PRIMITIVE, init-value=0, base-type=BT_MFL_Tip_rechts_Err, invalid-value=Invalid_MFL_Tip_rechts_Err_XIX_MFL_01_XIX_VLAN_Cockpit:1, compu {1=Cx1_Fehler (CM_MFL_Tip_rechts_Err_Cx1_Fehler), 0=Cx0_normal (CM_MFL_Tip_rechts_Err_Cx0_normal)}, range raw 0..1, transfer-property=PENDING  # Tiptronic rechts Fehler
  pdu MFL_Tasten_Konzern_XIX_VLAN_Cockpit: length=4, transmission-mode-true-timing=event-controlled-timing={number-of-repetitions=0, repetition-period=0.0}, unused-bit-pattern=0
    signal MFL_Tastencode_1_XIX_MFL_Tasten_Konzern_XIX_VLAN_Cockpit: start 0, 8 bit, little-endian, data-type-policy=OVERRIDE, i-signal-type=PRIMITIVE, init-value=0, base-type=BT_MFL_Tastencode_1, compu {117=Cx75_Launch_Control (CM_MFL_Tastencode_1_Cx75_Launch_Control), 123=Cx7b_Drive_Mode_Button_Select (CM_MFL_Tastencode_1_Cx7b_Drive_Mode_Button_Select), 13=Cxd_Left_Right_ThumbWheel (CM_MFL_Tastencode_1_Cxd_Left_Right_ThumbWheel) (Left__Right_ThumbWheel), 102=Cx66_Turn_signal_left (CM_MFL_Tastencode_1_Cx66_Turn_signal_left), 120=Cx78_Drift_Mode_Button_Select (CM_MFL_Tastencode_1_Cx78_Drift_Mode_Button_Select), 9=Cx9_Main_Menu (CM_MFL_Tastencode_1_Cx9_Main_Menu), 38=Cx26_Rekuperation (CM_MFL_Tastencode_1_Cx26_Rekuperation), 135=Cx87_TC_ESC_Wheel (CM_MFL_Tastencode_1_Cx87_TC_ESC_Wheel), 28=Cx1c_Hook (CM_MFL_Tastencode_1_Cx1c_Hook), 3=Cx3_Menu_Down_Previous_Screen (CM_MFL_Tastencode_1_Cx3_Menu_Down_Previous_Screen) (Menu_Down__Previous_Screen), 125=Cx7d_E_Boost_Button_Decrease (CM_MFL_Tastencode_1_Cx7d_E_Boost_Button_Decrease), 23=Cx17_Arrow_B_Up_Right (CM_MFL_Tastencode_1_Cx17_Arrow_B_Up_Right) (Arrow_B_Up__Right), 41=Cx29_Stopwatch_Start_Stop (CM_MFL_Tastencode_1_Cx29_Stopwatch_Start_Stop), 37=Cx25_Lenkradheizung (CM_MFL_Tastencode_1_Cx25_Lenkradheizung), 109=Cx6d_Wiper_button_right (CM_MFL_Tastencode_1_Cx6d_Wiper_button_right), 133=Cx85_PTV_Wheel (CM_MFL_Tastencode_1_Cx85_PTV_Wheel), 115=Cx73_PTT_special_vehicle (CM_MFL_Tastencode_1_Cx73_PTT_special_vehicle), 0=Cx0_Key_Released_No_Key (CM_MFL_Tastencode_1_Cx0_Key_Released_No_Key) (Key_Released__No_Key), 111=Cx6f_Exhaust_Sound (CM_MFL_Tastencode_1_Cx6f_Exhaust_Sound), 26=Cx1a_PTT_Cancel (CM_MFL_Tastencode_1_Cx1a_PTT_Cancel), 103=Cx67_Turn_signal_right (CM_MFL_Tastencode_1_Cx67_Turn_signal_right), 40=Cx28_DRS_Drag_Reduction_System (CM_MFL_Tastencode_1_Cx28_DRS_Drag_Reduction_System), 5=Cx5_Down (CM_MFL_Tastencode_1_Cx5_Down), 101=Cx65_MAP_Boost (CM_MFL_Tastencode_1_Cx65_MAP_Boost), 22=Cx16_Arrow_A_Down_Left (CM_MFL_Tastencode_1_Cx16_Arrow_A_Down_Left) (Arrow_A_Down__Left), 34=Cx22_Joker2 (CM_MFL_Tastencode_1_Cx22_Joker2), 136=Cx88_TC_ESC_Button (CM_MFL_Tastencode_1_Cx88_TC_ESC_Button), 32=Cx20_Mute (CM_MFL_Tastencode_1_Cx20_Mute), 118=Cx76_Drift_Mode_Button_Increase (CM_MFL_Tastencode_1_Cx76_Drift_Mode_Button_Increase), 113=Cx71_Sport_button (CM_MFL_Tastencode_1_Cx71_Sport_button), 35=Cx23_View (CM_MFL_Tastencode_1_Cx23_View), 39=Cx27_Tube_Toggle (CM_MFL_Tastencode_1_Cx27_Tube_Toggle), 127=Cx7f_PerformanceHybridButton_Increase (CM_MFL_Tastencode_1_Cx7f_PerformanceHybridButton_Increase), 116=Cx74_TravelAssist (CM_MFL_Tastencode_1_Cx74_TravelAssist), 10=Cxa_Side_Menu_left (CM_MFL_Tastencode_1_Cxa_Side_Menu_left), 241=Cxf1_Initialization (CM_MFL_Tastencode_1_Cxf1_Initialization), 110=Cx6e_Wiper_button_cancel (CM_MFL_Tastencode_1_Cx6e_Wiper_button_cancel), 112=Cx70_Drive_Select_button (CM_MFL_Tastencode_1_Cx70_Drive_Select_button), 31=Cx1f_Light_On_Off (CM_MFL_Tastencode_1_Cx1f_Light_On_Off) (Light_On__Off), 36=Cx24_Arrow_A_Up_Down_ThumbWheel (CM_MFL_Tastencode_1_Cx24_Arrow_A_Up_Down_ThumbWheel) (Arrow_A_Up__Down_ThumbWheel), 11=Cxb_Side_Menu_right (CM_MFL_Tastencode_1_Cxb_Side_Menu_right), 100=Cx64_MAP (CM_MFL_Tastencode_1_Cx64_MAP), 18=Cx12_Volume_Up_Down_ThumbWheel (CM_MFL_Tastencode_1_Cx12_Volume_Up_Down_ThumbWheel) (Volume_Up__Down_ThumbWheel), 129=Cx81_EV_Mode_Button (CM_MFL_Tastencode_1_Cx81_EV_Mode_Button), 20=Cx14_Audio_Source (CM_MFL_Tastencode_1_Cx14_Audio_Source), 42=Cx2a_Stopwatch_Nextlap (CM_MFL_Tastencode_1_Cx2a_Stopwatch_Nextlap), 6=Cx6_Up_Down_ThumbWheel (CM_MFL_Tastencode_1_Cx6_Up_Down_ThumbWheel) (Up__Down_ThumbWheel), 25=Cx19_PTT_PushToTalk (CM_MFL_Tastencode_1_Cx19_PTT_PushToTalk) (PTT__PushToTalk), 132=Cx84_PASM_Button (CM_MFL_Tastencode_1_Cx84_PASM_Button), 107=Cx6b_Washer_button (CM_MFL_Tastencode_1_Cx6b_Washer_button), 12=Cxc_FAS_Menu (CM_MFL_Tastencode_1_Cxc_FAS_Menu), 30=Cx1e_Off_Hook (CM_MFL_Tastencode_1_Cx1e_Off_Hook), 134=Cx86_PTV_Button (CM_MFL_Tastencode_1_Cx86_PTV_Button), 106=Cx6a_Highbeam (CM_MFL_Tastencode_1_Cx6a_Highbeam), 124=Cx7c_E_Boost_Button_Increase (CM_MFL_Tastencode_1_Cx7c_E_Boost_Button_Increase), 105=Cx69_Flashlight (CM_MFL_Tastencode_1_Cx69_Flashlight), 130=Cx82_HUD_Button (CM_MFL_Tastencode_1_Cx82_HUD_Button), 121=Cx79_Drive_Mode_Button_Increase (CM_MFL_Tastencode_1_Cx79_Drive_Mode_Button_Increase), 126=Cx7e_E_Boost_Button_Select (CM_MFL_Tastencode_1_Cx7e_E_Boost_Button_Select), 240=Cxf0_Startup_Reset (CM_MFL_Tastencode_1_Cxf0_Startup_Reset), 131=Cx83_PASM_Wheel (CM_MFL_Tastencode_1_Cx83_PASM_Wheel), 2=Cx2_Menu_Up_Next_Screen (CM_MFL_Tastencode_1_Cx2_Menu_Up_Next_Screen) (Menu_Up__Next_Screen), 104=Cx68_Turn_signal_off (CM_MFL_Tastencode_1_Cx68_Turn_signal_off), 17=Cx11_Volume_Down (CM_MFL_Tastencode_1_Cx11_Volume_Down), 14=Cxe_FAS_Menu_ThumbWheel (CM_MFL_Tastencode_1_Cxe_FAS_Menu_ThumbWheel), 7=Cx7_OK_ThumbWheel_Button (CM_MFL_Tastencode_1_Cx7_OK_ThumbWheel_Button) (OK__ThumbWheel_Button), 19=Cx13_Volume_ThumbWheel_Button (CM_MFL_Tastencode_1_Cx13_Volume_ThumbWheel_Button), 16=Cx10_Volume_Up (CM_MFL_Tastencode_1_Cx10_Volume_Up), 122=Cx7a_Drive_Mode_Button_Decrease (CM_MFL_Tastencode_1_Cx7a_Drive_Mode_Button_Decrease), 108=Cx6c_Wiper_button_left (CM_MFL_Tastencode_1_Cx6c_Wiper_button_left), 128=Cx80_PerformanceHybridButton_Decrease (CM_MFL_Tastencode_1_Cx80_PerformanceHybridButton_Decrease), 8=Cx8_Cancel_Escape (CM_MFL_Tastencode_1_Cx8_Cancel_Escape) (Cancel__Escape), 27=Cx1b_Route_Info (CM_MFL_Tastencode_1_Cx1b_Route_Info), 33=Cx21_Joker1 (CM_MFL_Tastencode_1_Cx21_Joker1), 24=Cx18_Arrow_B_Down_Left (CM_MFL_Tastencode_1_Cx18_Arrow_B_Down_Left) (Arrow_B_Down__Left), 21=Cx15_Arrow_A_Up_Right (CM_MFL_Tastencode_1_Cx15_Arrow_A_Up_Right) (Arrow_A_Up__Right), 4=Cx4_Up (CM_MFL_Tastencode_1_Cx4_Up), 114=Cx72_ESP_Drift_Selection_ThumbWheel (CM_MFL_Tastencode_1_Cx72_ESP_Drift_Selection_ThumbWheel), 29=Cx1d_Hang_Up (CM_MFL_Tastencode_1_Cx1d_Hang_Up), 1=Cx1_Context_Menu (CM_MFL_Tastencode_1_Cx1_Context_Menu), 119=Cx77_Drift_Mode_Button_Decrease (CM_MFL_Tastencode_1_Cx77_Drift_Mode_Button_Decrease)}, range raw 0..241, transfer-property=TRIGGERED-WITHOUT-REPETITION, to HCP3_IONode  # Beschreibt die Funktion einer fest zugeordneten Taste/Walze auf dem MFL. Bei Betätigung ändert sich der Wert von 0x0 auf den jeweiligen Tastencode.
    signal MFL_Tastencode_2_XIX_MFL_Tasten_Konzern_XIX_VLAN_Cockpit: start 8, 8 bit, little-endian, data-type-policy=OVERRIDE, i-signal-type=PRIMITIVE, init-value=0, base-type=BT_MFL_Tastencode_2, compu {35=Cx23_View (CM_MFL_Tastencode_2_Cx23_View), 125=Cx7d_E_Boost_Button_Decrease (CM_MFL_Tastencode_2_Cx7d_E_Boost_Button_Decrease), 25=Cx19_PTT_PushToTalk (CM_MFL_Tastencode_2_Cx19_PTT_PushToTalk) (PTT__PushToTalk), 10=Cxa_Side_Menu_left (CM_MFL_Tastencode_2_Cxa_Side_Menu_left), 33=Cx21_Joker1 (CM_MFL_Tastencode_2_Cx21_Joker1), 107=Cx6b_Washer_button (CM_MFL_Tastencode_2_Cx6b_Washer_button), 19=Cx13_Volume_ThumbWheel_Button (CM_MFL_Tastencode_2_Cx13_Volume_ThumbWheel_Button), 136=Cx88_TC_ESC_Button (CM_MFL_Tastencode_2_Cx88_TC_ESC_Button), 128=Cx80_PerformanceHybridButton_Decrease (CM_MFL_Tastencode_2_Cx80_PerformanceHybridButton_Decrease), 129=Cx81_EV_Mode_Button (CM_MFL_Tastencode_2_Cx81_EV_Mode_Button), 123=Cx7b_Drive_Mode_Button_Select (CM_MFL_Tastencode_2_Cx7b_Drive_Mode_Button_Select), 7=Cx7_OK_ThumbWheel_Button (CM_MFL_Tastencode_2_Cx7_OK_ThumbWheel_Button) (OK__ThumbWheel_Button), 36=Cx24_Arrow_A_Up_Right_Down_Left_ThumbWheel (CM_MFL_Tastencode_2_Cx24_Arrow_A_Up_Right_Down_Left_ThumbWheel), 14=Cxe_FAS_Menu_ThumbWheel (CM_MFL_Tastencode_2_Cxe_FAS_Menu_ThumbWheel), 4=Cx4_Up (CM_MFL_Tastencode_2_Cx4_Up), 0=Cx0_Key_Released_No_Key (CM_MFL_Tastencode_2_Cx0_Key_Released_No_Key) (Key_Released__No_Key), 241=Cxf1_Initialization (CM_MFL_Tastencode_2_Cxf1_Initialization), 134=Cx86_PTV_Button (CM_MFL_Tastencode_2_Cx86_PTV_Button), 104=Cx68_Turn_signal_off (CM_MFL_Tastencode_2_Cx68_Turn_signal_off), 26=Cx1a_PTT_Cancel (CM_MFL_Tastencode_2_Cx1a_PTT_Cancel), 23=Cx17_Arrow_B_Up_Right (CM_MFL_Tastencode_2_Cx17_Arrow_B_Up_Right) (Arrow_B_Up__Right), 34=Cx22_Joker2 (CM_MFL_Tastencode_2_Cx22_Joker2), 132=Cx84_PASM_Button (CM_MFL_Tastencode_2_Cx84_PASM_Button), 133=Cx85_PTV_Wheel (CM_MFL_Tastencode_2_Cx85_PTV_Wheel), 240=Cxf0_Startup_Reset (CM_MFL_Tastencode_2_Cxf0_Startup_Reset), 110=Cx6e_Wiper_button_cancel (CM_MFL_Tastencode_2_Cx6e_Wiper_button_cancel), 38=Cx26_Rekuperation (CM_MFL_Tastencode_2_Cx26_Rekuperation), 42=Cx2a_Stopwatch_Nextlap (CM_MFL_Tastencode_2_Cx2a_Stopwatch_Nextlap), 113=Cx71_Sport_button (CM_MFL_Tastencode_2_Cx71_Sport_button), 112=Cx70_Drive_Select_button (CM_MFL_Tastencode_2_Cx70_Drive_Select_button), 117=Cx75_Launch_Control (CM_MFL_Tastencode_2_Cx75_Launch_Control), 37=Cx25_Lenkradheizung (CM_MFL_Tastencode_2_Cx25_Lenkradheizung), 20=Cx14_Audio_Source (CM_MFL_Tastencode_2_Cx14_Audio_Source), 5=Cx5_Down (CM_MFL_Tastencode_2_Cx5_Down), 101=Cx65_MAP_Boost (CM_MFL_Tastencode_2_Cx65_MAP_Boost), 40=Cx28_DRS_Drag_Reduction_System (CM_MFL_Tastencode_2_Cx28_DRS_Drag_Reduction_System), 121=Cx79_Drive_Mode_Button_Increase (CM_MFL_Tastencode_2_Cx79_Drive_Mode_Button_Increase), 12=Cxc_FAS_Menu (CM_MFL_Tastencode_2_Cxc_FAS_Menu), 27=Cx1b_Route_Info (CM_MFL_Tastencode_2_Cx1b_Route_Info), 9=Cx9_Main_Menu (CM_MFL_Tastencode_2_Cx9_Main_Menu), 102=Cx66_Turn_signal_left (CM_MFL_Tastencode_2_Cx66_Turn_signal_left), 18=Cx12_Volume_Up_Down_ThumbWheel (CM_MFL_Tastencode_2_Cx12_Volume_Up_Down_ThumbWheel) (Volume_Up__Down_ThumbWheel), 39=Cx27_Tube_Toggle (CM_MFL_Tastencode_2_Cx27_Tube_Toggle), 106=Cx6a_Highbeam (CM_MFL_Tastencode_2_Cx6a_Highbeam), 32=Cx20_Mute (CM_MFL_Tastencode_2_Cx20_Mute), 13=Cxd_Left_Right_ThumbWheel (CM_MFL_Tastencode_2_Cxd_Left_Right_ThumbWheel) (Left__Right_ThumbWheel), 30=Cx1e_Off_Hook (CM_MFL_Tastencode_2_Cx1e_Off_Hook), 126=Cx7e_E_Boost_Button_Select (CM_MFL_Tastencode_2_Cx7e_E_Boost_Button_Select), 16=Cx10_Volume_Up (CM_MFL_Tastencode_2_Cx10_Volume_Up), 118=Cx76_Drift_Mode_Button_Increase (CM_MFL_Tastencode_2_Cx76_Drift_Mode_Button_Increase), 103=Cx67_Turn_signal_right (CM_MFL_Tastencode_2_Cx67_Turn_signal_right), 11=Cxb_Side_Menu_right (CM_MFL_Tastencode_2_Cxb_Side_Menu_right), 21=Cx15_Arrow_A_Up_Right (CM_MFL_Tastencode_2_Cx15_Arrow_A_Up_Right) (Arrow_A_Up__Right), 31=Cx1f_Light_On_Off (CM_MFL_Tastencode_2_Cx1f_Light_On_Off) (Light_On__Off), 135=Cx87_TC_ESC_Wheel (CM_MFL_Tastencode_2_Cx87_TC_ESC_Wheel), 24=Cx18_Arrow_B_Down_Left (CM_MFL_Tastencode_2_Cx18_Arrow_B_Down_Left) (Arrow_B_Down__Left), 114=Cx72_ESP_Drift_Selection_ThumbWheel (CM_MFL_Tastencode_2_Cx72_ESP_Drift_Selection_ThumbWheel), 22=Cx16_Arrow_A_Down_Left (CM_MFL_Tastencode_2_Cx16_Arrow_A_Down_Left) (Arrow_A_Down__Left), 3=Cx3_Menu_Down_Previous_Screen (CM_MFL_Tastencode_2_Cx3_Menu_Down_Previous_Screen) (Menu_Down__Previous_Screen), 119=Cx77_Drift_Mode_Button_Decrease (CM_MFL_Tastencode_2_Cx77_Drift_Mode_Button_Decrease), 105=Cx69_Flashlight (CM_MFL_Tastencode_2_Cx69_Flashlight), 131=Cx83_PASM_Wheel (CM_MFL_Tastencode_2_Cx83_PASM_Wheel), 127=Cx7f_PerformanceHybridButton_Increase (CM_MFL_Tastencode_2_Cx7f_PerformanceHybridButton_Increase), 1=Cx1_Context_Menu (CM_MFL_Tastencode_2_Cx1_Context_Menu), 109=Cx6d_Wiper_button_right (CM_MFL_Tastencode_2_Cx6d_Wiper_button_right), 130=Cx82_HUD_Button (CM_MFL_Tastencode_2_Cx82_HUD_Button), 28=Cx1c_Hook (CM_MFL_Tastencode_2_Cx1c_Hook), 116=Cx74_TravelAssist (CM_MFL_Tastencode_2_Cx74_TravelAssist), 100=Cx64_MAP (CM_MFL_Tastencode_2_Cx64_MAP), 122=Cx7a_Drive_Mode_Button_Decrease (CM_MFL_Tastencode_2_Cx7a_Drive_Mode_Button_Decrease), 41=Cx29_Stopwatch_Start_Stop (CM_MFL_Tastencode_2_Cx29_Stopwatch_Start_Stop), 111=Cx6f_Exhaust_Sound (CM_MFL_Tastencode_2_Cx6f_Exhaust_Sound), 115=Cx73_PTT_special_vehicle (CM_MFL_Tastencode_2_Cx73_PTT_special_vehicle), 108=Cx6c_Wiper_button_left (CM_MFL_Tastencode_2_Cx6c_Wiper_button_left), 6=Cx6_Up_Down_ThumbWheel (CM_MFL_Tastencode_2_Cx6_Up_Down_ThumbWheel) (Up__Down_ThumbWheel), 17=Cx11_Volume_Down (CM_MFL_Tastencode_2_Cx11_Volume_Down), 2=Cx2_Menu_Up_Next_Screen (CM_MFL_Tastencode_2_Cx2_Menu_Up_Next_Screen) (Menu_Up__Next_Screen), 124=Cx7c_E_Boost_Button_Increase (CM_MFL_Tastencode_2_Cx7c_E_Boost_Button_Increase), 120=Cx78_Drift_Mode_Button_Select (CM_MFL_Tastencode_2_Cx78_Drift_Mode_Button_Select), 29=Cx1d_Hang_Up (CM_MFL_Tastencode_2_Cx1d_Hang_Up), 8=Cx8_Cancel_Escape (CM_MFL_Tastencode_2_Cx8_Cancel_Escape) (Cancel__Escape)}, range raw 0..241, transfer-property=TRIGGERED-WITHOUT-REPETITION, to HCP3_IONode  # Beschreibt die Funktion einer fest zugeordneten Taste/Walze auf dem MFL. Ist MFL_Tastencode_1 wegen Betätigung einer Taste/Walze bereits mit einem Wert ungleich 0x0 belegt, so ändert sich bei Betätigung einer weiteren Taste/Walze der Wert dieses Signals von 0x0 auf den jeweiligen Tastencode.
    signal MFL_Eventcode_1_XIX_MFL_Tasten_Konzern_XIX_VLAN_Cockpit: start 16, 4 bit, little-endian, data-type-policy=OVERRIDE, i-signal-type=PRIMITIVE, init-value=0, base-type=BT_MFL_Eventcode_1, compu {11=Cxb_W_5_Ticks_dn_T_double_click_str (CM_MFL_Eventcode_1_Cxb_W_5_Ticks_dn_T_double_click_str) (W_5_Ticks_dn__T_double_click_str), 0=Cx0_W_no_event_T_no_event (CM_MFL_Eventcode_1_Cx0_W_no_event_T_no_event) (W_no_event____T_no_event), 3=Cx3_W_3_Ticks_up_T_double_click_nor (CM_MFL_Eventcode_1_Cx3_W_3_Ticks_up_T_double_click_nor) (W_3_Ticks_up__T_double_click_nor), 13=Cxd_W_3_Ticks_dn_T_long_press_str_2 (CM_MFL_Eventcode_1_Cxd_W_3_Ticks_dn_T_long_press_str_2) (W_3_Ticks_dn__T_long_press_str_2), 15=Cxf_W_1_Tick_dn (CM_MFL_Eventcode_1_Cxf_W_1_Tick_dn), 4=Cx4_W_4_Ticks_up_T_long_press_nor_1 (CM_MFL_Eventcode_1_Cx4_W_4_Ticks_up_T_long_press_nor_1) (W_4_Ticks_up__T_long_press_nor_1), 1=Cx1_W_1_Tick_up_T_pressed_normal (CM_MFL_Eventcode_1_Cx1_W_1_Tick_up_T_pressed_normal) (W_1_Tick_up__T_pressed_normal), 12=Cxc_W_4_Ticks_dn_T_long_press_str_1 (CM_MFL_Eventcode_1_Cxc_W_4_Ticks_dn_T_long_press_str_1) (W_4_Ticks_dn__T_long_press_str_1), 5=Cx5_W_5_Ticks_up_T_long_press_nor_2 (CM_MFL_Eventcode_1_Cx5_W_5_Ticks_up_T_long_press_nor_2) (W_5_Ticks_up__T_long_press_nor_2), 14=Cxe_W_2_Ticks_dn_T_long_press_str_3 (CM_MFL_Eventcode_1_Cxe_W_2_Ticks_dn_T_long_press_str_3) (W_2_Ticks_dn__T_long_press_str_3), 2=Cx2_W_2_Ticks_up_T_touched (CM_MFL_Eventcode_1_Cx2_W_2_Ticks_up_T_touched) (W_2_Ticks_up__T_touched), 9=Cx9_W_7_Ticks_dn_T_pressed_strong (CM_MFL_Eventcode_1_Cx9_W_7_Ticks_dn_T_pressed_strong) (W_7_Ticks_dn__T_pressed_strong), 6=Cx6_W_6_Ticks_up_T_long_press_nor_3 (CM_MFL_Eventcode_1_Cx6_W_6_Ticks_up_T_long_press_nor_3) (W_6_Ticks_up__T_long_press_nor_3), 10=Cxa_W_6_Ticks_dn (CM_MFL_Eventcode_1_Cxa_W_6_Ticks_dn), 7=Cx7_W_7_Ticks_up (CM_MFL_Eventcode_1_Cx7_W_7_Ticks_up)}, range raw 0..15, transfer-property=TRIGGERED-WITHOUT-REPETITION, to HCP3_IONode  # Siehe Q-LAH MFL-Protokoll
    signal MFL_Eventcode_2_XIX_MFL_Tasten_Konzern_XIX_VLAN_Cockpit: start 20, 4 bit, little-endian, data-type-policy=OVERRIDE, i-signal-type=PRIMITIVE, init-value=0, base-type=BT_MFL_Eventcode_2, compu {11=Cxb_W_5_Ticks_dn_T_double_click_str (CM_MFL_Eventcode_2_Cxb_W_5_Ticks_dn_T_double_click_str) (W_5_Ticks_dn__T_double_click_str), 0=Cx0_W_no_event_T_no_event (CM_MFL_Eventcode_2_Cx0_W_no_event_T_no_event) (W_no_event____T_no_event), 3=Cx3_W_3_Ticks_up_T_double_click_nor (CM_MFL_Eventcode_2_Cx3_W_3_Ticks_up_T_double_click_nor) (W_3_Ticks_up__T_double_click_nor), 13=Cxd_W_3_Ticks_dn_T_long_press_str_2 (CM_MFL_Eventcode_2_Cxd_W_3_Ticks_dn_T_long_press_str_2) (W_3_Ticks_dn__T_long_press_str_2), 15=Cxf_W_1_Tick_dn (CM_MFL_Eventcode_2_Cxf_W_1_Tick_dn), 4=Cx4_W_4_Ticks_up_T_long_press_nor_1 (CM_MFL_Eventcode_2_Cx4_W_4_Ticks_up_T_long_press_nor_1) (W_4_Ticks_up__T_long_press_nor_1), 1=Cx1_W_1_Tick_up_T_pressed_normal (CM_MFL_Eventcode_2_Cx1_W_1_Tick_up_T_pressed_normal) (W_1_Tick_up__T_pressed_normal), 12=Cxc_W_4_Ticks_dn_T_long_press_str_1 (CM_MFL_Eventcode_2_Cxc_W_4_Ticks_dn_T_long_press_str_1) (W_4_Ticks_dn__T_long_press_str_1), 5=Cx5_W_5_Ticks_up_T_long_press_nor_2 (CM_MFL_Eventcode_2_Cx5_W_5_Ticks_up_T_long_press_nor_2) (W_5_Ticks_up__T_long_press_nor_2), 14=Cxe_W_2_Ticks_dn_T_long_press_str_3 (CM_MFL_Eventcode_2_Cxe_W_2_Ticks_dn_T_long_press_str_3) (W_2_Ticks_dn__T_long_press_str_3), 2=Cx2_W_2_Ticks_up_T_touched (CM_MFL_Eventcode_2_Cx2_W_2_Ticks_up_T_touched) (W_2_Ticks_up__T_touched), 9=Cx9_W_7_Ticks_dn_T_pressed_strong (CM_MFL_Eventcode_2_Cx9_W_7_Ticks_dn_T_pressed_strong) (W_7_Ticks_dn__T_pressed_strong), 6=Cx6_W_6_Ticks_up_T_long_press_nor_3 (CM_MFL_Eventcode_2_Cx6_W_6_Ticks_up_T_long_press_nor_3) (W_6_Ticks_up__T_long_press_nor_3), 10=Cxa_W_6_Ticks_dn (CM_MFL_Eventcode_2_Cxa_W_6_Ticks_dn), 7=Cx7_W_7_Ticks_up (CM_MFL_Eventcode_2_Cx7_W_7_Ticks_up)}, range raw 0..15, transfer-property=TRIGGERED-WITHOUT-REPETITION, to HCP3_IONode  # Siehe Q-LAH MFL-Protokoll
    signal MFL_Marke_XIX_MFL_Tasten_Konzern_XIX_VLAN_Cockpit: start 24, 4 bit, little-endian, data-type-policy=OVERRIDE, i-signal-type=PRIMITIVE, init-value=0, base-type=BT_MFL_Marke, compu {8=Cx8_Rolls_Royce (CM_MFL_Marke_Cx8_Rolls_Royce) (Rolls Royce), 3=Cx3_Skoda (CM_MFL_Marke_Cx3_Skoda), 12=Cxc_kein_Hersteller_3 (CM_MFL_Marke_Cxc_kein_Hersteller_3), 0=Cx0_VW (CM_MFL_Marke_Cx0_VW), 15=Cxf_Porsche (CM_MFL_Marke_Cxf_Porsche), 4=Cx4_VW_Nutzf (CM_MFL_Marke_Cx4_VW_Nutzf), 9=Cx9_Quattro (CM_MFL_Marke_Cx9_Quattro), 5=Cx5_Bugatti (CM_MFL_Marke_Cx5_Bugatti), 13=Cxd_kein_Hersteller_4 (CM_MFL_Marke_Cxd_kein_Hersteller_4), 2=Cx2_Seat (CM_MFL_Marke_Cx2_Seat), 6=Cx6_Lamborghini (CM_MFL_Marke_Cx6_Lamborghini), 10=Cxa_kein_Hersteller_1 (CM_MFL_Marke_Cxa_kein_Hersteller_1), 11=Cxb_kein_Hersteller_2 (CM_MFL_Marke_Cxb_kein_Hersteller_2), 1=Cx1_Audi (CM_MFL_Marke_Cx1_Audi), 14=Cxe_Ford (CM_MFL_Marke_Cxe_Ford), 7=Cx7_Bentley (CM_MFL_Marke_Cx7_Bentley)}, range raw 0..15, transfer-property=TRIGGERED-WITHOUT-REPETITION, to HCP3_IONode  # Marke für markenspezifische Variantennummer des MFL
    signal MFL_Variante_XIX_MFL_Tasten_Konzern_XIX_VLAN_Cockpit: start 28, 4 bit, little-endian, data-type-policy=OVERRIDE, i-signal-type=PRIMITIVE, init-value=0, base-type=BT_MFL_Variante, compu {phys=raw for raw 0..15}, range phys 0..15, raw 0..15, transfer-property=TRIGGERED-WITHOUT-REPETITION, to HCP3_IONode  # Markenspezifische Variantennummer des MFL
  pdu MKGO_FBS_01_XIX_VLAN_Cockpit: length=64, transmission-mode-true-timing=event-controlled-timing={number-of-repetitions=0, repetition-period=0.0}, unused-bit-pattern=0
    signal MKGO_FBS_01_XIX_MKGO_FBS_01_XIX_VLAN_Cockpit: start 0, 512 bit, opaque, data-type-policy=OVERRIDE, i-signal-type=ARRAY, init-value=64 x 0, base-type=BT_MKGO_FBS_01, implementation-data-type=MKGO_FBS_01, transfer-property=TRIGGERED-WITHOUT-REPETITION  # NFC Kommunikation MKGO zu FBS
  pdu MKGO_FBS_02_XIX_VLAN_Cockpit: length=64, transmission-mode-true-timing=event-controlled-timing={number-of-repetitions=0, repetition-period=0.0}, unused-bit-pattern=0
    signal MKGO_FBS_02_XIX_MKGO_FBS_02_XIX_VLAN_Cockpit: start 0, 512 bit, opaque, data-type-policy=OVERRIDE, i-signal-type=ARRAY, init-value=64 x 0, base-type=BT_MKGO_FBS_02, implementation-data-type=MKGO_FBS_02, transfer-property=TRIGGERED-WITHOUT-REPETITION  # NFC Kommunikation MKGO zu FBS
  pdu MKGO_FBS_03_XIX_VLAN_Cockpit: length=64, transmission-mode-true-timing=event-controlled-timing={number-of-repetitions=0, repetition-period=0.0}, unused-bit-pattern=0
    signal MKGO_FBS_03_XIX_MKGO_FBS_03_XIX_VLAN_Cockpit: start 0, 512 bit, opaque, data-type-policy=OVERRIDE, i-signal-type=ARRAY, init-value=64 x 0, base-type=BT_MKGO_FBS_03, implementation-data-type=MKGO_FBS_03, transfer-property=TRIGGERED-WITHOUT-REPETITION  # NFC Kommunikation MKGO zu FBS
  pdu MKGO_FBS_04_XIX_VLAN_Cockpit: length=64, transmission-mode-true-timing=event-controlled-timing={number-of-repetitions=0, repetition-period=0.0}, unused-bit-pattern=0
    signal MKGO_FBS_04_XIX_MKGO_FBS_04_XIX_VLAN_Cockpit: start 0, 512 bit, opaque, data-type-policy=OVERRIDE, i-signal-type=ARRAY, init-value=64 x 0, base-type=BT_MKGO_FBS_04, implementation-data-type=MKGO_FBS_04, transfer-property=TRIGGERED-WITHOUT-REPETITION  # NFC Kommunikation MKGO zu FBS
  pdu MKGO_FBS_05_XIX_VLAN_Cockpit: length=64, transmission-mode-true-timing=event-controlled-timing={number-of-repetitions=0, repetition-period=0.0}, unused-bit-pattern=0
    signal MKGO_FBS_05_XIX_MKGO_FBS_05_XIX_VLAN_Cockpit: start 0, 512 bit, opaque, data-type-policy=OVERRIDE, i-signal-type=ARRAY, init-value=64 x 0, base-type=BT_MKGO_FBS_05, implementation-data-type=MKGO_FBS_05, transfer-property=TRIGGERED-WITHOUT-REPETITION  # NFC Kommunikation MKGO zu FBS
  pdu NFC_MiKo_01_XIX_VLAN_Cockpit: length=8, transmission-mode-true-timing=cyclic-timing={time-offset=0.0, time-period=0.2}, unused-bit-pattern=0
    signal NFC_MiKo_NFC_Device_Status_XIX_NFC_MiKo_01_XIX_VLAN_Cockpit: start 58, 3 bit, little-endian, data-type-policy=OVERRIDE, i-signal-type=PRIMITIVE, init-value=0, base-type=BT_NFC_MiKo_NFC_Device_Status, compu {3=Cx3_MDK_Applet_erkannt (CM_NFC_MiKo_NFC_Device_Status_Cx3_MDK_Applet_erkannt), 2=Cx2_MDK_Framework_erkannt (CM_NFC_MiKo_NFC_Device_Status_Cx2_MDK_Framework_erkannt), 1=Cx1_NFC_Device_erkannt (CM_NFC_MiKo_NFC_Device_Status_Cx1_NFC_Device_erkannt), 4=Cx4_MDK_Servicekarte_erkannt (CM_NFC_MiKo_NFC_Device_Status_Cx4_MDK_Servicekarte_erkannt), 5=Cx5_MDK_Device_authentifiziert (CM_NFC_MiKo_NFC_Device_Status_Cx5_MDK_Device_authentifiziert), 0=Cx0_Init_nicht_erkannt (CM_NFC_MiKo_NFC_Device_Status_Cx0_Init_nicht_erkannt)}, range raw 0..5, transfer-property=PENDING  # Status der aktuellen NFC Erkennung
    signal NFC_MiKo_NFC_Device_gekoppelt_XIX_NFC_MiKo_01_XIX_VLAN_Cockpit: start 61, 1 bit, little-endian, data-type-policy=OVERRIDE, i-signal-type=PRIMITIVE, init-value=0, base-type=BT_NFC_MiKo_NFC_Device_gekoppelt, compu {0=Cx0_Init_kein_NFC_Device_gekoppelt (CM_NFC_MiKo_NFC_Device_gekoppelt_Cx0_Init_kein_NFC_Device_gekoppelt), 1=Cx1_NFC_Device_gekoppelt (CM_NFC_MiKo_NFC_Device_gekoppelt_Cx1_NFC_Device_gekoppelt)}, range raw 0..1, transfer-property=PENDING  # Ein NFC-Device ist im Empfangsbereich und der NFC-Reader hat eine aktive Verbindung aufgebaut.
  pdu NVEM_12_XIX_VLAN_Cockpit: length=12, transmission-mode-true-timing=cyclic-timing={time-offset=0.0, time-period=0.1}, unused-bit-pattern=0
    signal NVEM_12_CRC_XIX_NVEM_12_XIX_VLAN_Cockpit: start 0, 8 bit, little-endian, data-type-policy=OVERRIDE, i-signal-type=PRIMITIVE, init-value=0, base-type=BT_NVEM_12_CRC, compu {phys=raw for raw 0..255}, range phys 0..255, raw 0..255, transfer-property=TRIGGERED-WITHOUT-REPETITION  # Für MLB: Berechnung siehe Lastenheft "Kommunikationsabsicherung für FlexRay und CAN" Ab MQB und MLBevo: Berechnung siehe Lastenheft "End-to-End Kommunikationsabsicherung" Endwerte siehe Begleitdokument "S-PDU Kennungsfolgen"
    signal NVEM_12_BZ_XIX_NVEM_12_XIX_VLAN_Cockpit: start 8, 4 bit, little-endian, data-type-policy=OVERRIDE, i-signal-type=PRIMITIVE, init-value=0, base-type=BT_NVEM_12_BZ, compu {phys=raw for raw 0..15}, range phys 0..15, raw 0..15, transfer-property=TRIGGERED-WITHOUT-REPETITION  # 4bit Botschaftszähler, wird mit jeder Sendebotschaft inkrementiert
    signal NVEM_Bordnetzdiagnose_XIX_NVEM_12_XIX_VLAN_Cockpit: start 12, 2 bit, little-endian, data-type-policy=OVERRIDE, i-signal-type=PRIMITIVE, init-value=0, base-type=BT_NVEM_Bordnetzdiagnose, compu {1=Cx1_Warnung_1 (CM_NVEM_Bordnetzdiagnose_Cx1_Warnung_1), 2=Cx2_Warnung_2 (CM_NVEM_Bordnetzdiagnose_Cx2_Warnung_2), 3=Cx3_Warnung_3 (CM_NVEM_Bordnetzdiagnose_Cx3_Warnung_3), 0=Cx0_kein_Fehler (CM_NVEM_Bordnetzdiagnose_Cx0_kein_Fehler)}, range raw 0..3, transfer-property=TRIGGERED-WITHOUT-REPETITION  # Wird vom NVEM im NV-Netz ein Bordnetz-Fehler erkannt, so soll dies zu einer mehrstufigen Anzeige führen.
    signal NVEM_Last_Anf_XIX_NVEM_12_XIX_VLAN_Cockpit: start 14, 2 bit, little-endian, data-type-policy=OVERRIDE, i-signal-type=PRIMITIVE, init-value=0, base-type=BT_NVEM_Last_Anf, compu {3=Cx3_Verbraucher_Anforderung_Stufe_3 (CM_NVEM_Last_Anf_Cx3_Verbraucher_Anforderung_Stufe_3), 1=Cx1_Verbraucher_Anforderung_Stufe_1 (CM_NVEM_Last_Anf_Cx1_Verbraucher_Anforderung_Stufe_1), 0=Cx0_keine_Anforderung (CM_NVEM_Last_Anf_Cx0_keine_Anforderung) (keine Anforderung), 2=Cx2_Verbraucher_Anforderung_Stufe_2 (CM_NVEM_Last_Anf_Cx2_Verbraucher_Anforderung_Stufe_2)}, range raw 0..3, transfer-property=TRIGGERED-WITHOUT-REPETITION  # Das NVEM fordert für die Batteriediagnose einen Lastimpuls vom Fahrzeug an, der durch kontrollierte Verbraucherzuschaltungen (z. B. Aktivierung Heckscheibenheizung) generiert wird
    signal BEM_HL_Regelung_Status_XIX_NVEM_12_XIX_VLAN_Cockpit: start 16, 3 bit, little-endian, data-type-policy=OVERRIDE, i-signal-type=PRIMITIVE, init-value=0, base-type=BT_BEM_HL_Regelung_Status, compu {1=Cx1_HL_Regelung_Stufe_1 (CM_BEM_HL_Regelung_Status_Cx1_HL_Regelung_Stufe_1), 2=Cx2_HL_Regelung_Stufe_2 (CM_BEM_HL_Regelung_Status_Cx2_HL_Regelung_Stufe_2), 7=Cx7_Default (CM_BEM_HL_Regelung_Status_Cx7_Default), 4=Cx4_Verbrauchernotabschaltung_VNA (CM_BEM_HL_Regelung_Status_Cx4_Verbrauchernotabschaltung_VNA) (Verbrauchernotabschaltung_(VNA)), 0=Cx0_HL_Regelung_inaktiv_vor_und_waehrend_Motorstart (CM_BEM_HL_Regelung_Status_Cx0_HL_Regelung_inaktiv_vor_und_waehrend_Motorstart) (HL_Regelung_inaktiv_(vor_und_waehrend_Motorstart)), 3=Cx3_HL_Regelung_Stufe_3 (CM_BEM_HL_Regelung_Status_Cx3_HL_Regelung_Stufe_3), 5=Cx5_HL_Regelung_Stufe_5 (CM_BEM_HL_Regelung_Status_Cx5_HL_Regelung_Stufe_5)}, range raw 0..7, transfer-property=TRIGGERED-WITHOUT-REPETITION  # Status Regelung Heizleistung
    signal NVEM_Abschaltstufe_XIX_NVEM_12_XIX_VLAN_Cockpit: start 19, 2 bit, little-endian, data-type-policy=OVERRIDE, i-signal-type=PRIMITIVE, init-value=0, base-type=BT_NVEM_Abschaltstufe, compu {3=Cx3_Stufe_3 (CM_NVEM_Abschaltstufe_Cx3_Stufe_3), 0=Cx0_Stufe_0_keine_Einschraenkung (CM_NVEM_Abschaltstufe_Cx0_Stufe_0_keine_Einschraenkung), 2=Cx2_Stufe_2 (CM_NVEM_Abschaltstufe_Cx2_Stufe_2), 1=Cx1_Stufe_1 (CM_NVEM_Abschaltstufe_Cx1_Stufe_1)}, range raw 0..3, transfer-property=TRIGGERED-WITHOUT-REPETITION, to HCP3_IONode(timeout 1 s)  # Abschaltstufe aus dem Ruheenergiemanagement Maßnahmen des Empfängers werden im QLAH Ruhestrommanagement definiert
    signal NVEM_NV_BAT_ZellStatus_Index_Anf_XIX_NVEM_12_XIX_VLAN_Cockpit: start 21, 4 bit, little-endian, data-type-policy=OVERRIDE, i-signal-type=PRIMITIVE, init-value=0, base-type=BT_NVEM_NV_BAT_ZellStatus_Index_Anf, compu {8=Cx8_Cell_Nr_9 (CM_NVEM_NV_BAT_ZellStatus_Index_Anf_Cx8_Cell_Nr_9), 15=Cxf_Cell_Nr_16 (CM_NVEM_NV_BAT_ZellStatus_Index_Anf_Cxf_Cell_Nr_16), 5=Cx5_Cell_Nr_6 (CM_NVEM_NV_BAT_ZellStatus_Index_Anf_Cx5_Cell_Nr_6), 1=Cx1_Cell_Nr_2 (CM_NVEM_NV_BAT_ZellStatus_Index_Anf_Cx1_Cell_Nr_2), 9=Cx9_Cell_Nr_10 (CM_NVEM_NV_BAT_ZellStatus_Index_Anf_Cx9_Cell_Nr_10), 10=Cxa_Cell_Nr_11 (CM_NVEM_NV_BAT_ZellStatus_Index_Anf_Cxa_Cell_Nr_11), 11=Cxb_Cell_Nr_12 (CM_NVEM_NV_BAT_ZellStatus_Index_Anf_Cxb_Cell_Nr_12), 13=Cxd_Cell_Nr_14 (CM_NVEM_NV_BAT_ZellStatus_Index_Anf_Cxd_Cell_Nr_14), 12=Cxc_Cell_Nr_13 (CM_NVEM_NV_BAT_ZellStatus_Index_Anf_Cxc_Cell_Nr_13), 7=Cx7_Cell_Nr_8 (CM_NVEM_NV_BAT_ZellStatus_Index_Anf_Cx7_Cell_Nr_8), 2=Cx2_Cell_Nr_3 (CM_NVEM_NV_BAT_ZellStatus_Index_Anf_Cx2_Cell_Nr_3), 4=Cx4_Cell_Nr_5 (CM_NVEM_NV_BAT_ZellStatus_Index_Anf_Cx4_Cell_Nr_5), 0=Cx0_Cell_Nr_1 (CM_NVEM_NV_BAT_ZellStatus_Index_Anf_Cx0_Cell_Nr_1), 3=Cx3_Cell_Nr_4 (CM_NVEM_NV_BAT_ZellStatus_Index_Anf_Cx3_Cell_Nr_4), 14=Cxe_Cell_Nr_15 (CM_NVEM_NV_BAT_ZellStatus_Index_Anf_Cxe_Cell_Nr_15), 6=Cx6_Cell_Nr_7 (CM_NVEM_NV_BAT_ZellStatus_Index_Anf_Cx6_Cell_Nr_7)}, range raw 0..15, transfer-property=TRIGGERED-WITHOUT-REPETITION  # Multiplex signal for cell number of low voltage battery.
    signal NVEM_NV_BAT_ZellStatus_Typ_Anf_XIX_NVEM_12_XIX_VLAN_Cockpit: start 25, 3 bit, little-endian, data-type-policy=OVERRIDE, i-signal-type=PRIMITIVE, init-value=0, base-type=BT_NVEM_NV_BAT_ZellStatus_Typ_Anf, compu {0=Cx0_Init (CM_NVEM_NV_BAT_ZellStatus_Typ_Anf_Cx0_Init), 2=Cx2_Temperature (CM_NVEM_NV_BAT_ZellStatus_Typ_Anf_Cx2_Temperature), 6=Cx6_reserved (CM_NVEM_NV_BAT_ZellStatus_Typ_Anf_Cx6_reserved), 5=Cx5_SoH_C (CM_NVEM_NV_BAT_ZellStatus_Typ_Anf_Cx5_SoH_C), 4=Cx4_SoF (CM_NVEM_NV_BAT_ZellStatus_Typ_Anf_Cx4_SoF), 1=Cx1_Voltage (CM_NVEM_NV_BAT_ZellStatus_Typ_Anf_Cx1_Voltage), 3=Cx3_Voltage_limit (CM_NVEM_NV_BAT_ZellStatus_Typ_Anf_Cx3_Voltage_limit) (Voltage limit), 7=Cx7_reserved (CM_NVEM_NV_BAT_ZellStatus_Typ_Anf_Cx7_reserved)}, range raw 0..7, transfer-property=TRIGGERED-WITHOUT-REPETITION  # Multiplex signal for cell status of low voltage battery.
    signal NVEM_Freigabe_OTA_XIX_NVEM_12_XIX_VLAN_Cockpit: start 28, 2 bit, little-endian, data-type-policy=OVERRIDE, i-signal-type=PRIMITIVE, init-value=0, base-type=BT_NVEM_Freigabe_OTA, compu {0=Cx0_Init (CM_NVEM_Freigabe_OTA_Cx0_Init), 1=Cx1_Keine_Freigabe (CM_NVEM_Freigabe_OTA_Cx1_Keine_Freigabe), 2=Cx2_Freigabe (CM_NVEM_Freigabe_OTA_Cx2_Freigabe)}, range raw 0..2, transfer-property=TRIGGERED-WITHOUT-REPETITION  # Bestätigung oder Ablehnung eines konkreten, angefragten Online-Updates durch das Energiemangement
    signal BEM_Generatordiagnose_XIX_NVEM_12_XIX_VLAN_Cockpit: start 30, 2 bit, little-endian, data-type-policy=OVERRIDE, i-signal-type=PRIMITIVE, init-value=0, base-type=BT_BEM_Generatordiagnose, compu {1=Cx1_Ladekontrollanzeige_ein_Vorhalt (CM_BEM_Generatordiagnose_Cx1_Ladekontrollanzeige_ein_Vorhalt) (Ladekontrollanzeige ein (Vorhalt)), 3=Cx3_Hybrid_DCDC_Wandler_defekt (CM_BEM_Generatordiagnose_Cx3_Hybrid_DCDC_Wandler_defekt), 2=Cx2_rotes_Batteriesymbol_und_Text_Generator_defekt (CM_BEM_Generatordiagnose_Cx2_rotes_Batteriesymbol_und_Text_Generator_defekt) (rotes Batteriesymbol und Text (Generator defekt)), 0=Cx0_keine_Anzeige (CM_BEM_Generatordiagnose_Cx0_keine_Anzeige) (keine Anzeige)}, range raw 0..3, transfer-property=TRIGGERED-WITHOUT-REPETITION  # Ansteuerung Generatorwarnleuchte im Kombi
    signal NVEM_DC_uSoll_NV_XIX_NVEM_12_XIX_VLAN_Cockpit: start 32, 8 bit, little-endian, data-type-policy=OVERRIDE, i-signal-type=PRIMITIVE, init-value=116, base-type=BT_NVEM_DC_uSoll_NV, invalid-value=Invalid_NVEM_DC_uSoll_NV_XIX_NVEM_12_XIX_VLAN_Cockpit:255, compu {phys=raw*0.025+10.6 for raw 0..216, 255=Cxff_Fehler (CM_NVEM_DC_uSoll_NV_Cxff_Fehler); unit Unit_Volt}, range phys 10.6..16 Unit_Volt, raw 0..255, unit=Unit_Volt, transfer-property=TRIGGERED-WITHOUT-REPETITION  # Sollspannung 12V Seite des DC Wandlers, feine Auflösung
    signal NVEM_DC_iSoll_NV_XIX_NVEM_12_XIX_VLAN_Cockpit: start 40, 8 bit, little-endian, data-type-policy=OVERRIDE, i-signal-type=PRIMITIVE, init-value=254, base-type=BT_NVEM_DC_iSoll_NV, invalid-value=Invalid_NVEM_DC_iSoll_NV_XIX_NVEM_12_XIX_VLAN_Cockpit:255, compu {phys=raw-253 for raw 0..253, 255=Cxff_Fehler (CM_NVEM_DC_iSoll_NV_Cxff_Fehler), 254=Cxfe_Init (CM_NVEM_DC_iSoll_NV_Cxfe_Init); unit Unit_Amper}, range phys -253..0 Unit_Amper, raw 0..255, unit=Unit_Amper, transfer-property=TRIGGERED-WITHOUT-REPETITION  # Soll-Entladestrom 12V Seite des DCDC Wandlers
    signal BEM_Batt_Ab_XIX_NVEM_12_XIX_VLAN_Cockpit: start 48, 1 bit, little-endian, data-type-policy=OVERRIDE, i-signal-type=PRIMITIVE, init-value=0, base-type=BT_BEM_Batt_Ab, compu {0=Cx0_verbunden (CM_BEM_Batt_Ab_Cx0_verbunden), 1=Cx1_nicht_verbunden (CM_BEM_Batt_Ab_Cx1_nicht_verbunden)}, range raw 0..1, transfer-property=TRIGGERED-WITHOUT-REPETITION  # Batterieverbindungskontrolle: 0x0: Batterie am Bordnetz 0x1: Batterie ab erkannt
    signal BEM_Red_Innengeblaese_XIX_NVEM_12_XIX_VLAN_Cockpit: start 49, 2 bit, little-endian, data-type-policy=OVERRIDE, i-signal-type=PRIMITIVE, init-value=0, base-type=BT_BEM_Red_Innengeblaese, compu {3=Cx3_Reduzierung_Stufe_2_und_Abschaltung_Kompressor (CM_BEM_Red_Innengeblaese_Cx3_Reduzierung_Stufe_2_und_Abschaltung_Kompressor) (Reduzierung Stufe 2 und Abschaltung Kompressor), 1=Cx1_Reduzierung_Stufe_1 (CM_BEM_Red_Innengeblaese_Cx1_Reduzierung_Stufe_1) (Reduzierung Stufe 1), 2=Cx2_Reduzierung_Stufe_2 (CM_BEM_Red_Innengeblaese_Cx2_Reduzierung_Stufe_2) (Reduzierung Stufe 2), 0=Cx0_keine_Reduzierung (CM_BEM_Red_Innengeblaese_Cx0_keine_Reduzierung) (keine Reduzierung)}, range raw 0..3, transfer-property=TRIGGERED-WITHOUT-REPETITION  # Reduzierung Innengebläse
    signal NVEM_MV_DC_uMinLV_XIX_NVEM_12_XIX_VLAN_Cockpit: start 51, 7 bit, little-endian, data-type-policy=OVERRIDE, i-signal-type=PRIMITIVE, init-value=126, base-type=BT_NVEM_MV_DC_uMinLV, invalid-value=Invalid_NVEM_MV_DC_uMinLV_XIX_NVEM_12_XIX_VLAN_Cockpit:127, compu {phys=raw*0.1+3.5 for raw 0..125, 127=Cx7f_Fehler (CM_NVEM_MV_DC_uMinLV_Cx7f_Fehler), 126=Cx7e_Init (CM_NVEM_MV_DC_uMinLV_Cx7e_Init); unit Unit_Volt}, range phys 3.5..16 Unit_Volt, raw 0..127, unit=Unit_Volt, transfer-property=TRIGGERED-WITHOUT-REPETITION  # Abregelgrenze: minimal erlaubte Bordnetzspannung im Hochsetzbetrieb vom 12V-Bordnetz ins 48V-Netz
    signal NVEM_MV_DC_uSollLV_XIX_NVEM_12_XIX_VLAN_Cockpit: start 58, 7 bit, little-endian, data-type-policy=OVERRIDE, i-signal-type=PRIMITIVE, init-value=126, base-type=BT_NVEM_MV_DC_uSollLV, invalid-value=Invalid_NVEM_MV_DC_uSollLV_XIX_NVEM_12_XIX_VLAN_Cockpit:127, compu {phys=raw*0.05+10.6 for raw 0..108, 127=Cx7f_Fehler (CM_NVEM_MV_DC_uSollLV_Cx7f_Fehler), 126=Cx7e_Init (CM_NVEM_MV_DC_uSollLV_Cx7e_Init); unit Unit_Volt}, range phys 10.6..16 Unit_Volt, raw 0..127, unit=Unit_Volt, transfer-property=TRIGGERED-WITHOUT-REPETITION  # Sollwert für die 12V-Bordnetzspannung im Tiefsetzbetrieb vom 48V-Netz ins 12V-Bordnetz
    signal BEM_STH_Einschaltverbot_XIX_NVEM_12_XIX_VLAN_Cockpit: start 65, 1 bit, little-endian, data-type-policy=OVERRIDE, i-signal-type=PRIMITIVE, init-value=0, base-type=BT_BEM_STH_Einschaltverbot, compu {1=Cx1_Standheizung_lueftung_nicht_aktivierbar (CM_BEM_STH_Einschaltverbot_Cx1_Standheizung_lueftung_nicht_aktivierbar) (Standheizung/-lueftung nicht aktivierbar), 0=Cx0_volle_Verfuegbarkeit_Standheizung_lueftung (CM_BEM_STH_Einschaltverbot_Cx0_volle_Verfuegbarkeit_Standheizung_lueftung) (volle Verfuegbarkeit Standheizung/-lueftung)}, range raw 0..1, transfer-property=TRIGGERED-WITHOUT-REPETITION  # Einschränkung Standheizung/-lüftung durch BEM: Setzt der BEM das Bit, dann darf die Standheizung nicht mehr einschalten (Die Standheizung muss aber nicht abschalten, sondern darf weiterbrennen) (Initialisierungswert aus EEprom)
    signal BEM_STH_Zielzeit_XIX_NVEM_12_XIX_VLAN_Cockpit: start 66, 4 bit, little-endian, data-type-policy=OVERRIDE, i-signal-type=PRIMITIVE, init-value=14, base-type=BT_BEM_STH_Zielzeit, invalid-value=Invalid_BEM_STH_Zielzeit_XIX_NVEM_12_XIX_VLAN_Cockpit:15, compu {phys=raw*5 for raw 0..12, 15=Cxf_Fehler (CM_BEM_STH_Zielzeit_Cxf_Fehler), 14=Cxe_Init (CM_BEM_STH_Zielzeit_Cxe_Init); unit Unit_Minut}, range phys 0..60 Unit_Minut, raw 0..15, unit=Unit_Minut, transfer-property=TRIGGERED-WITHOUT-REPETITION  # Maximal mögliche Zeit für den Standheizungsbetrieb, um die Startfähigkeit nicht zu gefährden
    signal NVEM_Verbraucher_Information_XIX_NVEM_12_XIX_VLAN_Cockpit: start 70, 3 bit, little-endian, data-type-policy=OVERRIDE, i-signal-type=PRIMITIVE, init-value=6, base-type=BT_NVEM_Verbraucher_Information, invalid-value=Invalid_NVEM_Verbraucher_Information_XIX_NVEM_12_XIX_VLAN_Cockpit:7, compu {7=Cx7_Fehler (CM_NVEM_Verbraucher_Information_Cx7_Fehler), 0=Cx0_Keine_Anzeige (CM_NVEM_Verbraucher_Information_Cx0_Keine_Anzeige), 1=Cx1_MMI_Vorwarnung (CM_NVEM_Verbraucher_Information_Cx1_MMI_Vorwarnung), 2=Cx2_Anzeige_Verbraucherabschaltung (CM_NVEM_Verbraucher_Information_Cx2_Anzeige_Verbraucherabschaltung), 5=Cx5_reserviert (CM_NVEM_Verbraucher_Information_Cx5_reserviert), 3=Cx3_reserviert (CM_NVEM_Verbraucher_Information_Cx3_reserviert), 4=Cx4_reserviert (CM_NVEM_Verbraucher_Information_Cx4_reserviert), 6=Cx6_Init (CM_NVEM_Verbraucher_Information_Cx6_Init)}, range raw 0..7, transfer-property=TRIGGERED-WITHOUT-REPETITION  # Mit diesem Signal löst Das NVM eine Anzeige bzgl. einer bevorstehenden oder erfolgten Verbraucherabschaltung aus
    signal NVEM3_Absch_SCR_XIX_NVEM_12_XIX_VLAN_Cockpit: start 73, 1 bit, little-endian, data-type-policy=OVERRIDE, i-signal-type=PRIMITIVE, init-value=0, base-type=BT_NVEM3_Absch_SCR, compu {1=Cx1_Abschaltung_SCR (CM_NVEM3_Absch_SCR_Cx1_Abschaltung_SCR), 0=Cx0_Init (CM_NVEM3_Absch_SCR_Cx0_Init)}, range raw 0..1, transfer-property=TRIGGERED-WITHOUT-REPETITION  # Abschaltung der SCR-Heizung durch das NVEM bei energetisch kritischen Zuständen.
    signal NVEM_Bordnetz_Information_XIX_NVEM_12_XIX_VLAN_Cockpit: start 76, 4 bit, little-endian, data-type-policy=OVERRIDE, i-signal-type=PRIMITIVE, init-value=14, base-type=BT_NVEM_Bordnetz_Information, invalid-value=Invalid_NVEM_Bordnetz_Information_XIX_NVEM_12_XIX_VLAN_Cockpit:15, compu {15=Cxf_Fehler (CM_NVEM_Bordnetz_Information_Cxf_Fehler), 1=Cx1_NV_Batterie_iO (CM_NVEM_Bordnetz_Information_Cx1_NV_Batterie_iO), 8=Cx8_Ladekontrollleuchte (CM_NVEM_Bordnetz_Information_Cx8_Ladekontrollleuchte), 0=Cx0_keine_Anzeige (CM_NVEM_Bordnetz_Information_Cx0_keine_Anzeige), 4=Cx4_NV_Batterie_schwach (CM_NVEM_Bordnetz_Information_Cx4_NV_Batterie_schwach), 3=Cx3_NV_Batterie_pruefen (CM_NVEM_Bordnetz_Information_Cx3_NV_Batterie_pruefen), 2=Cx2_NV_Batterie_laden (CM_NVEM_Bordnetz_Information_Cx2_NV_Batterie_laden), 13=Cxd_reserviert (CM_NVEM_Bordnetz_Information_Cxd_reserviert), 7=Cx7_NV_Energiesystem_unplausibel (CM_NVEM_Bordnetz_Information_Cx7_NV_Energiesystem_unplausibel), 14=Cxe_Init (CM_NVEM_Bordnetz_Information_Cxe_Init), 6=Cx6_NV_Batterie_Service (CM_NVEM_Bordnetz_Information_Cx6_NV_Batterie_Service), 5=Cx5_NV_Batterie_Ab (CM_NVEM_Bordnetz_Information_Cx5_NV_Batterie_Ab), 9=Cx9_Generator_defekt (CM_NVEM_Bordnetz_Information_Cx9_Generator_defekt), 10=Cxa_reserviert (CM_NVEM_Bordnetz_Information_Cxa_reserviert), 11=Cxb_reserviert (CM_NVEM_Bordnetz_Information_Cxb_reserviert), 12=Cxc_reserviert (CM_NVEM_Bordnetz_Information_Cxc_reserviert)}, range raw 0..15, transfer-property=TRIGGERED-WITHOUT-REPETITION  # Informationsanzeigen zum 12V - Bordnetz
    signal NVEM_DC_uMin_NV_XIX_NVEM_12_XIX_VLAN_Cockpit: start 80, 8 bit, little-endian, data-type-policy=OVERRIDE, i-signal-type=PRIMITIVE, init-value=122, base-type=BT_NVEM_DC_uMin_NV, compu {phys=raw*0.1 for raw 0..255; unit Unit_Volt}, range phys 0..25.5 Unit_Volt, raw 0..255, unit=Unit_Volt, transfer-property=TRIGGERED-WITHOUT-REPETITION  # Mindestspannung des DCDC Wandlers im Hochsetzbetrieb auf 12V Seite
    signal NVEM_MV_DC_iSoll_NV_XIX_NVEM_12_XIX_VLAN_Cockpit: start 88, 8 bit, little-endian, data-type-policy=OVERRIDE, i-signal-type=PRIMITIVE, init-value=254, base-type=BT_NVEM_MV_DC_iSoll_NV, invalid-value=Invalid_NVEM_MV_DC_iSoll_NV_XIX_NVEM_12_XIX_VLAN_Cockpit:255, compu {phys=raw-253 for raw 0..253, 255=Cxff_Fehler (CM_NVEM_MV_DC_iSoll_NV_Cxff_Fehler), 254=Cxfe_Init (CM_NVEM_MV_DC_iSoll_NV_Cxfe_Init); unit Unit_Amper}, range phys -253..0 Unit_Amper, raw 0..255, unit=Unit_Amper, transfer-property=TRIGGERED-WITHOUT-REPETITION  # Sollstromvorgabe NVEM an MV - DCDC Wandler
  pdu OBD_03_XIX_VLAN_Cockpit: length=8, transmission-mode-true-timing=cyclic-timing={time-offset=0.0, time-period=0.32}, unused-bit-pattern=0
    signal OBD_Eng_Cool_Temp_XIX_OBD_03_XIX_VLAN_Cockpit: start 12, 8 bit, little-endian, data-type-policy=OVERRIDE, i-signal-type=PRIMITIVE, init-value=255, base-type=BT_OBD_Eng_Cool_Temp, compu {phys=raw-40 for raw 0..255; unit Unit_DegreCelsi}, range phys -40..215 Unit_DegreCelsi, raw 0..255, unit=Unit_DegreCelsi, transfer-property=PENDING  # Engine Coolant Temperature Übertragung von Meßgrößen an das Getriebesteuergerät für Freeze Frame Abspeicherung bei Getriebefehlern PID $05 Engine Coolant Temperature; -40 .. +215°C mit 1°C/bit und 40°C Offset
    signal OBD_Abs_Throttle_Pos_XIX_OBD_03_XIX_VLAN_Cockpit: start 20, 8 bit, little-endian, data-type-policy=OVERRIDE, i-signal-type=PRIMITIVE, init-value=255, base-type=BT_OBD_Abs_Throttle_Pos, compu {phys=raw*0.3921568627 for raw 0..255; unit Unit_PerCent}, range phys 0..100 Unit_PerCent, raw 0..255, unit=Unit_PerCent, transfer-property=PENDING  # Absolute Throttle Position Übertragung von Meßgrößen an das Getriebesteuergerät für Freeze Frame Abspeicherung bei Getriebefehlern PID $11 Absolute Throttle Position; 0 .. 100% mit 100/255 %/bit
    signal OBD_Abs_Load_Val_XIX_OBD_03_XIX_VLAN_Cockpit: start 28, 16 bit, little-endian, data-type-policy=OVERRIDE, i-signal-type=PRIMITIVE, init-value=65535, base-type=BT_OBD_Abs_Load_Val, compu {phys=raw*0.3921568627 for raw 0..65535; unit Unit_PerCent}, range phys 0..25700 Unit_PerCent, raw 0..65535, unit=Unit_PerCent, transfer-property=PENDING  # Absolute Load Value Übertragung von Meßgrößen an das Getriebesteuergerät für Freeze Frame Abspeicherung bei Getriebefehlern PID $43 Absolute Load Value; 0 .. 25700% mit 100/255 %/bit
    signal OBD_Abs_Pedal_Pos_XIX_OBD_03_XIX_VLAN_Cockpit: start 44, 8 bit, little-endian, data-type-policy=OVERRIDE, i-signal-type=PRIMITIVE, init-value=255, base-type=BT_OBD_Abs_Pedal_Pos, compu {phys=raw*0.3921568627 for raw 0..255; unit Unit_PerCent}, range phys 0..100 Unit_PerCent, raw 0..255, unit=Unit_PerCent, transfer-property=PENDING  # Absolute Pedal Position Übertragung von Meßgrößen an das Getriebesteuergerät für Freeze Frame Abspeicherung bei Getriebefehlern PID $49 Accelerator Pedal Position D; 0 .. 100% mit 100/255 %/bit
    signal OBD_Aussen_Temp_gef_XIX_OBD_03_XIX_VLAN_Cockpit: start 52, 8 bit, little-endian, data-type-policy=OVERRIDE, i-signal-type=PRIMITIVE, init-value=254, base-type=BT_OBD_Aussen_Temp_gef, invalid-value=Invalid_OBD_Aussen_Temp_gef_XIX_OBD_03_XIX_VLAN_Cockpit:255, compu {phys=raw-40 for raw 0..253, 255=Cxff_Fehler (CM_OBD_Aussen_Temp_gef_Cxff_Fehler), 254=Cxfe_Initwert (CM_OBD_Aussen_Temp_gef_Cxfe_Initwert); unit Unit_DegreCelsi}, range phys -40..213 Unit_DegreCelsi, raw 0..255, unit=Unit_DegreCelsi, transfer-property=PENDING  # Gefilterte Aussentemperatur vom Motor für OBD Funktionen.
    signal OBD_Minimum_Trip_XIX_OBD_03_XIX_VLAN_Cockpit: start 60, 1 bit, little-endian, data-type-policy=OVERRIDE, i-signal-type=PRIMITIVE, init-value=0, base-type=BT_OBD_Minimum_Trip, compu {0=Cx0_kein_Min_Normed_Trip (CM_OBD_Minimum_Trip_Cx0_kein_Min_Normed_Trip), 1=Cx1_Min_Normed_Trip (CM_OBD_Minimum_Trip_Cx1_Min_Normed_Trip)}, range raw 0..1, transfer-property=PENDING  # Grundlage OBD-Gesetz CCR 1968.2 (d)(4.3) Denominator Specifications Bildung des General Denominator "Normed Trip": 600 sec. (kumulativ) Zeit nach Motorstart 300 sec. (kumulativ) mit Fahrzeuggeschwindigkeit > 25 mph (40 km/h) 30 sec. (kontinuierlich) Leerlauf Wenn alle diese Bedingungen erfüllt wurden ist ein OBD_Min_Normed_Trip erfüllt
    signal OBD_Driving_Cycle_XIX_OBD_03_XIX_VLAN_Cockpit: start 61, 1 bit, little-endian, data-type-policy=OVERRIDE, i-signal-type=PRIMITIVE, init-value=0, base-type=BT_OBD_Driving_Cycle, compu {0=Cx0_kein_Driving_Cycle_erkannt (CM_OBD_Driving_Cycle_Cx0_kein_Driving_Cycle_erkannt), 1=Cx1_Driving_Cycle_erkannt (CM_OBD_Driving_Cycle_Cx1_Driving_Cycle_erkannt)}, range raw 0..1, transfer-property=PENDING, to HCP3_IONode(timeout 3.2 s)  # Signalisierung Driving Cycle Qualifizierung - Trigger Ignition Cycle Counter
    signal OBD_Warm_Up_Cycle_XIX_OBD_03_XIX_VLAN_Cockpit: start 62, 1 bit, little-endian, data-type-policy=OVERRIDE, i-signal-type=PRIMITIVE, init-value=0, base-type=BT_OBD_Warm_Up_Cycle, compu {0=Cx0_kein_Warm_Up_Cycle_erkannt (CM_OBD_Warm_Up_Cycle_Cx0_kein_Warm_Up_Cycle_erkannt), 1=Cx1_Warm_Up_Cycle_erkannt (CM_OBD_Warm_Up_Cycle_Cx1_Warm_Up_Cycle_erkannt)}, range raw 0..1, transfer-property=PENDING, to HCP3_IONode(timeout 3.2 s)  # Mit dem Warm-Up-Cycle wird der zentrale Verlernzähler vom Gateway inkrementiert
    signal OBD_Normed_Trip_XIX_OBD_03_XIX_VLAN_Cockpit: start 63, 1 bit, little-endian, data-type-policy=OVERRIDE, i-signal-type=PRIMITIVE, init-value=0, base-type=BT_OBD_Normed_Trip, compu {1=Cx1_Normed_Trip (CM_OBD_Normed_Trip_Cx1_Normed_Trip), 0=Cx0_kein_Normed_Trip (CM_OBD_Normed_Trip_Cx0_kein_Normed_Trip)}, range raw 0..1, transfer-property=PENDING  # Gesetzlich definierte "Normed Condition" erfüllt, "General Denominator" darf erhöht werden
  pdu OBD_04_XIX_VLAN_Cockpit: length=8, minimum-delay=0.08, transmission-mode-true-timing={cyclic-timing={time-offset=0.0, time-period=0.32}, event-controlled-timing={number-of-repetitions=0, repetition-period=0.0}}, unused-bit-pattern=0
    signal OBD_Calc_Load_Val_XIX_OBD_04_XIX_VLAN_Cockpit: start 12, 8 bit, little-endian, data-type-policy=OVERRIDE, i-signal-type=PRIMITIVE, init-value=255, base-type=BT_OBD_Calc_Load_Val, compu {phys=raw*0.3921568627 for raw 0..255; unit Unit_PerCent}, range phys 0..100 Unit_PerCent, raw 0..255, unit=Unit_PerCent, transfer-property=PENDING  # Calculated Load Value Übertragung von Meßgrößen an das Getriebesteuergerät für Freeze Frame Abspeicherung bei Getriebefehlern PID $04 Calculated Load Value; 0 .. 100% mit 100/255 % per bit
    signal OBD_ClearMem_Inhibit_XIX_OBD_04_XIX_VLAN_Cockpit: start 20, 1 bit, little-endian, data-type-policy=OVERRIDE, i-signal-type=PRIMITIVE, init-value=0, base-type=BT_OBD_ClearMem_Inhibit, compu {1=Cx1_FSP_Loeschen_nicht_zulaessig (CM_OBD_ClearMem_Inhibit_Cx1_FSP_Loeschen_nicht_zulaessig), 0=Cx0_FSP_Loeschen_zulaessig (CM_OBD_ClearMem_Inhibit_Cx0_FSP_Loeschen_zulaessig)}, range raw 0..1, transfer-property=PENDING  # Bei FSP_Loeschen_zulässig müssen alle OBD-ECUs im Gesamtfahrzeug einen Service 04hex Request (Ereignisspeicher löschen) korrekt ausführen. In MLB-, MLBevo-, MQB-Fahrzeugkonzepten muss der MIL-Master/Motorsteuergerät bei Kl.15 ein, projektabhängig, konstant OBD_ClearMem_Inhibit = 0 senden, sofern das Löschen des Ereignisspeichers noch in jedem Betriebszustand (auch bei laufendem Motor, etc.) gefordert ist. Projektspezifisch im MLB-, MLBevo-, und MQB-Fahrzeugkonzepten und vollumfänglich in MQB_37W- und MLB3-Fahrzeugkonzepten wird das Ereignisspeicher löschen in allen OBD-ECUs auf den Betriebszustand stehendes Fahrzeug und stehender Motor beschränkt und die entsprechende Freigabe das Ereignisspeicher Löschens vom MIL-Master über das Bussignal OBD_ClearMem_Inhibit für alle anderen OBD-ECUs im Gesamtfahrzeug signalisiert. Hinweis: Steuergerät- oder Komponentenspezifische Randbedingungen sind unter Abhängigkeit des Sicherheitskonzepts zu prüfen und zu bewerten.
    signal OBD_Sperrung_IUMPR_XIX_OBD_04_XIX_VLAN_Cockpit: start 21, 1 bit, little-endian, data-type-policy=OVERRIDE, i-signal-type=PRIMITIVE, init-value=0, base-type=BT_OBD_Sperrung_IUMPR, compu {0=Cx0_IUMPR_Berechnung_freigegeben (CM_OBD_Sperrung_IUMPR_Cx0_IUMPR_Berechnung_freigegeben), 1=Cx1_IUMPR_Berechnung_gesperrt (CM_OBD_Sperrung_IUMPR_Cx1_IUMPR_Berechnung_gesperrt)}, range raw 0..1, transfer-property=PENDING  # Wenn der General Denominator auf Grund eines Fehlers in den Eingangsgrößen gesperrt wird, wird diese Information über Bussystem als OBD-Statusinformation OBD_Sperrung_IUMPR für andere OBD-Steuergeräte bereitgestellt. Das MSG (MIL-Master) setzt dieses Bit, wenn auf Grund vorliegender Sperrbedingungen keine Inkrementierung des GeneralDenominator mehr stattfindet. Im Empfänger-SG ist entsprechend die Inkrementierung des oder der Numeratoren einzufrieren.
    signal OBD_Sperrung_Kaltstart_Denom_XIX_OBD_04_XIX_VLAN_Cockpit: start 22, 1 bit, little-endian, data-type-policy=OVERRIDE, i-signal-type=PRIMITIVE, init-value=0, base-type=BT_OBD_Sperrung_Kaltstart_Denom, compu {1=Cx1_EVAP_Berechnung_gesperrt (CM_OBD_Sperrung_Kaltstart_Denom_Cx1_EVAP_Berechnung_gesperrt), 0=Cx0_EVAP_Berechnung_freigegeben (CM_OBD_Sperrung_Kaltstart_Denom_Cx0_EVAP_Berechnung_freigegeben)}, range raw 0..1, transfer-property=PENDING  # Information vom MIL Master, dass die Bildung des EVAP Denominators im Motor nicht möglich ist und damit der noECM-Denominator gesperrt werden darf.
    signal OBD_Kaltstart_Denominator_XIX_OBD_04_XIX_VLAN_Cockpit: start 23, 1 bit, little-endian, data-type-policy=OVERRIDE, i-signal-type=PRIMITIVE, init-value=0, base-type=BT_OBD_Kaltstart_Denominator, compu {0=Cx0_Denominator_nicht_hochzaehlen (CM_OBD_Kaltstart_Denominator_Cx0_Denominator_nicht_hochzaehlen), 1=Cx1_Bedingungen_zum_Inkr_des_Kaltstart_Denom_erf (CM_OBD_Kaltstart_Denominator_Cx1_Bedingungen_zum_Inkr_des_Kaltstart_Denom_erf)}, range raw 0..1, transfer-property=PENDING  # Bestimmte Diagnosen werden nur unter Kaltstartbedingungen durchgeführt, der entsprechende Denominator bei IUMPR-pflichtigen Systemen wird anhand dieses vom MSG gebildeten Signals inkrementiert. (Entspricht EVAP-Denominator)
    signal MM_PropulsionSystemActive_XIX_OBD_04_XIX_VLAN_Cockpit: start 24, 1 bit, little-endian, data-type-policy=OVERRIDE, i-signal-type=PRIMITIVE, init-value=0, base-type=BT_MM_PropulsionSystemActive, compu {1=Cx1_PropulsionSystemActive (CM_MM_PropulsionSystemActive_Cx1_PropulsionSystemActive), 0=Cx0_PropulsionSystemNotActive (CM_MM_PropulsionSystemActive_Cx0_PropulsionSystemNotActive)}, range raw 0..1, transfer-property=TRIGGERED-ON-CHANGE-WITHOUT-REPETITION, to HCP3_IONode(timeout 3.2 s)  # Fahrzeug ist fahrbereit
    signal OBD_Typ_XIX_OBD_04_XIX_VLAN_Cockpit: start 25, 1 bit, little-endian, data-type-policy=OVERRIDE, i-signal-type=PRIMITIVE, init-value=0, base-type=BT_OBD_Typ, compu {1=Cx1_FullOBD (CM_OBD_Typ_Cx1_FullOBD), 0=Cx0_OBDReady (CM_OBD_Typ_Cx0_OBDReady)}, range raw 0..1, transfer-property=PENDING  # Abgastyp OBD Hinweis: In Fahrzeugen mit dem Zielmarkt China und einer Zertifizierung ab China 6 muss auf dem Signal "OBD_Typ" der Wert "US_OBD" gesendet werden."
    signal OBD_MIL_XIX_OBD_04_XIX_VLAN_Cockpit: start 26, 1 bit, little-endian, data-type-policy=OVERRIDE, i-signal-type=PRIMITIVE, init-value=0, base-type=BT_OBD_MIL, invalid-value=Invalid_OBD_MIL_XIX_OBD_04_XIX_VLAN_Cockpit:1, compu {1=Cx1_Fehler (CM_OBD_MIL_Cx1_Fehler), 0=Cx0_Lampe_aus (CM_OBD_MIL_Cx0_Lampe_aus)}, range raw 0..1, transfer-property=TRIGGERED-ON-CHANGE-WITHOUT-REPETITION  # Ansteuerung der MIL
    signal OBD_QBit_Aussen_Temp_XIX_OBD_04_XIX_VLAN_Cockpit: start 27, 1 bit, little-endian, data-type-policy=OVERRIDE, i-signal-type=PRIMITIVE, init-value=1, base-type=BT_OBD_QBit_Aussen_Temp, compu {0=Cx0_gueltiger_Wert (CM_OBD_QBit_Aussen_Temp_Cx0_gueltiger_Wert), 1=Cx1_Ersatz_Init_oder_Fehlerwert (CM_OBD_QBit_Aussen_Temp_Cx1_Ersatz_Init_oder_Fehlerwert)}, range raw 0..1, transfer-property=TRIGGERED-ON-CHANGE-WITHOUT-REPETITION  # QBit der Aussentemperatur. Gesetzt bei Ersatzwert, Init oder Fehler.
    signal OBD_NumDcyMilOnReq_XIX_OBD_04_XIX_VLAN_Cockpit: start 28, 8 bit, little-endian, data-type-policy=OVERRIDE, i-signal-type=PRIMITIVE, init-value=0, base-type=BT_OBD_NumDcyMilOnReq, compu {phys=raw for raw 0..255; unit Unit_None}, range phys 0..255 Unit_None, raw 0..255, unit=Unit_None, transfer-property=PENDING  # Anzahl der DrivingCycle für MIL-Entprellung von MIL-Master
    signal OBD_Normed_Trip_Wout_Fu_Cdn_XIX_OBD_04_XIX_VLAN_Cockpit: start 36, 1 bit, little-endian, data-type-policy=OVERRIDE, i-signal-type=PRIMITIVE, init-value=0, base-type=BT_OBD_Normed_Trip_Wout_Fu_Cdn, compu {1=Cx1_Normed_Trip_wo_Fu_Cdn (CM_OBD_Normed_Trip_Wout_Fu_Cdn_Cx1_Normed_Trip_wo_Fu_Cdn), 0=Cx0_kein_Normed_Trip_wo_Fu_Cdn (CM_OBD_Normed_Trip_Wout_Fu_Cdn_Cx0_kein_Normed_Trip_wo_Fu_Cdn)}, range raw 0..1, transfer-property=PENDING  # Bedingung für General Denominator-Inkrementierung ohne FueledEngine-Operation -> wird für die Berechnung des General Denominators in der Motorsteuerung (ScanTool-Ausgabe Mode$09, InfoType$08, OBDCOND) benötigt
    signal OBD_Engine_RPM_XIX_OBD_04_XIX_VLAN_Cockpit: start 40, 16 bit, little-endian, data-type-policy=OVERRIDE, i-signal-type=PRIMITIVE, init-value=0, base-type=BT_OBD_Engine_RPM, compu {phys=raw*0.25 for raw 0..65535; unit Unit_MinutInver}, range phys 0..16383.75 Unit_MinutInver, raw 0..65535, unit=Unit_MinutInver, transfer-property=PENDING  # Motordrehzahl des Verbrennungsmotors für OBD freeze frame
    signal OBD_Barometric_Pressure_XIX_OBD_04_XIX_VLAN_Cockpit: start 56, 8 bit, little-endian, data-type-policy=OVERRIDE, i-signal-type=PRIMITIVE, init-value=0, base-type=BT_OBD_Barometric_Pressure, compu {phys=raw for raw 0..255; unit Unit_KiloPascal}, range phys 0..255 Unit_KiloPascal, raw 0..255, unit=Unit_KiloPascal, transfer-property=PENDING  # Umgebungsdruck für OBD freeze frame
  pdu ORU_01_XIX_VLAN_Cockpit: length=8, transmission-mode-true-timing=cyclic-timing={time-offset=0.0, time-period=0.5}, unused-bit-pattern=0
    signal ORU_AgLgtSdsl_XIX_ORU_01_XIX_VLAN_Cockpit: start 12, 11 bit, little-endian, data-type-policy=OVERRIDE, i-signal-type=PRIMITIVE, init-value=2001, base-type=BT_ORU_AgLgtSdsl, invalid-value=Invalid_ORU_AgLgtSdsl_XIX_ORU_01_XIX_VLAN_Cockpit:2002, compu {phys=raw*0.1-100 for raw 0..2000, 2002=Cx7d2_Fehler (CM_ORU_AgLgtSdsl_Cx7d2_Fehler), 2001=Cx7d1_InitWert (CM_ORU_AgLgtSdsl_Cx7d1_InitWert); unit Unit_PerCent}, range phys -100..100 Unit_PerCent, raw 0..2002, unit=Unit_PerCent, transfer-property=PENDING  # Vehicle inclination angle at standstill in percent
    signal ORU_Status_XIX_ORU_01_XIX_VLAN_Cockpit: start 61, 3 bit, little-endian, data-type-policy=OVERRIDE, i-signal-type=PRIMITIVE, init-value=0, base-type=BT_ORU_Status, compu {6=Cx6_PENDING_NOTREADY (CM_ORU_Status_Cx6_PENDING_NOTREADY), 1=Cx1_PENDING (CM_ORU_Status_Cx1_PENDING), 5=Cx5_RUNNING_HV (CM_ORU_Status_Cx5_RUNNING_HV), 2=Cx2_PREPARATION (CM_ORU_Status_Cx2_PREPARATION), 7=Cx7_FAILURE_POWERTRAIN_DISABLED (CM_ORU_Status_Cx7_FAILURE_POWERTRAIN_DISABLED), 0=Cx0_IDLE (CM_ORU_Status_Cx0_IDLE), 4=Cx4_RUNNING (CM_ORU_Status_Cx4_RUNNING), 3=Cx3_PREPARATION_HV (CM_ORU_Status_Cx3_PREPARATION_HV)}, range raw 0..7, transfer-property=PENDING, to HCP3_IONode(timeout 5 s)  # Verteilung des internen ORU Zustandes
  pdu ORU_Control_A_01_XIX_VLAN_Cockpit_E2E: length=8, transmission-mode-true-timing=event-controlled-timing={number-of-repetitions=0, repetition-period=0.0}, unused-bit-pattern=0  # Fuer die Botschaft ist das Cyclic-Timing 0.5 zu verwenden.
    signal ORU_Control_A_01_CRC_XIX_ORU_Control_A_01_XIX_VLAN_Cockpit: start 0, 8 bit, little-endian, data-type-policy=OVERRIDE, i-signal-type=PRIMITIVE, init-value=0, base-type=BT_ORU_Control_A_01_CRC, compu {phys=raw for raw 0..255}, range phys 0..255, raw 0..255, to HCP3_IONode(timeout 5 s)
    signal ORU_Control_A_01_BZ_XIX_ORU_Control_A_01_XIX_VLAN_Cockpit: start 8, 4 bit, little-endian, data-type-policy=OVERRIDE, i-signal-type=PRIMITIVE, init-value=0, base-type=BT_ORU_Control_A_01_BZ, compu {phys=raw for raw 0..15}, range phys 0..15, raw 0..15, to HCP3_IONode(timeout 5 s)
    signal OnlineRemoteUpdateControlA_XIX_ORU_Control_A_01_XIX_VLAN_Cockpit: start 12, 4 bit, little-endian, data-type-policy=OVERRIDE, i-signal-type=PRIMITIVE, init-value=0, base-type=BT_OnlineRemoteUpdateControlA, invalid-value=Invalid_OnlineRemoteUpdateControlA_XIX_ORU_Control_A_01_XIX_VLAN_Cockpit:15, compu {15=Cxf_Fehler (CM_OnlineRemoteUpdateControlA_Cxf_Fehler), 8=Cx8_FUNCTIONAL_SAFETY_RELEASED (CM_OnlineRemoteUpdateControlA_Cx8_FUNCTIONAL_SAFETY_RELEASED), 5=Cx5_RUNNING_HV (CM_OnlineRemoteUpdateControlA_Cx5_RUNNING_HV), 9=Cx9_PREPARATION_SG (CM_OnlineRemoteUpdateControlA_Cx9_PREPARATION_SG), 0=Cx0_IDLE (CM_OnlineRemoteUpdateControlA_Cx0_IDLE), 7=Cx7_OTA_FAILURE_POWERTRAIN_DISABLED (CM_OnlineRemoteUpdateControlA_Cx7_OTA_FAILURE_POWERTRAIN_DISABLED), 3=Cx3_PREPARATION_HV (CM_OnlineRemoteUpdateControlA_Cx3_PREPARATION_HV), 2=Cx2_PREPARATION (CM_OnlineRemoteUpdateControlA_Cx2_PREPARATION), 4=Cx4_RUNNING (CM_OnlineRemoteUpdateControlA_Cx4_RUNNING), 1=Cx1_PENDING (CM_OnlineRemoteUpdateControlA_Cx1_PENDING), 6=Cx6_PENDING_NOTREADY (CM_OnlineRemoteUpdateControlA_Cx6_PENDING_NOTREADY)}, range raw 0..15, to HCP3_IONode(timeout 5 s)  # Current state of the oru control component
    signal OnlineRemoteUpdateControlOldA_XIX_ORU_Control_A_01_XIX_VLAN_Cockpit: start 16, 4 bit, little-endian, data-type-policy=OVERRIDE, i-signal-type=PRIMITIVE, init-value=0, base-type=BT_OnlineRemoteUpdateControlOldA, invalid-value=Invalid_OnlineRemoteUpdateControlOldA_XIX_ORU_Control_A_01_XIX_VLAN_Cockpit:15, compu {15=Cxf_Fehler (CM_OnlineRemoteUpdateControlOldA_Cxf_Fehler), 3=Cx3_PREPARATION_HV (CM_OnlineRemoteUpdateControlOldA_Cx3_PREPARATION_HV), 6=Cx6_PENDING_NOTREADY (CM_OnlineRemoteUpdateControlOldA_Cx6_PENDING_NOTREADY), 9=Cx9_PREPARATION_SG (CM_OnlineRemoteUpdateControlOldA_Cx9_PREPARATION_SG), 4=Cx4_RUNNING (CM_OnlineRemoteUpdateControlOldA_Cx4_RUNNING), 2=Cx2_PREPARATION (CM_OnlineRemoteUpdateControlOldA_Cx2_PREPARATION), 5=Cx5_RUNNING_HV (CM_OnlineRemoteUpdateControlOldA_Cx5_RUNNING_HV), 1=Cx1_PENDING (CM_OnlineRemoteUpdateControlOldA_Cx1_PENDING), 0=Cx0_IDLE (CM_OnlineRemoteUpdateControlOldA_Cx0_IDLE), 8=Cx8_FUNCTIONAL_SAFETY_RELEASE (CM_OnlineRemoteUpdateControlOldA_Cx8_FUNCTIONAL_SAFETY_RELEASE), 7=Cx7_OTA_FAILURE_POWERTRAIN_DISABLED (CM_OnlineRemoteUpdateControlOldA_Cx7_OTA_FAILURE_POWERTRAIN_DISABLED)}, range raw 0..15, to HCP3_IONode(timeout 5 s)  # Old state of the ORU control A signal (state 5 cycles before)
    signal OruVehicleLockRequestA_XIX_ORU_Control_A_01_XIX_VLAN_Cockpit: start 20, 2 bit, little-endian, data-type-policy=OVERRIDE, i-signal-type=PRIMITIVE, init-value=0, base-type=BT_OruVehicleLockRequestA, invalid-value=Invalid_OruVehicleLockRequestA_XIX_ORU_Control_A_01_XIX_VLAN_Cockpit:3, compu {3=Cx3_Fehler (CM_OruVehicleLockRequestA_Cx3_Fehler), 2=Cx2_Release (CM_OruVehicleLockRequestA_Cx2_Release), 1=Cx1_Lock (CM_OruVehicleLockRequestA_Cx1_Lock), 0=Cx0_Init (CM_OruVehicleLockRequestA_Cx0_Init)}, range raw 0..3, to HCP3_IONode(timeout 5 s)  # Releases or locks one or more ECUs with their specific functions (e.g. immobilizer)
    signal OruIntegrityCheckActiveA_XIX_ORU_Control_A_01_XIX_VLAN_Cockpit: start 22, 2 bit, little-endian, data-type-policy=OVERRIDE, i-signal-type=PRIMITIVE, init-value=0, base-type=BT_OruIntegrityCheckActiveA, invalid-value=Invalid_OruIntegrityCheckActiveA_XIX_ORU_Control_A_01_XIX_VLAN_Cockpit:3, compu {3=Cx3_Fehler (CM_OruIntegrityCheckActiveA_Cx3_Fehler), 1=Cx1_Inactive (CM_OruIntegrityCheckActiveA_Cx1_Inactive), 2=Cx2_Active (CM_OruIntegrityCheckActiveA_Cx2_Active), 0=Cx0_Init (CM_OruIntegrityCheckActiveA_Cx0_Init)}, range raw 0..3  # Signal to indicate if the integrity check is active
    signal OruControlReleaseA_XIX_ORU_Control_A_01_XIX_VLAN_Cockpit: start 24, 16 bit, little-endian, data-type-policy=OVERRIDE, i-signal-type=PRIMITIVE, init-value=0, base-type=BT_OruControlReleaseA, compu {phys=raw for raw 0..65535; unit Unit_None}, range phys 0..65535 Unit_None, raw 0..65535, unit=Unit_None  # Release of an ecu to be flashed by oru
    signal OruControlStateA_XIX_ORU_Control_A_01_XIX_VLAN_Cockpit: start 40, 8 bit, little-endian, data-type-policy=OVERRIDE, i-signal-type=PRIMITIVE, init-value=0, base-type=BT_OruControlStateA, invalid-value=Invalid_OruControlStateA_XIX_ORU_Control_A_01_XIX_VLAN_Cockpit:129, compu {129=Cx81_Fehler (CM_OruControlStateA_Cx81_Fehler), 63=Cx3f_Done (CM_OruControlStateA_Cx3f_Done), 15=Cxf_Running (CM_OruControlStateA_Cxf_Running), 0=Cx0_Idle (CM_OruControlStateA_Cx0_Idle), 1=Cx1_Check (CM_OruControlStateA_Cx1_Check), 3=Cx3_DataPresent (CM_OruControlStateA_Cx3_DataPresent), 31=Cx1f_Save (CM_OruControlStateA_Cx1f_Save), 65=Cx41_Fail (CM_OruControlStateA_Cx41_Fail), 7=Cx7_LockActive (CM_OruControlStateA_Cx7_LockActive)}, range raw 0..129  # Internal State of ORU Control component.
    signal OruReleasePartitionSwitchA_XIX_ORU_Control_A_01_XIX_VLAN_Cockpit: start 48, 2 bit, little-endian, data-type-policy=OVERRIDE, i-signal-type=PRIMITIVE, init-value=0, base-type=BT_OruReleasePartitionSwitchA, invalid-value=Invalid_OruReleasePartitionSwitchA_XIX_ORU_Control_A_01_XIX_VLAN_Cockpit:3, compu {3=Cx3_Fehler (CM_OruReleasePartitionSwitchA_Cx3_Fehler), 1=Cx1_Lock (CM_OruReleasePartitionSwitchA_Cx1_Lock), 0=Cx0_Init (CM_OruReleasePartitionSwitchA_Cx0_Init), 2=Cx2_Release (CM_OruReleasePartitionSwitchA_Cx2_Release)}, range raw 0..3  # Release to switch the partition in case of an A/B partition update
    signal OruHostUpdateA_XIX_ORU_Control_A_01_XIX_VLAN_Cockpit: start 50, 3 bit, little-endian, data-type-policy=OVERRIDE, i-signal-type=PRIMITIVE, init-value=0, base-type=BT_OruHostUpdateA, invalid-value=Invalid_OruHostUpdateA_XIX_ORU_Control_A_01_XIX_VLAN_Cockpit:4, compu {4=Cx4_Fehler (CM_OruHostUpdateA_Cx4_Fehler), 0=Cx0_Init (CM_OruHostUpdateA_Cx0_Init), 3=Cx3_HostControlOther (CM_OruHostUpdateA_Cx3_HostControlOther), 2=Cx2_HostControl2 (CM_OruHostUpdateA_Cx2_HostControl2), 1=Cx1_HostControl1 (CM_OruHostUpdateA_Cx1_HostControl1)}, range raw 0..4  # Releases an update of an critical funcion's host (due to functional safety)
    signal OTA_FlgPTAcvPhdA_XIX_ORU_Control_A_01_XIX_VLAN_Cockpit: start 53, 2 bit, little-endian, data-type-policy=OVERRIDE, i-signal-type=PRIMITIVE, init-value=0, base-type=BT_OTA_FlgPTAcvPhdA, invalid-value=Invalid_OTA_FlgPTAcvPhdA_XIX_ORU_Control_A_01_XIX_VLAN_Cockpit:3, compu {3=Cx3_Fehler (CM_OTA_FlgPTAcvPhdA_Cx3_Fehler), 2=Cx2_Release (CM_OTA_FlgPTAcvPhdA_Cx2_Release), 1=Cx1_Lock (CM_OTA_FlgPTAcvPhdA_Cx1_Lock), 0=Cx0_Init (CM_OTA_FlgPTAcvPhdA_Cx0_Init)}, range raw 0..3  # Signal to reqest a locking of the powertrain that is used in case of an failed update to prevent the customer from driving with a potentially unsafe car.
    signal ISignalVoid_ORU_Control_A_01_XIX_VLAN_Cockpit_0: start 55, 1 bit, little-endian, system signal SignalVoid_ORU_Control_A_01_0, data-type-policy=OVERRIDE, i-signal-type=PRIMITIVE, base-type=BT_SignalVoid
    signal ISignalVoid_ORU_Control_A_01_XIX_VLAN_Cockpit_1: start 56, 8 bit, little-endian, system signal SignalVoid_ORU_Control_A_01_1, data-type-policy=OVERRIDE, i-signal-type=PRIMITIVE, base-type=BT_SignalVoid
    mapping SG_ORU_Control_A_01_XIX_VLAN_Cockpit: i-signal-group=SG_ORU_Control_A_01_XIX_VLAN_Cockpit, transfer-property=TRIGGERED-WITHOUT-REPETITION
  pdu ORU_Control_D_01_XIX_VLAN_Cockpit_E2E: length=8, transmission-mode-true-timing=event-controlled-timing={number-of-repetitions=0, repetition-period=0.0}, unused-bit-pattern=0  # Fuer die Botschaft ist das Cyclic-Timing 0.32 zu verwenden.
    signal ORU_Control_D_01_CRC_XIX_ORU_Control_D_01_XIX_VLAN_Cockpit: start 0, 8 bit, little-endian, data-type-policy=OVERRIDE, i-signal-type=PRIMITIVE, init-value=0, base-type=BT_ORU_Control_D_01_CRC, compu {phys=raw for raw 0..255}, range phys 0..255, raw 0..255, to HCP3_IONode(timeout 3.2 s)
    signal ORU_Control_D_01_BZ_XIX_ORU_Control_D_01_XIX_VLAN_Cockpit: start 8, 4 bit, little-endian, data-type-policy=OVERRIDE, i-signal-type=PRIMITIVE, init-value=0, base-type=BT_ORU_Control_D_01_BZ, compu {phys=raw for raw 0..15}, range phys 0..15, raw 0..15, to HCP3_IONode(timeout 3.2 s)
    signal OnlineRemoteUpdateControlD_XIX_ORU_Control_D_01_XIX_VLAN_Cockpit: start 12, 4 bit, little-endian, data-type-policy=OVERRIDE, i-signal-type=PRIMITIVE, init-value=0, base-type=BT_OnlineRemoteUpdateControlD, invalid-value=Invalid_OnlineRemoteUpdateControlD_XIX_ORU_Control_D_01_XIX_VLAN_Cockpit:15, compu {15=Cxf_Fehler (CM_OnlineRemoteUpdateControlD_Cxf_Fehler), 8=Cx8_FUNCTIONAL_SAFETY_RELEASE (CM_OnlineRemoteUpdateControlD_Cx8_FUNCTIONAL_SAFETY_RELEASE), 5=Cx5_RUNNING_HV (CM_OnlineRemoteUpdateControlD_Cx5_RUNNING_HV), 4=Cx4_RUNNING (CM_OnlineRemoteUpdateControlD_Cx4_RUNNING), 0=Cx0_IDLE (CM_OnlineRemoteUpdateControlD_Cx0_IDLE), 2=Cx2_PREPARATION (CM_OnlineRemoteUpdateControlD_Cx2_PREPARATION), 3=Cx3_PREPARATION_HV (CM_OnlineRemoteUpdateControlD_Cx3_PREPARATION_HV), 6=Cx6_PENDING_NOTREADY (CM_OnlineRemoteUpdateControlD_Cx6_PENDING_NOTREADY), 1=Cx1_PENDING (CM_OnlineRemoteUpdateControlD_Cx1_PENDING), 9=Cx9_PREPARATION_SG (CM_OnlineRemoteUpdateControlD_Cx9_PREPARATION_SG), 7=Cx7_OTA_FAILURE_POWERTRAIN_DISABLED (CM_OnlineRemoteUpdateControlD_Cx7_OTA_FAILURE_POWERTRAIN_DISABLED)}, range raw 0..15, to HCP3_IONode(timeout 3.2 s)  # This signal is part of the ORU functional safety concept to inform ECUs, if an update is possible
    signal OnlineRemoteUpdateControlOldD_XIX_ORU_Control_D_01_XIX_VLAN_Cockpit: start 16, 4 bit, little-endian, data-type-policy=OVERRIDE, i-signal-type=PRIMITIVE, init-value=0, base-type=BT_OnlineRemoteUpdateControlOldD, invalid-value=Invalid_OnlineRemoteUpdateControlOldD_XIX_ORU_Control_D_01_XIX_VLAN_Cockpit:15, compu {15=Cxf_Fehler (CM_OnlineRemoteUpdateControlOldD_Cxf_Fehler), 8=Cx8_FUNCTIONAL_SAFETY_RELEASE (CM_OnlineRemoteUpdateControlOldD_Cx8_FUNCTIONAL_SAFETY_RELEASE), 3=Cx3_PREPARATION_HV (CM_OnlineRemoteUpdateControlOldD_Cx3_PREPARATION_HV), 7=Cx7_OTA_FAILURE_POWERTRAIN_DISABLED (CM_OnlineRemoteUpdateControlOldD_Cx7_OTA_FAILURE_POWERTRAIN_DISABLED), 4=Cx4_RUNNING (CM_OnlineRemoteUpdateControlOldD_Cx4_RUNNING), 6=Cx6_PENDING_NOTREADY (CM_OnlineRemoteUpdateControlOldD_Cx6_PENDING_NOTREADY), 2=Cx2_PREPARATION (CM_OnlineRemoteUpdateControlOldD_Cx2_PREPARATION), 1=Cx1_PENDING (CM_OnlineRemoteUpdateControlOldD_Cx1_PENDING), 5=Cx5_RUNNING_HV (CM_OnlineRemoteUpdateControlOldD_Cx5_RUNNING_HV), 0=Cx0_IDLE (CM_OnlineRemoteUpdateControlOldD_Cx0_IDLE), 9=Cx9_PREPARATION_SG (CM_OnlineRemoteUpdateControlOldD_Cx9_PREPARATION_SG)}, range raw 0..15, to HCP3_IONode(timeout 3.2 s)  # Old state of the ORU control C component (state as of 5 previous cycles)
    signal OruVehicleLockRequestD_XIX_ORU_Control_D_01_XIX_VLAN_Cockpit: start 20, 2 bit, little-endian, data-type-policy=OVERRIDE, i-signal-type=PRIMITIVE, init-value=0, base-type=BT_OruVehicleLockRequestD, invalid-value=Invalid_OruVehicleLockRequestD_XIX_ORU_Control_D_01_XIX_VLAN_Cockpit:3, compu {3=Cx3_Fehler (CM_OruVehicleLockRequestD_Cx3_Fehler), 1=Cx1_Lock (CM_OruVehicleLockRequestD_Cx1_Lock), 0=Cx0_Init (CM_OruVehicleLockRequestD_Cx0_Init), 2=Cx2_Release (CM_OruVehicleLockRequestD_Cx2_Release)}, range raw 0..3  # Releases or locks one or more ECUs with their specific functions (e.g. immobilizer)
    signal OruIntegrityCheckActiveD_XIX_ORU_Control_D_01_XIX_VLAN_Cockpit: start 22, 2 bit, little-endian, data-type-policy=OVERRIDE, i-signal-type=PRIMITIVE, init-value=0, base-type=BT_OruIntegrityCheckActiveD, invalid-value=Invalid_OruIntegrityCheckActiveD_XIX_ORU_Control_D_01_XIX_VLAN_Cockpit:3, compu {3=Cx3_Fehler (CM_OruIntegrityCheckActiveD_Cx3_Fehler), 1=Cx1_Inactive (CM_OruIntegrityCheckActiveD_Cx1_Inactive), 2=Cx2_Active (CM_OruIntegrityCheckActiveD_Cx2_Active), 0=Cx0_Init (CM_OruIntegrityCheckActiveD_Cx0_Init)}, range raw 0..3  # Signal to indicate if the integrity check is active
    signal OruControlReleaseD_XIX_ORU_Control_D_01_XIX_VLAN_Cockpit: start 24, 16 bit, little-endian, data-type-policy=OVERRIDE, i-signal-type=PRIMITIVE, init-value=0, base-type=BT_OruControlReleaseD, compu {phys=raw for raw 0..65535; unit Unit_None}, range phys 0..65535 Unit_None, raw 0..65535, unit=Unit_None  # This signal is used to allow an ECU to start an update session. As this is a critical point, 2 components have to approve this
    signal OruControlStateD_XIX_ORU_Control_D_01_XIX_VLAN_Cockpit: start 40, 8 bit, little-endian, data-type-policy=OVERRIDE, i-signal-type=PRIMITIVE, init-value=0, base-type=BT_OruControlStateD, invalid-value=Invalid_OruControlStateD_XIX_ORU_Control_D_01_XIX_VLAN_Cockpit:129, compu {129=Cx81_Fehler (CM_OruControlStateD_Cx81_Fehler), 15=Cxf_Running (CM_OruControlStateD_Cxf_Running), 1=Cx1_Check (CM_OruControlStateD_Cx1_Check), 65=Cx41_Fail (CM_OruControlStateD_Cx41_Fail), 31=Cx1f_Save (CM_OruControlStateD_Cx1f_Save), 0=Cx0_Idle (CM_OruControlStateD_Cx0_Idle), 63=Cx3f_Done (CM_OruControlStateD_Cx3f_Done), 3=Cx3_DataPresent (CM_OruControlStateD_Cx3_DataPresent), 7=Cx7_LockActive (CM_OruControlStateD_Cx7_LockActive)}, range raw 0..129  # This signal is used to allow an ECU to start an update session.
    signal OruReleasePartitionSwitchD_XIX_ORU_Control_D_01_XIX_VLAN_Cockpit: start 48, 2 bit, little-endian, data-type-policy=OVERRIDE, i-signal-type=PRIMITIVE, init-value=0, base-type=BT_OruReleasePartitionSwitchD, invalid-value=Invalid_OruReleasePartitionSwitchD_XIX_ORU_Control_D_01_XIX_VLAN_Cockpit:3, compu {3=Cx3_Fehler (CM_OruReleasePartitionSwitchD_Cx3_Fehler), 2=Cx2_Release (CM_OruReleasePartitionSwitchD_Cx2_Release), 0=Cx0_Init (CM_OruReleasePartitionSwitchD_Cx0_Init), 1=Cx1_Lock (CM_OruReleasePartitionSwitchD_Cx1_Lock)}, range raw 0..3  # Release to switch the partition in case of an A/B partition update
    signal OruHostUpdateD_XIX_ORU_Control_D_01_XIX_VLAN_Cockpit: start 50, 3 bit, little-endian, data-type-policy=OVERRIDE, i-signal-type=PRIMITIVE, init-value=0, base-type=BT_OruHostUpdateD, invalid-value=Invalid_OruHostUpdateD_XIX_ORU_Control_D_01_XIX_VLAN_Cockpit:4, compu {4=Cx4_Fehler (CM_OruHostUpdateD_Cx4_Fehler), 0=Cx0_Init (CM_OruHostUpdateD_Cx0_Init), 1=Cx1_HostControl1 (CM_OruHostUpdateD_Cx1_HostControl1), 3=Cx3_HostControlOther (CM_OruHostUpdateD_Cx3_HostControlOther), 2=Cx2_HostControl2 (CM_OruHostUpdateD_Cx2_HostControl2)}, range raw 0..4  # Releases an update of an critical funcion's host (due to functional safety)
    signal ISignalVoid_ORU_Control_D_01_XIX_VLAN_Cockpit_0: start 53, 3 bit, little-endian, system signal SignalVoid_ORU_Control_D_01_0, data-type-policy=OVERRIDE, i-signal-type=PRIMITIVE, base-type=BT_SignalVoid
    signal ISignalVoid_ORU_Control_D_01_XIX_VLAN_Cockpit_1: start 56, 8 bit, little-endian, system signal SignalVoid_ORU_Control_D_01_1, data-type-policy=OVERRIDE, i-signal-type=PRIMITIVE, base-type=BT_SignalVoid
    mapping SG_ORU_Control_D_01_XIX_VLAN_Cockpit: i-signal-group=SG_ORU_Control_D_01_XIX_VLAN_Cockpit, transfer-property=TRIGGERED-WITHOUT-REPETITION
  pdu OTAMC_D_01_XIX_VLAN_Cockpit_E2E: length=4, transmission-mode-true-timing=event-controlled-timing={number-of-repetitions=0, repetition-period=0.0}, unused-bit-pattern=0  # Fuer die Botschaft ist das Cyclic-Timing 0.32 zu verwenden.
    signal OTAMC_D_01_CRC_XIX_OTAMC_D_01_XIX_VLAN_Cockpit: start 0, 8 bit, little-endian, data-type-policy=OVERRIDE, i-signal-type=PRIMITIVE, init-value=0, base-type=BT_OTAMC_D_01_CRC, compu {phys=raw for raw 0..255}, range phys 0..255, raw 0..255, to HCP3_IONode(timeout 3.2 s)
    signal OTAMC_D_01_BZ_XIX_OTAMC_D_01_XIX_VLAN_Cockpit: start 8, 4 bit, little-endian, data-type-policy=OVERRIDE, i-signal-type=PRIMITIVE, init-value=0, base-type=BT_OTAMC_D_01_BZ, compu {phys=raw for raw 0..15}, range phys 0..15, raw 0..15, to HCP3_IONode(timeout 3.2 s)
    signal VehicleProtectedEnvironment_D_XIX_OTAMC_D_01_XIX_VLAN_Cockpit: start 12, 2 bit, little-endian, data-type-policy=OVERRIDE, i-signal-type=PRIMITIVE, init-value=0, base-type=BT_VehicleProtectedEnvironment_D, compu {2=Cx2_VPE_aftersales (CM_VehicleProtectedEnvironment_D_Cx2_VPE_aftersales), 0=Cx0_VPE_none (CM_VehicleProtectedEnvironment_D_Cx0_VPE_none), 1=Cx1_VPE_production (CM_VehicleProtectedEnvironment_D_Cx1_VPE_production)}, range raw 0..2, to HCP3_IONode(timeout 3.2 s)  # Environment of vehicle in case of Remote Production
    signal ISignalVoid_OTAMC_D_01_XIX_VLAN_Cockpit_0: start 14, 2 bit, little-endian, system signal SignalVoid_OTAMC_D_01_0, data-type-policy=OVERRIDE, i-signal-type=PRIMITIVE, base-type=BT_SignalVoid
    signal ISignalVoid_OTAMC_D_01_XIX_VLAN_Cockpit_1: start 16, 8 bit, little-endian, system signal SignalVoid_OTAMC_D_01_1, data-type-policy=OVERRIDE, i-signal-type=PRIMITIVE, base-type=BT_SignalVoid
    signal ISignalVoid_OTAMC_D_01_XIX_VLAN_Cockpit_2: start 24, 8 bit, little-endian, system signal SignalVoid_OTAMC_D_01_2, data-type-policy=OVERRIDE, i-signal-type=PRIMITIVE, base-type=BT_SignalVoid
    mapping SG_OTAMC_D_01_XIX_VLAN_Cockpit: i-signal-group=SG_OTAMC_D_01_XIX_VLAN_Cockpit, transfer-property=TRIGGERED-WITHOUT-REPETITION
  pdu RadioFunc_01_XIX_VLAN_Cockpit: length=12, minimum-delay=0.05, transmission-mode-true-timing={cyclic-timing={time-offset=0.0, time-period=1.0}, event-controlled-timing={number-of-repetitions=0, repetition-period=0.0}}, unused-bit-pattern=0
    signal WLC1_Systemzustand_XIX_RadioFunc_01_XIX_VLAN_Cockpit: start 12, 1 bit, little-endian, data-type-policy=OVERRIDE, i-signal-type=PRIMITIVE, init-value=1, base-type=BT_WLC1_Systemzustand, compu {0=Cx0_Wireless_Charger_off (CM_WLC1_Systemzustand_Cx0_Wireless_Charger_off), 1=Cx1_InitWert_Wireless_Charger_on (CM_WLC1_Systemzustand_Cx1_InitWert_Wireless_Charger_on)}, range raw 0..1, transfer-property=PENDING  # 0 = Wireless Charger off (Message produced by HMI) 1 = Wireless Charger on (Message produced by HMI)
    signal WLC2_Systemzustand_XIX_RadioFunc_01_XIX_VLAN_Cockpit: start 13, 1 bit, little-endian, data-type-policy=OVERRIDE, i-signal-type=PRIMITIVE, init-value=1, base-type=BT_WLC2_Systemzustand, compu {0=Cx0_Wireless_Charger_off (CM_WLC2_Systemzustand_Cx0_Wireless_Charger_off), 1=Cx1_InitWert_Wireless_Charger_on (CM_WLC2_Systemzustand_Cx1_InitWert_Wireless_Charger_on)}, range raw 0..1, transfer-property=PENDING  # 0 = Wireless Charger off 1 = Wireless Charger on
    signal RA_Frequency_unit_XIX_RadioFunc_01_XIX_VLAN_Cockpit: start 14, 2 bit, little-endian, data-type-policy=OVERRIDE, i-signal-type=PRIMITIVE, init-value=0, base-type=BT_RA_Frequency_unit, compu {0=Cx0_1_kHz (CM_RA_Frequency_unit_Cx0_1_kHz), 1=Cx1_100_kHz (CM_RA_Frequency_unit_Cx1_100_kHz)}, range raw 0..1, transfer-property=TRIGGERED-ON-CHANGE-WITHOUT-REPETITION  # Faktor für RA_Frequency bei AM: Faktor 0 = 1kHz sonst Faktor 1 = 100kHz
    signal RA_Frequency_XIX_RadioFunc_01_XIX_VLAN_Cockpit: start 16, 14 bit, little-endian, data-type-policy=OVERRIDE, i-signal-type=PRIMITIVE, init-value=0, base-type=BT_RA_Frequency, compu {phys=raw for raw 0..16383; unit Unit_None}, range phys 0..16383 Unit_None, raw 0..16383, unit=Unit_None, transfer-property=TRIGGERED-ON-CHANGE-WITHOUT-REPETITION  # Übermittlung der eingestellten Sendefrequenz AM oder FM, diese wird mit RA_Frequency_unit multipliziert. Im DAB oder Hybrid/Online Mode wird die aktuelle FM-Alternativfrequenz oder, falls nicht vorhanden, die zuletzt gehörte Senderfrequenz übertragen (AM xor FM). Die CAN-Bus Signalempfänger verstimmen ihre Takt-/Oszillatorfrequenzen, so dass die eingestellte Radio-Sendefrequenz nicht gestört wird. Auf dem Bus werden nur statische Frequenzen übertragen.
    signal RA_AM_Tuning_XIX_RadioFunc_01_XIX_VLAN_Cockpit: start 30, 1 bit, little-endian, data-type-policy=OVERRIDE, i-signal-type=PRIMITIVE, init-value=0, base-type=BT_RA_AM_Tuning, compu {0=Cx0_frequency_locked (CM_RA_AM_Tuning_Cx0_frequency_locked), 1=Cx1_AM_tuning (CM_RA_AM_Tuning_Cx1_AM_tuning)}, range raw 0..1, transfer-property=TRIGGERED-ON-CHANGE-WITHOUT-REPETITION  # Das Signal kennzeichnet einen aktiven AM Suchlauf. Während des Suchlaufes wird die Frequenz = 0 übertragen. 0 = frequency locked => Störquelle vermeidet die aktuelle Frequenz 1 = AM tuning in progress => Störquelle abschalten bzw.PWM Signal auf DC umschalten
  pdu RLS_01_XIX_VLAN_Cockpit: length=8, transmission-mode-true-timing=cyclic-timing={time-offset=0.0, time-period=0.2}, unused-bit-pattern=0
    signal LS_Helligkeit_global_XIX_RLS_01_XIX_VLAN_Cockpit: start 0, 8 bit, little-endian, data-type-policy=OVERRIDE, i-signal-type=PRIMITIVE, init-value=254, base-type=BT_LS_Helligkeit_global, invalid-value=Invalid_LS_Helligkeit_global_XIX_RLS_01_XIX_VLAN_Cockpit:255, compu {phys=raw*400 for raw 0..253, 255=Cxff_Fehler (CM_LS_Helligkeit_global_Cxff_Fehler), 254=Cxfe_Init (CM_LS_Helligkeit_global_Cxfe_Init); unit Unit_Lux}, range phys 0..101200 Unit_Lux, raw 0..255, unit=Unit_Lux, transfer-property=PENDING  # Globalfeldhelligkeit
    signal LS_Helligkeit_FW_XIX_RLS_01_XIX_VLAN_Cockpit: start 8, 10 bit, little-endian, data-type-policy=OVERRIDE, i-signal-type=PRIMITIVE, init-value=1022, base-type=BT_LS_Helligkeit_FW, invalid-value=Invalid_LS_Helligkeit_FW_XIX_RLS_01_XIX_VLAN_Cockpit:1023, compu {phys=raw*6 for raw 0..1021, 1023=Cx3ff_Fehler (CM_LS_Helligkeit_FW_Cx3ff_Fehler), 1022=Cx3fe_Init (CM_LS_Helligkeit_FW_Cx3fe_Init); unit Unit_Lux}, range phys 0..6126 Unit_Lux, raw 0..1023, unit=Unit_Lux, transfer-property=PENDING  # Vorfeldhelligkeit
    signal LS_Dunkel_XIX_RLS_01_XIX_VLAN_Cockpit: start 18, 1 bit, little-endian, data-type-policy=OVERRIDE, i-signal-type=PRIMITIVE, init-value=0, base-type=BT_LS_Dunkel, compu {1=Cx1_Dunkel (CM_LS_Dunkel_Cx1_Dunkel), 0=Cx0_Hell (CM_LS_Dunkel_Cx0_Hell)}, range raw 0..1, transfer-property=PENDING  # Regen- / Lichtsensor
    signal LS_Licht_ein_XIX_RLS_01_XIX_VLAN_Cockpit: start 19, 1 bit, little-endian, data-type-policy=OVERRIDE, i-signal-type=PRIMITIVE, init-value=0, base-type=BT_LS_Licht_ein, compu {1=Cx1_Ein (CM_LS_Licht_ein_Cx1_Ein), 0=Cx0_Aus (CM_LS_Licht_ein_Cx0_Aus)}, range raw 0..1, transfer-property=PENDING  # Anfoderung Fahrlicht
    signal LS_Licht_ein_invers_XIX_RLS_01_XIX_VLAN_Cockpit: start 20, 1 bit, little-endian, data-type-policy=OVERRIDE, i-signal-type=PRIMITIVE, init-value=1, base-type=BT_LS_Licht_ein_invers, compu {1=Cx1_Ein (CM_LS_Licht_ein_invers_Cx1_Ein), 0=Cx0_Aus (CM_LS_Licht_ein_invers_Cx0_Aus)}, range raw 0..1, transfer-property=PENDING  # Inversbit Anforderung Fahrlicht
    signal LS_defekt_XIX_RLS_01_XIX_VLAN_Cockpit: start 22, 1 bit, little-endian, data-type-policy=OVERRIDE, i-signal-type=PRIMITIVE, init-value=0, base-type=BT_LS_defekt, compu {0=Cx0_OK (CM_LS_defekt_Cx0_OK), 1=Cx1_defekt (CM_LS_defekt_Cx1_defekt)}, range raw 0..1, transfer-property=PENDING  # Fehlererkennung Lichtsensor
    signal LS_Verbau_XIX_RLS_01_XIX_VLAN_Cockpit: start 23, 1 bit, little-endian, data-type-policy=OVERRIDE, i-signal-type=PRIMITIVE, init-value=0, base-type=BT_LS_Verbau, compu {0=Cx0_Init (CM_LS_Verbau_Cx0_Init), 1=Cx1_Lichtsensor_verbaut (CM_LS_Verbau_Cx1_Lichtsensor_verbaut)}, range raw 0..1, transfer-property=PENDING  # Verbauinfo Lichtsensor
    signal RS_Regenmenge_XIX_RLS_01_XIX_VLAN_Cockpit: start 24, 4 bit, little-endian, data-type-policy=OVERRIDE, i-signal-type=PRIMITIVE, init-value=14, base-type=BT_RS_Regenmenge, invalid-value=Invalid_RS_Regenmenge_XIX_RLS_01_XIX_VLAN_Cockpit:15, compu {15=Cxf_Fehler (CM_RS_Regenmenge_Cxf_Fehler), 10=Cxa_9_01_bis_11_0 (CM_RS_Regenmenge_Cxa_9_01_bis_11_0) (9,01_bis_11,0), 5=Cx5_2_81_bis_3_3 (CM_RS_Regenmenge_Cx5_2_81_bis_3_3) (2,81_bis_3,3), 0=Cx0_0 (CM_RS_Regenmenge_Cx0_0), 9=Cx9_7_01_bis_9_0 (CM_RS_Regenmenge_Cx9_7_01_bis_9_0) (7,01_bis_9,0), 8=Cx8_5_01_bis_7_0 (CM_RS_Regenmenge_Cx8_5_01_bis_7_0) (5,01_bis_7,0), 14=Cxe_Init (CM_RS_Regenmenge_Cxe_Init), 4=Cx4_2_01_bis_2_8 (CM_RS_Regenmenge_Cx4_2_01_bis_2_8) (2,01_bis_2,8), 12=Cxc_15_01_bis_22_0 (CM_RS_Regenmenge_Cxc_15_01_bis_22_0) (15,01_bis_22,0), 3=Cx3_1_41_bis_2_0 (CM_RS_Regenmenge_Cx3_1_41_bis_2_0) (1,41_bis_2,0), 13=Cxd_22_01 (CM_RS_Regenmenge_Cxd_22_01) (>22,01), 11=Cxb_11_01_bis_15_0 (CM_RS_Regenmenge_Cxb_11_01_bis_15_0) (11,01_bis_15,0), 2=Cx2_0_31_bis_1_4 (CM_RS_Regenmenge_Cx2_0_31_bis_1_4) (0,31_bis_1,4), 7=Cx7_4_01_bis_5_0 (CM_RS_Regenmenge_Cx7_4_01_bis_5_0) (4,01_bis_5,0), 1=Cx1_0_0_bis_0_3 (CM_RS_Regenmenge_Cx1_0_0_bis_0_3) (0,0_bis_0,3), 6=Cx6_3_31_bis_4_0 (CM_RS_Regenmenge_Cx6_3_31_bis_4_0) (3,31_bis_4,0)}, range raw 0..15, transfer-property=PENDING  # Regenmenge
    signal RS_Schwall_XIX_RLS_01_XIX_VLAN_Cockpit: start 28, 1 bit, little-endian, data-type-policy=OVERRIDE, i-signal-type=PRIMITIVE, init-value=0, base-type=BT_RS_Schwall, compu {1=Cx1_Ein (CM_RS_Schwall_Cx1_Ein), 0=Cx0_Aus (CM_RS_Schwall_Cx0_Aus)}, range raw 0..1, transfer-property=PENDING  # Schwallereignis
    signal RS_Verbau_XIX_RLS_01_XIX_VLAN_Cockpit: start 29, 1 bit, little-endian, data-type-policy=OVERRIDE, i-signal-type=PRIMITIVE, init-value=0, base-type=BT_RS_Verbau, compu {1=Cx1_Regensensor_verbaut (CM_RS_Verbau_Cx1_Regensensor_verbaut) (Regensensor verbaut), 0=Cx0_Init (CM_RS_Verbau_Cx0_Init)}, range raw 0..1, transfer-property=PENDING  # Verbauinfo Regensensor
    signal RS_Verglasung_schliessen_XIX_RLS_01_XIX_VLAN_Cockpit: start 30, 1 bit, little-endian, data-type-policy=OVERRIDE, i-signal-type=PRIMITIVE, init-value=0, base-type=BT_RS_Verglasung_schliessen, compu {0=Cx0_Verglasung_nicht_schliessen (CM_RS_Verglasung_schliessen_Cx0_Verglasung_nicht_schliessen) (Verglasung nicht schliessen), 1=Cx1_Verglasung_schliessen (CM_RS_Verglasung_schliessen_Cx1_Verglasung_schliessen) (Verglasung schliessen)}, range raw 0..1, transfer-property=PENDING  # Anforderung: Verglasung schliessen
    signal RS_defekt_XIX_RLS_01_XIX_VLAN_Cockpit: start 31, 1 bit, little-endian, data-type-policy=OVERRIDE, i-signal-type=PRIMITIVE, init-value=0, base-type=BT_RS_defekt, compu {1=Cx1_defekt (CM_RS_defekt_Cx1_defekt), 0=Cx0_OK (CM_RS_defekt_Cx0_OK)}, range raw 0..1, transfer-property=PENDING  # Fehlererkennung Regensensor
    signal RS_Wischergeschwindigkeit_XIX_RLS_01_XIX_VLAN_Cockpit: start 32, 3 bit, little-endian, data-type-policy=OVERRIDE, i-signal-type=PRIMITIVE, init-value=0, base-type=BT_RS_Wischergeschwindigkeit, compu {4=Cx4_51_Huebe_min (CM_RS_Wischergeschwindigkeit_Cx4_51_Huebe_min) (51 Huebe/min), 0=Cx0_kein_Wischen (CM_RS_Wischergeschwindigkeit_Cx0_kein_Wischen) (kein Wischen), 2=Cx2_45_Huebe_min (CM_RS_Wischergeschwindigkeit_Cx2_45_Huebe_min) (45 Huebe/min), 1=Cx1_42_Huebe_min (CM_RS_Wischergeschwindigkeit_Cx1_42_Huebe_min) (42 Huebe/min), 3=Cx3_48_Huebe_min (CM_RS_Wischergeschwindigkeit_Cx3_48_Huebe_min) (48 Huebe/min), 6=Cx6_57_Huebe_min (CM_RS_Wischergeschwindigkeit_Cx6_57_Huebe_min) (57 Huebe/min), 7=Cx7_60_Huebe_min (CM_RS_Wischergeschwindigkeit_Cx7_60_Huebe_min) (60 Huebe/min), 5=Cx5_54_Huebe_min (CM_RS_Wischergeschwindigkeit_Cx5_54_Huebe_min) (54 Huebe/min)}, range raw 0..7, transfer-property=PENDING  # Wischergeschwindigkeit (Hübe/min)
    signal RLS_Vorfeldhelligkeit_Boost_XIX_RLS_01_XIX_VLAN_Cockpit: start 35, 4 bit, little-endian, data-type-policy=OVERRIDE, i-signal-type=PRIMITIVE, init-value=15, base-type=BT_RLS_Vorfeldhelligkeit_Boost, compu {9=Cx9_bis_11388_Lux (CM_RLS_Vorfeldhelligkeit_Boost_Cx9_bis_11388_Lux), 2=Cx2_bis_22193_Lux (CM_RLS_Vorfeldhelligkeit_Boost_Cx2_bis_22193_Lux), 0=Cx0_groesser_24413_Lux (CM_RLS_Vorfeldhelligkeit_Boost_Cx0_groesser_24413_Lux), 5=Cx5_bis_16647_Lux (CM_RLS_Vorfeldhelligkeit_Boost_Cx5_bis_16647_Lux), 4=Cx4_bis_18342_Lux (CM_RLS_Vorfeldhelligkeit_Boost_Cx4_bis_18342_Lux), 3=Cx3_bis_20176_Lux (CM_RLS_Vorfeldhelligkeit_Boost_Cx3_bis_20176_Lux), 6=Cx6_bis_15158_Lux (CM_RLS_Vorfeldhelligkeit_Boost_Cx6_bis_15158_Lux), 12=Cxc_bis_8556_Lux (CM_RLS_Vorfeldhelligkeit_Boost_Cxc_bis_8556_Lux), 11=Cxb_bis_9412_Lux (CM_RLS_Vorfeldhelligkeit_Boost_Cxb_bis_9412_Lux), 15=Cxf_bis_6428_Lux (CM_RLS_Vorfeldhelligkeit_Boost_Cxf_bis_6428_Lux), 14=Cxe_bis_7071_Lux (CM_RLS_Vorfeldhelligkeit_Boost_Cxe_bis_7071_Lux), 8=Cx8_bis_12527_Lux (CM_RLS_Vorfeldhelligkeit_Boost_Cx8_bis_12527_Lux), 7=Cx7_bis_13780_Lux (CM_RLS_Vorfeldhelligkeit_Boost_Cx7_bis_13780_Lux), 10=Cxa_bis_10353_Lux (CM_RLS_Vorfeldhelligkeit_Boost_Cxa_bis_10353_Lux), 1=Cx1_bis_24413_Lux (CM_RLS_Vorfeldhelligkeit_Boost_Cx1_bis_24413_Lux), 13=Cxd_bis_7778_Lux (CM_RLS_Vorfeldhelligkeit_Boost_Cxd_bis_7778_Lux)}, range raw 0..15, transfer-property=PENDING  # erweiterte Helligkeitssensierung für HUD
    signal RLS_HUD_Plausibilisierung_XIX_RLS_01_XIX_VLAN_Cockpit: start 48, 4 bit, little-endian, data-type-policy=OVERRIDE, i-signal-type=PRIMITIVE, init-value=0, base-type=BT_RLS_HUD_Plausibilisierung, compu {phys=raw for raw 0..15; unit Unit_None}, range phys 0..15 Unit_None, raw 0..15, unit=Unit_None, transfer-property=PENDING  # Plausibilisierung RLS -HUD
  pdu RLSs_01_XIX_VLAN_Cockpit: length=8, transmission-mode-true-timing=cyclic-timing={time-offset=0, time-period=0.06}, unused-bit-pattern=0
    signal RLS_BZ_XIX_RLSs_01_XIX_VLAN_Cockpit: start 0, 4 bit, little-endian, data-type-policy=OVERRIDE, i-signal-type=PRIMITIVE, base-type=BT_RLS_BZ, compu {phys=raw for raw 0..15}, range phys 0..15, raw 0..15, transfer-property=PENDING  # Botschaftszähler
    signal RLS_Qualifizierungsbit_XIX_RLSs_01_XIX_VLAN_Cockpit: start 4, 1 bit, little-endian, data-type-policy=OVERRIDE, i-signal-type=PRIMITIVE, init-value=0, base-type=BT_RLS_Qualifizierungsbit, compu {1=Cx1_gueltig (CM_RLS_Qualifizierungsbit_Cx1_gueltig), 0=Cx0_ungueltig (CM_RLS_Qualifizierungsbit_Cx0_ungueltig)}, range raw 0..1, transfer-property=PENDING  # Qualifizierungsbit für die Signale "LS_Licht_ein" und "LS_Licht_ein_invers"
    signal RS_Wischergeschwindigkeit_XIX_RLSs_01_XIX_VLAN_Cockpit: start 5, 3 bit, little-endian, data-type-policy=OVERRIDE, i-signal-type=PRIMITIVE, init-value=0, base-type=BT_RS_Wischergeschwindigkeit, compu {4=Cx4_51_Huebe_min (CM_RS_Wischergeschwindigkeit_Cx4_51_Huebe_min) (51 Huebe/min), 0=Cx0_kein_Wischen (CM_RS_Wischergeschwindigkeit_Cx0_kein_Wischen) (kein Wischen), 2=Cx2_45_Huebe_min (CM_RS_Wischergeschwindigkeit_Cx2_45_Huebe_min) (45 Huebe/min), 1=Cx1_42_Huebe_min (CM_RS_Wischergeschwindigkeit_Cx1_42_Huebe_min) (42 Huebe/min), 3=Cx3_48_Huebe_min (CM_RS_Wischergeschwindigkeit_Cx3_48_Huebe_min) (48 Huebe/min), 6=Cx6_57_Huebe_min (CM_RS_Wischergeschwindigkeit_Cx6_57_Huebe_min) (57 Huebe/min), 7=Cx7_60_Huebe_min (CM_RS_Wischergeschwindigkeit_Cx7_60_Huebe_min) (60 Huebe/min), 5=Cx5_54_Huebe_min (CM_RS_Wischergeschwindigkeit_Cx5_54_Huebe_min) (54 Huebe/min)}, range raw 0..7, transfer-property=PENDING  # Wischergeschwindigkeit (Hübe/min)
    signal RS_Schwall_XIX_RLSs_01_XIX_VLAN_Cockpit: start 8, 1 bit, little-endian, data-type-policy=OVERRIDE, i-signal-type=PRIMITIVE, init-value=0, base-type=BT_RS_Schwall, compu {1=Cx1_Ein (CM_RS_Schwall_Cx1_Ein), 0=Cx0_Aus (CM_RS_Schwall_Cx0_Aus)}, range raw 0..1, transfer-property=PENDING  # Schwallereignis
    signal RS_Verglasung_schliessen_XIX_RLSs_01_XIX_VLAN_Cockpit: start 9, 1 bit, little-endian, data-type-policy=OVERRIDE, i-signal-type=PRIMITIVE, init-value=0, base-type=BT_RS_Verglasung_schliessen, compu {0=Cx0_Verglasung_nicht_schliessen (CM_RS_Verglasung_schliessen_Cx0_Verglasung_nicht_schliessen) (Verglasung nicht schliessen), 1=Cx1_Verglasung_schliessen (CM_RS_Verglasung_schliessen_Cx1_Verglasung_schliessen) (Verglasung schliessen)}, range raw 0..1, transfer-property=PENDING  # Anforderung: Verglasung schliessen
    signal RS_versParklage_Wischer_XIX_RLSs_01_XIX_VLAN_Cockpit: start 10, 1 bit, little-endian, data-type-policy=OVERRIDE, i-signal-type=PRIMITIVE, init-value=0, base-type=BT_RS_versParklage_Wischer, compu {0=Cx0_Aus (CM_RS_versParklage_Wischer_Cx0_Aus), 1=Cx1_Ein (CM_RS_versParklage_Wischer_Cx1_Ein)}, range raw 0..1, transfer-property=PENDING  # versenkte Parklage Wischer
    signal LS_Licht_ein_XIX_RLSs_01_XIX_VLAN_Cockpit: start 11, 1 bit, little-endian, data-type-policy=OVERRIDE, i-signal-type=PRIMITIVE, init-value=0, base-type=BT_LS_Licht_ein, compu {1=Cx1_Ein (CM_LS_Licht_ein_Cx1_Ein), 0=Cx0_Aus (CM_LS_Licht_ein_Cx0_Aus)}, range raw 0..1, transfer-property=PENDING  # Anfoderung Fahrlicht
    signal LS_Licht_ein_invers_XIX_RLSs_01_XIX_VLAN_Cockpit: start 12, 1 bit, little-endian, data-type-policy=OVERRIDE, i-signal-type=PRIMITIVE, init-value=1, base-type=BT_LS_Licht_ein_invers, compu {1=Cx1_Ein (CM_LS_Licht_ein_invers_Cx1_Ein), 0=Cx0_Aus (CM_LS_Licht_ein_invers_Cx0_Aus)}, range raw 0..1, transfer-property=PENDING  # Inversbit Anforderung Fahrlicht
    signal LS_Dunkel_XIX_RLSs_01_XIX_VLAN_Cockpit: start 13, 1 bit, little-endian, data-type-policy=OVERRIDE, i-signal-type=PRIMITIVE, init-value=0, base-type=BT_LS_Dunkel, compu {1=Cx1_Dunkel (CM_LS_Dunkel_Cx1_Dunkel), 0=Cx0_Hell (CM_LS_Dunkel_Cx0_Hell)}, range raw 0..1, transfer-property=PENDING  # Regen- / Lichtsensor
    signal LS_Autobahnfahrlicht_XIX_RLSs_01_XIX_VLAN_Cockpit: start 14, 1 bit, little-endian, data-type-policy=OVERRIDE, i-signal-type=PRIMITIVE, init-value=0, base-type=BT_LS_Autobahnfahrlicht, compu {0=Cx0_Aus (CM_LS_Autobahnfahrlicht_Cx0_Aus), 1=Cx1_Ein (CM_LS_Autobahnfahrlicht_Cx1_Ein)}, range raw 0..1, transfer-property=PENDING  # Autobahnfahrlicht Anforderung
    signal RS_Regenfahrlicht_XIX_RLSs_01_XIX_VLAN_Cockpit: start 15, 1 bit, little-endian, data-type-policy=OVERRIDE, i-signal-type=PRIMITIVE, init-value=0, base-type=BT_RS_Regenfahrlicht, compu {1=Cx1_Ein (CM_RS_Regenfahrlicht_Cx1_Ein), 0=Cx0_Aus (CM_RS_Regenfahrlicht_Cx0_Aus)}, range raw 0..1, transfer-property=PENDING  # Regenlicht Anforderung
    signal RS_AdaptierungError_XIX_RLSs_01_XIX_VLAN_Cockpit: start 16, 1 bit, little-endian, data-type-policy=OVERRIDE, i-signal-type=PRIMITIVE, init-value=0, base-type=BT_RS_AdaptierungError, invalid-value=Invalid_RS_AdaptierungError_XIX_RLSs_01_XIX_VLAN_Cockpit:1, compu {1=Cx1_Fehler (CM_RS_AdaptierungError_Cx1_Fehler), 0=Cx0_normal (CM_RS_AdaptierungError_Cx0_normal)}, range raw 0..1, transfer-property=PENDING  # Adaptierungsfehler Regensensor
    signal RS_Error_XIX_RLSs_01_XIX_VLAN_Cockpit: start 17, 1 bit, little-endian, data-type-policy=OVERRIDE, i-signal-type=PRIMITIVE, init-value=0, base-type=BT_RS_Error, invalid-value=Invalid_RS_Error_XIX_RLSs_01_XIX_VLAN_Cockpit:1, compu {1=Cx1_Fehler (CM_RS_Error_Cx1_Fehler), 0=Cx0_normal (CM_RS_Error_Cx0_normal)}, range raw 0..1, transfer-property=PENDING  # Fehler/Defekt Regensensorik
    signal LS_Error_XIX_RLSs_01_XIX_VLAN_Cockpit: start 18, 1 bit, little-endian, data-type-policy=OVERRIDE, i-signal-type=PRIMITIVE, init-value=0, base-type=BT_LS_Error, invalid-value=Invalid_LS_Error_XIX_RLSs_01_XIX_VLAN_Cockpit:1, compu {1=Cx1_Fehler (CM_LS_Error_Cx1_Fehler), 0=Cx0_normal (CM_LS_Error_Cx0_normal)}, range raw 0..1, transfer-property=PENDING  # Fehler/Defekt Lichtsensorik
    signal RLS_ResponseError_XIX_RLSs_01_XIX_VLAN_Cockpit: start 19, 1 bit, little-endian, data-type-policy=OVERRIDE, i-signal-type=PRIMITIVE, init-value=0, base-type=BT_RLS_ResponseError, invalid-value=Invalid_RLS_ResponseError_XIX_RLSs_01_XIX_VLAN_Cockpit:1, compu {1=Cx1_Fehler (CM_RLS_ResponseError_Cx1_Fehler), 0=Cx0_normal (CM_RLS_ResponseError_Cx0_normal)}, range raw 0..1, transfer-property=PENDING  # siehe LIN2.0-Specification (Darf nicht über ein Fehlergueltigkeitsbit abgesichtert werden!)
    signal RLS_Vorfeldhelligkeit_Boost_XIX_RLSs_01_XIX_VLAN_Cockpit: start 20, 4 bit, little-endian, data-type-policy=OVERRIDE, i-signal-type=PRIMITIVE, init-value=15, base-type=BT_RLS_Vorfeldhelligkeit_Boost, compu {9=Cx9_bis_11388_Lux (CM_RLS_Vorfeldhelligkeit_Boost_Cx9_bis_11388_Lux), 2=Cx2_bis_22193_Lux (CM_RLS_Vorfeldhelligkeit_Boost_Cx2_bis_22193_Lux), 0=Cx0_groesser_24413_Lux (CM_RLS_Vorfeldhelligkeit_Boost_Cx0_groesser_24413_Lux), 5=Cx5_bis_16647_Lux (CM_RLS_Vorfeldhelligkeit_Boost_Cx5_bis_16647_Lux), 4=Cx4_bis_18342_Lux (CM_RLS_Vorfeldhelligkeit_Boost_Cx4_bis_18342_Lux), 3=Cx3_bis_20176_Lux (CM_RLS_Vorfeldhelligkeit_Boost_Cx3_bis_20176_Lux), 6=Cx6_bis_15158_Lux (CM_RLS_Vorfeldhelligkeit_Boost_Cx6_bis_15158_Lux), 12=Cxc_bis_8556_Lux (CM_RLS_Vorfeldhelligkeit_Boost_Cxc_bis_8556_Lux), 11=Cxb_bis_9412_Lux (CM_RLS_Vorfeldhelligkeit_Boost_Cxb_bis_9412_Lux), 15=Cxf_bis_6428_Lux (CM_RLS_Vorfeldhelligkeit_Boost_Cxf_bis_6428_Lux), 14=Cxe_bis_7071_Lux (CM_RLS_Vorfeldhelligkeit_Boost_Cxe_bis_7071_Lux), 8=Cx8_bis_12527_Lux (CM_RLS_Vorfeldhelligkeit_Boost_Cx8_bis_12527_Lux), 7=Cx7_bis_13780_Lux (CM_RLS_Vorfeldhelligkeit_Boost_Cx7_bis_13780_Lux), 10=Cxa_bis_10353_Lux (CM_RLS_Vorfeldhelligkeit_Boost_Cxa_bis_10353_Lux), 1=Cx1_bis_24413_Lux (CM_RLS_Vorfeldhelligkeit_Boost_Cx1_bis_24413_Lux), 13=Cxd_bis_7778_Lux (CM_RLS_Vorfeldhelligkeit_Boost_Cxd_bis_7778_Lux)}, range raw 0..15, transfer-property=PENDING  # erweiterte Helligkeitssensierung für HUD
    signal LS_Helligkeit_global_XIX_RLSs_01_XIX_VLAN_Cockpit: start 24, 8 bit, little-endian, data-type-policy=OVERRIDE, i-signal-type=PRIMITIVE, init-value=254, base-type=BT_LS_Helligkeit_global, invalid-value=Invalid_LS_Helligkeit_global_XIX_RLSs_01_XIX_VLAN_Cockpit:255, compu {phys=raw*400 for raw 0..253, 255=Cxff_Fehler (CM_LS_Helligkeit_global_Cxff_Fehler), 254=Cxfe_Init (CM_LS_Helligkeit_global_Cxfe_Init); unit Unit_Lux}, range phys 0..101200 Unit_Lux, raw 0..255, unit=Unit_Lux, transfer-property=PENDING  # Globalfeldhelligkeit
    signal LS_Helligkeit_FW_XIX_RLSs_01_XIX_VLAN_Cockpit: start 32, 10 bit, little-endian, data-type-policy=OVERRIDE, i-signal-type=PRIMITIVE, init-value=1022, base-type=BT_LS_Helligkeit_FW, invalid-value=Invalid_LS_Helligkeit_FW_XIX_RLSs_01_XIX_VLAN_Cockpit:1023, compu {phys=raw*6 for raw 0..1021, 1023=Cx3ff_Fehler (CM_LS_Helligkeit_FW_Cx3ff_Fehler), 1022=Cx3fe_Init (CM_LS_Helligkeit_FW_Cx3fe_Init); unit Unit_Lux}, range phys 0..6126 Unit_Lux, raw 0..1023, unit=Unit_Lux, transfer-property=PENDING  # Vorfeldhelligkeit
    signal RS_Regenmenge_XIX_RLSs_01_XIX_VLAN_Cockpit: start 44, 4 bit, little-endian, data-type-policy=OVERRIDE, i-signal-type=PRIMITIVE, init-value=14, base-type=BT_RS_Regenmenge, invalid-value=Invalid_RS_Regenmenge_XIX_RLSs_01_XIX_VLAN_Cockpit:15, compu {15=Cxf_Fehler (CM_RS_Regenmenge_Cxf_Fehler), 10=Cxa_9_01_bis_11_0 (CM_RS_Regenmenge_Cxa_9_01_bis_11_0) (9,01_bis_11,0), 5=Cx5_2_81_bis_3_3 (CM_RS_Regenmenge_Cx5_2_81_bis_3_3) (2,81_bis_3,3), 0=Cx0_0 (CM_RS_Regenmenge_Cx0_0), 9=Cx9_7_01_bis_9_0 (CM_RS_Regenmenge_Cx9_7_01_bis_9_0) (7,01_bis_9,0), 8=Cx8_5_01_bis_7_0 (CM_RS_Regenmenge_Cx8_5_01_bis_7_0) (5,01_bis_7,0), 14=Cxe_Init (CM_RS_Regenmenge_Cxe_Init), 4=Cx4_2_01_bis_2_8 (CM_RS_Regenmenge_Cx4_2_01_bis_2_8) (2,01_bis_2,8), 12=Cxc_15_01_bis_22_0 (CM_RS_Regenmenge_Cxc_15_01_bis_22_0) (15,01_bis_22,0), 3=Cx3_1_41_bis_2_0 (CM_RS_Regenmenge_Cx3_1_41_bis_2_0) (1,41_bis_2,0), 13=Cxd_22_01 (CM_RS_Regenmenge_Cxd_22_01) (>22,01), 11=Cxb_11_01_bis_15_0 (CM_RS_Regenmenge_Cxb_11_01_bis_15_0) (11,01_bis_15,0), 2=Cx2_0_31_bis_1_4 (CM_RS_Regenmenge_Cx2_0_31_bis_1_4) (0,31_bis_1,4), 7=Cx7_4_01_bis_5_0 (CM_RS_Regenmenge_Cx7_4_01_bis_5_0) (4,01_bis_5,0), 1=Cx1_0_0_bis_0_3 (CM_RS_Regenmenge_Cx1_0_0_bis_0_3) (0,0_bis_0,3), 6=Cx6_3_31_bis_4_0 (CM_RS_Regenmenge_Cx6_3_31_bis_4_0) (3,31_bis_4,0)}, range raw 0..15, transfer-property=PENDING  # Regenmenge
    signal RLSs_01_Checksum_XIX_RLSs_01_XIX_VLAN_Cockpit: start 56, 8 bit, little-endian, data-type-policy=OVERRIDE, i-signal-type=PRIMITIVE, init-value=0, base-type=BT_RLSs_01_Checksum, compu {phys=raw for raw 0..255; unit Unit_None}, range phys 0..255 Unit_None, raw 0..255, unit=Unit_None, transfer-property=PENDING  # Ab MQB und MLBevo: Berechnung siehe Lastenheft "End-to-End Kommunikationsabsicherung"
  pdu SOK_FoD_Info_El_Req_Challenge_XIX_VLAN_Cockpit: length=8, transmission-mode-true-timing=event-controlled-timing={number-of-repetitions=0, repetition-period=0.0}, unused-bit-pattern=0
    signal SOK_FoD_Info_El_Req_Eth_Challeng_XIX_SOK_FoD_Info_El_Req_Challenge_XIX_VLAN_Cockpit: start 0, 64 bit, opaque, data-type-policy=OVERRIDE, i-signal-type=ARRAY, init-value=8 x 0, base-type=BT_SOK_FoD_Info_El_Req_Eth_Challeng, compu {phys=raw for raw 0..18446744073709551615; unit Unit_None}, range phys 0..18446744073709551615 Unit_None, raw 0..18446744073709551615, unit=Unit_None, transfer-property=TRIGGERED-WITHOUT-REPETITION, to HCP3_IONode  # Challenge im Rahmen des SOK Challenge-Response Protokolls. Geschützte Funktion: Function on Demand
  pdu SOK_FoD_Info_El_Resp_Challenge_XIX_VLAN_Cockpit: length=8, transmission-mode-true-timing=event-controlled-timing={number-of-repetitions=0, repetition-period=0.0}, unused-bit-pattern=0
    signal SOK_FoD_Info_El_Resp_Eth_Challen_XIX_SOK_FoD_Info_El_Resp_Challenge_XIX_VLAN_Cockpit: start 0, 64 bit, opaque, data-type-policy=OVERRIDE, i-signal-type=ARRAY, init-value=8 x 0, base-type=BT_SOK_FoD_Info_El_Resp_Eth_Challen, compu {phys=raw for raw 0..18446744073709551615; unit Unit_None}, range phys 0..18446744073709551615 Unit_None, raw 0..18446744073709551615, unit=Unit_None, transfer-property=TRIGGERED-WITHOUT-REPETITION  # Challenge im Rahmen des SOK Challenge-Response Protokolls. Geschützte Funktion: Function on Demand
  pdu SOK_NoAuthenticTime_01_XIX_VLAN_Cockpit: length=8, transmission-mode-true-timing=event-controlled-timing={number-of-repetitions=0, repetition-period=0.0}, unused-bit-pattern=0
    signal SOK_ungeschuetzte_Zeit_XIX_SOK_NoAuthenticTime_01_XIX_VLAN_Cockpit: start 8, 56 bit, opaque, data-type-policy=OVERRIDE, i-signal-type=ARRAY, init-value=7 x 0, base-type=BT_SOK_ungeschuetzte_Zeit, compu {phys=raw for raw 1..72057594037927935, 0=Cx0_Init (CM_SOK_ungeschuetzte_Zeit_Cx0_Init); unit Unit_None}, range phys 1..72057594037927935 Unit_None, raw 0..72057594037927935, unit=Unit_None, transfer-property=TRIGGERED-ON-CHANGE-WITHOUT-REPETITION, to HCP3_IONode  # Periodisch verschickter SOK Zeitwert des SOK Zeitmasters als Referenzzeit zur Erkennung von Clockjitter durch andere SOK Teilnehmer. Der Empfang dieses Signals ist verpflichtend für jedes Steuergerät, das durch die authentische Broadcast Funktionalität von SOK geschützte Daten versendet oder empfängt.
  pdu SOK_Zeit_Info_E_Chal_01_XIX_VLAN_Cockpit: length=8, minimum-delay=0.1, transmission-mode-true-timing=event-controlled-timing={number-of-repetitions=0, repetition-period=0.0}, unused-bit-pattern=0
    signal SOK_Zeit_Info_El_Challenge_XIX_SOK_Zeit_Info_E_Chal_01_XIX_VLAN_Cockpit: start 0, 64 bit, opaque, data-type-policy=OVERRIDE, i-signal-type=ARRAY, base-type=BT_SOK_Zeit_Info_El_Challenge, compu {phys=raw for raw 0..18446744073709551615; unit Unit_None}, range phys 0..18446744073709551615 Unit_None, raw 0..18446744073709551615, unit=Unit_None, transfer-property=TRIGGERED-ON-CHANGE-WITHOUT-REPETITION  # Challenge im Rahmen des SOK Challenge-Response Protokolls. Geschützte Funktion: Empfang der SOK-Zeit vom SOK-Zeitmaster; verbindlich für Steuergeräte, welche mit der durch SOK geschützten Broadcast Nachrichten empfangen oder versenden
  pdu SOK_Zeit_Info_El_Resp_01_XIX_VLAN_Cockpit: length=8, minimum-delay=0.1, transmission-mode-true-timing=event-controlled-timing={number-of-repetitions=0, repetition-period=0.0}, unused-bit-pattern=0
    signal SOK_Zeit_Info_El_Zeit_XIX_SOK_Zeit_Info_El_Resp_01_XIX_VLAN_Cockpit: start 0, 56 bit, opaque, data-type-policy=OVERRIDE, i-signal-type=ARRAY, init-value=7 x 0, base-type=BT_SOK_Zeit_Info_El_Zeit, compu {phys=raw for raw 0..72057594037927935; unit Unit_None}, range phys 0..72057594037927935 Unit_None, raw 0..72057594037927935, unit=Unit_None, transfer-property=TRIGGERED-ON-CHANGE-WITHOUT-REPETITION, to HCP3_IONode  # Aktueller Wert der SOK-Zeit des SOK-Zeitmasters; geschützt durch das SOK Challenge-Response Protokoll
  pdu SOMEIPTestabilityClient_Events_testEventUInt8: length=9, transmission-mode-true-timing=event-controlled-timing={number-of-repetitions=0, repetition-period=0.0}, unused-bit-pattern=0
    signal SOMEIPTestabilityClient_Events_testEventUInt8: start 0, 72 bit, opaque, data-transformations=SOMEIPOnlyTransformerChain, data-type-policy=TRANSFORMING-I-SIGNAL, i-signal-type=ARRAY, someip-transformation-i-signal-props{transformer=TransformationTechnologySOMEIP, interface-version=1, message-type=NOTIFICATION}, dynamic-length=true, transfer-property=TRIGGERED, to HCP3_IONode  # SOMEIPTestabilityClient Implementierung Dieser Service muss an allen uC ECUs die einen SOMEIP Client implementiert haben (Service Empfänger).
  pdu SOMEIPTestabilityClient_Events_TestFieldUInt8: length=9, transmission-mode-true-timing=event-controlled-timing={number-of-repetitions=0, repetition-period=0.0}, unused-bit-pattern=0
    signal SOMEIPTestabilityClient_Events_TestFieldUInt8: start 0, 72 bit, opaque, data-transformations=SOMEIPOnlyTransformerChain, data-type-policy=TRANSFORMING-I-SIGNAL, i-signal-type=ARRAY, someip-transformation-i-signal-props{transformer=TransformationTechnologySOMEIP, interface-version=1, message-type=NOTIFICATION}, dynamic-length=true, transfer-property=TRIGGERED, to HCP3_IONode  # SOMEIPTestabilityClient Implementierung Dieser Service muss an allen uC ECUs die einen SOMEIP Client implementiert haben (Service Empfänger).
  pdu SOMEIPTestabilityClient_Methods_echoComplexDynamicArray_Request_XIX_SomeIP_ServiceProvider_Test_5975F69CF86108D92A7FF5DE502EED3C: length=51, transmission-mode-true-timing=event-controlled-timing={number-of-repetitions=0, repetition-period=0.0}, unused-bit-pattern=0  # SOMEIPTestabilityClient_Methods_echoComplexDynamicArray_Request_XIX_SomeIP_ServiceProvider_Testability_TestSysIP_Info_El_XIX_VLAN_Cockpit
    signal SOMEIPTestabilityClient_Methods_echoComplexDynamicArray_Request_XIX_SomeIP_ServiceProvider_Test_5975F69CF86108D92A7FF5DE502EED3C: start 0, 408 bit, opaque, data-transformations=SOMEIPOnlyTransformerChain, data-type-policy=TRANSFORMING-I-SIGNAL, i-signal-type=ARRAY, someip-transformation-i-signal-props{cs-error-reaction=AUTONOMOUS, transformer=TransformationTechnologySOMEIP, interface-version=1, message-type=REQUEST, size-of-array-length-fields=1, size-of-struct-length-fields=1, size-of-union-length-fields=1}, dynamic-length=true, transfer-property=TRIGGERED  # SOMEIPTestabilityClient_Methods_echoComplexDynamicArray_Request_XIX_SomeIP_ServiceProvider_Testability_TestSysIP_Info_El_XIX_VLAN_Cockpit  # SOMEIPTestabilityClient Implementierung Dieser Service muss an allen uC ECUs die einen SOMEIP Client implementiert haben (Service Empfänger).
  pdu SOMEIPTestabilityClient_Methods_echoComplexDynamicArray_Response_XIX_SomeIP_ServiceProvider_Tes_A3E901FC688CD8C3B0D5838E355C4D78: length=51, transmission-mode-true-timing=event-controlled-timing={number-of-repetitions=0, repetition-period=0.0}, unused-bit-pattern=0  # SOMEIPTestabilityClient_Methods_echoComplexDynamicArray_Response_XIX_SomeIP_ServiceProvider_Testability_TestSysIP_Info_El_XIX_VLAN_Cockpit
    signal SOMEIPTestabilityClient_Methods_echoComplexDynamicArray_Response_XIX_SomeIP_ServiceProvider_Tes_A3E901FC688CD8C3B0D5838E355C4D78: start 0, 408 bit, opaque, data-transformations=SOMEIPOnlyTransformerChain, data-type-policy=TRANSFORMING-I-SIGNAL, i-signal-type=ARRAY, someip-transformation-i-signal-props{cs-error-reaction=AUTONOMOUS, transformer=TransformationTechnologySOMEIP, interface-version=1, message-type=RESPONSE, size-of-array-length-fields=1, size-of-struct-length-fields=1, size-of-union-length-fields=1}, dynamic-length=true, transfer-property=TRIGGERED, to HCP3_IONode  # SOMEIPTestabilityClient_Methods_echoComplexDynamicArray_Response_XIX_SomeIP_ServiceProvider_Testability_TestSysIP_Info_El_XIX_VLAN_Cockpit  # SOMEIPTestabilityClient Implementierung Dieser Service muss an allen uC ECUs die einen SOMEIP Client implementiert haben (Service Empfänger).
  pdu SOMEIPTestabilityClient_Methods_echoComplexStruct_Request_XIX_SomeIP_ServiceProvider_Testabilit_3C83CBA50BCB4C48B5D9E17802CF63AB: length=89, transmission-mode-true-timing=event-controlled-timing={number-of-repetitions=0, repetition-period=0.0}, unused-bit-pattern=0  # SOMEIPTestabilityClient_Methods_echoComplexStruct_Request_XIX_SomeIP_ServiceProvider_Testability_TestSysIP_Info_El_XIX_VLAN_Cockpit
    signal SOMEIPTestabilityClient_Methods_echoComplexStruct_Request_XIX_SomeIP_ServiceProvider_Testabilit_3C83CBA50BCB4C48B5D9E17802CF63AB: start 0, 712 bit, opaque, data-transformations=SOMEIPOnlyTransformerChain, data-type-policy=TRANSFORMING-I-SIGNAL, i-signal-type=ARRAY, someip-transformation-i-signal-props{cs-error-reaction=AUTONOMOUS, transformer=TransformationTechnologySOMEIP, interface-version=1, message-type=REQUEST, size-of-array-length-fields=1, size-of-struct-length-fields=1, size-of-union-length-fields=1}, dynamic-length=true, transfer-property=TRIGGERED  # SOMEIPTestabilityClient_Methods_echoComplexStruct_Request_XIX_SomeIP_ServiceProvider_Testability_TestSysIP_Info_El_XIX_VLAN_Cockpit  # SOMEIPTestabilityClient Implementierung Dieser Service muss an allen uC ECUs die einen SOMEIP Client implementiert haben (Service Empfänger).
  pdu SOMEIPTestabilityClient_Methods_echoComplexStruct_Response_XIX_SomeIP_ServiceProvider_Testabili_FF4764BE3783B4EC0607B4ECD4F98E29: length=89, transmission-mode-true-timing=event-controlled-timing={number-of-repetitions=0, repetition-period=0.0}, unused-bit-pattern=0  # SOMEIPTestabilityClient_Methods_echoComplexStruct_Response_XIX_SomeIP_ServiceProvider_Testability_TestSysIP_Info_El_XIX_VLAN_Cockpit
    signal SOMEIPTestabilityClient_Methods_echoComplexStruct_Response_XIX_SomeIP_ServiceProvider_Testabili_FF4764BE3783B4EC0607B4ECD4F98E29: start 0, 712 bit, opaque, data-transformations=SOMEIPOnlyTransformerChain, data-type-policy=TRANSFORMING-I-SIGNAL, i-signal-type=ARRAY, someip-transformation-i-signal-props{cs-error-reaction=AUTONOMOUS, transformer=TransformationTechnologySOMEIP, interface-version=1, message-type=RESPONSE, size-of-array-length-fields=1, size-of-struct-length-fields=1, size-of-union-length-fields=1}, dynamic-length=true, transfer-property=TRIGGERED, to HCP3_IONode  # SOMEIPTestabilityClient_Methods_echoComplexStruct_Response_XIX_SomeIP_ServiceProvider_Testability_TestSysIP_Info_El_XIX_VLAN_Cockpit  # SOMEIPTestabilityClient Implementierung Dieser Service muss an allen uC ECUs die einen SOMEIP Client implementiert haben (Service Empfänger).
  pdu SOMEIPTestabilityClient_Methods_echoFloat32_Request_XIX_SomeIP_ServiceProvider_Testability_TestSysIP_Info_El_XIX_VLAN_Cockpit: length=14, transmission-mode-true-timing=event-controlled-timing={number-of-repetitions=0, repetition-period=0.0}, unused-bit-pattern=0
    signal SOMEIPTestabilityClient_Methods_echoFloat32_Request_XIX_SomeIP_ServiceProvider_Testability_TestSysIP_Info_El_XIX_VLAN_Cockpit: start 0, 112 bit, opaque, data-transformations=SOMEIPOnlyTransformerChain, data-type-policy=TRANSFORMING-I-SIGNAL, i-signal-type=ARRAY, someip-transformation-i-signal-props{cs-error-reaction=AUTONOMOUS, transformer=TransformationTechnologySOMEIP, interface-version=1, message-type=REQUEST, size-of-array-length-fields=1, size-of-struct-length-fields=1, size-of-union-length-fields=1}, dynamic-length=true, transfer-property=TRIGGERED  # SOMEIPTestabilityClient Implementierung Dieser Service muss an allen uC ECUs die einen SOMEIP Client implementiert haben (Service Empfänger).
  pdu SOMEIPTestabilityClient_Methods_echoFloat32_Response_XIX_SomeIP_ServiceProvider_Testability_TestSysIP_Info_El_XIX_VLAN_Cockpit: length=14, transmission-mode-true-timing=event-controlled-timing={number-of-repetitions=0, repetition-period=0.0}, unused-bit-pattern=0
    signal SOMEIPTestabilityClient_Methods_echoFloat32_Response_XIX_SomeIP_ServiceProvider_Testability_TestSysIP_Info_El_XIX_VLAN_Cockpit: start 0, 112 bit, opaque, data-transformations=SOMEIPOnlyTransformerChain, data-type-policy=TRANSFORMING-I-SIGNAL, i-signal-type=ARRAY, someip-transformation-i-signal-props{cs-error-reaction=AUTONOMOUS, transformer=TransformationTechnologySOMEIP, interface-version=1, message-type=RESPONSE, size-of-array-length-fields=1, size-of-struct-length-fields=1, size-of-union-length-fields=1}, dynamic-length=true, transfer-property=TRIGGERED, to HCP3_IONode  # SOMEIPTestabilityClient Implementierung Dieser Service muss an allen uC ECUs die einen SOMEIP Client implementiert haben (Service Empfänger).
